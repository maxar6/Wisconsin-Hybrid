ASAP2_VERSION 1 51
/begin PROJECT Project ""
/begin MODULE Mooventur_214 ""
/begin MOD_COMMON /* MOD_COMMON Comment */ "" BYTE_ORDER MSB_FIRST ALIGNMENT_BYTE 1 ALIGNMENT_FLOAT32_IEEE 1 ALIGNMENT_FLOAT64_IEEE 1 ALIGNMENT_LONG 1 ALIGNMENT_WORD 1 /end MOD_COMMON
/begin MEASUREMENT DATA_MODE_1_Prb "" FLOAT32_IEEE CompuMethod_2 1 0 -1E+17 1E+17 ECU_ADDRESS 0x4000029B /end MEASUREMENT
/begin MEASUREMENT DATA_MODE_2_Prb "" FLOAT32_IEEE CompuMethod_2 1 0 -1E+17 1E+17 ECU_ADDRESS 0x4000029F /end MEASUREMENT
/begin MEASUREMENT DATA_MODE_3_Prb "" FLOAT32_IEEE CompuMethod_2 1 0 -1E+17 1E+17 ECU_ADDRESS 0x400002A3 /end MEASUREMENT
/begin MEASUREMENT DATA_MODE_4_Ovr "" FLOAT32_IEEE CompuMethod_2 1 0 -1E+17 1E+17 ECU_ADDRESS 0x400002A7 /end MEASUREMENT
/begin MEASUREMENT DCDC_Status_Prb "" UWORD CompuMethod_5 1 0 0 65535 ECU_ADDRESS 0x400002AF /end MEASUREMENT
/begin MEASUREMENT Engine_Crank_Prb "" FLOAT32_IEEE CompuMethod_2 1 0 -1E+17 1E+17 ECU_ADDRESS 0x40000301 /end MEASUREMENT
/begin MEASUREMENT Engine_On_Prb "" FLOAT32_IEEE CompuMethod_2 1 0 -1E+17 1E+17 ECU_ADDRESS 0x40000309 /end MEASUREMENT
/begin MEASUREMENT Fault_Prb "" FLOAT32_IEEE CompuMethod_2 1 0 -1E+17 1E+17 ECU_ADDRESS 0x40000335 /end MEASUREMENT
/begin MEASUREMENT FaultActionReason._.Batt_Light "Displays a rolling marquee of the reasons for fault action: FaultActionReason." UBYTE CompuMethod_479 1 0 0 255 ECU_ADDRESS 0x4000033A /end MEASUREMENT
/begin MEASUREMENT FaultActionReason._.Batt_Shutdown "Displays a rolling marquee of the reasons for fault action: FaultActionReason." UBYTE CompuMethod_479 1 0 0 255 ECU_ADDRESS 0x4000033B /end MEASUREMENT
/begin MEASUREMENT FaultActionReason._.Cell_Voltage_Max "Displays a rolling marquee of the reasons for fault action: FaultActionReason." UBYTE CompuMethod_479 1 0 0 255 ECU_ADDRESS 0x4000033C /end MEASUREMENT
/begin MEASUREMENT FaultActionReason._.Check_Engine_Light "Displays a rolling marquee of the reasons for fault action: FaultActionReason." UBYTE CompuMethod_479 1 0 0 255 ECU_ADDRESS 0x4000033D /end MEASUREMENT
/begin MEASUREMENT FaultActionReason._.Check_Engine_Light_Flashing "Displays a rolling marquee of the reasons for fault action: FaultActionReason." UBYTE CompuMethod_479 1 0 0 255 ECU_ADDRESS 0x4000033E /end MEASUREMENT
/begin MEASUREMENT FaultActionReason._.Cooling_Max "Displays a rolling marquee of the reasons for fault action: FaultActionReason." UBYTE CompuMethod_479 1 0 0 255 ECU_ADDRESS 0x4000033F /end MEASUREMENT
/begin MEASUREMENT FaultActionReason._.Cruise "Displays a rolling marquee of the reasons for fault action: FaultActionReason." UBYTE CompuMethod_479 1 0 0 255 ECU_ADDRESS 0x40000340 /end MEASUREMENT
/begin MEASUREMENT FaultActionReason._.Dyno_Shutdown "Displays a rolling marquee of the reasons for fault action: FaultActionReason." UBYTE CompuMethod_479 1 0 0 255 ECU_ADDRESS 0x40000341 /end MEASUREMENT
/begin MEASUREMENT FaultActionReason._.EatonChargerFault "Displays a rolling marquee of the reasons for fault action: FaultActionReason." UBYTE CompuMethod_479 1 0 0 255 ECU_ADDRESS 0x40000342 /end MEASUREMENT
/begin MEASUREMENT FaultActionReason._.HV_Light "Displays a rolling marquee of the reasons for fault action: FaultActionReason." UBYTE CompuMethod_479 1 0 0 255 ECU_ADDRESS 0x40000343 /end MEASUREMENT
/begin MEASUREMENT FaultActionReason._.Pump_On "Displays a rolling marquee of the reasons for fault action: FaultActionReason." UBYTE CompuMethod_479 1 0 0 255 ECU_ADDRESS 0x40000344 /end MEASUREMENT
/begin MEASUREMENT FaultActionReason._.Regen_Brakes_Disabled "Displays a rolling marquee of the reasons for fault action: FaultActionReason." UBYTE CompuMethod_479 1 0 0 255 ECU_ADDRESS 0x40000345 /end MEASUREMENT
/begin MEASUREMENT FaultActionReason._.Set_Crawl_Home "Displays a rolling marquee of the reasons for fault action: FaultActionReason." UBYTE CompuMethod_479 1 0 0 255 ECU_ADDRESS 0x40000346 /end MEASUREMENT
/begin MEASUREMENT FaultActionReason._.Temperature_Flash "Displays a rolling marquee of the reasons for fault action: FaultActionReason." UBYTE CompuMethod_479 1 0 0 255 ECU_ADDRESS 0x40000347 /end MEASUREMENT
/begin MEASUREMENT FaultActionReason._.Temperature_Solid "Displays a rolling marquee of the reasons for fault action: FaultActionReason." UBYTE CompuMethod_479 1 0 0 255 ECU_ADDRESS 0x40000348 /end MEASUREMENT
/begin MEASUREMENT FaultActionReason._.Wrench_Light "Displays a rolling marquee of the reasons for fault action: FaultActionReason." UBYTE CompuMethod_479 1 0 0 255 ECU_ADDRESS 0x40000349 /end MEASUREMENT
/begin MEASUREMENT FaultMarquees.FaultMarquees.Current_Suspected "Displays a rolling marquee for suspected, active and occurred faults." UBYTE CompuMethod_479 1 0 0 255 ECU_ADDRESS 0x4000034A /end MEASUREMENT
/begin MEASUREMENT FaultMarquees.FaultMarquees.Current_Active "Displays a rolling marquee for suspected, active and occurred faults." UBYTE CompuMethod_479 1 0 0 255 ECU_ADDRESS 0x4000034B /end MEASUREMENT
/begin MEASUREMENT FaultMarquees.FaultMarquees.Current_Occurred "Displays a rolling marquee for suspected, active and occurred faults." UBYTE CompuMethod_479 1 0 0 255 ECU_ADDRESS 0x4000034C /end MEASUREMENT
/begin MEASUREMENT Inv_Temp_Prb "" FLOAT32_IEEE CompuMethod_2 1 0 -1E+17 1E+17 ECU_ADDRESS 0x400003C9 /end MEASUREMENT
/begin MEASUREMENT IPT_Direction_Prb "" FLOAT32_IEEE CompuMethod_2 1 0 -1E+17 1E+17 ECU_ADDRESS 0x400003F9 /end MEASUREMENT
/begin MEASUREMENT Load_On_Prb "" FLOAT32_IEEE CompuMethod_2 1 0 -1E+17 1E+17 ECU_ADDRESS 0x40000457 /end MEASUREMENT
/begin MEASUREMENT Mode_1_Prb "" FLOAT32_IEEE CompuMethod_2 1 0 -1E+17 1E+17 ECU_ADDRESS 0x400004DF /end MEASUREMENT
/begin MEASUREMENT Mode_2_Prb "" FLOAT32_IEEE CompuMethod_2 1 0 -1E+17 1E+17 ECU_ADDRESS 0x400004E3 /end MEASUREMENT
/begin MEASUREMENT Mode_3_Prb "" FLOAT32_IEEE CompuMethod_2 1 0 -1E+17 1E+17 ECU_ADDRESS 0x400004E7 /end MEASUREMENT
/begin MEASUREMENT Mode_4_Prb "" FLOAT32_IEEE CompuMethod_2 1 0 -1E+17 1E+17 ECU_ADDRESS 0x400004EB /end MEASUREMENT
/begin MEASUREMENT MPRD "Indicates whether the main power relay is active" UBYTE CompuMethod_491 1 0 0 1 ECU_ADDRESS 0x40000672 /end MEASUREMENT
/begin MEASUREMENT Oil_Pressure_Prb "" FLOAT32_IEEE CompuMethod_2 1 0 -1E+17 1E+17 ECU_ADDRESS 0x40000680 /end MEASUREMENT
/begin MEASUREMENT pre_Filter_Torque_Request "" FLOAT32_IEEE CompuMethod_2 1 0 -1E+17 1E+17 ECU_ADDRESS 0x400006E1 /end MEASUREMENT
/begin MEASUREMENT RPM_Prb "" FLOAT32_IEEE CompuMethod_2 1 0 -1E+17 1E+17 ECU_ADDRESS 0x40000729 /end MEASUREMENT
/begin MEASUREMENT Temp_Guage_Ovr "" FLOAT32_IEEE CompuMethod_2 1 0 -1E+17 1E+17 ECU_ADDRESS 0x40000789 /end MEASUREMENT
/begin MEASUREMENT Torque_Request_Probe "" FLOAT32_IEEE CompuMethod_2 1 0 -1E+17 1E+17 ECU_ADDRESS 0x40000791 /end MEASUREMENT
/begin MEASUREMENT VEH_ID_Prb "" FLOAT32_IEEE CompuMethod_2 1 0 -1E+17 1E+17 ECU_ADDRESS 0x400007A9 /end MEASUREMENT
/begin MEASUREMENT VIN_DATA_BYTE_1_Prb "" FLOAT32_IEEE CompuMethod_2 1 0 -1E+17 1E+17 ECU_ADDRESS 0x400007B5 /end MEASUREMENT
/begin MEASUREMENT VIN_DATA_BYTE_10_Prb "" FLOAT32_IEEE CompuMethod_2 1 0 -1E+17 1E+17 ECU_ADDRESS 0x400007B9 /end MEASUREMENT
/begin MEASUREMENT VIN_DATA_BYTE_11_Prb "" FLOAT32_IEEE CompuMethod_2 1 0 -1E+17 1E+17 ECU_ADDRESS 0x400007BD /end MEASUREMENT
/begin MEASUREMENT VIN_DATA_BYTE_12_Prb "" FLOAT32_IEEE CompuMethod_2 1 0 -1E+17 1E+17 ECU_ADDRESS 0x400007C1 /end MEASUREMENT
/begin MEASUREMENT VIN_DATA_BYTE_13_Prb "" FLOAT32_IEEE CompuMethod_2 1 0 -1E+17 1E+17 ECU_ADDRESS 0x400007C5 /end MEASUREMENT
/begin MEASUREMENT VIN_DATA_BYTE_14_Prb "" FLOAT32_IEEE CompuMethod_2 1 0 -1E+17 1E+17 ECU_ADDRESS 0x400007C9 /end MEASUREMENT
/begin MEASUREMENT VIN_DATA_BYTE_15_Prb "" FLOAT32_IEEE CompuMethod_2 1 0 -1E+17 1E+17 ECU_ADDRESS 0x400007CD /end MEASUREMENT
/begin MEASUREMENT VIN_DATA_BYte_16_Prb "" FLOAT32_IEEE CompuMethod_2 1 0 -1E+17 1E+17 ECU_ADDRESS 0x400007D1 /end MEASUREMENT
/begin MEASUREMENT VIN_DATA_BYTE_17_Prb "" FLOAT32_IEEE CompuMethod_2 1 0 -1E+17 1E+17 ECU_ADDRESS 0x400007D5 /end MEASUREMENT
/begin MEASUREMENT VIN_DATA_BYTE_2_Prb "" FLOAT32_IEEE CompuMethod_2 1 0 -1E+17 1E+17 ECU_ADDRESS 0x400007D9 /end MEASUREMENT
/begin MEASUREMENT VIN_DATA_BYTE_3_Prb "" FLOAT32_IEEE CompuMethod_2 1 0 -1E+17 1E+17 ECU_ADDRESS 0x400007DD /end MEASUREMENT
/begin MEASUREMENT VIN_DATA_BYTE_4_Prb "" FLOAT32_IEEE CompuMethod_2 1 0 -1E+17 1E+17 ECU_ADDRESS 0x400007E1 /end MEASUREMENT
/begin MEASUREMENT VIN_DATA_BYTE_5_Prb "" FLOAT32_IEEE CompuMethod_2 1 0 -1E+17 1E+17 ECU_ADDRESS 0x400007E5 /end MEASUREMENT
/begin MEASUREMENT VIN_DATA_BYTE_6_Prb "" FLOAT32_IEEE CompuMethod_2 1 0 -1E+17 1E+17 ECU_ADDRESS 0x400007E9 /end MEASUREMENT
/begin MEASUREMENT VIN_DATA_BYTE_7_Prb "" FLOAT32_IEEE CompuMethod_2 1 0 -1E+17 1E+17 ECU_ADDRESS 0x400007ED /end MEASUREMENT
/begin MEASUREMENT VIN_DATA_BYTE_8_Prb "" FLOAT32_IEEE CompuMethod_2 1 0 -1E+17 1E+17 ECU_ADDRESS 0x400007F1 /end MEASUREMENT
/begin MEASUREMENT VIN_DATA_BYTE_9_Prb "" FLOAT32_IEEE CompuMethod_2 1 0 -1E+17 1E+17 ECU_ADDRESS 0x400007F5 /end MEASUREMENT
/begin CHARACTERISTIC Cruise_Control_SetP_Ovr_new "" VALUE 0x80000589 RecordLayout_3 0 CompuMethod_11 0 1 /end CHARACTERISTIC
/begin CHARACTERISTIC Cruise_Control_SetP_Ovr_ovr "" VALUE 0x8000058A RecordLayout_3 0 CompuMethod_7 0 1 /end CHARACTERISTIC
/begin CHARACTERISTIC Cruise_Ctrl_Light_Ovr_new "" VALUE 0x8000058B RecordLayout_3 0 CompuMethod_11 0 1 /end CHARACTERISTIC
/begin CHARACTERISTIC Cruise_Ctrl_Light_Ovr_ovr "" VALUE 0x8000058C RecordLayout_3 0 CompuMethod_7 0 1 /end CHARACTERISTIC
/begin CHARACTERISTIC Cruise_Disable_Brake_Fault1 "" VALUE 0x80000591 RecordLayout_4 0 CompuMethod_2 -1E+17 1E+17 /end CHARACTERISTIC
/begin CHARACTERISTIC Cruise_Disable_Brake_Fault2 "" VALUE 0x80000595 RecordLayout_4 0 CompuMethod_2 -1E+17 1E+17 /end CHARACTERISTIC
/begin CHARACTERISTIC Current_Limit_Override_new "" VALUE 0x8000059D RecordLayout_4 0 CompuMethod_2 -1E+17 1E+17 /end CHARACTERISTIC
/begin CHARACTERISTIC Current_Limit_Override_ovr "" VALUE 0x800005A1 RecordLayout_3 0 CompuMethod_7 0 1 /end CHARACTERISTIC
/begin CHARACTERISTIC Current_Ovr_new "" VALUE 0x800005A2 RecordLayout_4 0 CompuMethod_2 -1E+17 1E+17 /end CHARACTERISTIC
/begin CHARACTERISTIC Current_Ovr_ovr "" VALUE 0x800005A6 RecordLayout_3 0 CompuMethod_7 0 1 /end CHARACTERISTIC
/begin CHARACTERISTIC CurrentLimitingEnabled "" VALUE 0x800005A7 RecordLayout_4 0 CompuMethod_2 -1E+17 1E+17 /end CHARACTERISTIC
/begin CHARACTERISTIC Data_Mode_1 "" VALUE 0x800005AB RecordLayout_4 0 CompuMethod_2 -1E+17 1E+17 /end CHARACTERISTIC
/begin CHARACTERISTIC DATA_MODE_1_Ovr_new "" VALUE 0x800005AF RecordLayout_4 0 CompuMethod_2 -1E+17 1E+17 /end CHARACTERISTIC
/begin CHARACTERISTIC DATA_MODE_1_Ovr_ovr "" VALUE 0x800005B3 RecordLayout_3 0 CompuMethod_7 0 1 /end CHARACTERISTIC
/begin CHARACTERISTIC DATA_MODE_2 "" VALUE 0x800005B4 RecordLayout_4 0 CompuMethod_2 -1E+17 1E+17 /end CHARACTERISTIC
/begin CHARACTERISTIC DATA_MODE_2_Ovr_new "" VALUE 0x800005B8 RecordLayout_4 0 CompuMethod_2 -1E+17 1E+17 /end CHARACTERISTIC
/begin CHARACTERISTIC DATA_MODE_2_Ovr_ovr "" VALUE 0x800005BC RecordLayout_3 0 CompuMethod_7 0 1 /end CHARACTERISTIC
/begin CHARACTERISTIC DATA_MODE_3 "" VALUE 0x800005BD RecordLayout_4 0 CompuMethod_2 -1E+17 1E+17 /end CHARACTERISTIC
/begin CHARACTERISTIC DATA_MODE_3_Ovr_new "" VALUE 0x800005C1 RecordLayout_4 0 CompuMethod_2 -1E+17 1E+17 /end CHARACTERISTIC
/begin CHARACTERISTIC DATA_MODE_3_Ovr_ovr "" VALUE 0x800005C5 RecordLayout_3 0 CompuMethod_7 0 1 /end CHARACTERISTIC
/begin CHARACTERISTIC DATA_MODE_4 "" VALUE 0x800005C6 RecordLayout_4 0 CompuMethod_2 -1E+17 1E+17 /end CHARACTERISTIC
/begin CHARACTERISTIC DATA_MODE_4_Ovr_new "" VALUE 0x800005CA RecordLayout_4 0 CompuMethod_2 -1E+17 1E+17 /end CHARACTERISTIC
/begin CHARACTERISTIC DATA_MODE_4_Ovr_ovr "" VALUE 0x800005CE RecordLayout_3 0 CompuMethod_7 0 1 /end CHARACTERISTIC
/begin CHARACTERISTIC DateTime_Ovr_new "" VALUE 0x800005CF RecordLayout_4 0 CompuMethod_2 -1E+17 1E+17 /end CHARACTERISTIC
/begin CHARACTERISTIC DateTime_Ovr_ovr "" VALUE 0x800005D3 RecordLayout_3 0 CompuMethod_7 0 1 /end CHARACTERISTIC
/begin CHARACTERISTIC DCDC_Converter_Not_Running_Fault "" VALUE 0x800005D4 RecordLayout_4 0 CompuMethod_2 -1E+17 1E+17 /end CHARACTERISTIC
/begin CHARACTERISTIC DCDC_Status_Ovr_new "" VALUE 0x800005D8 RecordLayout_6 0 CompuMethod_5 0 65535 /end CHARACTERISTIC
/begin CHARACTERISTIC DCDC_Status_Ovr_ovr "" VALUE 0x800005DA RecordLayout_3 0 CompuMethod_7 0 1 /end CHARACTERISTIC
/begin CHARACTERISTIC Defrost_Mode_Ovr_new "" VALUE 0x800005DF RecordLayout_4 0 CompuMethod_2 -1E+17 1E+17 /end CHARACTERISTIC
/begin CHARACTERISTIC Defrost_Mode_Ovr_ovr "" VALUE 0x800005E3 RecordLayout_3 0 CompuMethod_7 0 1 /end CHARACTERISTIC
/begin CHARACTERISTIC Defrost_Ovr_new "" VALUE 0x800005E4 RecordLayout_4 0 CompuMethod_2 -1E+17 1E+17 /end CHARACTERISTIC
/begin CHARACTERISTIC Defrost_Ovr_ovr "" VALUE 0x800005E8 RecordLayout_3 0 CompuMethod_7 0 1 /end CHARACTERISTIC
/begin CHARACTERISTIC Drive_Switch_Input_High_Fault "" VALUE 0x800005FD RecordLayout_4 0 CompuMethod_2 -1E+17 1E+17 /end CHARACTERISTIC
/begin CHARACTERISTIC Drive_Switch_Input_Low_Fault "" VALUE 0x80000601 RecordLayout_4 0 CompuMethod_2 -1E+17 1E+17 /end CHARACTERISTIC
/begin CHARACTERISTIC Driver_1_Ovr_new "" VALUE 0x80000611 RecordLayout_4 0 CompuMethod_2 -1E+17 1E+17 /end CHARACTERISTIC
/begin CHARACTERISTIC Driver_1_Ovr_ovr "" VALUE 0x80000615 RecordLayout_3 0 CompuMethod_7 0 1 /end CHARACTERISTIC
/begin CHARACTERISTIC Driver_10_Ovr_new "" VALUE 0x80000616 RecordLayout_4 0 CompuMethod_2 -1E+17 1E+17 /end CHARACTERISTIC
/begin CHARACTERISTIC Driver_10_Ovr_ovr "" VALUE 0x8000061A RecordLayout_3 0 CompuMethod_7 0 1 /end CHARACTERISTIC
/begin CHARACTERISTIC Driver_Temp_Ovr_new "" VALUE 0x8000061B RecordLayout_4 0 CompuMethod_2 -1E+17 1E+17 /end CHARACTERISTIC
/begin CHARACTERISTIC Driver_Temp_Ovr_ovr "" VALUE 0x8000061F RecordLayout_3 0 CompuMethod_7 0 1 /end CHARACTERISTIC
/begin CHARACTERISTIC Eaton_Charger_AgeCount_Ovr_new "" VALUE 0x80000624 RecordLayout_2 0 CompuMethod_6 0 4294970000 /end CHARACTERISTIC
/begin CHARACTERISTIC Eaton_Charger_AgeCount_Ovr_ovr "" VALUE 0x80000628 RecordLayout_3 0 CompuMethod_7 0 1 /end CHARACTERISTIC
/begin CHARACTERISTIC Eaton_Charger_Message_Checksum_Ovr_new "" VALUE 0x80000629 RecordLayout_4 0 CompuMethod_2 -1E+17 1E+17 /end CHARACTERISTIC
/begin CHARACTERISTIC Eaton_Charger_Message_Checksum_Ovr_ovr "" VALUE 0x8000062D RecordLayout_3 0 CompuMethod_7 0 1 /end CHARACTERISTIC
/begin CHARACTERISTIC Eaton_Charger_Message_Counter_Ovr_new "" VALUE 0x8000062E RecordLayout_4 0 CompuMethod_2 -1E+17 1E+17 /end CHARACTERISTIC
/begin CHARACTERISTIC Eaton_Charger_Message_Counter_Ovr_ovr "" VALUE 0x80000632 RecordLayout_3 0 CompuMethod_7 0 1 /end CHARACTERISTIC
/begin CHARACTERISTIC Eaton_HV_Charger_Temperature_Ovr_new "" VALUE 0x80000634 RecordLayout_4 0 CompuMethod_2 -1E+17 1E+17 /end CHARACTERISTIC
/begin CHARACTERISTIC Eaton_HV_Charger_Temperature_Ovr_ovr "" VALUE 0x80000638 RecordLayout_3 0 CompuMethod_7 0 1 /end CHARACTERISTIC
/begin CHARACTERISTIC ecoMode_Ovr_new "" VALUE 0x8000078A RecordLayout_4 0 CompuMethod_2 -1E+17 1E+17 /end CHARACTERISTIC
/begin CHARACTERISTIC ecoMode_Ovr_ovr "" VALUE 0x8000078E RecordLayout_3 0 CompuMethod_7 0 1 /end CHARACTERISTIC
/begin CHARACTERISTIC ECUP_Threshold "ADC voltage threshold above which ECU is considered powered" VALUE 0x8000078F RecordLayout_6 0 CompuMethod_477 0 1023 /end CHARACTERISTIC
/begin CHARACTERISTIC Electric_Motor_Derated_Approaching_Over_Temperature_Fault_Over "" VALUE 0x80000791 RecordLayout_4 0 CompuMethod_2 -1E+17 1E+17 /end CHARACTERISTIC
/begin CHARACTERISTIC Electric_Motor_Derated_Approaching_Over_Temperature_Fault_Under "" VALUE 0x80000795 RecordLayout_4 0 CompuMethod_2 -1E+17 1E+17 /end CHARACTERISTIC
/begin CHARACTERISTIC Electric_Motor_Derated_Over_Temperature_Fault "" VALUE 0x80000799 RecordLayout_4 0 CompuMethod_2 -1E+17 1E+17 /end CHARACTERISTIC
/begin CHARACTERISTIC Electric_Motor_Derated_Over_Voltage_Fault "" VALUE 0x8000079D RecordLayout_4 0 CompuMethod_2 -1E+17 1E+17 /end CHARACTERISTIC
/begin CHARACTERISTIC Electric_Motor_Derated_Under_Temperature_Fault "" VALUE 0x800007A1 RecordLayout_4 0 CompuMethod_2 -1E+17 1E+17 /end CHARACTERISTIC
/begin CHARACTERISTIC Electric_Motor_Derated_Under_Voltage_Fault "" VALUE 0x800007A5 RecordLayout_4 0 CompuMethod_2 -1E+17 1E+17 /end CHARACTERISTIC
/begin CHARACTERISTIC Electric_Motor_General_Error_Fault_Over "" VALUE 0x800007A9 RecordLayout_4 0 CompuMethod_2 -1E+17 1E+17 /end CHARACTERISTIC
/begin CHARACTERISTIC Electric_Motor_General_Error_Fault_Under "" VALUE 0x800007AD RecordLayout_4 0 CompuMethod_2 -1E+17 1E+17 /end CHARACTERISTIC
/begin CHARACTERISTIC Electric_Motor_Over_Speed_Forward_Fault "" VALUE 0x800007B1 RecordLayout_4 0 CompuMethod_2 -1E+17 1E+17 /end CHARACTERISTIC
/begin CHARACTERISTIC Electric_Motor_Over_Speed_Reverse_Fault "" VALUE 0x800007B5 RecordLayout_4 0 CompuMethod_2 -1E+17 1E+17 /end CHARACTERISTIC
/begin CHARACTERISTIC Electric_Motor_Shutdown_Error_Fault "" VALUE 0x800007B9 RecordLayout_4 0 CompuMethod_2 -1E+17 1E+17 /end CHARACTERISTIC
/begin CHARACTERISTIC Electric_Motor_Torque_Output_Fault "" VALUE 0x800007BD RecordLayout_4 0 CompuMethod_2 -1E+17 1E+17 /end CHARACTERISTIC
/begin CHARACTERISTIC Eng_Cool_Temp_Ovr_new "" VALUE 0x800007C1 RecordLayout_4 0 CompuMethod_2 -1E+17 1E+17 /end CHARACTERISTIC
/begin CHARACTERISTIC Eng_Cool_Temp_Ovr_ovr "" VALUE 0x800007C5 RecordLayout_3 0 CompuMethod_7 0 1 /end CHARACTERISTIC
/begin CHARACTERISTIC Engine_Crank_Ovr_new "" VALUE 0x800007C6 RecordLayout_4 0 CompuMethod_2 -1E+17 1E+17 /end CHARACTERISTIC
/begin CHARACTERISTIC Engine_Crank_Ovr_ovr "" VALUE 0x800007CA RecordLayout_3 0 CompuMethod_7 0 1 /end CHARACTERISTIC
/begin CHARACTERISTIC Engine_On_ABS_Ovr_new "" VALUE 0x800007D3 RecordLayout_4 0 CompuMethod_2 0 4 /end CHARACTERISTIC
/begin CHARACTERISTIC Engine_On_ABS_Ovr_ovr "" VALUE 0x800007D7 RecordLayout_3 0 CompuMethod_7 0 1 /end CHARACTERISTIC
/begin CHARACTERISTIC Engine_On_Ovr_new "" VALUE 0x800007D8 RecordLayout_4 0 CompuMethod_2 -1E+17 1E+17 /end CHARACTERISTIC
/begin CHARACTERISTIC Engine_On_Ovr_ovr "" VALUE 0x800007DC RecordLayout_3 0 CompuMethod_7 0 1 /end CHARACTERISTIC
/begin CHARACTERISTIC Engine_On_Time_Threshold "" VALUE 0x800007DD RecordLayout_4 0 CompuMethod_2 -1E+17 1E+17 /end CHARACTERISTIC
/begin CHARACTERISTIC Engine_Speed_Ovr_new "" VALUE 0x800007E1 RecordLayout_4 0 CompuMethod_2 -1E+17 1E+17 /end CHARACTERISTIC
/begin CHARACTERISTIC Engine_Speed_Ovr_ovr "" VALUE 0x800007E5 RecordLayout_3 0 CompuMethod_7 0 1 /end CHARACTERISTIC
/begin CHARACTERISTIC Fan1_Ovr_new "" VALUE 0x80000812 RecordLayout_4 0 CompuMethod_2 -1E+17 1E+17 /end CHARACTERISTIC
/begin CHARACTERISTIC Fan1_Ovr_ovr "" VALUE 0x80000816 RecordLayout_3 0 CompuMethod_7 0 1 /end CHARACTERISTIC
/begin CHARACTERISTIC Fan2_Ovr_new "" VALUE 0x80000817 RecordLayout_4 0 CompuMethod_2 -1E+17 1E+17 /end CHARACTERISTIC
/begin CHARACTERISTIC Fan2_Ovr_ovr "" VALUE 0x8000081B RecordLayout_3 0 CompuMethod_7 0 1 /end CHARACTERISTIC
/begin CHARACTERISTIC Fan3_Ovr_new "" VALUE 0x8000081C RecordLayout_4 0 CompuMethod_2 -1E+17 1E+17 /end CHARACTERISTIC
/begin CHARACTERISTIC Fan3_Ovr_ovr "" VALUE 0x80000820 RecordLayout_3 0 CompuMethod_7 0 1 /end CHARACTERISTIC
/begin CHARACTERISTIC Fault_Ovr_new "" VALUE 0x80000821 RecordLayout_4 0 CompuMethod_2 -1E+17 1E+17 /end CHARACTERISTIC
/begin CHARACTERISTIC Fault_Ovr_ovr "" VALUE 0x80000825 RecordLayout_3 0 CompuMethod_7 0 1 /end CHARACTERISTIC
/begin CHARACTERISTIC Fault_Severity_Indicator_Ovr_new "" VALUE 0x80000826 RecordLayout_3 0 CompuMethod_11 0 1 /end CHARACTERISTIC
/begin CHARACTERISTIC Fault_Severity_Indicator_Ovr_ovr "" VALUE 0x80000827 RecordLayout_3 0 CompuMethod_7 0 1 /end CHARACTERISTIC
/begin CHARACTERISTIC FaultCommand "Select a command to control the fault manager." VALUE 0x80000828 RecordLayout_3 0 CompuMethod_480 0 255 /end CHARACTERISTIC
/begin CHARACTERISTIC FaultManager.ABS_ToneRing_AgeCount.Mode "Fault manager configuration.  Select up to 4 actions for each fault." VALUE 0x80000829 RecordLayout_6 0 CompuMethod_481 0 65535 /end CHARACTERISTIC
/begin CHARACTERISTIC FaultManager.ABS_ToneRing_AgeCount.ID "Fault manager configuration.  Select up to 4 actions for each fault." VALUE 0x8000082B RecordLayout_6 0 CompuMethod_1 0 65535 /end CHARACTERISTIC
/begin CHARACTERISTIC FaultManager.ABS_ToneRing_AgeCount.Test "Fault manager configuration.  Select up to 4 actions for each fault." VALUE 0x8000082D RecordLayout_6 0 CompuMethod_482 0 65535 /end CHARACTERISTIC
/begin CHARACTERISTIC FaultManager.ABS_ToneRing_AgeCount.Faulty_Samples__X_ "Fault manager configuration.  Select up to 4 actions for each fault." VALUE 0x8000082F RecordLayout_6 0 CompuMethod_1 0 65535 /end CHARACTERISTIC
/begin CHARACTERISTIC FaultManager.ABS_ToneRing_AgeCount.Total_Samples__Y_ "Fault manager configuration.  Select up to 4 actions for each fault." VALUE 0x80000831 RecordLayout_6 0 CompuMethod_1 0 65535 /end CHARACTERISTIC
/begin CHARACTERISTIC FaultManager.ABS_ToneRing_AgeCount.Action_1 "Fault manager configuration.  Select up to 4 actions for each fault." VALUE 0x80000833 RecordLayout_6 0 CompuMethod_483 0 65535 /end CHARACTERISTIC
/begin CHARACTERISTIC FaultManager.ABS_ToneRing_AgeCount.Action_1_Condition "Fault manager configuration.  Select up to 4 actions for each fault." VALUE 0x80000835 RecordLayout_6 0 CompuMethod_484 0 65535 /end CHARACTERISTIC
/begin CHARACTERISTIC FaultManager.ABS_ToneRing_AgeCount.Action_2 "Fault manager configuration.  Select up to 4 actions for each fault." VALUE 0x80000837 RecordLayout_6 0 CompuMethod_483 0 65535 /end CHARACTERISTIC
/begin CHARACTERISTIC FaultManager.ABS_ToneRing_AgeCount.Action_2_Condition "Fault manager configuration.  Select up to 4 actions for each fault." VALUE 0x80000839 RecordLayout_6 0 CompuMethod_484 0 65535 /end CHARACTERISTIC
/begin CHARACTERISTIC FaultManager.ABS_ToneRing_AgeCount.Action_3 "Fault manager configuration.  Select up to 4 actions for each fault." VALUE 0x8000083B RecordLayout_6 0 CompuMethod_483 0 65535 /end CHARACTERISTIC
/begin CHARACTERISTIC FaultManager.ABS_ToneRing_AgeCount.Action_3_Condition "Fault manager configuration.  Select up to 4 actions for each fault." VALUE 0x8000083D RecordLayout_6 0 CompuMethod_484 0 65535 /end CHARACTERISTIC
/begin CHARACTERISTIC FaultManager.ABS_ToneRing_AgeCount.Action_4 "Fault manager configuration.  Select up to 4 actions for each fault." VALUE 0x8000083F RecordLayout_6 0 CompuMethod_483 0 65535 /end CHARACTERISTIC
/begin CHARACTERISTIC FaultManager.ABS_ToneRing_AgeCount.Action_4_Condition "Fault manager configuration.  Select up to 4 actions for each fault." VALUE 0x80000841 RecordLayout_6 0 CompuMethod_484 0 65535 /end CHARACTERISTIC
/begin CHARACTERISTIC FaultManager.ABS_Traction_Control_AgeCount.Mode "Fault manager configuration.  Select up to 4 actions for each fault." VALUE 0x80000843 RecordLayout_6 0 CompuMethod_481 0 65535 /end CHARACTERISTIC
/begin CHARACTERISTIC FaultManager.ABS_Traction_Control_AgeCount.ID "Fault manager configuration.  Select up to 4 actions for each fault." VALUE 0x80000845 RecordLayout_6 0 CompuMethod_1 0 65535 /end CHARACTERISTIC
/begin CHARACTERISTIC FaultManager.ABS_Traction_Control_AgeCount.Test "Fault manager configuration.  Select up to 4 actions for each fault." VALUE 0x80000847 RecordLayout_6 0 CompuMethod_482 0 65535 /end CHARACTERISTIC
/begin CHARACTERISTIC FaultManager.ABS_Traction_Control_AgeCount.Faulty_Samples__X_ "Fault manager configuration.  Select up to 4 actions for each fault." VALUE 0x80000849 RecordLayout_6 0 CompuMethod_1 0 65535 /end CHARACTERISTIC
/begin CHARACTERISTIC FaultManager.ABS_Traction_Control_AgeCount.Total_Samples__Y_ "Fault manager configuration.  Select up to 4 actions for each fault." VALUE 0x8000084B RecordLayout_6 0 CompuMethod_1 0 65535 /end CHARACTERISTIC
/begin CHARACTERISTIC FaultManager.ABS_Traction_Control_AgeCount.Action_1 "Fault manager configuration.  Select up to 4 actions for each fault." VALUE 0x8000084D RecordLayout_6 0 CompuMethod_483 0 65535 /end CHARACTERISTIC
/begin CHARACTERISTIC FaultManager.ABS_Traction_Control_AgeCount.Action_1_Condition "Fault manager configuration.  Select up to 4 actions for each fault." VALUE 0x8000084F RecordLayout_6 0 CompuMethod_484 0 65535 /end CHARACTERISTIC
/begin CHARACTERISTIC FaultManager.ABS_Traction_Control_AgeCount.Action_2 "Fault manager configuration.  Select up to 4 actions for each fault." VALUE 0x80000851 RecordLayout_6 0 CompuMethod_483 0 65535 /end CHARACTERISTIC
/begin CHARACTERISTIC FaultManager.ABS_Traction_Control_AgeCount.Action_2_Condition "Fault manager configuration.  Select up to 4 actions for each fault." VALUE 0x80000853 RecordLayout_6 0 CompuMethod_484 0 65535 /end CHARACTERISTIC
/begin CHARACTERISTIC FaultManager.ABS_Traction_Control_AgeCount.Action_3 "Fault manager configuration.  Select up to 4 actions for each fault." VALUE 0x80000855 RecordLayout_6 0 CompuMethod_483 0 65535 /end CHARACTERISTIC
/begin CHARACTERISTIC FaultManager.ABS_Traction_Control_AgeCount.Action_3_Condition "Fault manager configuration.  Select up to 4 actions for each fault." VALUE 0x80000857 RecordLayout_6 0 CompuMethod_484 0 65535 /end CHARACTERISTIC
/begin CHARACTERISTIC FaultManager.ABS_Traction_Control_AgeCount.Action_4 "Fault manager configuration.  Select up to 4 actions for each fault." VALUE 0x80000859 RecordLayout_6 0 CompuMethod_483 0 65535 /end CHARACTERISTIC
/begin CHARACTERISTIC FaultManager.ABS_Traction_Control_AgeCount.Action_4_Condition "Fault manager configuration.  Select up to 4 actions for each fault." VALUE 0x8000085B RecordLayout_6 0 CompuMethod_484 0 65535 /end CHARACTERISTIC
/begin CHARACTERISTIC FaultManager.ABS_WheelSpeed_AgeCount.Mode "Fault manager configuration.  Select up to 4 actions for each fault." VALUE 0x8000085D RecordLayout_6 0 CompuMethod_481 0 65535 /end CHARACTERISTIC
/begin CHARACTERISTIC FaultManager.ABS_WheelSpeed_AgeCount.ID "Fault manager configuration.  Select up to 4 actions for each fault." VALUE 0x8000085F RecordLayout_6 0 CompuMethod_1 0 65535 /end CHARACTERISTIC
/begin CHARACTERISTIC FaultManager.ABS_WheelSpeed_AgeCount.Test "Fault manager configuration.  Select up to 4 actions for each fault." VALUE 0x80000861 RecordLayout_6 0 CompuMethod_482 0 65535 /end CHARACTERISTIC
/begin CHARACTERISTIC FaultManager.ABS_WheelSpeed_AgeCount.Faulty_Samples__X_ "Fault manager configuration.  Select up to 4 actions for each fault." VALUE 0x80000863 RecordLayout_6 0 CompuMethod_1 0 65535 /end CHARACTERISTIC
/begin CHARACTERISTIC FaultManager.ABS_WheelSpeed_AgeCount.Total_Samples__Y_ "Fault manager configuration.  Select up to 4 actions for each fault." VALUE 0x80000865 RecordLayout_6 0 CompuMethod_1 0 65535 /end CHARACTERISTIC
/begin CHARACTERISTIC FaultManager.ABS_WheelSpeed_AgeCount.Action_1 "Fault manager configuration.  Select up to 4 actions for each fault." VALUE 0x80000867 RecordLayout_6 0 CompuMethod_483 0 65535 /end CHARACTERISTIC
/begin CHARACTERISTIC FaultManager.ABS_WheelSpeed_AgeCount.Action_1_Condition "Fault manager configuration.  Select up to 4 actions for each fault." VALUE 0x80000869 RecordLayout_6 0 CompuMethod_484 0 65535 /end CHARACTERISTIC
/begin CHARACTERISTIC FaultManager.ABS_WheelSpeed_AgeCount.Action_2 "Fault manager configuration.  Select up to 4 actions for each fault." VALUE 0x8000086B RecordLayout_6 0 CompuMethod_483 0 65535 /end CHARACTERISTIC
/begin CHARACTERISTIC FaultManager.ABS_WheelSpeed_AgeCount.Action_2_Condition "Fault manager configuration.  Select up to 4 actions for each fault." VALUE 0x8000086D RecordLayout_6 0 CompuMethod_484 0 65535 /end CHARACTERISTIC
/begin CHARACTERISTIC FaultManager.ABS_WheelSpeed_AgeCount.Action_3 "Fault manager configuration.  Select up to 4 actions for each fault." VALUE 0x8000086F RecordLayout_6 0 CompuMethod_483 0 65535 /end CHARACTERISTIC
/begin CHARACTERISTIC FaultManager.ABS_WheelSpeed_AgeCount.Action_3_Condition "Fault manager configuration.  Select up to 4 actions for each fault." VALUE 0x80000871 RecordLayout_6 0 CompuMethod_484 0 65535 /end CHARACTERISTIC
/begin CHARACTERISTIC FaultManager.ABS_WheelSpeed_AgeCount.Action_4 "Fault manager configuration.  Select up to 4 actions for each fault." VALUE 0x80000873 RecordLayout_6 0 CompuMethod_483 0 65535 /end CHARACTERISTIC
/begin CHARACTERISTIC FaultManager.ABS_WheelSpeed_AgeCount.Action_4_Condition "Fault manager configuration.  Select up to 4 actions for each fault." VALUE 0x80000875 RecordLayout_6 0 CompuMethod_484 0 65535 /end CHARACTERISTIC
/begin CHARACTERISTIC FaultManager.Battery_AgeCount.Mode "Fault manager configuration.  Select up to 4 actions for each fault." VALUE 0x80000877 RecordLayout_6 0 CompuMethod_481 0 65535 /end CHARACTERISTIC
/begin CHARACTERISTIC FaultManager.Battery_AgeCount.ID "Fault manager configuration.  Select up to 4 actions for each fault." VALUE 0x80000879 RecordLayout_6 0 CompuMethod_1 0 65535 /end CHARACTERISTIC
/begin CHARACTERISTIC FaultManager.Battery_AgeCount.Test "Fault manager configuration.  Select up to 4 actions for each fault." VALUE 0x8000087B RecordLayout_6 0 CompuMethod_482 0 65535 /end CHARACTERISTIC
/begin CHARACTERISTIC FaultManager.Battery_AgeCount.Faulty_Samples__X_ "Fault manager configuration.  Select up to 4 actions for each fault." VALUE 0x8000087D RecordLayout_6 0 CompuMethod_1 0 65535 /end CHARACTERISTIC
/begin CHARACTERISTIC FaultManager.Battery_AgeCount.Total_Samples__Y_ "Fault manager configuration.  Select up to 4 actions for each fault." VALUE 0x8000087F RecordLayout_6 0 CompuMethod_1 0 65535 /end CHARACTERISTIC
/begin CHARACTERISTIC FaultManager.Battery_AgeCount.Action_1 "Fault manager configuration.  Select up to 4 actions for each fault." VALUE 0x80000881 RecordLayout_6 0 CompuMethod_483 0 65535 /end CHARACTERISTIC
/begin CHARACTERISTIC FaultManager.Battery_AgeCount.Action_1_Condition "Fault manager configuration.  Select up to 4 actions for each fault." VALUE 0x80000883 RecordLayout_6 0 CompuMethod_484 0 65535 /end CHARACTERISTIC
/begin CHARACTERISTIC FaultManager.Battery_AgeCount.Action_2 "Fault manager configuration.  Select up to 4 actions for each fault." VALUE 0x80000885 RecordLayout_6 0 CompuMethod_483 0 65535 /end CHARACTERISTIC
/begin CHARACTERISTIC FaultManager.Battery_AgeCount.Action_2_Condition "Fault manager configuration.  Select up to 4 actions for each fault." VALUE 0x80000887 RecordLayout_6 0 CompuMethod_484 0 65535 /end CHARACTERISTIC
/begin CHARACTERISTIC FaultManager.Battery_AgeCount.Action_3 "Fault manager configuration.  Select up to 4 actions for each fault." VALUE 0x80000889 RecordLayout_6 0 CompuMethod_483 0 65535 /end CHARACTERISTIC
/begin CHARACTERISTIC FaultManager.Battery_AgeCount.Action_3_Condition "Fault manager configuration.  Select up to 4 actions for each fault." VALUE 0x8000088B RecordLayout_6 0 CompuMethod_484 0 65535 /end CHARACTERISTIC
/begin CHARACTERISTIC FaultManager.Battery_AgeCount.Action_4 "Fault manager configuration.  Select up to 4 actions for each fault." VALUE 0x8000088D RecordLayout_6 0 CompuMethod_483 0 65535 /end CHARACTERISTIC
/begin CHARACTERISTIC FaultManager.Battery_AgeCount.Action_4_Condition "Fault manager configuration.  Select up to 4 actions for each fault." VALUE 0x8000088F RecordLayout_6 0 CompuMethod_484 0 65535 /end CHARACTERISTIC
/begin CHARACTERISTIC FaultManager.Battery_Voltage_Too_High.Mode "Fault manager configuration.  Select up to 4 actions for each fault." VALUE 0x80000891 RecordLayout_6 0 CompuMethod_481 0 65535 /end CHARACTERISTIC
/begin CHARACTERISTIC FaultManager.Battery_Voltage_Too_High.ID "Fault manager configuration.  Select up to 4 actions for each fault." VALUE 0x80000893 RecordLayout_6 0 CompuMethod_1 0 65535 /end CHARACTERISTIC
/begin CHARACTERISTIC FaultManager.Battery_Voltage_Too_High.Test "Fault manager configuration.  Select up to 4 actions for each fault." VALUE 0x80000895 RecordLayout_6 0 CompuMethod_482 0 65535 /end CHARACTERISTIC
/begin CHARACTERISTIC FaultManager.Battery_Voltage_Too_High.Faulty_Samples__X_ "Fault manager configuration.  Select up to 4 actions for each fault." VALUE 0x80000897 RecordLayout_6 0 CompuMethod_1 0 65535 /end CHARACTERISTIC
/begin CHARACTERISTIC FaultManager.Battery_Voltage_Too_High.Total_Samples__Y_ "Fault manager configuration.  Select up to 4 actions for each fault." VALUE 0x80000899 RecordLayout_6 0 CompuMethod_1 0 65535 /end CHARACTERISTIC
/begin CHARACTERISTIC FaultManager.Battery_Voltage_Too_High.Action_1 "Fault manager configuration.  Select up to 4 actions for each fault." VALUE 0x8000089B RecordLayout_6 0 CompuMethod_483 0 65535 /end CHARACTERISTIC
/begin CHARACTERISTIC FaultManager.Battery_Voltage_Too_High.Action_1_Condition "Fault manager configuration.  Select up to 4 actions for each fault." VALUE 0x8000089D RecordLayout_6 0 CompuMethod_484 0 65535 /end CHARACTERISTIC
/begin CHARACTERISTIC FaultManager.Battery_Voltage_Too_High.Action_2 "Fault manager configuration.  Select up to 4 actions for each fault." VALUE 0x8000089F RecordLayout_6 0 CompuMethod_483 0 65535 /end CHARACTERISTIC
/begin CHARACTERISTIC FaultManager.Battery_Voltage_Too_High.Action_2_Condition "Fault manager configuration.  Select up to 4 actions for each fault." VALUE 0x800008A1 RecordLayout_6 0 CompuMethod_484 0 65535 /end CHARACTERISTIC
/begin CHARACTERISTIC FaultManager.Battery_Voltage_Too_High.Action_3 "Fault manager configuration.  Select up to 4 actions for each fault." VALUE 0x800008A3 RecordLayout_6 0 CompuMethod_483 0 65535 /end CHARACTERISTIC
/begin CHARACTERISTIC FaultManager.Battery_Voltage_Too_High.Action_3_Condition "Fault manager configuration.  Select up to 4 actions for each fault." VALUE 0x800008A5 RecordLayout_6 0 CompuMethod_484 0 65535 /end CHARACTERISTIC
/begin CHARACTERISTIC FaultManager.Battery_Voltage_Too_High.Action_4 "Fault manager configuration.  Select up to 4 actions for each fault." VALUE 0x800008A7 RecordLayout_6 0 CompuMethod_483 0 65535 /end CHARACTERISTIC
/begin CHARACTERISTIC FaultManager.Battery_Voltage_Too_High.Action_4_Condition "Fault manager configuration.  Select up to 4 actions for each fault." VALUE 0x800008A9 RecordLayout_6 0 CompuMethod_484 0 65535 /end CHARACTERISTIC
/begin CHARACTERISTIC FaultManager.Battery_Voltage_Too_Low.Mode "Fault manager configuration.  Select up to 4 actions for each fault." VALUE 0x800008AB RecordLayout_6 0 CompuMethod_481 0 65535 /end CHARACTERISTIC
/begin CHARACTERISTIC FaultManager.Battery_Voltage_Too_Low.ID "Fault manager configuration.  Select up to 4 actions for each fault." VALUE 0x800008AD RecordLayout_6 0 CompuMethod_1 0 65535 /end CHARACTERISTIC
/begin CHARACTERISTIC FaultManager.Battery_Voltage_Too_Low.Test "Fault manager configuration.  Select up to 4 actions for each fault." VALUE 0x800008AF RecordLayout_6 0 CompuMethod_482 0 65535 /end CHARACTERISTIC
/begin CHARACTERISTIC FaultManager.Battery_Voltage_Too_Low.Faulty_Samples__X_ "Fault manager configuration.  Select up to 4 actions for each fault." VALUE 0x800008B1 RecordLayout_6 0 CompuMethod_1 0 65535 /end CHARACTERISTIC
/begin CHARACTERISTIC FaultManager.Battery_Voltage_Too_Low.Total_Samples__Y_ "Fault manager configuration.  Select up to 4 actions for each fault." VALUE 0x800008B3 RecordLayout_6 0 CompuMethod_1 0 65535 /end CHARACTERISTIC
/begin CHARACTERISTIC FaultManager.Battery_Voltage_Too_Low.Action_1 "Fault manager configuration.  Select up to 4 actions for each fault." VALUE 0x800008B5 RecordLayout_6 0 CompuMethod_483 0 65535 /end CHARACTERISTIC
/begin CHARACTERISTIC FaultManager.Battery_Voltage_Too_Low.Action_1_Condition "Fault manager configuration.  Select up to 4 actions for each fault." VALUE 0x800008B7 RecordLayout_6 0 CompuMethod_484 0 65535 /end CHARACTERISTIC
/begin CHARACTERISTIC FaultManager.Battery_Voltage_Too_Low.Action_2 "Fault manager configuration.  Select up to 4 actions for each fault." VALUE 0x800008B9 RecordLayout_6 0 CompuMethod_483 0 65535 /end CHARACTERISTIC
/begin CHARACTERISTIC FaultManager.Battery_Voltage_Too_Low.Action_2_Condition "Fault manager configuration.  Select up to 4 actions for each fault." VALUE 0x800008BB RecordLayout_6 0 CompuMethod_484 0 65535 /end CHARACTERISTIC
/begin CHARACTERISTIC FaultManager.Battery_Voltage_Too_Low.Action_3 "Fault manager configuration.  Select up to 4 actions for each fault." VALUE 0x800008BD RecordLayout_6 0 CompuMethod_483 0 65535 /end CHARACTERISTIC
/begin CHARACTERISTIC FaultManager.Battery_Voltage_Too_Low.Action_3_Condition "Fault manager configuration.  Select up to 4 actions for each fault." VALUE 0x800008BF RecordLayout_6 0 CompuMethod_484 0 65535 /end CHARACTERISTIC
/begin CHARACTERISTIC FaultManager.Battery_Voltage_Too_Low.Action_4 "Fault manager configuration.  Select up to 4 actions for each fault." VALUE 0x800008C1 RecordLayout_6 0 CompuMethod_483 0 65535 /end CHARACTERISTIC
/begin CHARACTERISTIC FaultManager.Battery_Voltage_Too_Low.Action_4_Condition "Fault manager configuration.  Select up to 4 actions for each fault." VALUE 0x800008C3 RecordLayout_6 0 CompuMethod_484 0 65535 /end CHARACTERISTIC
/begin CHARACTERISTIC FaultManager.Blend_Valve_A_No_Response.Mode "Fault manager configuration.  Select up to 4 actions for each fault." VALUE 0x800008C5 RecordLayout_6 0 CompuMethod_481 0 65535 /end CHARACTERISTIC
/begin CHARACTERISTIC FaultManager.Blend_Valve_A_No_Response.ID "Fault manager configuration.  Select up to 4 actions for each fault." VALUE 0x800008C7 RecordLayout_6 0 CompuMethod_1 0 65535 /end CHARACTERISTIC
/begin CHARACTERISTIC FaultManager.Blend_Valve_A_No_Response.Test "Fault manager configuration.  Select up to 4 actions for each fault." VALUE 0x800008C9 RecordLayout_6 0 CompuMethod_482 0 65535 /end CHARACTERISTIC
/begin CHARACTERISTIC FaultManager.Blend_Valve_A_No_Response.Faulty_Samples__X_ "Fault manager configuration.  Select up to 4 actions for each fault." VALUE 0x800008CB RecordLayout_6 0 CompuMethod_1 0 65535 /end CHARACTERISTIC
/begin CHARACTERISTIC FaultManager.Blend_Valve_A_No_Response.Total_Samples__Y_ "Fault manager configuration.  Select up to 4 actions for each fault." VALUE 0x800008CD RecordLayout_6 0 CompuMethod_1 0 65535 /end CHARACTERISTIC
/begin CHARACTERISTIC FaultManager.Blend_Valve_A_No_Response.Action_1 "Fault manager configuration.  Select up to 4 actions for each fault." VALUE 0x800008CF RecordLayout_6 0 CompuMethod_483 0 65535 /end CHARACTERISTIC
/begin CHARACTERISTIC FaultManager.Blend_Valve_A_No_Response.Action_1_Condition "Fault manager configuration.  Select up to 4 actions for each fault." VALUE 0x800008D1 RecordLayout_6 0 CompuMethod_484 0 65535 /end CHARACTERISTIC
/begin CHARACTERISTIC FaultManager.Blend_Valve_A_No_Response.Action_2 "Fault manager configuration.  Select up to 4 actions for each fault." VALUE 0x800008D3 RecordLayout_6 0 CompuMethod_483 0 65535 /end CHARACTERISTIC
/begin CHARACTERISTIC FaultManager.Blend_Valve_A_No_Response.Action_2_Condition "Fault manager configuration.  Select up to 4 actions for each fault." VALUE 0x800008D5 RecordLayout_6 0 CompuMethod_484 0 65535 /end CHARACTERISTIC
/begin CHARACTERISTIC FaultManager.Blend_Valve_A_No_Response.Action_3 "Fault manager configuration.  Select up to 4 actions for each fault." VALUE 0x800008D7 RecordLayout_6 0 CompuMethod_483 0 65535 /end CHARACTERISTIC
/begin CHARACTERISTIC FaultManager.Blend_Valve_A_No_Response.Action_3_Condition "Fault manager configuration.  Select up to 4 actions for each fault." VALUE 0x800008D9 RecordLayout_6 0 CompuMethod_484 0 65535 /end CHARACTERISTIC
/begin CHARACTERISTIC FaultManager.Blend_Valve_A_No_Response.Action_4 "Fault manager configuration.  Select up to 4 actions for each fault." VALUE 0x800008DB RecordLayout_6 0 CompuMethod_483 0 65535 /end CHARACTERISTIC
/begin CHARACTERISTIC FaultManager.Blend_Valve_A_No_Response.Action_4_Condition "Fault manager configuration.  Select up to 4 actions for each fault." VALUE 0x800008DD RecordLayout_6 0 CompuMethod_484 0 65535 /end CHARACTERISTIC
/begin CHARACTERISTIC FaultManager.Blend_Valve_B_No_Response.Mode "Fault manager configuration.  Select up to 4 actions for each fault." VALUE 0x800008DF RecordLayout_6 0 CompuMethod_481 0 65535 /end CHARACTERISTIC
/begin CHARACTERISTIC FaultManager.Blend_Valve_B_No_Response.ID "Fault manager configuration.  Select up to 4 actions for each fault." VALUE 0x800008E1 RecordLayout_6 0 CompuMethod_1 0 65535 /end CHARACTERISTIC
/begin CHARACTERISTIC FaultManager.Blend_Valve_B_No_Response.Test "Fault manager configuration.  Select up to 4 actions for each fault." VALUE 0x800008E3 RecordLayout_6 0 CompuMethod_482 0 65535 /end CHARACTERISTIC
/begin CHARACTERISTIC FaultManager.Blend_Valve_B_No_Response.Faulty_Samples__X_ "Fault manager configuration.  Select up to 4 actions for each fault." VALUE 0x800008E5 RecordLayout_6 0 CompuMethod_1 0 65535 /end CHARACTERISTIC
/begin CHARACTERISTIC FaultManager.Blend_Valve_B_No_Response.Total_Samples__Y_ "Fault manager configuration.  Select up to 4 actions for each fault." VALUE 0x800008E7 RecordLayout_6 0 CompuMethod_1 0 65535 /end CHARACTERISTIC
/begin CHARACTERISTIC FaultManager.Blend_Valve_B_No_Response.Action_1 "Fault manager configuration.  Select up to 4 actions for each fault." VALUE 0x800008E9 RecordLayout_6 0 CompuMethod_483 0 65535 /end CHARACTERISTIC
/begin CHARACTERISTIC FaultManager.Blend_Valve_B_No_Response.Action_1_Condition "Fault manager configuration.  Select up to 4 actions for each fault." VALUE 0x800008EB RecordLayout_6 0 CompuMethod_484 0 65535 /end CHARACTERISTIC
/begin CHARACTERISTIC FaultManager.Blend_Valve_B_No_Response.Action_2 "Fault manager configuration.  Select up to 4 actions for each fault." VALUE 0x800008ED RecordLayout_6 0 CompuMethod_483 0 65535 /end CHARACTERISTIC
/begin CHARACTERISTIC FaultManager.Blend_Valve_B_No_Response.Action_2_Condition "Fault manager configuration.  Select up to 4 actions for each fault." VALUE 0x800008EF RecordLayout_6 0 CompuMethod_484 0 65535 /end CHARACTERISTIC
/begin CHARACTERISTIC FaultManager.Blend_Valve_B_No_Response.Action_3 "Fault manager configuration.  Select up to 4 actions for each fault." VALUE 0x800008F1 RecordLayout_6 0 CompuMethod_483 0 65535 /end CHARACTERISTIC
/begin CHARACTERISTIC FaultManager.Blend_Valve_B_No_Response.Action_3_Condition "Fault manager configuration.  Select up to 4 actions for each fault." VALUE 0x800008F3 RecordLayout_6 0 CompuMethod_484 0 65535 /end CHARACTERISTIC
/begin CHARACTERISTIC FaultManager.Blend_Valve_B_No_Response.Action_4 "Fault manager configuration.  Select up to 4 actions for each fault." VALUE 0x800008F5 RecordLayout_6 0 CompuMethod_483 0 65535 /end CHARACTERISTIC
/begin CHARACTERISTIC FaultManager.Blend_Valve_B_No_Response.Action_4_Condition "Fault manager configuration.  Select up to 4 actions for each fault." VALUE 0x800008F7 RecordLayout_6 0 CompuMethod_484 0 65535 /end CHARACTERISTIC
/begin CHARACTERISTIC FaultManager.Blend_Valve_Sensor_A_High_Voltage.Mode "Fault manager configuration.  Select up to 4 actions for each fault." VALUE 0x800008F9 RecordLayout_6 0 CompuMethod_481 0 65535 /end CHARACTERISTIC
/begin CHARACTERISTIC FaultManager.Blend_Valve_Sensor_A_High_Voltage.ID "Fault manager configuration.  Select up to 4 actions for each fault." VALUE 0x800008FB RecordLayout_6 0 CompuMethod_1 0 65535 /end CHARACTERISTIC
/begin CHARACTERISTIC FaultManager.Blend_Valve_Sensor_A_High_Voltage.Test "Fault manager configuration.  Select up to 4 actions for each fault." VALUE 0x800008FD RecordLayout_6 0 CompuMethod_482 0 65535 /end CHARACTERISTIC
/begin CHARACTERISTIC FaultManager.Blend_Valve_Sensor_A_High_Voltage.Faulty_Samples__X_ "Fault manager configuration.  Select up to 4 actions for each fault." VALUE 0x800008FF RecordLayout_6 0 CompuMethod_1 0 65535 /end CHARACTERISTIC
/begin CHARACTERISTIC FaultManager.Blend_Valve_Sensor_A_High_Voltage.Total_Samples__Y_ "Fault manager configuration.  Select up to 4 actions for each fault." VALUE 0x80000901 RecordLayout_6 0 CompuMethod_1 0 65535 /end CHARACTERISTIC
/begin CHARACTERISTIC FaultManager.Blend_Valve_Sensor_A_High_Voltage.Action_1 "Fault manager configuration.  Select up to 4 actions for each fault." VALUE 0x80000903 RecordLayout_6 0 CompuMethod_483 0 65535 /end CHARACTERISTIC
/begin CHARACTERISTIC FaultManager.Blend_Valve_Sensor_A_High_Voltage.Action_1_Condition "Fault manager configuration.  Select up to 4 actions for each fault." VALUE 0x80000905 RecordLayout_6 0 CompuMethod_484 0 65535 /end CHARACTERISTIC
/begin CHARACTERISTIC FaultManager.Blend_Valve_Sensor_A_High_Voltage.Action_2 "Fault manager configuration.  Select up to 4 actions for each fault." VALUE 0x80000907 RecordLayout_6 0 CompuMethod_483 0 65535 /end CHARACTERISTIC
/begin CHARACTERISTIC FaultManager.Blend_Valve_Sensor_A_High_Voltage.Action_2_Condition "Fault manager configuration.  Select up to 4 actions for each fault." VALUE 0x80000909 RecordLayout_6 0 CompuMethod_484 0 65535 /end CHARACTERISTIC
/begin CHARACTERISTIC FaultManager.Blend_Valve_Sensor_A_High_Voltage.Action_3 "Fault manager configuration.  Select up to 4 actions for each fault." VALUE 0x8000090B RecordLayout_6 0 CompuMethod_483 0 65535 /end CHARACTERISTIC
/begin CHARACTERISTIC FaultManager.Blend_Valve_Sensor_A_High_Voltage.Action_3_Condition "Fault manager configuration.  Select up to 4 actions for each fault." VALUE 0x8000090D RecordLayout_6 0 CompuMethod_484 0 65535 /end CHARACTERISTIC
/begin CHARACTERISTIC FaultManager.Blend_Valve_Sensor_A_High_Voltage.Action_4 "Fault manager configuration.  Select up to 4 actions for each fault." VALUE 0x8000090F RecordLayout_6 0 CompuMethod_483 0 65535 /end CHARACTERISTIC
/begin CHARACTERISTIC FaultManager.Blend_Valve_Sensor_A_High_Voltage.Action_4_Condition "Fault manager configuration.  Select up to 4 actions for each fault." VALUE 0x80000911 RecordLayout_6 0 CompuMethod_484 0 65535 /end CHARACTERISTIC
/begin CHARACTERISTIC FaultManager.Blend_Valve_Sensor_A_Intermittent.Mode "Fault manager configuration.  Select up to 4 actions for each fault." VALUE 0x80000913 RecordLayout_6 0 CompuMethod_481 0 65535 /end CHARACTERISTIC
/begin CHARACTERISTIC FaultManager.Blend_Valve_Sensor_A_Intermittent.ID "Fault manager configuration.  Select up to 4 actions for each fault." VALUE 0x80000915 RecordLayout_6 0 CompuMethod_1 0 65535 /end CHARACTERISTIC
/begin CHARACTERISTIC FaultManager.Blend_Valve_Sensor_A_Intermittent.Test "Fault manager configuration.  Select up to 4 actions for each fault." VALUE 0x80000917 RecordLayout_6 0 CompuMethod_482 0 65535 /end CHARACTERISTIC
/begin CHARACTERISTIC FaultManager.Blend_Valve_Sensor_A_Intermittent.Faulty_Samples__X_ "Fault manager configuration.  Select up to 4 actions for each fault." VALUE 0x80000919 RecordLayout_6 0 CompuMethod_1 0 65535 /end CHARACTERISTIC
/begin CHARACTERISTIC FaultManager.Blend_Valve_Sensor_A_Intermittent.Total_Samples__Y_ "Fault manager configuration.  Select up to 4 actions for each fault." VALUE 0x8000091B RecordLayout_6 0 CompuMethod_1 0 65535 /end CHARACTERISTIC
/begin CHARACTERISTIC FaultManager.Blend_Valve_Sensor_A_Intermittent.Action_1 "Fault manager configuration.  Select up to 4 actions for each fault." VALUE 0x8000091D RecordLayout_6 0 CompuMethod_483 0 65535 /end CHARACTERISTIC
/begin CHARACTERISTIC FaultManager.Blend_Valve_Sensor_A_Intermittent.Action_1_Condition "Fault manager configuration.  Select up to 4 actions for each fault." VALUE 0x8000091F RecordLayout_6 0 CompuMethod_484 0 65535 /end CHARACTERISTIC
/begin CHARACTERISTIC FaultManager.Blend_Valve_Sensor_A_Intermittent.Action_2 "Fault manager configuration.  Select up to 4 actions for each fault." VALUE 0x80000921 RecordLayout_6 0 CompuMethod_483 0 65535 /end CHARACTERISTIC
/begin CHARACTERISTIC FaultManager.Blend_Valve_Sensor_A_Intermittent.Action_2_Condition "Fault manager configuration.  Select up to 4 actions for each fault." VALUE 0x80000923 RecordLayout_6 0 CompuMethod_484 0 65535 /end CHARACTERISTIC
/begin CHARACTERISTIC FaultManager.Blend_Valve_Sensor_A_Intermittent.Action_3 "Fault manager configuration.  Select up to 4 actions for each fault." VALUE 0x80000925 RecordLayout_6 0 CompuMethod_483 0 65535 /end CHARACTERISTIC
/begin CHARACTERISTIC FaultManager.Blend_Valve_Sensor_A_Intermittent.Action_3_Condition "Fault manager configuration.  Select up to 4 actions for each fault." VALUE 0x80000927 RecordLayout_6 0 CompuMethod_484 0 65535 /end CHARACTERISTIC
/begin CHARACTERISTIC FaultManager.Blend_Valve_Sensor_A_Intermittent.Action_4 "Fault manager configuration.  Select up to 4 actions for each fault." VALUE 0x80000929 RecordLayout_6 0 CompuMethod_483 0 65535 /end CHARACTERISTIC
/begin CHARACTERISTIC FaultManager.Blend_Valve_Sensor_A_Intermittent.Action_4_Condition "Fault manager configuration.  Select up to 4 actions for each fault." VALUE 0x8000092B RecordLayout_6 0 CompuMethod_484 0 65535 /end CHARACTERISTIC
/begin CHARACTERISTIC FaultManager.Blend_Valve_Sensor_A_Low_Voltage.Mode "Fault manager configuration.  Select up to 4 actions for each fault." VALUE 0x8000092D RecordLayout_6 0 CompuMethod_481 0 65535 /end CHARACTERISTIC
/begin CHARACTERISTIC FaultManager.Blend_Valve_Sensor_A_Low_Voltage.ID "Fault manager configuration.  Select up to 4 actions for each fault." VALUE 0x8000092F RecordLayout_6 0 CompuMethod_1 0 65535 /end CHARACTERISTIC
/begin CHARACTERISTIC FaultManager.Blend_Valve_Sensor_A_Low_Voltage.Test "Fault manager configuration.  Select up to 4 actions for each fault." VALUE 0x80000931 RecordLayout_6 0 CompuMethod_482 0 65535 /end CHARACTERISTIC
/begin CHARACTERISTIC FaultManager.Blend_Valve_Sensor_A_Low_Voltage.Faulty_Samples__X_ "Fault manager configuration.  Select up to 4 actions for each fault." VALUE 0x80000933 RecordLayout_6 0 CompuMethod_1 0 65535 /end CHARACTERISTIC
/begin CHARACTERISTIC FaultManager.Blend_Valve_Sensor_A_Low_Voltage.Total_Samples__Y_ "Fault manager configuration.  Select up to 4 actions for each fault." VALUE 0x80000935 RecordLayout_6 0 CompuMethod_1 0 65535 /end CHARACTERISTIC
/begin CHARACTERISTIC FaultManager.Blend_Valve_Sensor_A_Low_Voltage.Action_1 "Fault manager configuration.  Select up to 4 actions for each fault." VALUE 0x80000937 RecordLayout_6 0 CompuMethod_483 0 65535 /end CHARACTERISTIC
/begin CHARACTERISTIC FaultManager.Blend_Valve_Sensor_A_Low_Voltage.Action_1_Condition "Fault manager configuration.  Select up to 4 actions for each fault." VALUE 0x80000939 RecordLayout_6 0 CompuMethod_484 0 65535 /end CHARACTERISTIC
/begin CHARACTERISTIC FaultManager.Blend_Valve_Sensor_A_Low_Voltage.Action_2 "Fault manager configuration.  Select up to 4 actions for each fault." VALUE 0x8000093B RecordLayout_6 0 CompuMethod_483 0 65535 /end CHARACTERISTIC
/begin CHARACTERISTIC FaultManager.Blend_Valve_Sensor_A_Low_Voltage.Action_2_Condition "Fault manager configuration.  Select up to 4 actions for each fault." VALUE 0x8000093D RecordLayout_6 0 CompuMethod_484 0 65535 /end CHARACTERISTIC
/begin CHARACTERISTIC FaultManager.Blend_Valve_Sensor_A_Low_Voltage.Action_3 "Fault manager configuration.  Select up to 4 actions for each fault." VALUE 0x8000093F RecordLayout_6 0 CompuMethod_483 0 65535 /end CHARACTERISTIC
/begin CHARACTERISTIC FaultManager.Blend_Valve_Sensor_A_Low_Voltage.Action_3_Condition "Fault manager configuration.  Select up to 4 actions for each fault." VALUE 0x80000941 RecordLayout_6 0 CompuMethod_484 0 65535 /end CHARACTERISTIC
/begin CHARACTERISTIC FaultManager.Blend_Valve_Sensor_A_Low_Voltage.Action_4 "Fault manager configuration.  Select up to 4 actions for each fault." VALUE 0x80000943 RecordLayout_6 0 CompuMethod_483 0 65535 /end CHARACTERISTIC
/begin CHARACTERISTIC FaultManager.Blend_Valve_Sensor_A_Low_Voltage.Action_4_Condition "Fault manager configuration.  Select up to 4 actions for each fault." VALUE 0x80000945 RecordLayout_6 0 CompuMethod_484 0 65535 /end CHARACTERISTIC
/begin CHARACTERISTIC FaultManager.Blend_Valve_Sensor_B_High_Voltage.Mode "Fault manager configuration.  Select up to 4 actions for each fault." VALUE 0x80000947 RecordLayout_6 0 CompuMethod_481 0 65535 /end CHARACTERISTIC
/begin CHARACTERISTIC FaultManager.Blend_Valve_Sensor_B_High_Voltage.ID "Fault manager configuration.  Select up to 4 actions for each fault." VALUE 0x80000949 RecordLayout_6 0 CompuMethod_1 0 65535 /end CHARACTERISTIC
/begin CHARACTERISTIC FaultManager.Blend_Valve_Sensor_B_High_Voltage.Test "Fault manager configuration.  Select up to 4 actions for each fault." VALUE 0x8000094B RecordLayout_6 0 CompuMethod_482 0 65535 /end CHARACTERISTIC
/begin CHARACTERISTIC FaultManager.Blend_Valve_Sensor_B_High_Voltage.Faulty_Samples__X_ "Fault manager configuration.  Select up to 4 actions for each fault." VALUE 0x8000094D RecordLayout_6 0 CompuMethod_1 0 65535 /end CHARACTERISTIC
/begin CHARACTERISTIC FaultManager.Blend_Valve_Sensor_B_High_Voltage.Total_Samples__Y_ "Fault manager configuration.  Select up to 4 actions for each fault." VALUE 0x8000094F RecordLayout_6 0 CompuMethod_1 0 65535 /end CHARACTERISTIC
/begin CHARACTERISTIC FaultManager.Blend_Valve_Sensor_B_High_Voltage.Action_1 "Fault manager configuration.  Select up to 4 actions for each fault." VALUE 0x80000951 RecordLayout_6 0 CompuMethod_483 0 65535 /end CHARACTERISTIC
/begin CHARACTERISTIC FaultManager.Blend_Valve_Sensor_B_High_Voltage.Action_1_Condition "Fault manager configuration.  Select up to 4 actions for each fault." VALUE 0x80000953 RecordLayout_6 0 CompuMethod_484 0 65535 /end CHARACTERISTIC
/begin CHARACTERISTIC FaultManager.Blend_Valve_Sensor_B_High_Voltage.Action_2 "Fault manager configuration.  Select up to 4 actions for each fault." VALUE 0x80000955 RecordLayout_6 0 CompuMethod_483 0 65535 /end CHARACTERISTIC
/begin CHARACTERISTIC FaultManager.Blend_Valve_Sensor_B_High_Voltage.Action_2_Condition "Fault manager configuration.  Select up to 4 actions for each fault." VALUE 0x80000957 RecordLayout_6 0 CompuMethod_484 0 65535 /end CHARACTERISTIC
/begin CHARACTERISTIC FaultManager.Blend_Valve_Sensor_B_High_Voltage.Action_3 "Fault manager configuration.  Select up to 4 actions for each fault." VALUE 0x80000959 RecordLayout_6 0 CompuMethod_483 0 65535 /end CHARACTERISTIC
/begin CHARACTERISTIC FaultManager.Blend_Valve_Sensor_B_High_Voltage.Action_3_Condition "Fault manager configuration.  Select up to 4 actions for each fault." VALUE 0x8000095B RecordLayout_6 0 CompuMethod_484 0 65535 /end CHARACTERISTIC
/begin CHARACTERISTIC FaultManager.Blend_Valve_Sensor_B_High_Voltage.Action_4 "Fault manager configuration.  Select up to 4 actions for each fault." VALUE 0x8000095D RecordLayout_6 0 CompuMethod_483 0 65535 /end CHARACTERISTIC
/begin CHARACTERISTIC FaultManager.Blend_Valve_Sensor_B_High_Voltage.Action_4_Condition "Fault manager configuration.  Select up to 4 actions for each fault." VALUE 0x8000095F RecordLayout_6 0 CompuMethod_484 0 65535 /end CHARACTERISTIC
/begin CHARACTERISTIC FaultManager.Blend_Valve_Sensor_B_Intermittent.Mode "Fault manager configuration.  Select up to 4 actions for each fault." VALUE 0x80000961 RecordLayout_6 0 CompuMethod_481 0 65535 /end CHARACTERISTIC
/begin CHARACTERISTIC FaultManager.Blend_Valve_Sensor_B_Intermittent.ID "Fault manager configuration.  Select up to 4 actions for each fault." VALUE 0x80000963 RecordLayout_6 0 CompuMethod_1 0 65535 /end CHARACTERISTIC
/begin CHARACTERISTIC FaultManager.Blend_Valve_Sensor_B_Intermittent.Test "Fault manager configuration.  Select up to 4 actions for each fault." VALUE 0x80000965 RecordLayout_6 0 CompuMethod_482 0 65535 /end CHARACTERISTIC
/begin CHARACTERISTIC FaultManager.Blend_Valve_Sensor_B_Intermittent.Faulty_Samples__X_ "Fault manager configuration.  Select up to 4 actions for each fault." VALUE 0x80000967 RecordLayout_6 0 CompuMethod_1 0 65535 /end CHARACTERISTIC
/begin CHARACTERISTIC FaultManager.Blend_Valve_Sensor_B_Intermittent.Total_Samples__Y_ "Fault manager configuration.  Select up to 4 actions for each fault." VALUE 0x80000969 RecordLayout_6 0 CompuMethod_1 0 65535 /end CHARACTERISTIC
/begin CHARACTERISTIC FaultManager.Blend_Valve_Sensor_B_Intermittent.Action_1 "Fault manager configuration.  Select up to 4 actions for each fault." VALUE 0x8000096B RecordLayout_6 0 CompuMethod_483 0 65535 /end CHARACTERISTIC
/begin CHARACTERISTIC FaultManager.Blend_Valve_Sensor_B_Intermittent.Action_1_Condition "Fault manager configuration.  Select up to 4 actions for each fault." VALUE 0x8000096D RecordLayout_6 0 CompuMethod_484 0 65535 /end CHARACTERISTIC
/begin CHARACTERISTIC FaultManager.Blend_Valve_Sensor_B_Intermittent.Action_2 "Fault manager configuration.  Select up to 4 actions for each fault." VALUE 0x8000096F RecordLayout_6 0 CompuMethod_483 0 65535 /end CHARACTERISTIC
/begin CHARACTERISTIC FaultManager.Blend_Valve_Sensor_B_Intermittent.Action_2_Condition "Fault manager configuration.  Select up to 4 actions for each fault." VALUE 0x80000971 RecordLayout_6 0 CompuMethod_484 0 65535 /end CHARACTERISTIC
/begin CHARACTERISTIC FaultManager.Blend_Valve_Sensor_B_Intermittent.Action_3 "Fault manager configuration.  Select up to 4 actions for each fault." VALUE 0x80000973 RecordLayout_6 0 CompuMethod_483 0 65535 /end CHARACTERISTIC
/begin CHARACTERISTIC FaultManager.Blend_Valve_Sensor_B_Intermittent.Action_3_Condition "Fault manager configuration.  Select up to 4 actions for each fault." VALUE 0x80000975 RecordLayout_6 0 CompuMethod_484 0 65535 /end CHARACTERISTIC
/begin CHARACTERISTIC FaultManager.Blend_Valve_Sensor_B_Intermittent.Action_4 "Fault manager configuration.  Select up to 4 actions for each fault." VALUE 0x80000977 RecordLayout_6 0 CompuMethod_483 0 65535 /end CHARACTERISTIC
/begin CHARACTERISTIC FaultManager.Blend_Valve_Sensor_B_Intermittent.Action_4_Condition "Fault manager configuration.  Select up to 4 actions for each fault." VALUE 0x80000979 RecordLayout_6 0 CompuMethod_484 0 65535 /end CHARACTERISTIC
/begin CHARACTERISTIC FaultManager.Blend_Valve_Sensor_B_Low_Voltage.Mode "Fault manager configuration.  Select up to 4 actions for each fault." VALUE 0x8000097B RecordLayout_6 0 CompuMethod_481 0 65535 /end CHARACTERISTIC
/begin CHARACTERISTIC FaultManager.Blend_Valve_Sensor_B_Low_Voltage.ID "Fault manager configuration.  Select up to 4 actions for each fault." VALUE 0x8000097D RecordLayout_6 0 CompuMethod_1 0 65535 /end CHARACTERISTIC
/begin CHARACTERISTIC FaultManager.Blend_Valve_Sensor_B_Low_Voltage.Test "Fault manager configuration.  Select up to 4 actions for each fault." VALUE 0x8000097F RecordLayout_6 0 CompuMethod_482 0 65535 /end CHARACTERISTIC
/begin CHARACTERISTIC FaultManager.Blend_Valve_Sensor_B_Low_Voltage.Faulty_Samples__X_ "Fault manager configuration.  Select up to 4 actions for each fault." VALUE 0x80000981 RecordLayout_6 0 CompuMethod_1 0 65535 /end CHARACTERISTIC
/begin CHARACTERISTIC FaultManager.Blend_Valve_Sensor_B_Low_Voltage.Total_Samples__Y_ "Fault manager configuration.  Select up to 4 actions for each fault." VALUE 0x80000983 RecordLayout_6 0 CompuMethod_1 0 65535 /end CHARACTERISTIC
/begin CHARACTERISTIC FaultManager.Blend_Valve_Sensor_B_Low_Voltage.Action_1 "Fault manager configuration.  Select up to 4 actions for each fault." VALUE 0x80000985 RecordLayout_6 0 CompuMethod_483 0 65535 /end CHARACTERISTIC
/begin CHARACTERISTIC FaultManager.Blend_Valve_Sensor_B_Low_Voltage.Action_1_Condition "Fault manager configuration.  Select up to 4 actions for each fault." VALUE 0x80000987 RecordLayout_6 0 CompuMethod_484 0 65535 /end CHARACTERISTIC
/begin CHARACTERISTIC FaultManager.Blend_Valve_Sensor_B_Low_Voltage.Action_2 "Fault manager configuration.  Select up to 4 actions for each fault." VALUE 0x80000989 RecordLayout_6 0 CompuMethod_483 0 65535 /end CHARACTERISTIC
/begin CHARACTERISTIC FaultManager.Blend_Valve_Sensor_B_Low_Voltage.Action_2_Condition "Fault manager configuration.  Select up to 4 actions for each fault." VALUE 0x8000098B RecordLayout_6 0 CompuMethod_484 0 65535 /end CHARACTERISTIC
/begin CHARACTERISTIC FaultManager.Blend_Valve_Sensor_B_Low_Voltage.Action_3 "Fault manager configuration.  Select up to 4 actions for each fault." VALUE 0x8000098D RecordLayout_6 0 CompuMethod_483 0 65535 /end CHARACTERISTIC
/begin CHARACTERISTIC FaultManager.Blend_Valve_Sensor_B_Low_Voltage.Action_3_Condition "Fault manager configuration.  Select up to 4 actions for each fault." VALUE 0x8000098F RecordLayout_6 0 CompuMethod_484 0 65535 /end CHARACTERISTIC
/begin CHARACTERISTIC FaultManager.Blend_Valve_Sensor_B_Low_Voltage.Action_4 "Fault manager configuration.  Select up to 4 actions for each fault." VALUE 0x80000991 RecordLayout_6 0 CompuMethod_483 0 65535 /end CHARACTERISTIC
/begin CHARACTERISTIC FaultManager.Blend_Valve_Sensor_B_Low_Voltage.Action_4_Condition "Fault manager configuration.  Select up to 4 actions for each fault." VALUE 0x80000993 RecordLayout_6 0 CompuMethod_484 0 65535 /end CHARACTERISTIC
/begin CHARACTERISTIC FaultManager.Brake_Pedal_Position_Communication_Loss.Mode "Fault manager configuration.  Select up to 4 actions for each fault." VALUE 0x80000995 RecordLayout_6 0 CompuMethod_481 0 65535 /end CHARACTERISTIC
/begin CHARACTERISTIC FaultManager.Brake_Pedal_Position_Communication_Loss.ID "Fault manager configuration.  Select up to 4 actions for each fault." VALUE 0x80000997 RecordLayout_6 0 CompuMethod_1 0 65535 /end CHARACTERISTIC
/begin CHARACTERISTIC FaultManager.Brake_Pedal_Position_Communication_Loss.Test "Fault manager configuration.  Select up to 4 actions for each fault." VALUE 0x80000999 RecordLayout_6 0 CompuMethod_482 0 65535 /end CHARACTERISTIC
/begin CHARACTERISTIC FaultManager.Brake_Pedal_Position_Communication_Loss.Faulty_Samples__X_ "Fault manager configuration.  Select up to 4 actions for each fault." VALUE 0x8000099B RecordLayout_6 0 CompuMethod_1 0 65535 /end CHARACTERISTIC
/begin CHARACTERISTIC FaultManager.Brake_Pedal_Position_Communication_Loss.Total_Samples__Y_ "Fault manager configuration.  Select up to 4 actions for each fault." VALUE 0x8000099D RecordLayout_6 0 CompuMethod_1 0 65535 /end CHARACTERISTIC
/begin CHARACTERISTIC FaultManager.Brake_Pedal_Position_Communication_Loss.Action_1 "Fault manager configuration.  Select up to 4 actions for each fault." VALUE 0x8000099F RecordLayout_6 0 CompuMethod_483 0 65535 /end CHARACTERISTIC
/begin CHARACTERISTIC FaultManager.Brake_Pedal_Position_Communication_Loss.Action_1_Condition "Fault manager configuration.  Select up to 4 actions for each fault." VALUE 0x800009A1 RecordLayout_6 0 CompuMethod_484 0 65535 /end CHARACTERISTIC
/begin CHARACTERISTIC FaultManager.Brake_Pedal_Position_Communication_Loss.Action_2 "Fault manager configuration.  Select up to 4 actions for each fault." VALUE 0x800009A3 RecordLayout_6 0 CompuMethod_483 0 65535 /end CHARACTERISTIC
/begin CHARACTERISTIC FaultManager.Brake_Pedal_Position_Communication_Loss.Action_2_Condition "Fault manager configuration.  Select up to 4 actions for each fault." VALUE 0x800009A5 RecordLayout_6 0 CompuMethod_484 0 65535 /end CHARACTERISTIC
/begin CHARACTERISTIC FaultManager.Brake_Pedal_Position_Communication_Loss.Action_3 "Fault manager configuration.  Select up to 4 actions for each fault." VALUE 0x800009A7 RecordLayout_6 0 CompuMethod_483 0 65535 /end CHARACTERISTIC
/begin CHARACTERISTIC FaultManager.Brake_Pedal_Position_Communication_Loss.Action_3_Condition "Fault manager configuration.  Select up to 4 actions for each fault." VALUE 0x800009A9 RecordLayout_6 0 CompuMethod_484 0 65535 /end CHARACTERISTIC
/begin CHARACTERISTIC FaultManager.Brake_Pedal_Position_Communication_Loss.Action_4 "Fault manager configuration.  Select up to 4 actions for each fault." VALUE 0x800009AB RecordLayout_6 0 CompuMethod_483 0 65535 /end CHARACTERISTIC
/begin CHARACTERISTIC FaultManager.Brake_Pedal_Position_Communication_Loss.Action_4_Condition "Fault manager configuration.  Select up to 4 actions for each fault." VALUE 0x800009AD RecordLayout_6 0 CompuMethod_484 0 65535 /end CHARACTERISTIC
/begin CHARACTERISTIC FaultManager.Brake_Pedal_Position_Intermiitent.Mode "Fault manager configuration.  Select up to 4 actions for each fault." VALUE 0x800009AF RecordLayout_6 0 CompuMethod_481 0 65535 /end CHARACTERISTIC
/begin CHARACTERISTIC FaultManager.Brake_Pedal_Position_Intermiitent.ID "Fault manager configuration.  Select up to 4 actions for each fault." VALUE 0x800009B1 RecordLayout_6 0 CompuMethod_1 0 65535 /end CHARACTERISTIC
/begin CHARACTERISTIC FaultManager.Brake_Pedal_Position_Intermiitent.Test "Fault manager configuration.  Select up to 4 actions for each fault." VALUE 0x800009B3 RecordLayout_6 0 CompuMethod_482 0 65535 /end CHARACTERISTIC
/begin CHARACTERISTIC FaultManager.Brake_Pedal_Position_Intermiitent.Faulty_Samples__X_ "Fault manager configuration.  Select up to 4 actions for each fault." VALUE 0x800009B5 RecordLayout_6 0 CompuMethod_1 0 65535 /end CHARACTERISTIC
/begin CHARACTERISTIC FaultManager.Brake_Pedal_Position_Intermiitent.Total_Samples__Y_ "Fault manager configuration.  Select up to 4 actions for each fault." VALUE 0x800009B7 RecordLayout_6 0 CompuMethod_1 0 65535 /end CHARACTERISTIC
/begin CHARACTERISTIC FaultManager.Brake_Pedal_Position_Intermiitent.Action_1 "Fault manager configuration.  Select up to 4 actions for each fault." VALUE 0x800009B9 RecordLayout_6 0 CompuMethod_483 0 65535 /end CHARACTERISTIC
/begin CHARACTERISTIC FaultManager.Brake_Pedal_Position_Intermiitent.Action_1_Condition "Fault manager configuration.  Select up to 4 actions for each fault." VALUE 0x800009BB RecordLayout_6 0 CompuMethod_484 0 65535 /end CHARACTERISTIC
/begin CHARACTERISTIC FaultManager.Brake_Pedal_Position_Intermiitent.Action_2 "Fault manager configuration.  Select up to 4 actions for each fault." VALUE 0x800009BD RecordLayout_6 0 CompuMethod_483 0 65535 /end CHARACTERISTIC
/begin CHARACTERISTIC FaultManager.Brake_Pedal_Position_Intermiitent.Action_2_Condition "Fault manager configuration.  Select up to 4 actions for each fault." VALUE 0x800009BF RecordLayout_6 0 CompuMethod_484 0 65535 /end CHARACTERISTIC
/begin CHARACTERISTIC FaultManager.Brake_Pedal_Position_Intermiitent.Action_3 "Fault manager configuration.  Select up to 4 actions for each fault." VALUE 0x800009C1 RecordLayout_6 0 CompuMethod_483 0 65535 /end CHARACTERISTIC
/begin CHARACTERISTIC FaultManager.Brake_Pedal_Position_Intermiitent.Action_3_Condition "Fault manager configuration.  Select up to 4 actions for each fault." VALUE 0x800009C3 RecordLayout_6 0 CompuMethod_484 0 65535 /end CHARACTERISTIC
/begin CHARACTERISTIC FaultManager.Brake_Pedal_Position_Intermiitent.Action_4 "Fault manager configuration.  Select up to 4 actions for each fault." VALUE 0x800009C5 RecordLayout_6 0 CompuMethod_483 0 65535 /end CHARACTERISTIC
/begin CHARACTERISTIC FaultManager.Brake_Pedal_Position_Intermiitent.Action_4_Condition "Fault manager configuration.  Select up to 4 actions for each fault." VALUE 0x800009C7 RecordLayout_6 0 CompuMethod_484 0 65535 /end CHARACTERISTIC
/begin CHARACTERISTIC FaultManager.Brake_Pedal_Position_Low.Mode "Fault manager configuration.  Select up to 4 actions for each fault." VALUE 0x800009C9 RecordLayout_6 0 CompuMethod_481 0 65535 /end CHARACTERISTIC
/begin CHARACTERISTIC FaultManager.Brake_Pedal_Position_Low.ID "Fault manager configuration.  Select up to 4 actions for each fault." VALUE 0x800009CB RecordLayout_6 0 CompuMethod_1 0 65535 /end CHARACTERISTIC
/begin CHARACTERISTIC FaultManager.Brake_Pedal_Position_Low.Test "Fault manager configuration.  Select up to 4 actions for each fault." VALUE 0x800009CD RecordLayout_6 0 CompuMethod_482 0 65535 /end CHARACTERISTIC
/begin CHARACTERISTIC FaultManager.Brake_Pedal_Position_Low.Faulty_Samples__X_ "Fault manager configuration.  Select up to 4 actions for each fault." VALUE 0x800009CF RecordLayout_6 0 CompuMethod_1 0 65535 /end CHARACTERISTIC
/begin CHARACTERISTIC FaultManager.Brake_Pedal_Position_Low.Total_Samples__Y_ "Fault manager configuration.  Select up to 4 actions for each fault." VALUE 0x800009D1 RecordLayout_6 0 CompuMethod_1 0 65535 /end CHARACTERISTIC
/begin CHARACTERISTIC FaultManager.Brake_Pedal_Position_Low.Action_1 "Fault manager configuration.  Select up to 4 actions for each fault." VALUE 0x800009D3 RecordLayout_6 0 CompuMethod_483 0 65535 /end CHARACTERISTIC
/begin CHARACTERISTIC FaultManager.Brake_Pedal_Position_Low.Action_1_Condition "Fault manager configuration.  Select up to 4 actions for each fault." VALUE 0x800009D5 RecordLayout_6 0 CompuMethod_484 0 65535 /end CHARACTERISTIC
/begin CHARACTERISTIC FaultManager.Brake_Pedal_Position_Low.Action_2 "Fault manager configuration.  Select up to 4 actions for each fault." VALUE 0x800009D7 RecordLayout_6 0 CompuMethod_483 0 65535 /end CHARACTERISTIC
/begin CHARACTERISTIC FaultManager.Brake_Pedal_Position_Low.Action_2_Condition "Fault manager configuration.  Select up to 4 actions for each fault." VALUE 0x800009D9 RecordLayout_6 0 CompuMethod_484 0 65535 /end CHARACTERISTIC
/begin CHARACTERISTIC FaultManager.Brake_Pedal_Position_Low.Action_3 "Fault manager configuration.  Select up to 4 actions for each fault." VALUE 0x800009DB RecordLayout_6 0 CompuMethod_483 0 65535 /end CHARACTERISTIC
/begin CHARACTERISTIC FaultManager.Brake_Pedal_Position_Low.Action_3_Condition "Fault manager configuration.  Select up to 4 actions for each fault." VALUE 0x800009DD RecordLayout_6 0 CompuMethod_484 0 65535 /end CHARACTERISTIC
/begin CHARACTERISTIC FaultManager.Brake_Pedal_Position_Low.Action_4 "Fault manager configuration.  Select up to 4 actions for each fault." VALUE 0x800009DF RecordLayout_6 0 CompuMethod_483 0 65535 /end CHARACTERISTIC
/begin CHARACTERISTIC FaultManager.Brake_Pedal_Position_Low.Action_4_Condition "Fault manager configuration.  Select up to 4 actions for each fault." VALUE 0x800009E1 RecordLayout_6 0 CompuMethod_484 0 65535 /end CHARACTERISTIC
/begin CHARACTERISTIC FaultManager.Brake_Pedal_Position_Sensor_A_Circuit_High.Mode "Fault manager configuration.  Select up to 4 actions for each fault." VALUE 0x800009E3 RecordLayout_6 0 CompuMethod_481 0 65535 /end CHARACTERISTIC
/begin CHARACTERISTIC FaultManager.Brake_Pedal_Position_Sensor_A_Circuit_High.ID "Fault manager configuration.  Select up to 4 actions for each fault." VALUE 0x800009E5 RecordLayout_6 0 CompuMethod_1 0 65535 /end CHARACTERISTIC
/begin CHARACTERISTIC FaultManager.Brake_Pedal_Position_Sensor_A_Circuit_High.Test "Fault manager configuration.  Select up to 4 actions for each fault." VALUE 0x800009E7 RecordLayout_6 0 CompuMethod_482 0 65535 /end CHARACTERISTIC
/begin CHARACTERISTIC FaultManager.Brake_Pedal_Position_Sensor_A_Circuit_High.Faulty_Samples__X_ "Fault manager configuration.  Select up to 4 actions for each fault." VALUE 0x800009E9 RecordLayout_6 0 CompuMethod_1 0 65535 /end CHARACTERISTIC
/begin CHARACTERISTIC FaultManager.Brake_Pedal_Position_Sensor_A_Circuit_High.Total_Samples__Y_ "Fault manager configuration.  Select up to 4 actions for each fault." VALUE 0x800009EB RecordLayout_6 0 CompuMethod_1 0 65535 /end CHARACTERISTIC
/begin CHARACTERISTIC FaultManager.Brake_Pedal_Position_Sensor_A_Circuit_High.Action_1 "Fault manager configuration.  Select up to 4 actions for each fault." VALUE 0x800009ED RecordLayout_6 0 CompuMethod_483 0 65535 /end CHARACTERISTIC
/begin CHARACTERISTIC FaultManager.Brake_Pedal_Position_Sensor_A_Circuit_High.Action_1_Condition "Fault manager configuration.  Select up to 4 actions for each fault." VALUE 0x800009EF RecordLayout_6 0 CompuMethod_484 0 65535 /end CHARACTERISTIC
/begin CHARACTERISTIC FaultManager.Brake_Pedal_Position_Sensor_A_Circuit_High.Action_2 "Fault manager configuration.  Select up to 4 actions for each fault." VALUE 0x800009F1 RecordLayout_6 0 CompuMethod_483 0 65535 /end CHARACTERISTIC
/begin CHARACTERISTIC FaultManager.Brake_Pedal_Position_Sensor_A_Circuit_High.Action_2_Condition "Fault manager configuration.  Select up to 4 actions for each fault." VALUE 0x800009F3 RecordLayout_6 0 CompuMethod_484 0 65535 /end CHARACTERISTIC
/begin CHARACTERISTIC FaultManager.Brake_Pedal_Position_Sensor_A_Circuit_High.Action_3 "Fault manager configuration.  Select up to 4 actions for each fault." VALUE 0x800009F5 RecordLayout_6 0 CompuMethod_483 0 65535 /end CHARACTERISTIC
/begin CHARACTERISTIC FaultManager.Brake_Pedal_Position_Sensor_A_Circuit_High.Action_3_Condition "Fault manager configuration.  Select up to 4 actions for each fault." VALUE 0x800009F7 RecordLayout_6 0 CompuMethod_484 0 65535 /end CHARACTERISTIC
/begin CHARACTERISTIC FaultManager.Brake_Pedal_Position_Sensor_A_Circuit_High.Action_4 "Fault manager configuration.  Select up to 4 actions for each fault." VALUE 0x800009F9 RecordLayout_6 0 CompuMethod_483 0 65535 /end CHARACTERISTIC
/begin CHARACTERISTIC FaultManager.Brake_Pedal_Position_Sensor_A_Circuit_High.Action_4_Condition "Fault manager configuration.  Select up to 4 actions for each fault." VALUE 0x800009FB RecordLayout_6 0 CompuMethod_484 0 65535 /end CHARACTERISTIC
/begin CHARACTERISTIC FaultManager.Brakes_AgeCount.Mode "Fault manager configuration.  Select up to 4 actions for each fault." VALUE 0x800009FD RecordLayout_6 0 CompuMethod_481 0 65535 /end CHARACTERISTIC
/begin CHARACTERISTIC FaultManager.Brakes_AgeCount.ID "Fault manager configuration.  Select up to 4 actions for each fault." VALUE 0x800009FF RecordLayout_6 0 CompuMethod_1 0 65535 /end CHARACTERISTIC
/begin CHARACTERISTIC FaultManager.Brakes_AgeCount.Test "Fault manager configuration.  Select up to 4 actions for each fault." VALUE 0x80000A01 RecordLayout_6 0 CompuMethod_482 0 65535 /end CHARACTERISTIC
/begin CHARACTERISTIC FaultManager.Brakes_AgeCount.Faulty_Samples__X_ "Fault manager configuration.  Select up to 4 actions for each fault." VALUE 0x80000A03 RecordLayout_6 0 CompuMethod_1 0 65535 /end CHARACTERISTIC
/begin CHARACTERISTIC FaultManager.Brakes_AgeCount.Total_Samples__Y_ "Fault manager configuration.  Select up to 4 actions for each fault." VALUE 0x80000A05 RecordLayout_6 0 CompuMethod_1 0 65535 /end CHARACTERISTIC
/begin CHARACTERISTIC FaultManager.Brakes_AgeCount.Action_1 "Fault manager configuration.  Select up to 4 actions for each fault." VALUE 0x80000A07 RecordLayout_6 0 CompuMethod_483 0 65535 /end CHARACTERISTIC
/begin CHARACTERISTIC FaultManager.Brakes_AgeCount.Action_1_Condition "Fault manager configuration.  Select up to 4 actions for each fault." VALUE 0x80000A09 RecordLayout_6 0 CompuMethod_484 0 65535 /end CHARACTERISTIC
/begin CHARACTERISTIC FaultManager.Brakes_AgeCount.Action_2 "Fault manager configuration.  Select up to 4 actions for each fault." VALUE 0x80000A0B RecordLayout_6 0 CompuMethod_483 0 65535 /end CHARACTERISTIC
/begin CHARACTERISTIC FaultManager.Brakes_AgeCount.Action_2_Condition "Fault manager configuration.  Select up to 4 actions for each fault." VALUE 0x80000A0D RecordLayout_6 0 CompuMethod_484 0 65535 /end CHARACTERISTIC
/begin CHARACTERISTIC FaultManager.Brakes_AgeCount.Action_3 "Fault manager configuration.  Select up to 4 actions for each fault." VALUE 0x80000A0F RecordLayout_6 0 CompuMethod_483 0 65535 /end CHARACTERISTIC
/begin CHARACTERISTIC FaultManager.Brakes_AgeCount.Action_3_Condition "Fault manager configuration.  Select up to 4 actions for each fault." VALUE 0x80000A11 RecordLayout_6 0 CompuMethod_484 0 65535 /end CHARACTERISTIC
/begin CHARACTERISTIC FaultManager.Brakes_AgeCount.Action_4 "Fault manager configuration.  Select up to 4 actions for each fault." VALUE 0x80000A13 RecordLayout_6 0 CompuMethod_483 0 65535 /end CHARACTERISTIC
/begin CHARACTERISTIC FaultManager.Brakes_AgeCount.Action_4_Condition "Fault manager configuration.  Select up to 4 actions for each fault." VALUE 0x80000A15 RecordLayout_6 0 CompuMethod_484 0 65535 /end CHARACTERISTIC
/begin CHARACTERISTIC FaultManager.Charge_Complete_Cell_Max_Volt.Mode "Fault manager configuration.  Select up to 4 actions for each fault." VALUE 0x80000A17 RecordLayout_6 0 CompuMethod_481 0 65535 /end CHARACTERISTIC
/begin CHARACTERISTIC FaultManager.Charge_Complete_Cell_Max_Volt.ID "Fault manager configuration.  Select up to 4 actions for each fault." VALUE 0x80000A19 RecordLayout_6 0 CompuMethod_1 0 65535 /end CHARACTERISTIC
/begin CHARACTERISTIC FaultManager.Charge_Complete_Cell_Max_Volt.Test "Fault manager configuration.  Select up to 4 actions for each fault." VALUE 0x80000A1B RecordLayout_6 0 CompuMethod_482 0 65535 /end CHARACTERISTIC
/begin CHARACTERISTIC FaultManager.Charge_Complete_Cell_Max_Volt.Faulty_Samples__X_ "Fault manager configuration.  Select up to 4 actions for each fault." VALUE 0x80000A1D RecordLayout_6 0 CompuMethod_1 0 65535 /end CHARACTERISTIC
/begin CHARACTERISTIC FaultManager.Charge_Complete_Cell_Max_Volt.Total_Samples__Y_ "Fault manager configuration.  Select up to 4 actions for each fault." VALUE 0x80000A1F RecordLayout_6 0 CompuMethod_1 0 65535 /end CHARACTERISTIC
/begin CHARACTERISTIC FaultManager.Charge_Complete_Cell_Max_Volt.Action_1 "Fault manager configuration.  Select up to 4 actions for each fault." VALUE 0x80000A21 RecordLayout_6 0 CompuMethod_483 0 65535 /end CHARACTERISTIC
/begin CHARACTERISTIC FaultManager.Charge_Complete_Cell_Max_Volt.Action_1_Condition "Fault manager configuration.  Select up to 4 actions for each fault." VALUE 0x80000A23 RecordLayout_6 0 CompuMethod_484 0 65535 /end CHARACTERISTIC
/begin CHARACTERISTIC FaultManager.Charge_Complete_Cell_Max_Volt.Action_2 "Fault manager configuration.  Select up to 4 actions for each fault." VALUE 0x80000A25 RecordLayout_6 0 CompuMethod_483 0 65535 /end CHARACTERISTIC
/begin CHARACTERISTIC FaultManager.Charge_Complete_Cell_Max_Volt.Action_2_Condition "Fault manager configuration.  Select up to 4 actions for each fault." VALUE 0x80000A27 RecordLayout_6 0 CompuMethod_484 0 65535 /end CHARACTERISTIC
/begin CHARACTERISTIC FaultManager.Charge_Complete_Cell_Max_Volt.Action_3 "Fault manager configuration.  Select up to 4 actions for each fault." VALUE 0x80000A29 RecordLayout_6 0 CompuMethod_483 0 65535 /end CHARACTERISTIC
/begin CHARACTERISTIC FaultManager.Charge_Complete_Cell_Max_Volt.Action_3_Condition "Fault manager configuration.  Select up to 4 actions for each fault." VALUE 0x80000A2B RecordLayout_6 0 CompuMethod_484 0 65535 /end CHARACTERISTIC
/begin CHARACTERISTIC FaultManager.Charge_Complete_Cell_Max_Volt.Action_4 "Fault manager configuration.  Select up to 4 actions for each fault." VALUE 0x80000A2D RecordLayout_6 0 CompuMethod_483 0 65535 /end CHARACTERISTIC
/begin CHARACTERISTIC FaultManager.Charge_Complete_Cell_Max_Volt.Action_4_Condition "Fault manager configuration.  Select up to 4 actions for each fault." VALUE 0x80000A2F RecordLayout_6 0 CompuMethod_484 0 65535 /end CHARACTERISTIC
/begin CHARACTERISTIC FaultManager.Charger_Amperage_Draw_Greater_Then_Supply.Mode "Fault manager configuration.  Select up to 4 actions for each fault." VALUE 0x80000A31 RecordLayout_6 0 CompuMethod_481 0 65535 /end CHARACTERISTIC
/begin CHARACTERISTIC FaultManager.Charger_Amperage_Draw_Greater_Then_Supply.ID "Fault manager configuration.  Select up to 4 actions for each fault." VALUE 0x80000A33 RecordLayout_6 0 CompuMethod_1 0 65535 /end CHARACTERISTIC
/begin CHARACTERISTIC FaultManager.Charger_Amperage_Draw_Greater_Then_Supply.Test "Fault manager configuration.  Select up to 4 actions for each fault." VALUE 0x80000A35 RecordLayout_6 0 CompuMethod_482 0 65535 /end CHARACTERISTIC
/begin CHARACTERISTIC FaultManager.Charger_Amperage_Draw_Greater_Then_Supply.Faulty_Samples__X_ "Fault manager configuration.  Select up to 4 actions for each fault." VALUE 0x80000A37 RecordLayout_6 0 CompuMethod_1 0 65535 /end CHARACTERISTIC
/begin CHARACTERISTIC FaultManager.Charger_Amperage_Draw_Greater_Then_Supply.Total_Samples__Y_ "Fault manager configuration.  Select up to 4 actions for each fault." VALUE 0x80000A39 RecordLayout_6 0 CompuMethod_1 0 65535 /end CHARACTERISTIC
/begin CHARACTERISTIC FaultManager.Charger_Amperage_Draw_Greater_Then_Supply.Action_1 "Fault manager configuration.  Select up to 4 actions for each fault." VALUE 0x80000A3B RecordLayout_6 0 CompuMethod_483 0 65535 /end CHARACTERISTIC
/begin CHARACTERISTIC FaultManager.Charger_Amperage_Draw_Greater_Then_Supply.Action_1_Condition "Fault manager configuration.  Select up to 4 actions for each fault." VALUE 0x80000A3D RecordLayout_6 0 CompuMethod_484 0 65535 /end CHARACTERISTIC
/begin CHARACTERISTIC FaultManager.Charger_Amperage_Draw_Greater_Then_Supply.Action_2 "Fault manager configuration.  Select up to 4 actions for each fault." VALUE 0x80000A3F RecordLayout_6 0 CompuMethod_483 0 65535 /end CHARACTERISTIC
/begin CHARACTERISTIC FaultManager.Charger_Amperage_Draw_Greater_Then_Supply.Action_2_Condition "Fault manager configuration.  Select up to 4 actions for each fault." VALUE 0x80000A41 RecordLayout_6 0 CompuMethod_484 0 65535 /end CHARACTERISTIC
/begin CHARACTERISTIC FaultManager.Charger_Amperage_Draw_Greater_Then_Supply.Action_3 "Fault manager configuration.  Select up to 4 actions for each fault." VALUE 0x80000A43 RecordLayout_6 0 CompuMethod_483 0 65535 /end CHARACTERISTIC
/begin CHARACTERISTIC FaultManager.Charger_Amperage_Draw_Greater_Then_Supply.Action_3_Condition "Fault manager configuration.  Select up to 4 actions for each fault." VALUE 0x80000A45 RecordLayout_6 0 CompuMethod_484 0 65535 /end CHARACTERISTIC
/begin CHARACTERISTIC FaultManager.Charger_Amperage_Draw_Greater_Then_Supply.Action_4 "Fault manager configuration.  Select up to 4 actions for each fault." VALUE 0x80000A47 RecordLayout_6 0 CompuMethod_483 0 65535 /end CHARACTERISTIC
/begin CHARACTERISTIC FaultManager.Charger_Amperage_Draw_Greater_Then_Supply.Action_4_Condition "Fault manager configuration.  Select up to 4 actions for each fault." VALUE 0x80000A49 RecordLayout_6 0 CompuMethod_484 0 65535 /end CHARACTERISTIC
/begin CHARACTERISTIC FaultManager.Charger_Derated_Over_Temperature.Mode "Fault manager configuration.  Select up to 4 actions for each fault." VALUE 0x80000A4B RecordLayout_6 0 CompuMethod_481 0 65535 /end CHARACTERISTIC
/begin CHARACTERISTIC FaultManager.Charger_Derated_Over_Temperature.ID "Fault manager configuration.  Select up to 4 actions for each fault." VALUE 0x80000A4D RecordLayout_6 0 CompuMethod_1 0 65535 /end CHARACTERISTIC
/begin CHARACTERISTIC FaultManager.Charger_Derated_Over_Temperature.Test "Fault manager configuration.  Select up to 4 actions for each fault." VALUE 0x80000A4F RecordLayout_6 0 CompuMethod_482 0 65535 /end CHARACTERISTIC
/begin CHARACTERISTIC FaultManager.Charger_Derated_Over_Temperature.Faulty_Samples__X_ "Fault manager configuration.  Select up to 4 actions for each fault." VALUE 0x80000A51 RecordLayout_6 0 CompuMethod_1 0 65535 /end CHARACTERISTIC
/begin CHARACTERISTIC FaultManager.Charger_Derated_Over_Temperature.Total_Samples__Y_ "Fault manager configuration.  Select up to 4 actions for each fault." VALUE 0x80000A53 RecordLayout_6 0 CompuMethod_1 0 65535 /end CHARACTERISTIC
/begin CHARACTERISTIC FaultManager.Charger_Derated_Over_Temperature.Action_1 "Fault manager configuration.  Select up to 4 actions for each fault." VALUE 0x80000A55 RecordLayout_6 0 CompuMethod_483 0 65535 /end CHARACTERISTIC
/begin CHARACTERISTIC FaultManager.Charger_Derated_Over_Temperature.Action_1_Condition "Fault manager configuration.  Select up to 4 actions for each fault." VALUE 0x80000A57 RecordLayout_6 0 CompuMethod_484 0 65535 /end CHARACTERISTIC
/begin CHARACTERISTIC FaultManager.Charger_Derated_Over_Temperature.Action_2 "Fault manager configuration.  Select up to 4 actions for each fault." VALUE 0x80000A59 RecordLayout_6 0 CompuMethod_483 0 65535 /end CHARACTERISTIC
/begin CHARACTERISTIC FaultManager.Charger_Derated_Over_Temperature.Action_2_Condition "Fault manager configuration.  Select up to 4 actions for each fault." VALUE 0x80000A5B RecordLayout_6 0 CompuMethod_484 0 65535 /end CHARACTERISTIC
/begin CHARACTERISTIC FaultManager.Charger_Derated_Over_Temperature.Action_3 "Fault manager configuration.  Select up to 4 actions for each fault." VALUE 0x80000A5D RecordLayout_6 0 CompuMethod_483 0 65535 /end CHARACTERISTIC
/begin CHARACTERISTIC FaultManager.Charger_Derated_Over_Temperature.Action_3_Condition "Fault manager configuration.  Select up to 4 actions for each fault." VALUE 0x80000A5F RecordLayout_6 0 CompuMethod_484 0 65535 /end CHARACTERISTIC
/begin CHARACTERISTIC FaultManager.Charger_Derated_Over_Temperature.Action_4 "Fault manager configuration.  Select up to 4 actions for each fault." VALUE 0x80000A61 RecordLayout_6 0 CompuMethod_483 0 65535 /end CHARACTERISTIC
/begin CHARACTERISTIC FaultManager.Charger_Derated_Over_Temperature.Action_4_Condition "Fault manager configuration.  Select up to 4 actions for each fault." VALUE 0x80000A63 RecordLayout_6 0 CompuMethod_484 0 65535 /end CHARACTERISTIC
/begin CHARACTERISTIC FaultManager.Charger_Derated_Under_Temperature.Mode "Fault manager configuration.  Select up to 4 actions for each fault." VALUE 0x80000A65 RecordLayout_6 0 CompuMethod_481 0 65535 /end CHARACTERISTIC
/begin CHARACTERISTIC FaultManager.Charger_Derated_Under_Temperature.ID "Fault manager configuration.  Select up to 4 actions for each fault." VALUE 0x80000A67 RecordLayout_6 0 CompuMethod_1 0 65535 /end CHARACTERISTIC
/begin CHARACTERISTIC FaultManager.Charger_Derated_Under_Temperature.Test "Fault manager configuration.  Select up to 4 actions for each fault." VALUE 0x80000A69 RecordLayout_6 0 CompuMethod_482 0 65535 /end CHARACTERISTIC
/begin CHARACTERISTIC FaultManager.Charger_Derated_Under_Temperature.Faulty_Samples__X_ "Fault manager configuration.  Select up to 4 actions for each fault." VALUE 0x80000A6B RecordLayout_6 0 CompuMethod_1 0 65535 /end CHARACTERISTIC
/begin CHARACTERISTIC FaultManager.Charger_Derated_Under_Temperature.Total_Samples__Y_ "Fault manager configuration.  Select up to 4 actions for each fault." VALUE 0x80000A6D RecordLayout_6 0 CompuMethod_1 0 65535 /end CHARACTERISTIC
/begin CHARACTERISTIC FaultManager.Charger_Derated_Under_Temperature.Action_1 "Fault manager configuration.  Select up to 4 actions for each fault." VALUE 0x80000A6F RecordLayout_6 0 CompuMethod_483 0 65535 /end CHARACTERISTIC
/begin CHARACTERISTIC FaultManager.Charger_Derated_Under_Temperature.Action_1_Condition "Fault manager configuration.  Select up to 4 actions for each fault." VALUE 0x80000A71 RecordLayout_6 0 CompuMethod_484 0 65535 /end CHARACTERISTIC
/begin CHARACTERISTIC FaultManager.Charger_Derated_Under_Temperature.Action_2 "Fault manager configuration.  Select up to 4 actions for each fault." VALUE 0x80000A73 RecordLayout_6 0 CompuMethod_483 0 65535 /end CHARACTERISTIC
/begin CHARACTERISTIC FaultManager.Charger_Derated_Under_Temperature.Action_2_Condition "Fault manager configuration.  Select up to 4 actions for each fault." VALUE 0x80000A75 RecordLayout_6 0 CompuMethod_484 0 65535 /end CHARACTERISTIC
/begin CHARACTERISTIC FaultManager.Charger_Derated_Under_Temperature.Action_3 "Fault manager configuration.  Select up to 4 actions for each fault." VALUE 0x80000A77 RecordLayout_6 0 CompuMethod_483 0 65535 /end CHARACTERISTIC
/begin CHARACTERISTIC FaultManager.Charger_Derated_Under_Temperature.Action_3_Condition "Fault manager configuration.  Select up to 4 actions for each fault." VALUE 0x80000A79 RecordLayout_6 0 CompuMethod_484 0 65535 /end CHARACTERISTIC
/begin CHARACTERISTIC FaultManager.Charger_Derated_Under_Temperature.Action_4 "Fault manager configuration.  Select up to 4 actions for each fault." VALUE 0x80000A7B RecordLayout_6 0 CompuMethod_483 0 65535 /end CHARACTERISTIC
/begin CHARACTERISTIC FaultManager.Charger_Derated_Under_Temperature.Action_4_Condition "Fault manager configuration.  Select up to 4 actions for each fault." VALUE 0x80000A7D RecordLayout_6 0 CompuMethod_484 0 65535 /end CHARACTERISTIC
/begin CHARACTERISTIC FaultManager.Charger_Internal_Fault.Mode "Fault manager configuration.  Select up to 4 actions for each fault." VALUE 0x80000A7F RecordLayout_6 0 CompuMethod_481 0 65535 /end CHARACTERISTIC
/begin CHARACTERISTIC FaultManager.Charger_Internal_Fault.ID "Fault manager configuration.  Select up to 4 actions for each fault." VALUE 0x80000A81 RecordLayout_6 0 CompuMethod_1 0 65535 /end CHARACTERISTIC
/begin CHARACTERISTIC FaultManager.Charger_Internal_Fault.Test "Fault manager configuration.  Select up to 4 actions for each fault." VALUE 0x80000A83 RecordLayout_6 0 CompuMethod_482 0 65535 /end CHARACTERISTIC
/begin CHARACTERISTIC FaultManager.Charger_Internal_Fault.Faulty_Samples__X_ "Fault manager configuration.  Select up to 4 actions for each fault." VALUE 0x80000A85 RecordLayout_6 0 CompuMethod_1 0 65535 /end CHARACTERISTIC
/begin CHARACTERISTIC FaultManager.Charger_Internal_Fault.Total_Samples__Y_ "Fault manager configuration.  Select up to 4 actions for each fault." VALUE 0x80000A87 RecordLayout_6 0 CompuMethod_1 0 65535 /end CHARACTERISTIC
/begin CHARACTERISTIC FaultManager.Charger_Internal_Fault.Action_1 "Fault manager configuration.  Select up to 4 actions for each fault." VALUE 0x80000A89 RecordLayout_6 0 CompuMethod_483 0 65535 /end CHARACTERISTIC
/begin CHARACTERISTIC FaultManager.Charger_Internal_Fault.Action_1_Condition "Fault manager configuration.  Select up to 4 actions for each fault." VALUE 0x80000A8B RecordLayout_6 0 CompuMethod_484 0 65535 /end CHARACTERISTIC
/begin CHARACTERISTIC FaultManager.Charger_Internal_Fault.Action_2 "Fault manager configuration.  Select up to 4 actions for each fault." VALUE 0x80000A8D RecordLayout_6 0 CompuMethod_483 0 65535 /end CHARACTERISTIC
/begin CHARACTERISTIC FaultManager.Charger_Internal_Fault.Action_2_Condition "Fault manager configuration.  Select up to 4 actions for each fault." VALUE 0x80000A8F RecordLayout_6 0 CompuMethod_484 0 65535 /end CHARACTERISTIC
/begin CHARACTERISTIC FaultManager.Charger_Internal_Fault.Action_3 "Fault manager configuration.  Select up to 4 actions for each fault." VALUE 0x80000A91 RecordLayout_6 0 CompuMethod_483 0 65535 /end CHARACTERISTIC
/begin CHARACTERISTIC FaultManager.Charger_Internal_Fault.Action_3_Condition "Fault manager configuration.  Select up to 4 actions for each fault." VALUE 0x80000A93 RecordLayout_6 0 CompuMethod_484 0 65535 /end CHARACTERISTIC
/begin CHARACTERISTIC FaultManager.Charger_Internal_Fault.Action_4 "Fault manager configuration.  Select up to 4 actions for each fault." VALUE 0x80000A95 RecordLayout_6 0 CompuMethod_483 0 65535 /end CHARACTERISTIC
/begin CHARACTERISTIC FaultManager.Charger_Internal_Fault.Action_4_Condition "Fault manager configuration.  Select up to 4 actions for each fault." VALUE 0x80000A97 RecordLayout_6 0 CompuMethod_484 0 65535 /end CHARACTERISTIC
/begin CHARACTERISTIC FaultManager.Charger_Line_Voltage_Too_Low.Mode "Fault manager configuration.  Select up to 4 actions for each fault." VALUE 0x80000A99 RecordLayout_6 0 CompuMethod_481 0 65535 /end CHARACTERISTIC
/begin CHARACTERISTIC FaultManager.Charger_Line_Voltage_Too_Low.ID "Fault manager configuration.  Select up to 4 actions for each fault." VALUE 0x80000A9B RecordLayout_6 0 CompuMethod_1 0 65535 /end CHARACTERISTIC
/begin CHARACTERISTIC FaultManager.Charger_Line_Voltage_Too_Low.Test "Fault manager configuration.  Select up to 4 actions for each fault." VALUE 0x80000A9D RecordLayout_6 0 CompuMethod_482 0 65535 /end CHARACTERISTIC
/begin CHARACTERISTIC FaultManager.Charger_Line_Voltage_Too_Low.Faulty_Samples__X_ "Fault manager configuration.  Select up to 4 actions for each fault." VALUE 0x80000A9F RecordLayout_6 0 CompuMethod_1 0 65535 /end CHARACTERISTIC
/begin CHARACTERISTIC FaultManager.Charger_Line_Voltage_Too_Low.Total_Samples__Y_ "Fault manager configuration.  Select up to 4 actions for each fault." VALUE 0x80000AA1 RecordLayout_6 0 CompuMethod_1 0 65535 /end CHARACTERISTIC
/begin CHARACTERISTIC FaultManager.Charger_Line_Voltage_Too_Low.Action_1 "Fault manager configuration.  Select up to 4 actions for each fault." VALUE 0x80000AA3 RecordLayout_6 0 CompuMethod_483 0 65535 /end CHARACTERISTIC
/begin CHARACTERISTIC FaultManager.Charger_Line_Voltage_Too_Low.Action_1_Condition "Fault manager configuration.  Select up to 4 actions for each fault." VALUE 0x80000AA5 RecordLayout_6 0 CompuMethod_484 0 65535 /end CHARACTERISTIC
/begin CHARACTERISTIC FaultManager.Charger_Line_Voltage_Too_Low.Action_2 "Fault manager configuration.  Select up to 4 actions for each fault." VALUE 0x80000AA7 RecordLayout_6 0 CompuMethod_483 0 65535 /end CHARACTERISTIC
/begin CHARACTERISTIC FaultManager.Charger_Line_Voltage_Too_Low.Action_2_Condition "Fault manager configuration.  Select up to 4 actions for each fault." VALUE 0x80000AA9 RecordLayout_6 0 CompuMethod_484 0 65535 /end CHARACTERISTIC
/begin CHARACTERISTIC FaultManager.Charger_Line_Voltage_Too_Low.Action_3 "Fault manager configuration.  Select up to 4 actions for each fault." VALUE 0x80000AAB RecordLayout_6 0 CompuMethod_483 0 65535 /end CHARACTERISTIC
/begin CHARACTERISTIC FaultManager.Charger_Line_Voltage_Too_Low.Action_3_Condition "Fault manager configuration.  Select up to 4 actions for each fault." VALUE 0x80000AAD RecordLayout_6 0 CompuMethod_484 0 65535 /end CHARACTERISTIC
/begin CHARACTERISTIC FaultManager.Charger_Line_Voltage_Too_Low.Action_4 "Fault manager configuration.  Select up to 4 actions for each fault." VALUE 0x80000AAF RecordLayout_6 0 CompuMethod_483 0 65535 /end CHARACTERISTIC
/begin CHARACTERISTIC FaultManager.Charger_Line_Voltage_Too_Low.Action_4_Condition "Fault manager configuration.  Select up to 4 actions for each fault." VALUE 0x80000AB1 RecordLayout_6 0 CompuMethod_484 0 65535 /end CHARACTERISTIC
/begin CHARACTERISTIC FaultManager.Charger_Line_Votlage_Too_High.Mode "Fault manager configuration.  Select up to 4 actions for each fault." VALUE 0x80000AB3 RecordLayout_6 0 CompuMethod_481 0 65535 /end CHARACTERISTIC
/begin CHARACTERISTIC FaultManager.Charger_Line_Votlage_Too_High.ID "Fault manager configuration.  Select up to 4 actions for each fault." VALUE 0x80000AB5 RecordLayout_6 0 CompuMethod_1 0 65535 /end CHARACTERISTIC
/begin CHARACTERISTIC FaultManager.Charger_Line_Votlage_Too_High.Test "Fault manager configuration.  Select up to 4 actions for each fault." VALUE 0x80000AB7 RecordLayout_6 0 CompuMethod_482 0 65535 /end CHARACTERISTIC
/begin CHARACTERISTIC FaultManager.Charger_Line_Votlage_Too_High.Faulty_Samples__X_ "Fault manager configuration.  Select up to 4 actions for each fault." VALUE 0x80000AB9 RecordLayout_6 0 CompuMethod_1 0 65535 /end CHARACTERISTIC
/begin CHARACTERISTIC FaultManager.Charger_Line_Votlage_Too_High.Total_Samples__Y_ "Fault manager configuration.  Select up to 4 actions for each fault." VALUE 0x80000ABB RecordLayout_6 0 CompuMethod_1 0 65535 /end CHARACTERISTIC
/begin CHARACTERISTIC FaultManager.Charger_Line_Votlage_Too_High.Action_1 "Fault manager configuration.  Select up to 4 actions for each fault." VALUE 0x80000ABD RecordLayout_6 0 CompuMethod_483 0 65535 /end CHARACTERISTIC
/begin CHARACTERISTIC FaultManager.Charger_Line_Votlage_Too_High.Action_1_Condition "Fault manager configuration.  Select up to 4 actions for each fault." VALUE 0x80000ABF RecordLayout_6 0 CompuMethod_484 0 65535 /end CHARACTERISTIC
/begin CHARACTERISTIC FaultManager.Charger_Line_Votlage_Too_High.Action_2 "Fault manager configuration.  Select up to 4 actions for each fault." VALUE 0x80000AC1 RecordLayout_6 0 CompuMethod_483 0 65535 /end CHARACTERISTIC
/begin CHARACTERISTIC FaultManager.Charger_Line_Votlage_Too_High.Action_2_Condition "Fault manager configuration.  Select up to 4 actions for each fault." VALUE 0x80000AC3 RecordLayout_6 0 CompuMethod_484 0 65535 /end CHARACTERISTIC
/begin CHARACTERISTIC FaultManager.Charger_Line_Votlage_Too_High.Action_3 "Fault manager configuration.  Select up to 4 actions for each fault." VALUE 0x80000AC5 RecordLayout_6 0 CompuMethod_483 0 65535 /end CHARACTERISTIC
/begin CHARACTERISTIC FaultManager.Charger_Line_Votlage_Too_High.Action_3_Condition "Fault manager configuration.  Select up to 4 actions for each fault." VALUE 0x80000AC7 RecordLayout_6 0 CompuMethod_484 0 65535 /end CHARACTERISTIC
/begin CHARACTERISTIC FaultManager.Charger_Line_Votlage_Too_High.Action_4 "Fault manager configuration.  Select up to 4 actions for each fault." VALUE 0x80000AC9 RecordLayout_6 0 CompuMethod_483 0 65535 /end CHARACTERISTIC
/begin CHARACTERISTIC FaultManager.Charger_Line_Votlage_Too_High.Action_4_Condition "Fault manager configuration.  Select up to 4 actions for each fault." VALUE 0x80000ACB RecordLayout_6 0 CompuMethod_484 0 65535 /end CHARACTERISTIC
/begin CHARACTERISTIC FaultManager.Charger_Requested_But_No_High_Voltage.Mode "Fault manager configuration.  Select up to 4 actions for each fault." VALUE 0x80000ACD RecordLayout_6 0 CompuMethod_481 0 65535 /end CHARACTERISTIC
/begin CHARACTERISTIC FaultManager.Charger_Requested_But_No_High_Voltage.ID "Fault manager configuration.  Select up to 4 actions for each fault." VALUE 0x80000ACF RecordLayout_6 0 CompuMethod_1 0 65535 /end CHARACTERISTIC
/begin CHARACTERISTIC FaultManager.Charger_Requested_But_No_High_Voltage.Test "Fault manager configuration.  Select up to 4 actions for each fault." VALUE 0x80000AD1 RecordLayout_6 0 CompuMethod_482 0 65535 /end CHARACTERISTIC
/begin CHARACTERISTIC FaultManager.Charger_Requested_But_No_High_Voltage.Faulty_Samples__X_ "Fault manager configuration.  Select up to 4 actions for each fault." VALUE 0x80000AD3 RecordLayout_6 0 CompuMethod_1 0 65535 /end CHARACTERISTIC
/begin CHARACTERISTIC FaultManager.Charger_Requested_But_No_High_Voltage.Total_Samples__Y_ "Fault manager configuration.  Select up to 4 actions for each fault." VALUE 0x80000AD5 RecordLayout_6 0 CompuMethod_1 0 65535 /end CHARACTERISTIC
/begin CHARACTERISTIC FaultManager.Charger_Requested_But_No_High_Voltage.Action_1 "Fault manager configuration.  Select up to 4 actions for each fault." VALUE 0x80000AD7 RecordLayout_6 0 CompuMethod_483 0 65535 /end CHARACTERISTIC
/begin CHARACTERISTIC FaultManager.Charger_Requested_But_No_High_Voltage.Action_1_Condition "Fault manager configuration.  Select up to 4 actions for each fault." VALUE 0x80000AD9 RecordLayout_6 0 CompuMethod_484 0 65535 /end CHARACTERISTIC
/begin CHARACTERISTIC FaultManager.Charger_Requested_But_No_High_Voltage.Action_2 "Fault manager configuration.  Select up to 4 actions for each fault." VALUE 0x80000ADB RecordLayout_6 0 CompuMethod_483 0 65535 /end CHARACTERISTIC
/begin CHARACTERISTIC FaultManager.Charger_Requested_But_No_High_Voltage.Action_2_Condition "Fault manager configuration.  Select up to 4 actions for each fault." VALUE 0x80000ADD RecordLayout_6 0 CompuMethod_484 0 65535 /end CHARACTERISTIC
/begin CHARACTERISTIC FaultManager.Charger_Requested_But_No_High_Voltage.Action_3 "Fault manager configuration.  Select up to 4 actions for each fault." VALUE 0x80000ADF RecordLayout_6 0 CompuMethod_483 0 65535 /end CHARACTERISTIC
/begin CHARACTERISTIC FaultManager.Charger_Requested_But_No_High_Voltage.Action_3_Condition "Fault manager configuration.  Select up to 4 actions for each fault." VALUE 0x80000AE1 RecordLayout_6 0 CompuMethod_484 0 65535 /end CHARACTERISTIC
/begin CHARACTERISTIC FaultManager.Charger_Requested_But_No_High_Voltage.Action_4 "Fault manager configuration.  Select up to 4 actions for each fault." VALUE 0x80000AE3 RecordLayout_6 0 CompuMethod_483 0 65535 /end CHARACTERISTIC
/begin CHARACTERISTIC FaultManager.Charger_Requested_But_No_High_Voltage.Action_4_Condition "Fault manager configuration.  Select up to 4 actions for each fault." VALUE 0x80000AE5 RecordLayout_6 0 CompuMethod_484 0 65535 /end CHARACTERISTIC
/begin CHARACTERISTIC FaultManager.Charger_Requested_But_No_Key_Singal.Mode "Fault manager configuration.  Select up to 4 actions for each fault." VALUE 0x80000AE7 RecordLayout_6 0 CompuMethod_481 0 65535 /end CHARACTERISTIC
/begin CHARACTERISTIC FaultManager.Charger_Requested_But_No_Key_Singal.ID "Fault manager configuration.  Select up to 4 actions for each fault." VALUE 0x80000AE9 RecordLayout_6 0 CompuMethod_1 0 65535 /end CHARACTERISTIC
/begin CHARACTERISTIC FaultManager.Charger_Requested_But_No_Key_Singal.Test "Fault manager configuration.  Select up to 4 actions for each fault." VALUE 0x80000AEB RecordLayout_6 0 CompuMethod_482 0 65535 /end CHARACTERISTIC
/begin CHARACTERISTIC FaultManager.Charger_Requested_But_No_Key_Singal.Faulty_Samples__X_ "Fault manager configuration.  Select up to 4 actions for each fault." VALUE 0x80000AED RecordLayout_6 0 CompuMethod_1 0 65535 /end CHARACTERISTIC
/begin CHARACTERISTIC FaultManager.Charger_Requested_But_No_Key_Singal.Total_Samples__Y_ "Fault manager configuration.  Select up to 4 actions for each fault." VALUE 0x80000AEF RecordLayout_6 0 CompuMethod_1 0 65535 /end CHARACTERISTIC
/begin CHARACTERISTIC FaultManager.Charger_Requested_But_No_Key_Singal.Action_1 "Fault manager configuration.  Select up to 4 actions for each fault." VALUE 0x80000AF1 RecordLayout_6 0 CompuMethod_483 0 65535 /end CHARACTERISTIC
/begin CHARACTERISTIC FaultManager.Charger_Requested_But_No_Key_Singal.Action_1_Condition "Fault manager configuration.  Select up to 4 actions for each fault." VALUE 0x80000AF3 RecordLayout_6 0 CompuMethod_484 0 65535 /end CHARACTERISTIC
/begin CHARACTERISTIC FaultManager.Charger_Requested_But_No_Key_Singal.Action_2 "Fault manager configuration.  Select up to 4 actions for each fault." VALUE 0x80000AF5 RecordLayout_6 0 CompuMethod_483 0 65535 /end CHARACTERISTIC
/begin CHARACTERISTIC FaultManager.Charger_Requested_But_No_Key_Singal.Action_2_Condition "Fault manager configuration.  Select up to 4 actions for each fault." VALUE 0x80000AF7 RecordLayout_6 0 CompuMethod_484 0 65535 /end CHARACTERISTIC
/begin CHARACTERISTIC FaultManager.Charger_Requested_But_No_Key_Singal.Action_3 "Fault manager configuration.  Select up to 4 actions for each fault." VALUE 0x80000AF9 RecordLayout_6 0 CompuMethod_483 0 65535 /end CHARACTERISTIC
/begin CHARACTERISTIC FaultManager.Charger_Requested_But_No_Key_Singal.Action_3_Condition "Fault manager configuration.  Select up to 4 actions for each fault." VALUE 0x80000AFB RecordLayout_6 0 CompuMethod_484 0 65535 /end CHARACTERISTIC
/begin CHARACTERISTIC FaultManager.Charger_Requested_But_No_Key_Singal.Action_4 "Fault manager configuration.  Select up to 4 actions for each fault." VALUE 0x80000AFD RecordLayout_6 0 CompuMethod_483 0 65535 /end CHARACTERISTIC
/begin CHARACTERISTIC FaultManager.Charger_Requested_But_No_Key_Singal.Action_4_Condition "Fault manager configuration.  Select up to 4 actions for each fault." VALUE 0x80000AFF RecordLayout_6 0 CompuMethod_484 0 65535 /end CHARACTERISTIC
/begin CHARACTERISTIC FaultManager.Charger_Requested_Current_Too_High.Mode "Fault manager configuration.  Select up to 4 actions for each fault." VALUE 0x80000B01 RecordLayout_6 0 CompuMethod_481 0 65535 /end CHARACTERISTIC
/begin CHARACTERISTIC FaultManager.Charger_Requested_Current_Too_High.ID "Fault manager configuration.  Select up to 4 actions for each fault." VALUE 0x80000B03 RecordLayout_6 0 CompuMethod_1 0 65535 /end CHARACTERISTIC
/begin CHARACTERISTIC FaultManager.Charger_Requested_Current_Too_High.Test "Fault manager configuration.  Select up to 4 actions for each fault." VALUE 0x80000B05 RecordLayout_6 0 CompuMethod_482 0 65535 /end CHARACTERISTIC
/begin CHARACTERISTIC FaultManager.Charger_Requested_Current_Too_High.Faulty_Samples__X_ "Fault manager configuration.  Select up to 4 actions for each fault." VALUE 0x80000B07 RecordLayout_6 0 CompuMethod_1 0 65535 /end CHARACTERISTIC
/begin CHARACTERISTIC FaultManager.Charger_Requested_Current_Too_High.Total_Samples__Y_ "Fault manager configuration.  Select up to 4 actions for each fault." VALUE 0x80000B09 RecordLayout_6 0 CompuMethod_1 0 65535 /end CHARACTERISTIC
/begin CHARACTERISTIC FaultManager.Charger_Requested_Current_Too_High.Action_1 "Fault manager configuration.  Select up to 4 actions for each fault." VALUE 0x80000B0B RecordLayout_6 0 CompuMethod_483 0 65535 /end CHARACTERISTIC
/begin CHARACTERISTIC FaultManager.Charger_Requested_Current_Too_High.Action_1_Condition "Fault manager configuration.  Select up to 4 actions for each fault." VALUE 0x80000B0D RecordLayout_6 0 CompuMethod_484 0 65535 /end CHARACTERISTIC
/begin CHARACTERISTIC FaultManager.Charger_Requested_Current_Too_High.Action_2 "Fault manager configuration.  Select up to 4 actions for each fault." VALUE 0x80000B0F RecordLayout_6 0 CompuMethod_483 0 65535 /end CHARACTERISTIC
/begin CHARACTERISTIC FaultManager.Charger_Requested_Current_Too_High.Action_2_Condition "Fault manager configuration.  Select up to 4 actions for each fault." VALUE 0x80000B11 RecordLayout_6 0 CompuMethod_484 0 65535 /end CHARACTERISTIC
/begin CHARACTERISTIC FaultManager.Charger_Requested_Current_Too_High.Action_3 "Fault manager configuration.  Select up to 4 actions for each fault." VALUE 0x80000B13 RecordLayout_6 0 CompuMethod_483 0 65535 /end CHARACTERISTIC
/begin CHARACTERISTIC FaultManager.Charger_Requested_Current_Too_High.Action_3_Condition "Fault manager configuration.  Select up to 4 actions for each fault." VALUE 0x80000B15 RecordLayout_6 0 CompuMethod_484 0 65535 /end CHARACTERISTIC
/begin CHARACTERISTIC FaultManager.Charger_Requested_Current_Too_High.Action_4 "Fault manager configuration.  Select up to 4 actions for each fault." VALUE 0x80000B17 RecordLayout_6 0 CompuMethod_483 0 65535 /end CHARACTERISTIC
/begin CHARACTERISTIC FaultManager.Charger_Requested_Current_Too_High.Action_4_Condition "Fault manager configuration.  Select up to 4 actions for each fault." VALUE 0x80000B19 RecordLayout_6 0 CompuMethod_484 0 65535 /end CHARACTERISTIC
/begin CHARACTERISTIC FaultManager.Charger_Requested_Voltage_Out_of_Bounds.Mode "Fault manager configuration.  Select up to 4 actions for each fault." VALUE 0x80000B1B RecordLayout_6 0 CompuMethod_481 0 65535 /end CHARACTERISTIC
/begin CHARACTERISTIC FaultManager.Charger_Requested_Voltage_Out_of_Bounds.ID "Fault manager configuration.  Select up to 4 actions for each fault." VALUE 0x80000B1D RecordLayout_6 0 CompuMethod_1 0 65535 /end CHARACTERISTIC
/begin CHARACTERISTIC FaultManager.Charger_Requested_Voltage_Out_of_Bounds.Test "Fault manager configuration.  Select up to 4 actions for each fault." VALUE 0x80000B1F RecordLayout_6 0 CompuMethod_482 0 65535 /end CHARACTERISTIC
/begin CHARACTERISTIC FaultManager.Charger_Requested_Voltage_Out_of_Bounds.Faulty_Samples__X_ "Fault manager configuration.  Select up to 4 actions for each fault." VALUE 0x80000B21 RecordLayout_6 0 CompuMethod_1 0 65535 /end CHARACTERISTIC
/begin CHARACTERISTIC FaultManager.Charger_Requested_Voltage_Out_of_Bounds.Total_Samples__Y_ "Fault manager configuration.  Select up to 4 actions for each fault." VALUE 0x80000B23 RecordLayout_6 0 CompuMethod_1 0 65535 /end CHARACTERISTIC
/begin CHARACTERISTIC FaultManager.Charger_Requested_Voltage_Out_of_Bounds.Action_1 "Fault manager configuration.  Select up to 4 actions for each fault." VALUE 0x80000B25 RecordLayout_6 0 CompuMethod_483 0 65535 /end CHARACTERISTIC
/begin CHARACTERISTIC FaultManager.Charger_Requested_Voltage_Out_of_Bounds.Action_1_Condition "Fault manager configuration.  Select up to 4 actions for each fault." VALUE 0x80000B27 RecordLayout_6 0 CompuMethod_484 0 65535 /end CHARACTERISTIC
/begin CHARACTERISTIC FaultManager.Charger_Requested_Voltage_Out_of_Bounds.Action_2 "Fault manager configuration.  Select up to 4 actions for each fault." VALUE 0x80000B29 RecordLayout_6 0 CompuMethod_483 0 65535 /end CHARACTERISTIC
/begin CHARACTERISTIC FaultManager.Charger_Requested_Voltage_Out_of_Bounds.Action_2_Condition "Fault manager configuration.  Select up to 4 actions for each fault." VALUE 0x80000B2B RecordLayout_6 0 CompuMethod_484 0 65535 /end CHARACTERISTIC
/begin CHARACTERISTIC FaultManager.Charger_Requested_Voltage_Out_of_Bounds.Action_3 "Fault manager configuration.  Select up to 4 actions for each fault." VALUE 0x80000B2D RecordLayout_6 0 CompuMethod_483 0 65535 /end CHARACTERISTIC
/begin CHARACTERISTIC FaultManager.Charger_Requested_Voltage_Out_of_Bounds.Action_3_Condition "Fault manager configuration.  Select up to 4 actions for each fault." VALUE 0x80000B2F RecordLayout_6 0 CompuMethod_484 0 65535 /end CHARACTERISTIC
/begin CHARACTERISTIC FaultManager.Charger_Requested_Voltage_Out_of_Bounds.Action_4 "Fault manager configuration.  Select up to 4 actions for each fault." VALUE 0x80000B31 RecordLayout_6 0 CompuMethod_483 0 65535 /end CHARACTERISTIC
/begin CHARACTERISTIC FaultManager.Charger_Requested_Voltage_Out_of_Bounds.Action_4_Condition "Fault manager configuration.  Select up to 4 actions for each fault." VALUE 0x80000B33 RecordLayout_6 0 CompuMethod_484 0 65535 /end CHARACTERISTIC
/begin CHARACTERISTIC FaultManager.Cruise_Control_Brake_Switch_A_Circuit_High.Mode "Fault manager configuration.  Select up to 4 actions for each fault." VALUE 0x80000B35 RecordLayout_6 0 CompuMethod_481 0 65535 /end CHARACTERISTIC
/begin CHARACTERISTIC FaultManager.Cruise_Control_Brake_Switch_A_Circuit_High.ID "Fault manager configuration.  Select up to 4 actions for each fault." VALUE 0x80000B37 RecordLayout_6 0 CompuMethod_1 0 65535 /end CHARACTERISTIC
/begin CHARACTERISTIC FaultManager.Cruise_Control_Brake_Switch_A_Circuit_High.Test "Fault manager configuration.  Select up to 4 actions for each fault." VALUE 0x80000B39 RecordLayout_6 0 CompuMethod_482 0 65535 /end CHARACTERISTIC
/begin CHARACTERISTIC FaultManager.Cruise_Control_Brake_Switch_A_Circuit_High.Faulty_Samples__X_ "Fault manager configuration.  Select up to 4 actions for each fault." VALUE 0x80000B3B RecordLayout_6 0 CompuMethod_1 0 65535 /end CHARACTERISTIC
/begin CHARACTERISTIC FaultManager.Cruise_Control_Brake_Switch_A_Circuit_High.Total_Samples__Y_ "Fault manager configuration.  Select up to 4 actions for each fault." VALUE 0x80000B3D RecordLayout_6 0 CompuMethod_1 0 65535 /end CHARACTERISTIC
/begin CHARACTERISTIC FaultManager.Cruise_Control_Brake_Switch_A_Circuit_High.Action_1 "Fault manager configuration.  Select up to 4 actions for each fault." VALUE 0x80000B3F RecordLayout_6 0 CompuMethod_483 0 65535 /end CHARACTERISTIC
/begin CHARACTERISTIC FaultManager.Cruise_Control_Brake_Switch_A_Circuit_High.Action_1_Condition "Fault manager configuration.  Select up to 4 actions for each fault." VALUE 0x80000B41 RecordLayout_6 0 CompuMethod_484 0 65535 /end CHARACTERISTIC
/begin CHARACTERISTIC FaultManager.Cruise_Control_Brake_Switch_A_Circuit_High.Action_2 "Fault manager configuration.  Select up to 4 actions for each fault." VALUE 0x80000B43 RecordLayout_6 0 CompuMethod_483 0 65535 /end CHARACTERISTIC
/begin CHARACTERISTIC FaultManager.Cruise_Control_Brake_Switch_A_Circuit_High.Action_2_Condition "Fault manager configuration.  Select up to 4 actions for each fault." VALUE 0x80000B45 RecordLayout_6 0 CompuMethod_484 0 65535 /end CHARACTERISTIC
/begin CHARACTERISTIC FaultManager.Cruise_Control_Brake_Switch_A_Circuit_High.Action_3 "Fault manager configuration.  Select up to 4 actions for each fault." VALUE 0x80000B47 RecordLayout_6 0 CompuMethod_483 0 65535 /end CHARACTERISTIC
/begin CHARACTERISTIC FaultManager.Cruise_Control_Brake_Switch_A_Circuit_High.Action_3_Condition "Fault manager configuration.  Select up to 4 actions for each fault." VALUE 0x80000B49 RecordLayout_6 0 CompuMethod_484 0 65535 /end CHARACTERISTIC
/begin CHARACTERISTIC FaultManager.Cruise_Control_Brake_Switch_A_Circuit_High.Action_4 "Fault manager configuration.  Select up to 4 actions for each fault." VALUE 0x80000B4B RecordLayout_6 0 CompuMethod_483 0 65535 /end CHARACTERISTIC
/begin CHARACTERISTIC FaultManager.Cruise_Control_Brake_Switch_A_Circuit_High.Action_4_Condition "Fault manager configuration.  Select up to 4 actions for each fault." VALUE 0x80000B4D RecordLayout_6 0 CompuMethod_484 0 65535 /end CHARACTERISTIC
/begin CHARACTERISTIC FaultManager.Cruise_Control_Brake_Switch_A_Circuit_Low.Mode "Fault manager configuration.  Select up to 4 actions for each fault." VALUE 0x80000B4F RecordLayout_6 0 CompuMethod_481 0 65535 /end CHARACTERISTIC
/begin CHARACTERISTIC FaultManager.Cruise_Control_Brake_Switch_A_Circuit_Low.ID "Fault manager configuration.  Select up to 4 actions for each fault." VALUE 0x80000B51 RecordLayout_6 0 CompuMethod_1 0 65535 /end CHARACTERISTIC
/begin CHARACTERISTIC FaultManager.Cruise_Control_Brake_Switch_A_Circuit_Low.Test "Fault manager configuration.  Select up to 4 actions for each fault." VALUE 0x80000B53 RecordLayout_6 0 CompuMethod_482 0 65535 /end CHARACTERISTIC
/begin CHARACTERISTIC FaultManager.Cruise_Control_Brake_Switch_A_Circuit_Low.Faulty_Samples__X_ "Fault manager configuration.  Select up to 4 actions for each fault." VALUE 0x80000B55 RecordLayout_6 0 CompuMethod_1 0 65535 /end CHARACTERISTIC
/begin CHARACTERISTIC FaultManager.Cruise_Control_Brake_Switch_A_Circuit_Low.Total_Samples__Y_ "Fault manager configuration.  Select up to 4 actions for each fault." VALUE 0x80000B57 RecordLayout_6 0 CompuMethod_1 0 65535 /end CHARACTERISTIC
/begin CHARACTERISTIC FaultManager.Cruise_Control_Brake_Switch_A_Circuit_Low.Action_1 "Fault manager configuration.  Select up to 4 actions for each fault." VALUE 0x80000B59 RecordLayout_6 0 CompuMethod_483 0 65535 /end CHARACTERISTIC
/begin CHARACTERISTIC FaultManager.Cruise_Control_Brake_Switch_A_Circuit_Low.Action_1_Condition "Fault manager configuration.  Select up to 4 actions for each fault." VALUE 0x80000B5B RecordLayout_6 0 CompuMethod_484 0 65535 /end CHARACTERISTIC
/begin CHARACTERISTIC FaultManager.Cruise_Control_Brake_Switch_A_Circuit_Low.Action_2 "Fault manager configuration.  Select up to 4 actions for each fault." VALUE 0x80000B5D RecordLayout_6 0 CompuMethod_483 0 65535 /end CHARACTERISTIC
/begin CHARACTERISTIC FaultManager.Cruise_Control_Brake_Switch_A_Circuit_Low.Action_2_Condition "Fault manager configuration.  Select up to 4 actions for each fault." VALUE 0x80000B5F RecordLayout_6 0 CompuMethod_484 0 65535 /end CHARACTERISTIC
/begin CHARACTERISTIC FaultManager.Cruise_Control_Brake_Switch_A_Circuit_Low.Action_3 "Fault manager configuration.  Select up to 4 actions for each fault." VALUE 0x80000B61 RecordLayout_6 0 CompuMethod_483 0 65535 /end CHARACTERISTIC
/begin CHARACTERISTIC FaultManager.Cruise_Control_Brake_Switch_A_Circuit_Low.Action_3_Condition "Fault manager configuration.  Select up to 4 actions for each fault." VALUE 0x80000B63 RecordLayout_6 0 CompuMethod_484 0 65535 /end CHARACTERISTIC
/begin CHARACTERISTIC FaultManager.Cruise_Control_Brake_Switch_A_Circuit_Low.Action_4 "Fault manager configuration.  Select up to 4 actions for each fault." VALUE 0x80000B65 RecordLayout_6 0 CompuMethod_483 0 65535 /end CHARACTERISTIC
/begin CHARACTERISTIC FaultManager.Cruise_Control_Brake_Switch_A_Circuit_Low.Action_4_Condition "Fault manager configuration.  Select up to 4 actions for each fault." VALUE 0x80000B67 RecordLayout_6 0 CompuMethod_484 0 65535 /end CHARACTERISTIC
/begin CHARACTERISTIC FaultManager.Cruise_Control_Brake_Switch_A_Circuit_Malfunction.Mode "Fault manager configuration.  Select up to 4 actions for each fault." VALUE 0x80000B69 RecordLayout_6 0 CompuMethod_481 0 65535 /end CHARACTERISTIC
/begin CHARACTERISTIC FaultManager.Cruise_Control_Brake_Switch_A_Circuit_Malfunction.ID "Fault manager configuration.  Select up to 4 actions for each fault." VALUE 0x80000B6B RecordLayout_6 0 CompuMethod_1 0 65535 /end CHARACTERISTIC
/begin CHARACTERISTIC FaultManager.Cruise_Control_Brake_Switch_A_Circuit_Malfunction.Test "Fault manager configuration.  Select up to 4 actions for each fault." VALUE 0x80000B6D RecordLayout_6 0 CompuMethod_482 0 65535 /end CHARACTERISTIC
/begin CHARACTERISTIC FaultManager.Cruise_Control_Brake_Switch_A_Circuit_Malfunction.Faulty_Samples__X_ "Fault manager configuration.  Select up to 4 actions for each fault." VALUE 0x80000B6F RecordLayout_6 0 CompuMethod_1 0 65535 /end CHARACTERISTIC
/begin CHARACTERISTIC FaultManager.Cruise_Control_Brake_Switch_A_Circuit_Malfunction.Total_Samples__Y_ "Fault manager configuration.  Select up to 4 actions for each fault." VALUE 0x80000B71 RecordLayout_6 0 CompuMethod_1 0 65535 /end CHARACTERISTIC
/begin CHARACTERISTIC FaultManager.Cruise_Control_Brake_Switch_A_Circuit_Malfunction.Action_1 "Fault manager configuration.  Select up to 4 actions for each fault." VALUE 0x80000B73 RecordLayout_6 0 CompuMethod_483 0 65535 /end CHARACTERISTIC
/begin CHARACTERISTIC FaultManager.Cruise_Control_Brake_Switch_A_Circuit_Malfunction.Action_1_Condition "Fault manager configuration.  Select up to 4 actions for each fault." VALUE 0x80000B75 RecordLayout_6 0 CompuMethod_484 0 65535 /end CHARACTERISTIC
/begin CHARACTERISTIC FaultManager.Cruise_Control_Brake_Switch_A_Circuit_Malfunction.Action_2 "Fault manager configuration.  Select up to 4 actions for each fault." VALUE 0x80000B77 RecordLayout_6 0 CompuMethod_483 0 65535 /end CHARACTERISTIC
/begin CHARACTERISTIC FaultManager.Cruise_Control_Brake_Switch_A_Circuit_Malfunction.Action_2_Condition "Fault manager configuration.  Select up to 4 actions for each fault." VALUE 0x80000B79 RecordLayout_6 0 CompuMethod_484 0 65535 /end CHARACTERISTIC
/begin CHARACTERISTIC FaultManager.Cruise_Control_Brake_Switch_A_Circuit_Malfunction.Action_3 "Fault manager configuration.  Select up to 4 actions for each fault." VALUE 0x80000B7B RecordLayout_6 0 CompuMethod_483 0 65535 /end CHARACTERISTIC
/begin CHARACTERISTIC FaultManager.Cruise_Control_Brake_Switch_A_Circuit_Malfunction.Action_3_Condition "Fault manager configuration.  Select up to 4 actions for each fault." VALUE 0x80000B7D RecordLayout_6 0 CompuMethod_484 0 65535 /end CHARACTERISTIC
/begin CHARACTERISTIC FaultManager.Cruise_Control_Brake_Switch_A_Circuit_Malfunction.Action_4 "Fault manager configuration.  Select up to 4 actions for each fault." VALUE 0x80000B7F RecordLayout_6 0 CompuMethod_483 0 65535 /end CHARACTERISTIC
/begin CHARACTERISTIC FaultManager.Cruise_Control_Brake_Switch_A_Circuit_Malfunction.Action_4_Condition "Fault manager configuration.  Select up to 4 actions for each fault." VALUE 0x80000B81 RecordLayout_6 0 CompuMethod_484 0 65535 /end CHARACTERISTIC
/begin CHARACTERISTIC FaultManager.Cruise_Control_Coast_Signal_Malfunction.Mode "Fault manager configuration.  Select up to 4 actions for each fault." VALUE 0x80000B83 RecordLayout_6 0 CompuMethod_481 0 65535 /end CHARACTERISTIC
/begin CHARACTERISTIC FaultManager.Cruise_Control_Coast_Signal_Malfunction.ID "Fault manager configuration.  Select up to 4 actions for each fault." VALUE 0x80000B85 RecordLayout_6 0 CompuMethod_1 0 65535 /end CHARACTERISTIC
/begin CHARACTERISTIC FaultManager.Cruise_Control_Coast_Signal_Malfunction.Test "Fault manager configuration.  Select up to 4 actions for each fault." VALUE 0x80000B87 RecordLayout_6 0 CompuMethod_482 0 65535 /end CHARACTERISTIC
/begin CHARACTERISTIC FaultManager.Cruise_Control_Coast_Signal_Malfunction.Faulty_Samples__X_ "Fault manager configuration.  Select up to 4 actions for each fault." VALUE 0x80000B89 RecordLayout_6 0 CompuMethod_1 0 65535 /end CHARACTERISTIC
/begin CHARACTERISTIC FaultManager.Cruise_Control_Coast_Signal_Malfunction.Total_Samples__Y_ "Fault manager configuration.  Select up to 4 actions for each fault." VALUE 0x80000B8B RecordLayout_6 0 CompuMethod_1 0 65535 /end CHARACTERISTIC
/begin CHARACTERISTIC FaultManager.Cruise_Control_Coast_Signal_Malfunction.Action_1 "Fault manager configuration.  Select up to 4 actions for each fault." VALUE 0x80000B8D RecordLayout_6 0 CompuMethod_483 0 65535 /end CHARACTERISTIC
/begin CHARACTERISTIC FaultManager.Cruise_Control_Coast_Signal_Malfunction.Action_1_Condition "Fault manager configuration.  Select up to 4 actions for each fault." VALUE 0x80000B8F RecordLayout_6 0 CompuMethod_484 0 65535 /end CHARACTERISTIC
/begin CHARACTERISTIC FaultManager.Cruise_Control_Coast_Signal_Malfunction.Action_2 "Fault manager configuration.  Select up to 4 actions for each fault." VALUE 0x80000B91 RecordLayout_6 0 CompuMethod_483 0 65535 /end CHARACTERISTIC
/begin CHARACTERISTIC FaultManager.Cruise_Control_Coast_Signal_Malfunction.Action_2_Condition "Fault manager configuration.  Select up to 4 actions for each fault." VALUE 0x80000B93 RecordLayout_6 0 CompuMethod_484 0 65535 /end CHARACTERISTIC
/begin CHARACTERISTIC FaultManager.Cruise_Control_Coast_Signal_Malfunction.Action_3 "Fault manager configuration.  Select up to 4 actions for each fault." VALUE 0x80000B95 RecordLayout_6 0 CompuMethod_483 0 65535 /end CHARACTERISTIC
/begin CHARACTERISTIC FaultManager.Cruise_Control_Coast_Signal_Malfunction.Action_3_Condition "Fault manager configuration.  Select up to 4 actions for each fault." VALUE 0x80000B97 RecordLayout_6 0 CompuMethod_484 0 65535 /end CHARACTERISTIC
/begin CHARACTERISTIC FaultManager.Cruise_Control_Coast_Signal_Malfunction.Action_4 "Fault manager configuration.  Select up to 4 actions for each fault." VALUE 0x80000B99 RecordLayout_6 0 CompuMethod_483 0 65535 /end CHARACTERISTIC
/begin CHARACTERISTIC FaultManager.Cruise_Control_Coast_Signal_Malfunction.Action_4_Condition "Fault manager configuration.  Select up to 4 actions for each fault." VALUE 0x80000B9B RecordLayout_6 0 CompuMethod_484 0 65535 /end CHARACTERISTIC
/begin CHARACTERISTIC FaultManager.Cruise_Control_Off_Signal_Malfunction.Mode "Fault manager configuration.  Select up to 4 actions for each fault." VALUE 0x80000B9D RecordLayout_6 0 CompuMethod_481 0 65535 /end CHARACTERISTIC
/begin CHARACTERISTIC FaultManager.Cruise_Control_Off_Signal_Malfunction.ID "Fault manager configuration.  Select up to 4 actions for each fault." VALUE 0x80000B9F RecordLayout_6 0 CompuMethod_1 0 65535 /end CHARACTERISTIC
/begin CHARACTERISTIC FaultManager.Cruise_Control_Off_Signal_Malfunction.Test "Fault manager configuration.  Select up to 4 actions for each fault." VALUE 0x80000BA1 RecordLayout_6 0 CompuMethod_482 0 65535 /end CHARACTERISTIC
/begin CHARACTERISTIC FaultManager.Cruise_Control_Off_Signal_Malfunction.Faulty_Samples__X_ "Fault manager configuration.  Select up to 4 actions for each fault." VALUE 0x80000BA3 RecordLayout_6 0 CompuMethod_1 0 65535 /end CHARACTERISTIC
/begin CHARACTERISTIC FiltConst "Filter time constant" VALUE 0x800011E9 RecordLayout_4 0 CompuMethod_485 -1E+17 1E+17 /end CHARACTERISTIC
/begin CHARACTERISTIC Gear_Shift_Module_Communication_Circuit "" VALUE 0x80001227 RecordLayout_4 0 CompuMethod_2 -1E+17 1E+17 /end CHARACTERISTIC
/begin CHARACTERISTIC Mode_1 "" VALUE 0x80001415 RecordLayout_4 0 CompuMethod_2 -1E+17 1E+17 /end CHARACTERISTIC
/begin CHARACTERISTIC Mode_2 "" VALUE 0x8000141E RecordLayout_4 0 CompuMethod_2 -1E+17 1E+17 /end CHARACTERISTIC
/begin CHARACTERISTIC Mode_3 "" VALUE 0x80001427 RecordLayout_4 0 CompuMethod_2 -1E+17 1E+17 /end CHARACTERISTIC
/begin CHARACTERISTIC Mode_4 "" VALUE 0x80001430 RecordLayout_4 0 CompuMethod_2 -1E+17 1E+17 /end CHARACTERISTIC
/begin CHARACTERISTIC MPRD_KeepAlive "When enabled, keeps the MPRD output on and keeps the processor alive" VALUE 0x80001465 RecordLayout_3 0 CompuMethod_492 0 1 /end CHARACTERISTIC
/begin CHARACTERISTIC Park_Nuetral_Switch_Input_High_Fault "" VALUE 0x80001493 RecordLayout_4 0 CompuMethod_2 -1E+17 1E+17 /end CHARACTERISTIC
/begin CHARACTERISTIC Park_Nuetral_Switch_Input_Low_Fault "" VALUE 0x80001497 RecordLayout_4 0 CompuMethod_2 -1E+17 1E+17 /end CHARACTERISTIC
/begin CHARACTERISTIC ProcessorReboot "Reboots the processor when set." VALUE 0x800014C5 RecordLayout_3 0 CompuMethod_500 0 1 /end CHARACTERISTIC
/begin CHARACTERISTIC RPM_to_Wheel_Speed_Multiplier2 "" VALUE 0x80001553 RecordLayout_4 0 CompuMethod_2 -1E+17 1E+17 /end CHARACTERISTIC
/begin CHARACTERISTIC Shutdown_Req "" VALUE 0x800016D5 RecordLayout_3 0 CompuMethod_11 0 1 /end CHARACTERISTIC
/begin CHARACTERISTIC VEH_ID "" VALUE 0x800018C0 RecordLayout_4 0 CompuMethod_2 -1E+17 1E+17 /end CHARACTERISTIC
/begin CHARACTERISTIC VIN_DATA_BYTE_1 "" VALUE 0x800018E9 RecordLayout_4 0 CompuMethod_2 -1E+17 1E+17 /end CHARACTERISTIC
/begin CHARACTERISTIC VIN_DATA_BYTE_10 "" VALUE 0x800018F2 RecordLayout_4 0 CompuMethod_2 -1E+17 1E+17 /end CHARACTERISTIC
/begin CHARACTERISTIC VIN_DATA_BYTE_11 "" VALUE 0x800018FB RecordLayout_4 0 CompuMethod_2 -1E+17 1E+17 /end CHARACTERISTIC
/begin CHARACTERISTIC VIN_DATA_BYTE_12 "" VALUE 0x80001904 RecordLayout_4 0 CompuMethod_2 -1E+17 1E+17 /end CHARACTERISTIC
/begin CHARACTERISTIC VIN_DATA_BYTE_13 "" VALUE 0x8000190D RecordLayout_4 0 CompuMethod_2 -1E+17 1E+17 /end CHARACTERISTIC
/begin CHARACTERISTIC VIN_DATA_BYTE_14 "" VALUE 0x80001916 RecordLayout_4 0 CompuMethod_2 -1E+17 1E+17 /end CHARACTERISTIC
/begin CHARACTERISTIC VIN_DATA_BYTE_15 "" VALUE 0x8000191F RecordLayout_4 0 CompuMethod_2 -1E+17 1E+17 /end CHARACTERISTIC
/begin CHARACTERISTIC VIN_DATA_BYTE_16 "" VALUE 0x80001928 RecordLayout_4 0 CompuMethod_2 -1E+17 1E+17 /end CHARACTERISTIC
/begin CHARACTERISTIC VIN_DATA_BYTE_17 "" VALUE 0x80001931 RecordLayout_4 0 CompuMethod_2 -1E+17 1E+17 /end CHARACTERISTIC
/begin CHARACTERISTIC VIN_DATA_BYTE_2 "" VALUE 0x8000193A RecordLayout_4 0 CompuMethod_2 -1E+17 1E+17 /end CHARACTERISTIC
/begin CHARACTERISTIC VIN_DATA_BYTE_3 "" VALUE 0x80001943 RecordLayout_4 0 CompuMethod_2 -1E+17 1E+17 /end CHARACTERISTIC
/begin CHARACTERISTIC VIN_DATA_BYTE_4 "" VALUE 0x8000194C RecordLayout_4 0 CompuMethod_2 -1E+17 1E+17 /end CHARACTERISTIC
/begin CHARACTERISTIC VIN_DATA_BYTE_5 "" VALUE 0x80001955 RecordLayout_4 0 CompuMethod_2 -1E+17 1E+17 /end CHARACTERISTIC
/begin CHARACTERISTIC VIN_DATA_BYTE_6 "" VALUE 0x8000195E RecordLayout_4 0 CompuMethod_2 -1E+17 1E+17 /end CHARACTERISTIC
/begin CHARACTERISTIC VIN_DATA_BYTE_7 "" VALUE 0x80001967 RecordLayout_4 0 CompuMethod_2 -1E+17 1E+17 /end CHARACTERISTIC
/begin CHARACTERISTIC VIN_DATA_BYTE_8 "" VALUE 0x80001970 RecordLayout_4 0 CompuMethod_2 -1E+17 1E+17 /end CHARACTERISTIC
/begin CHARACTERISTIC VIN_DATA_BYTE_9 "" VALUE 0x80001979 RecordLayout_4 0 CompuMethod_2 -1E+17 1E+17 /end CHARACTERISTIC
/begin RECORD_LAYOUT RecordLayout_2 FNC_VALUES 1 ULONG ROW_DIR DIRECT /end RECORD_LAYOUT
/begin RECORD_LAYOUT RecordLayout_3 FNC_VALUES 1 UBYTE ROW_DIR DIRECT /end RECORD_LAYOUT
/begin RECORD_LAYOUT RecordLayout_4 FNC_VALUES 1 FLOAT32_IEEE ROW_DIR DIRECT /end RECORD_LAYOUT
/begin RECORD_LAYOUT RecordLayout_6 FNC_VALUES 1 UWORD ROW_DIR DIRECT /end RECORD_LAYOUT
/*~~~~~~~~~ 6.3.31 COMPU_METHODs ~~~~~~~~~*/
/begin COMPU_METHOD CompuMethod_1 "" RAT_FUNC "%3.0" "" COEFFS 0 1 0 0 0 1 /end COMPU_METHOD
/begin COMPU_METHOD CompuMethod_2 "" RAT_FUNC "%6.2" "" COEFFS 0 1 0 0 0 1 /end COMPU_METHOD
/begin COMPU_METHOD CompuMethod_5 "" RAT_FUNC "%5.0" "" COEFFS 0 1 0 0 0 1 /end COMPU_METHOD
/begin COMPU_METHOD CompuMethod_6 "" RAT_FUNC "%8.0" "" COEFFS 0 1 0 0 0 1 /end COMPU_METHOD
/begin COMPU_METHOD CompuMethod_7 "" TAB_VERB "%1.0" "" COMPU_TAB_REF CompuVtab_2 /end COMPU_METHOD
/begin COMPU_METHOD CompuMethod_11 "" RAT_FUNC "%1.0" "" COEFFS 0 1 0 0 0 1 /end COMPU_METHOD
/begin COMPU_METHOD CompuMethod_477 "" RAT_FUNC "%5.0" "ADC_counts" COEFFS 0 1 0 0 0 1 /end COMPU_METHOD
/begin COMPU_METHOD CompuMethod_479 "" TAB_VERB "%3.0" "" COMPU_TAB_REF CompuVtab_465 /end COMPU_METHOD
/begin COMPU_METHOD CompuMethod_480 "" TAB_VERB "%3.0" "" COMPU_TAB_REF CompuVtab_466 /end COMPU_METHOD
/begin COMPU_METHOD CompuMethod_481 "" TAB_VERB "%3.0" "" COMPU_TAB_REF CompuVtab_467 /end COMPU_METHOD
/begin COMPU_METHOD CompuMethod_482 "" TAB_VERB "%3.0" "" COMPU_TAB_REF CompuVtab_468 /end COMPU_METHOD
/begin COMPU_METHOD CompuMethod_483 "" TAB_VERB "%3.0" "" COMPU_TAB_REF CompuVtab_469 /end COMPU_METHOD
/begin COMPU_METHOD CompuMethod_484 "" TAB_VERB "%3.0" "" COMPU_TAB_REF CompuVtab_470 /end COMPU_METHOD
/begin COMPU_METHOD CompuMethod_485 "" RAT_FUNC "%6.2" "sec" COEFFS 0 1 0 0 0 1 /end COMPU_METHOD
/begin COMPU_METHOD CompuMethod_491 "" TAB_VERB "%1.0" "" COMPU_TAB_REF CompuVtab_473 /end COMPU_METHOD
/begin COMPU_METHOD CompuMethod_492 "" TAB_VERB "%1.0" "" COMPU_TAB_REF CompuVtab_474 /end COMPU_METHOD
/begin COMPU_METHOD CompuMethod_500 "" TAB_VERB "%1.0" "" COMPU_TAB_REF CompuVtab_479 /end COMPU_METHOD
/begin COMPU_VTAB CompuVtab_2 "" TAB_VERB 2 0 "Pass-Through" 1 "Override" /end COMPU_VTAB
/begin COMPU_VTAB CompuVtab_465 "" TAB_VERB 97 0 "ABS_ToneRing_AgeCount" 1 "ABS_Traction_Control_AgeCount" 2 "ABS_WheelSpeed_AgeCount" 3 "Battery_AgeCount" 4 "Battery_Voltage_Too_High" 5 "Battery_Voltage_Too_Low" 6 "Blend_Valve_A_No_Response" 7 "Blend_Valve_B_No_Response" 8 "Blend_Valve_Sensor_A_High_Voltage" 9 "Blend_Valve_Sensor_A_Intermittent" 10 "Blend_Valve_Sensor_A_Low_Voltage" 11 "Blend_Valve_Sensor_B_High_Voltage" 12 "Blend_Valve_Sensor_B_Intermittent" 13 "Blend_Valve_Sensor_B_Low_Voltage" 14 "Brake_Pedal_Position_Communication_Loss" 15 "Brake_Pedal_Position_Intermiitent" 16 "Brake_Pedal_Position_Low" 17 "Brake_Pedal_Position_Sensor_A_Circuit_High" 18 "Brakes_AgeCount" 19 "Charge_Complete_Cell_Max_Volt" 20 "Charger_Amperage_Draw_Greater_Then_Supply" 21 "Charger_Derated_Over_Temperature" 22 "Charger_Derated_Under_Temperature" 23 "Charger_Internal_Fault" 24 "Charger_Line_Voltage_Too_Low" 25 "Charger_Line_Votlage_Too_High" 26 "Charger_Requested_But_No_High_Voltage" 27 "Charger_Requested_But_No_Key_Singal" 28 "Charger_Requested_Current_Too_High" 29 "Charger_Requested_Voltage_Out_of_Bounds" 30 "Cruise_Control_Brake_Switch_A_Circuit_High" 31 "Cruise_Control_Brake_Switch_A_Circuit_Low" 32 "Cruise_Control_Brake_Switch_A_Circuit_Malfunction" 33 "Cruise_Control_Coast_Signal_Malfunction" 34 "Cruise_Control_Off_Signal_Malfunction" 35 "Cruise_Control_On_Signal_Malfunction" 36 "Cruise_Control_Resume_Signal_Malfunction" 37 "Cruise_Control_Set_Signal_Malfunction" 38 "DCDC_Converter_Not_Running" 39 "Drive_Switch_Input_Circuit" 40 "Drive_Switch_Input_High" 41 "Drive_Switch_Input_Low" 42 "Eaton_Charger_AgeCount" 43 "Electric_Motor_Approaching_Over_Temperature" 44 "Electric_Motor_Derated_Over_Temperature" 45 "Electric_Motor_Derated_Over_Voltage" 46 "Electric_Motor_Derated_Under_Temperature" 47 "Electric_Motor_Derated_Under_Voltage" 48 "Electric_Motor_General_Error" 49 "Electric_Motor_Over_Speed_Forward" 50 "Electric_Motor_Over_Speed_Reverse" 51 "Electric_Motor_Shutodwn_Error" 52 "Electric_Motor_Torque_Output_Fault" 53 "Gear_Shift_Communication_Circuit" 54 "HV_Battery_2G_BMS_Fault" 55 "HV_Battery_48_Controller_Communication_Fault" 56 "HV_Battery_Above_Safe_Charge_Point" 57 "HV_Battery_Cell_Balancing_Required_Fault" 58 "HV_Battery_Pack_Above_Operating_Temperature" 59 "HV_Battery_Pack_Below_Operating_Temperature" 60 "HV_Battery_Pack_High_Temperature" 61 "HV_Battery_Pack_Low_Temperature" 62 "HV_Battery_Precharge_Failure" 63 "HV_Battery_Too_Low_For_Load" 64 "HV_Battery_Try_To_Balance_Under_Load" 65 "HV_Heater_Over_Temperature" 66 "HV_Heater_Poor_Performance" 67 "HV_Heater_Temperature_Sensor_A_High_Voltage" 68 "HV_Heater_Temperature_Sensor_A_Intermittent" 69 "HV_Heater_Temperature_Sensor_A_Low_Voltage" 70 "IPT_DCDC_AgeCount" 71 "IPT_Status1_AgeCount" 72 "IPT_Status2_AgeCount" 73 "Key_Line_Voltage" 74 "Key_Off_Voltage_High" 75 "Park_Nuetral_Switch_Input_Circuit" 76 "Park_Nuetral_Switch_Input_High" 77 "Park_Nuetral_Switch_Input_Low" 78 "Pedal_Position_Sensor_A_Circuit_High" 79 "Pedal_Position_Sensor_A_Circuit_Intermittent" 80 "Pedal_Position_Sensor_A_Circuit_Low" 81 "Steering_Wheel_AgeCount" 82 "System_Voltage_High" 83 "System_Voltage_Low" 84 "System_Voltage_Malfunction" 85 "System_Voltage_Unstable" 86 "Traction_Control_General_Fault" 87 "Traction_Control_LeftFront_Malfunction" 88 "Traction_Control_LeftRear_Malfunction" 89 "Traction_Control_RightFront_Malfunction" 90 "Traction_Control_RightRear_Malfunction" 91 "Transmission_AgeCount" 92 "Vehcile_Speed_Sensor_Malfunction" 93 "Vehicle_Speed_Sensor_Circuit_Low" 94 "Vehicle_Speed_Sensor_Erratic" 95 "Vehicle_Speed_Sensor_Rang_Performance" 96 "(None)" /end COMPU_VTAB
/begin COMPU_VTAB CompuVtab_466 "" TAB_VERB 2 0 "-" 1 "Clear All Faults" /end COMPU_VTAB
/begin COMPU_VTAB CompuVtab_467 "" TAB_VERB 6 0 "Disabled" 1 "Enabled" 2 "Sticky" 3 "Enabled - Persistent" 4 "Sticky - Persistent" 5 "Save Occurred" /end COMPU_VTAB
/begin COMPU_VTAB CompuVtab_468 "" TAB_VERB 2 0 "-" 1 "Test" /end COMPU_VTAB
/begin COMPU_VTAB CompuVtab_469 "" TAB_VERB 17 0 "Batt_Light" 1 "Batt_Shutdown" 2 "Cell_Voltage_Max" 3 "Check_Engine_Light" 4 "Check_Engine_Light_Flashing" 5 "Cooling_Max" 6 "Cruise" 7 "Dyno_Shutdown" 8 "EatonChargerFault" 9 "HV_Light" 10 "Pump_On" 11 "Regen_Brakes_Disabled" 12 "Set_Crawl_Home" 13 "Temperature_Flash" 14 "Temperature_Solid" 15 "Wrench_Light" 16 "(None)" /end COMPU_VTAB
/begin COMPU_VTAB CompuVtab_470 "" TAB_VERB 8 0 "(None)" 1 "Suspected" 2 "Active" 3 "Suspected or Active" 4 "Occurred" 5 "Suspected or Occurred" 6 "Active or Occurred" 7 "Suspected or Active or Occurred" /end COMPU_VTAB
/begin COMPU_VTAB CompuVtab_473 "" TAB_VERB 2 0 "Disabled" 1 "Enabled" /end COMPU_VTAB
/begin COMPU_VTAB CompuVtab_474 "" TAB_VERB 2 0 "Disable on low ECUP" 1 "Keep alive" /end COMPU_VTAB
/begin COMPU_VTAB CompuVtab_479 "" TAB_VERB 2 0 "Run" 1 "Reboot" /end COMPU_VTAB
/begin FUNCTION Cruise_Control_SetP_Ovr_Override "" /begin DEF_CHARACTERISTIC Cruise_Control_SetP_Ovr_new Cruise_Control_SetP_Ovr_ovr /end DEF_CHARACTERISTIC /end FUNCTION
/begin FUNCTION Cruise_Ctrl_Light_Ovr_Override "" /begin DEF_CHARACTERISTIC Cruise_Ctrl_Light_Ovr_new Cruise_Ctrl_Light_Ovr_ovr /end DEF_CHARACTERISTIC /end FUNCTION
/begin FUNCTION Cruise_Control_2 "" /begin DEF_CHARACTERISTIC Cruise_Disable_Brake_Fault1 Cruise_Disable_Brake_Fault2 /end DEF_CHARACTERISTIC /end FUNCTION
/begin FUNCTION Current_Limit_Override_Override "" /begin DEF_CHARACTERISTIC Current_Limit_Override_new Current_Limit_Override_ovr /end DEF_CHARACTERISTIC /end FUNCTION
/begin FUNCTION Current_Ovr_Override "" /begin DEF_CHARACTERISTIC Current_Ovr_new Current_Ovr_ovr /end DEF_CHARACTERISTIC /end FUNCTION
/begin FUNCTION IPT "" /begin DEF_CHARACTERISTIC CurrentLimitingEnabled FiltConst /end DEF_CHARACTERISTIC
 /begin OUT_MEASUREMENT IPT_Direction_Prb pre_Filter_Torque_Request Torque_Request_Probe /end OUT_MEASUREMENT
 /begin SUB_FUNCTION CurrentLimiting_TurboRequest Torque_Request_Override_Override Drive Reverse /end SUB_FUNCTION
/end FUNCTION
/begin FUNCTION VIN_Output_and_Button_Probing ""
 /begin DEF_CHARACTERISTIC Data_Mode_1 DATA_MODE_2 DATA_MODE_3 DATA_MODE_4 Mode_1 Mode_2 Mode_3 Mode_4 VEH_ID VIN_DATA_BYTE_1 VIN_DATA_BYTE_10 VIN_DATA_BYTE_11 VIN_DATA_BYTE_12 VIN_DATA_BYTE_13 VIN_DATA_BYTE_14 VIN_DATA_BYTE_15 VIN_DATA_BYTE_16 VIN_DATA_BYTE_17 VIN_DATA_BYTE_2 VIN_DATA_BYTE_3 VIN_DATA_BYTE_4 VIN_DATA_BYTE_5 VIN_DATA_BYTE_6 VIN_DATA_BYTE_7 VIN_DATA_BYTE_8 VIN_DATA_BYTE_9 /end DEF_CHARACTERISTIC
 /begin OUT_MEASUREMENT DATA_MODE_1_Prb DATA_MODE_2_Prb DATA_MODE_3_Prb DATA_MODE_4_Ovr Mode_1_Prb Mode_2_Prb Mode_3_Prb Mode_4_Prb VEH_ID_Prb VIN_DATA_BYTE_1_Prb VIN_DATA_BYTE_10_Prb VIN_DATA_BYTE_11_Prb VIN_DATA_BYTE_12_Prb VIN_DATA_BYTE_13_Prb VIN_DATA_BYTE_14_Prb VIN_DATA_BYTE_15_Prb VIN_DATA_BYte_16_Prb VIN_DATA_BYTE_17_Prb VIN_DATA_BYTE_2_Prb VIN_DATA_BYTE_3_Prb VIN_DATA_BYTE_4_Prb VIN_DATA_BYTE_5_Prb VIN_DATA_BYTE_6_Prb VIN_DATA_BYTE_7_Prb VIN_DATA_BYTE_8_Prb VIN_DATA_BYTE_9_Prb /end OUT_MEASUREMENT
 /begin SUB_FUNCTION DATA_MODE_1_Ovr_Override DATA_MODE_2_Ovr_Override DATA_MODE_3_Ovr_Override DATA_MODE_4_Ovr_Override Mode_1_Ovr_Override Mode_2_Ovr_Override Mode_3_Ovr_Override Mode_4_Ovr_Override VEH_ID_Ovr_Override VIN_DATA_BYTE_1_Ovr_Override VIN_DATA_BYTE_10_Ovr_Override VIN_DATA_BYTE_11_Ovr_Override VIN_DATA_BYTE_12_Ovr_Override VIN_DATA_BYTE_13_Ovr_Override VIN_DATA_BYTE_14_Ovr_Override VIN_DATA_BYTE_15_Ovr_Override VIN_DATA_BYTE_16_Ovr_Override VIN_DATA_BYTE_17_Ovr_Override VIN_DATA_BYTE_2_Ovr_Override VIN_DATA_BYTE_3_Ovr_Override VIN_DATA_BYTE_4_Ovr_Override VIN_DATA_BYTE_5_Ovr_Override VIN_DATA_BYTE_6_Ovr_Override VIN_DATA_BYTE_7_Ovr_Override VIN_DATA_BYTE_8_Ovr_Override VIN_DATA_BYTE_9_Ovr_Override /end SUB_FUNCTION
/end FUNCTION
/begin FUNCTION DATA_MODE_1_Ovr_Override "" /begin DEF_CHARACTERISTIC DATA_MODE_1_Ovr_new DATA_MODE_1_Ovr_ovr /end DEF_CHARACTERISTIC /end FUNCTION
/begin FUNCTION DATA_MODE_2_Ovr_Override "" /begin DEF_CHARACTERISTIC DATA_MODE_2_Ovr_new DATA_MODE_2_Ovr_ovr /end DEF_CHARACTERISTIC /end FUNCTION
/begin FUNCTION DATA_MODE_3_Ovr_Override "" /begin DEF_CHARACTERISTIC DATA_MODE_3_Ovr_new DATA_MODE_3_Ovr_ovr /end DEF_CHARACTERISTIC /end FUNCTION
/begin FUNCTION DATA_MODE_4_Ovr_Override "" /begin DEF_CHARACTERISTIC DATA_MODE_4_Ovr_new DATA_MODE_4_Ovr_ovr /end DEF_CHARACTERISTIC /end FUNCTION
/begin FUNCTION DateTime_Ovr_Override "" /begin DEF_CHARACTERISTIC DateTime_Ovr_new DateTime_Ovr_ovr /end DEF_CHARACTERISTIC /end FUNCTION
/begin FUNCTION DC_DC_Converter "" /begin DEF_CHARACTERISTIC DCDC_Converter_Not_Running_Fault /end DEF_CHARACTERISTIC /end FUNCTION
/begin FUNCTION DCDC_Status_Ovr_Override "" /begin DEF_CHARACTERISTIC DCDC_Status_Ovr_new DCDC_Status_Ovr_ovr /end DEF_CHARACTERISTIC /end FUNCTION
/begin FUNCTION DCDC_Converter "" /begin OUT_MEASUREMENT DCDC_Status_Prb /end OUT_MEASUREMENT /begin SUB_FUNCTION DCDC_Status_Ovr_Override /end SUB_FUNCTION /end FUNCTION
/begin FUNCTION Defrost_Mode_Ovr_Override "" /begin DEF_CHARACTERISTIC Defrost_Mode_Ovr_new Defrost_Mode_Ovr_ovr /end DEF_CHARACTERISTIC /end FUNCTION
/begin FUNCTION Defrost_Ovr_Override "" /begin DEF_CHARACTERISTIC Defrost_Ovr_new Defrost_Ovr_ovr /end DEF_CHARACTERISTIC /end FUNCTION
/begin FUNCTION Gear_Selector ""
 /begin DEF_CHARACTERISTIC Drive_Switch_Input_High_Fault Drive_Switch_Input_Low_Fault Gear_Shift_Module_Communication_Circuit Park_Nuetral_Switch_Input_High_Fault Park_Nuetral_Switch_Input_Low_Fault /end DEF_CHARACTERISTIC
/end FUNCTION
/begin FUNCTION Driver_1_Ovr_Override "" /begin DEF_CHARACTERISTIC Driver_1_Ovr_new Driver_1_Ovr_ovr /end DEF_CHARACTERISTIC /end FUNCTION
/begin FUNCTION Driver_10_Ovr_Override "" /begin DEF_CHARACTERISTIC Driver_10_Ovr_new Driver_10_Ovr_ovr /end DEF_CHARACTERISTIC /end FUNCTION
/begin FUNCTION Driver_Temp_Ovr_Override "" /begin DEF_CHARACTERISTIC Driver_Temp_Ovr_new Driver_Temp_Ovr_ovr /end DEF_CHARACTERISTIC /end FUNCTION
/begin FUNCTION Eaton_Charger_AgeCount_Ovr_Override ""
 /begin DEF_CHARACTERISTIC Eaton_Charger_AgeCount_Ovr_new Eaton_Charger_AgeCount_Ovr_ovr /end DEF_CHARACTERISTIC
/end FUNCTION
/begin FUNCTION Eaton_Charger_Message_Checksum_Ovr_Override ""
 /begin DEF_CHARACTERISTIC Eaton_Charger_Message_Checksum_Ovr_new Eaton_Charger_Message_Checksum_Ovr_ovr /end DEF_CHARACTERISTIC
/end FUNCTION
/begin FUNCTION Eaton_Charger_Message_Counter_Ovr_Override ""
 /begin DEF_CHARACTERISTIC Eaton_Charger_Message_Counter_Ovr_new Eaton_Charger_Message_Counter_Ovr_ovr /end DEF_CHARACTERISTIC
/end FUNCTION
/begin FUNCTION Eaton_HV_Charger_Temperature_Ovr_Override ""
 /begin DEF_CHARACTERISTIC Eaton_HV_Charger_Temperature_Ovr_new Eaton_HV_Charger_Temperature_Ovr_ovr /end DEF_CHARACTERISTIC
/end FUNCTION
/begin FUNCTION ecoMode_Ovr_Override "" /begin DEF_CHARACTERISTIC ecoMode_Ovr_new ecoMode_Ovr_ovr /end DEF_CHARACTERISTIC /end FUNCTION
/begin FUNCTION Main_Power_Relay_Config "" /begin DEF_CHARACTERISTIC ECUP_Threshold /end DEF_CHARACTERISTIC /end FUNCTION
/begin FUNCTION Main_Power_Relay "" /begin DEF_CHARACTERISTIC MPRD_KeepAlive ProcessorReboot Shutdown_Req /end DEF_CHARACTERISTIC /begin OUT_MEASUREMENT MPRD /end OUT_MEASUREMENT /begin SUB_FUNCTION Main_Power_Relay_Config MPRD_Override /end SUB_FUNCTION /end FUNCTION
/begin FUNCTION Electric_Motor ""
 /begin DEF_CHARACTERISTIC Electric_Motor_Derated_Approaching_Over_Temperature_Fault_Over Electric_Motor_Derated_Approaching_Over_Temperature_Fault_Under Electric_Motor_Derated_Over_Temperature_Fault Electric_Motor_Derated_Over_Voltage_Fault Electric_Motor_Derated_Under_Temperature_Fault Electric_Motor_Derated_Under_Voltage_Fault Electric_Motor_General_Error_Fault_Over Electric_Motor_General_Error_Fault_Under Electric_Motor_Over_Speed_Forward_Fault Electric_Motor_Over_Speed_Reverse_Fault Electric_Motor_Shutdown_Error_Fault Electric_Motor_Torque_Output_Fault RPM_to_Wheel_Speed_Multiplier2 /end DEF_CHARACTERISTIC
/end FUNCTION
/begin FUNCTION Eng_Cool_Temp_Ovr_Override "" /begin DEF_CHARACTERISTIC Eng_Cool_Temp_Ovr_new Eng_Cool_Temp_Ovr_ovr /end DEF_CHARACTERISTIC /end FUNCTION
/begin FUNCTION Engine_Crank_Ovr_Override "" /begin DEF_CHARACTERISTIC Engine_Crank_Ovr_new Engine_Crank_Ovr_ovr /end DEF_CHARACTERISTIC /end FUNCTION
/begin FUNCTION Engine_Inputs ""
 /begin OUT_MEASUREMENT Engine_Crank_Prb Engine_On_Prb Fault_Prb Inv_Temp_Prb Load_On_Prb Oil_Pressure_Prb RPM_Prb Temp_Guage_Ovr /end OUT_MEASUREMENT
 /begin SUB_FUNCTION Engine_Crank_Ovr_Override Engine_On_Ovr_Override Fault_Ovr_Override Inv_Temp_Ovr_Override Load_On_Ovr_Override Oil_Pressure_Ovr_Override RPM_Ovr_Override Temp_Guage_Ovr_Override /end SUB_FUNCTION
/end FUNCTION
/begin FUNCTION Engine_On_ABS_Ovr_Override "" /begin DEF_CHARACTERISTIC Engine_On_ABS_Ovr_new Engine_On_ABS_Ovr_ovr /end DEF_CHARACTERISTIC /end FUNCTION
/begin FUNCTION Engine_On_Ovr_Override "" /begin DEF_CHARACTERISTIC Engine_On_Ovr_new Engine_On_Ovr_ovr /end DEF_CHARACTERISTIC /end FUNCTION
/begin FUNCTION Engine_States "" /begin DEF_CHARACTERISTIC Engine_On_Time_Threshold /end DEF_CHARACTERISTIC /end FUNCTION
/begin FUNCTION Engine_Speed_Ovr_Override "" /begin DEF_CHARACTERISTIC Engine_Speed_Ovr_new Engine_Speed_Ovr_ovr /end DEF_CHARACTERISTIC /end FUNCTION
/begin FUNCTION Fan1_Ovr_Override "" /begin DEF_CHARACTERISTIC Fan1_Ovr_new Fan1_Ovr_ovr /end DEF_CHARACTERISTIC /end FUNCTION
/begin FUNCTION Fan2_Ovr_Override "" /begin DEF_CHARACTERISTIC Fan2_Ovr_new Fan2_Ovr_ovr /end DEF_CHARACTERISTIC /end FUNCTION
/begin FUNCTION Fan3_Ovr_Override "" /begin DEF_CHARACTERISTIC Fan3_Ovr_new Fan3_Ovr_ovr /end DEF_CHARACTERISTIC /end FUNCTION
/begin FUNCTION Fault_Ovr_Override "" /begin DEF_CHARACTERISTIC Fault_Ovr_new Fault_Ovr_ovr /end DEF_CHARACTERISTIC /end FUNCTION
/begin FUNCTION Fault_Severity_Indicator_Ovr_Override ""
 /begin DEF_CHARACTERISTIC Fault_Severity_Indicator_Ovr_new Fault_Severity_Indicator_Ovr_ovr /end DEF_CHARACTERISTIC
/end FUNCTION
/begin FUNCTION Action_Reasons ""
 /begin OUT_MEASUREMENT FaultActionReason._.Batt_Light FaultActionReason._.Batt_Shutdown FaultActionReason._.Cell_Voltage_Max FaultActionReason._.Check_Engine_Light FaultActionReason._.Check_Engine_Light_Flashing FaultActionReason._.Cooling_Max FaultActionReason._.Cruise FaultActionReason._.Dyno_Shutdown FaultActionReason._.EatonChargerFault FaultActionReason._.HV_Light FaultActionReason._.Pump_On FaultActionReason._.Regen_Brakes_Disabled FaultActionReason._.Set_Crawl_Home FaultActionReason._.Temperature_Flash FaultActionReason._.Temperature_Solid FaultActionReason._.Wrench_Light /end OUT_MEASUREMENT
/end FUNCTION
/begin FUNCTION Faults_1 ""
 /begin DEF_CHARACTERISTIC FaultCommand FaultManager.ABS_ToneRing_AgeCount.Mode FaultManager.ABS_ToneRing_AgeCount.ID FaultManager.ABS_ToneRing_AgeCount.Test FaultManager.ABS_ToneRing_AgeCount.Faulty_Samples__X_ FaultManager.ABS_ToneRing_AgeCount.Total_Samples__Y_ FaultManager.ABS_ToneRing_AgeCount.Action_1 FaultManager.ABS_ToneRing_AgeCount.Action_1_Condition FaultManager.ABS_ToneRing_AgeCount.Action_2 FaultManager.ABS_ToneRing_AgeCount.Action_2_Condition FaultManager.ABS_ToneRing_AgeCount.Action_3 FaultManager.ABS_ToneRing_AgeCount.Action_3_Condition FaultManager.ABS_ToneRing_AgeCount.Action_4 FaultManager.ABS_ToneRing_AgeCount.Action_4_Condition FaultManager.ABS_Traction_Control_AgeCount.Mode FaultManager.ABS_Traction_Control_AgeCount.ID FaultManager.ABS_Traction_Control_AgeCount.Test FaultManager.ABS_Traction_Control_AgeCount.Faulty_Samples__X_ FaultManager.ABS_Traction_Control_AgeCount.Total_Samples__Y_ FaultManager.ABS_Traction_Control_AgeCount.Action_1 FaultManager.ABS_Traction_Control_AgeCount.Action_1_Condition FaultManager.ABS_Traction_Control_AgeCount.Action_2 FaultManager.ABS_Traction_Control_AgeCount.Action_2_Condition FaultManager.ABS_Traction_Control_AgeCount.Action_3 FaultManager.ABS_Traction_Control_AgeCount.Action_3_Condition FaultManager.ABS_Traction_Control_AgeCount.Action_4 FaultManager.ABS_Traction_Control_AgeCount.Action_4_Condition FaultManager.ABS_WheelSpeed_AgeCount.Mode FaultManager.ABS_WheelSpeed_AgeCount.ID FaultManager.ABS_WheelSpeed_AgeCount.Test FaultManager.ABS_WheelSpeed_AgeCount.Faulty_Samples__X_ FaultManager.ABS_WheelSpeed_AgeCount.Total_Samples__Y_ FaultManager.ABS_WheelSpeed_AgeCount.Action_1 FaultManager.ABS_WheelSpeed_AgeCount.Action_1_Condition FaultManager.ABS_WheelSpeed_AgeCount.Action_2 FaultManager.ABS_WheelSpeed_AgeCount.Action_2_Condition FaultManager.ABS_WheelSpeed_AgeCount.Action_3 FaultManager.ABS_WheelSpeed_AgeCount.Action_3_Condition FaultManager.ABS_WheelSpeed_AgeCount.Action_4 FaultManager.ABS_WheelSpeed_AgeCount.Action_4_Condition FaultManager.Battery_AgeCount.Mode FaultManager.Battery_AgeCount.ID FaultManager.Battery_AgeCount.Test FaultManager.Battery_AgeCount.Faulty_Samples__X_ FaultManager.Battery_AgeCount.Total_Samples__Y_ FaultManager.Battery_AgeCount.Action_1 FaultManager.Battery_AgeCount.Action_1_Condition FaultManager.Battery_AgeCount.Action_2 FaultManager.Battery_AgeCount.Action_2_Condition FaultManager.Battery_AgeCount.Action_3 FaultManager.Battery_AgeCount.Action_3_Condition FaultManager.Battery_AgeCount.Action_4 FaultManager.Battery_AgeCount.Action_4_Condition FaultManager.Battery_Voltage_Too_High.Mode FaultManager.Battery_Voltage_Too_High.ID FaultManager.Battery_Voltage_Too_High.Test FaultManager.Battery_Voltage_Too_High.Faulty_Samples__X_ FaultManager.Battery_Voltage_Too_High.Total_Samples__Y_ FaultManager.Battery_Voltage_Too_High.Action_1 FaultManager.Battery_Voltage_Too_High.Action_1_Condition FaultManager.Battery_Voltage_Too_High.Action_2 FaultManager.Battery_Voltage_Too_High.Action_2_Condition FaultManager.Battery_Voltage_Too_High.Action_3 FaultManager.Battery_Voltage_Too_High.Action_3_Condition FaultManager.Battery_Voltage_Too_High.Action_4 FaultManager.Battery_Voltage_Too_High.Action_4_Condition FaultManager.Battery_Voltage_Too_Low.Mode FaultManager.Battery_Voltage_Too_Low.ID FaultManager.Battery_Voltage_Too_Low.Test FaultManager.Battery_Voltage_Too_Low.Faulty_Samples__X_ FaultManager.Battery_Voltage_Too_Low.Total_Samples__Y_ FaultManager.Battery_Voltage_Too_Low.Action_1 FaultManager.Battery_Voltage_Too_Low.Action_1_Condition FaultManager.Battery_Voltage_Too_Low.Action_2 FaultManager.Battery_Voltage_Too_Low.Action_2_Condition FaultManager.Battery_Voltage_Too_Low.Action_3 FaultManager.Battery_Voltage_Too_Low.Action_3_Condition FaultManager.Battery_Voltage_Too_Low.Action_4 FaultManager.Battery_Voltage_Too_Low.Action_4_Condition FaultManager.Blend_Valve_A_No_Response.Mode FaultManager.Blend_Valve_A_No_Response.ID FaultManager.Blend_Valve_A_No_Response.Test FaultManager.Blend_Valve_A_No_Response.Faulty_Samples__X_ FaultManager.Blend_Valve_A_No_Response.Total_Samples__Y_ FaultManager.Blend_Valve_A_No_Response.Action_1 FaultManager.Blend_Valve_A_No_Response.Action_1_Condition FaultManager.Blend_Valve_A_No_Response.Action_2 FaultManager.Blend_Valve_A_No_Response.Action_2_Condition FaultManager.Blend_Valve_A_No_Response.Action_3 FaultManager.Blend_Valve_A_No_Response.Action_3_Condition FaultManager.Blend_Valve_A_No_Response.Action_4 FaultManager.Blend_Valve_A_No_Response.Action_4_Condition FaultManager.Blend_Valve_B_No_Response.Mode FaultManager.Blend_Valve_B_No_Response.ID FaultManager.Blend_Valve_B_No_Response.Test FaultManager.Blend_Valve_B_No_Response.Faulty_Samples__X_ FaultManager.Blend_Valve_B_No_Response.Total_Samples__Y_ FaultManager.Blend_Valve_B_No_Response.Action_1 FaultManager.Blend_Valve_B_No_Response.Action_1_Condition FaultManager.Blend_Valve_B_No_Response.Action_2 FaultManager.Blend_Valve_B_No_Response.Action_2_Condition FaultManager.Blend_Valve_B_No_Response.Action_3 FaultManager.Blend_Valve_B_No_Response.Action_3_Condition FaultManager.Blend_Valve_B_No_Response.Action_4 FaultManager.Blend_Valve_B_No_Response.Action_4_Condition FaultManager.Blend_Valve_Sensor_A_High_Voltage.Mode FaultManager.Blend_Valve_Sensor_A_High_Voltage.ID FaultManager.Blend_Valve_Sensor_A_High_Voltage.Test FaultManager.Blend_Valve_Sensor_A_High_Voltage.Faulty_Samples__X_ FaultManager.Blend_Valve_Sensor_A_High_Voltage.Total_Samples__Y_ FaultManager.Blend_Valve_Sensor_A_High_Voltage.Action_1 FaultManager.Blend_Valve_Sensor_A_High_Voltage.Action_1_Condition FaultManager.Blend_Valve_Sensor_A_High_Voltage.Action_2 FaultManager.Blend_Valve_Sensor_A_High_Voltage.Action_2_Condition FaultManager.Blend_Valve_Sensor_A_High_Voltage.Action_3 FaultManager.Blend_Valve_Sensor_A_High_Voltage.Action_3_Condition FaultManager.Blend_Valve_Sensor_A_High_Voltage.Action_4 FaultManager.Blend_Valve_Sensor_A_High_Voltage.Action_4_Condition FaultManager.Blend_Valve_Sensor_A_Intermittent.Mode FaultManager.Blend_Valve_Sensor_A_Intermittent.ID FaultManager.Blend_Valve_Sensor_A_Intermittent.Test FaultManager.Blend_Valve_Sensor_A_Intermittent.Faulty_Samples__X_ FaultManager.Blend_Valve_Sensor_A_Intermittent.Total_Samples__Y_ FaultManager.Blend_Valve_Sensor_A_Intermittent.Action_1 FaultManager.Blend_Valve_Sensor_A_Intermittent.Action_1_Condition FaultManager.Blend_Valve_Sensor_A_Intermittent.Action_2 FaultManager.Blend_Valve_Sensor_A_Intermittent.Action_2_Condition FaultManager.Blend_Valve_Sensor_A_Intermittent.Action_3 FaultManager.Blend_Valve_Sensor_A_Intermittent.Action_3_Condition FaultManager.Blend_Valve_Sensor_A_Intermittent.Action_4 FaultManager.Blend_Valve_Sensor_A_Intermittent.Action_4_Condition FaultManager.Blend_Valve_Sensor_A_Low_Voltage.Mode FaultManager.Blend_Valve_Sensor_A_Low_Voltage.ID FaultManager.Blend_Valve_Sensor_A_Low_Voltage.Test FaultManager.Blend_Valve_Sensor_A_Low_Voltage.Faulty_Samples__X_ FaultManager.Blend_Valve_Sensor_A_Low_Voltage.Total_Samples__Y_ FaultManager.Blend_Valve_Sensor_A_Low_Voltage.Action_1 FaultManager.Blend_Valve_Sensor_A_Low_Voltage.Action_1_Condition FaultManager.Blend_Valve_Sensor_A_Low_Voltage.Action_2 FaultManager.Blend_Valve_Sensor_A_Low_Voltage.Action_2_Condition FaultManager.Blend_Valve_Sensor_A_Low_Voltage.Action_3 FaultManager.Blend_Valve_Sensor_A_Low_Voltage.Action_3_Condition FaultManager.Blend_Valve_Sensor_A_Low_Voltage.Action_4 FaultManager.Blend_Valve_Sensor_A_Low_Voltage.Action_4_Condition FaultManager.Blend_Valve_Sensor_B_High_Voltage.Mode FaultManager.Blend_Valve_Sensor_B_High_Voltage.ID FaultManager.Blend_Valve_Sensor_B_High_Voltage.Test FaultManager.Blend_Valve_Sensor_B_High_Voltage.Faulty_Samples__X_ FaultManager.Blend_Valve_Sensor_B_High_Voltage.Total_Samples__Y_ FaultManager.Blend_Valve_Sensor_B_High_Voltage.Action_1 FaultManager.Blend_Valve_Sensor_B_High_Voltage.Action_1_Condition FaultManager.Blend_Valve_Sensor_B_High_Voltage.Action_2 FaultManager.Blend_Valve_Sensor_B_High_Voltage.Action_2_Condition FaultManager.Blend_Valve_Sensor_B_High_Voltage.Action_3 FaultManager.Blend_Valve_Sensor_B_High_Voltage.Action_3_Condition FaultManager.Blend_Valve_Sensor_B_High_Voltage.Action_4 FaultManager.Blend_Valve_Sensor_B_High_Voltage.Action_4_Condition FaultManager.Blend_Valve_Sensor_B_Intermittent.Mode FaultManager.Blend_Valve_Sensor_B_Intermittent.ID FaultManager.Blend_Valve_Sensor_B_Intermittent.Test FaultManager.Blend_Valve_Sensor_B_Intermittent.Faulty_Samples__X_ FaultManager.Blend_Valve_Sensor_B_Intermittent.Total_Samples__Y_ FaultManager.Blend_Valve_Sensor_B_Intermittent.Action_1 FaultManager.Blend_Valve_Sensor_B_Intermittent.Action_1_Condition FaultManager.Blend_Valve_Sensor_B_Intermittent.Action_2 FaultManager.Blend_Valve_Sensor_B_Intermittent.Action_2_Condition FaultManager.Blend_Valve_Sensor_B_Intermittent.Action_3 FaultManager.Blend_Valve_Sensor_B_Intermittent.Action_3_Condition FaultManager.Blend_Valve_Sensor_B_Intermittent.Action_4 FaultManager.Blend_Valve_Sensor_B_Intermittent.Action_4_Condition FaultManager.Blend_Valve_Sensor_B_Low_Voltage.Mode FaultManager.Blend_Valve_Sensor_B_Low_Voltage.ID FaultManager.Blend_Valve_Sensor_B_Low_Voltage.Test FaultManager.Blend_Valve_Sensor_B_Low_Voltage.Faulty_Samples__X_ FaultManager.Blend_Valve_Sensor_B_Low_Voltage.Total_Samples__Y_ FaultManager.Blend_Valve_Sensor_B_Low_Voltage.Action_1 FaultManager.Blend_Valve_Sensor_B_Low_Voltage.Action_1_Condition FaultManager.Blend_Valve_Sensor_B_Low_Voltage.Action_2 FaultManager.Blend_Valve_Sensor_B_Low_Voltage.Action_2_Condition FaultManager.Blend_Valve_Sensor_B_Low_Voltage.Action_3 FaultManager.Blend_Valve_Sensor_B_Low_Voltage.Action_3_Condition FaultManager.Blend_Valve_Sensor_B_Low_Voltage.Action_4 FaultManager.Blend_Valve_Sensor_B_Low_Voltage.Action_4_Condition FaultManager.Brake_Pedal_Position_Communication_Loss.Mode FaultManager.Brake_Pedal_Position_Communication_Loss.ID FaultManager.Brake_Pedal_Position_Communication_Loss.Test FaultManager.Brake_Pedal_Position_Communication_Loss.Faulty_Samples__X_ FaultManager.Brake_Pedal_Position_Communication_Loss.Total_Samples__Y_ FaultManager.Brake_Pedal_Position_Communication_Loss.Action_1 FaultManager.Brake_Pedal_Position_Communication_Loss.Action_1_Condition FaultManager.Brake_Pedal_Position_Communication_Loss.Action_2 FaultManager.Brake_Pedal_Position_Communication_Loss.Action_2_Condition FaultManager.Brake_Pedal_Position_Communication_Loss.Action_3 FaultManager.Brake_Pedal_Position_Communication_Loss.Action_3_Condition FaultManager.Brake_Pedal_Position_Communication_Loss.Action_4 FaultManager.Brake_Pedal_Position_Communication_Loss.Action_4_Condition FaultManager.Brake_Pedal_Position_Intermiitent.Mode FaultManager.Brake_Pedal_Position_Intermiitent.ID FaultManager.Brake_Pedal_Position_Intermiitent.Test FaultManager.Brake_Pedal_Position_Intermiitent.Faulty_Samples__X_ FaultManager.Brake_Pedal_Position_Intermiitent.Total_Samples__Y_ FaultManager.Brake_Pedal_Position_Intermiitent.Action_1 FaultManager.Brake_Pedal_Position_Intermiitent.Action_1_Condition FaultManager.Brake_Pedal_Position_Intermiitent.Action_2 FaultManager.Brake_Pedal_Position_Intermiitent.Action_2_Condition FaultManager.Brake_Pedal_Position_Intermiitent.Action_3 FaultManager.Brake_Pedal_Position_Intermiitent.Action_3_Condition FaultManager.Brake_Pedal_Position_Intermiitent.Action_4 FaultManager.Brake_Pedal_Position_Intermiitent.Action_4_Condition FaultManager.Brake_Pedal_Position_Low.Mode FaultManager.Brake_Pedal_Position_Low.ID FaultManager.Brake_Pedal_Position_Low.Test FaultManager.Brake_Pedal_Position_Low.Faulty_Samples__X_ FaultManager.Brake_Pedal_Position_Low.Total_Samples__Y_ FaultManager.Brake_Pedal_Position_Low.Action_1 FaultManager.Brake_Pedal_Position_Low.Action_1_Condition FaultManager.Brake_Pedal_Position_Low.Action_2 FaultManager.Brake_Pedal_Position_Low.Action_2_Condition FaultManager.Brake_Pedal_Position_Low.Action_3 FaultManager.Brake_Pedal_Position_Low.Action_3_Condition FaultManager.Brake_Pedal_Position_Low.Action_4 FaultManager.Brake_Pedal_Position_Low.Action_4_Condition FaultManager.Brake_Pedal_Position_Sensor_A_Circuit_High.Mode FaultManager.Brake_Pedal_Position_Sensor_A_Circuit_High.ID FaultManager.Brake_Pedal_Position_Sensor_A_Circuit_High.Test FaultManager.Brake_Pedal_Position_Sensor_A_Circuit_High.Faulty_Samples__X_ FaultManager.Brake_Pedal_Position_Sensor_A_Circuit_High.Total_Samples__Y_ FaultManager.Brake_Pedal_Position_Sensor_A_Circuit_High.Action_1 FaultManager.Brake_Pedal_Position_Sensor_A_Circuit_High.Action_1_Condition FaultManager.Brake_Pedal_Position_Sensor_A_Circuit_High.Action_2 FaultManager.Brake_Pedal_Position_Sensor_A_Circuit_High.Action_2_Condition FaultManager.Brake_Pedal_Position_Sensor_A_Circuit_High.Action_3 FaultManager.Brake_Pedal_Position_Sensor_A_Circuit_High.Action_3_Condition FaultManager.Brake_Pedal_Position_Sensor_A_Circuit_High.Action_4 FaultManager.Brake_Pedal_Position_Sensor_A_Circuit_High.Action_4_Condition FaultManager.Brakes_AgeCount.Mode FaultManager.Brakes_AgeCount.ID FaultManager.Brakes_AgeCount.Test FaultManager.Brakes_AgeCount.Faulty_Samples__X_ FaultManager.Brakes_AgeCount.Total_Samples__Y_ FaultManager.Brakes_AgeCount.Action_1 FaultManager.Brakes_AgeCount.Action_1_Condition FaultManager.Brakes_AgeCount.Action_2 FaultManager.Brakes_AgeCount.Action_2_Condition FaultManager.Brakes_AgeCount.Action_3 FaultManager.Brakes_AgeCount.Action_3_Condition FaultManager.Brakes_AgeCount.Action_4 FaultManager.Brakes_AgeCount.Action_4_Condition FaultManager.Charge_Complete_Cell_Max_Volt.Mode FaultManager.Charge_Complete_Cell_Max_Volt.ID FaultManager.Charge_Complete_Cell_Max_Volt.Test FaultManager.Charge_Complete_Cell_Max_Volt.Faulty_Samples__X_ FaultManager.Charge_Complete_Cell_Max_Volt.Total_Samples__Y_ FaultManager.Charge_Complete_Cell_Max_Volt.Action_1 FaultManager.Charge_Complete_Cell_Max_Volt.Action_1_Condition FaultManager.Charge_Complete_Cell_Max_Volt.Action_2 FaultManager.Charge_Complete_Cell_Max_Volt.Action_2_Condition FaultManager.Charge_Complete_Cell_Max_Volt.Action_3 FaultManager.Charge_Complete_Cell_Max_Volt.Action_3_Condition FaultManager.Charge_Complete_Cell_Max_Volt.Action_4 FaultManager.Charge_Complete_Cell_Max_Volt.Action_4_Condition FaultManager.Charger_Amperage_Draw_Greater_Then_Supply.Mode FaultManager.Charger_Amperage_Draw_Greater_Then_Supply.ID FaultManager.Charger_Amperage_Draw_Greater_Then_Supply.Test FaultManager.Charger_Amperage_Draw_Greater_Then_Supply.Faulty_Samples__X_ FaultManager.Charger_Amperage_Draw_Greater_Then_Supply.Total_Samples__Y_ FaultManager.Charger_Amperage_Draw_Greater_Then_Supply.Action_1 FaultManager.Charger_Amperage_Draw_Greater_Then_Supply.Action_1_Condition FaultManager.Charger_Amperage_Draw_Greater_Then_Supply.Action_2 FaultManager.Charger_Amperage_Draw_Greater_Then_Supply.Action_2_Condition FaultManager.Charger_Amperage_Draw_Greater_Then_Supply.Action_3 FaultManager.Charger_Amperage_Draw_Greater_Then_Supply.Action_3_Condition FaultManager.Charger_Amperage_Draw_Greater_Then_Supply.Action_4 FaultManager.Charger_Amperage_Draw_Greater_Then_Supply.Action_4_Condition FaultManager.Charger_Derated_Over_Temperature.Mode FaultManager.Charger_Derated_Over_Temperature.ID FaultManager.Charger_Derated_Over_Temperature.Test FaultManager.Charger_Derated_Over_Temperature.Faulty_Samples__X_ FaultManager.Charger_Derated_Over_Temperature.Total_Samples__Y_ FaultManager.Charger_Derated_Over_Temperature.Action_1 FaultManager.Charger_Derated_Over_Temperature.Action_1_Condition FaultManager.Charger_Derated_Over_Temperature.Action_2 FaultManager.Charger_Derated_Over_Temperature.Action_2_Condition FaultManager.Charger_Derated_Over_Temperature.Action_3 FaultManager.Charger_Derated_Over_Temperature.Action_3_Condition FaultManager.Charger_Derated_Over_Temperature.Action_4 FaultManager.Charger_Derated_Over_Temperature.Action_4_Condition FaultManager.Charger_Derated_Under_Temperature.Mode FaultManager.Charger_Derated_Under_Temperature.ID FaultManager.Charger_Derated_Under_Temperature.Test FaultManager.Charger_Derated_Under_Temperature.Faulty_Samples__X_ FaultManager.Charger_Derated_Under_Temperature.Total_Samples__Y_ FaultManager.Charger_Derated_Under_Temperature.Action_1 FaultManager.Charger_Derated_Under_Temperature.Action_1_Condition FaultManager.Charger_Derated_Under_Temperature.Action_2 FaultManager.Charger_Derated_Under_Temperature.Action_2_Condition FaultManager.Charger_Derated_Under_Temperature.Action_3 FaultManager.Charger_Derated_Under_Temperature.Action_3_Condition FaultManager.Charger_Derated_Under_Temperature.Action_4 FaultManager.Charger_Derated_Under_Temperature.Action_4_Condition FaultManager.Charger_Internal_Fault.Mode FaultManager.Charger_Internal_Fault.ID FaultManager.Charger_Internal_Fault.Test FaultManager.Charger_Internal_Fault.Faulty_Samples__X_ FaultManager.Charger_Internal_Fault.Total_Samples__Y_ FaultManager.Charger_Internal_Fault.Action_1 FaultManager.Charger_Internal_Fault.Action_1_Condition FaultManager.Charger_Internal_Fault.Action_2 FaultManager.Charger_Internal_Fault.Action_2_Condition FaultManager.Charger_Internal_Fault.Action_3 FaultManager.Charger_Internal_Fault.Action_3_Condition FaultManager.Charger_Internal_Fault.Action_4 FaultManager.Charger_Internal_Fault.Action_4_Condition FaultManager.Charger_Line_Voltage_Too_Low.Mode FaultManager.Charger_Line_Voltage_Too_Low.ID FaultManager.Charger_Line_Voltage_Too_Low.Test FaultManager.Charger_Line_Voltage_Too_Low.Faulty_Samples__X_ FaultManager.Charger_Line_Voltage_Too_Low.Total_Samples__Y_ FaultManager.Charger_Line_Voltage_Too_Low.Action_1 FaultManager.Charger_Line_Voltage_Too_Low.Action_1_Condition FaultManager.Charger_Line_Voltage_Too_Low.Action_2 FaultManager.Charger_Line_Voltage_Too_Low.Action_2_Condition FaultManager.Charger_Line_Voltage_Too_Low.Action_3 FaultManager.Charger_Line_Voltage_Too_Low.Action_3_Condition FaultManager.Charger_Line_Voltage_Too_Low.Action_4 FaultManager.Charger_Line_Voltage_Too_Low.Action_4_Condition FaultManager.Charger_Line_Votlage_Too_High.Mode FaultManager.Charger_Line_Votlage_Too_High.ID FaultManager.Charger_Line_Votlage_Too_High.Test FaultManager.Charger_Line_Votlage_Too_High.Faulty_Samples__X_ FaultManager.Charger_Line_Votlage_Too_High.Total_Samples__Y_ FaultManager.Charger_Line_Votlage_Too_High.Action_1 FaultManager.Charger_Line_Votlage_Too_High.Action_1_Condition FaultManager.Charger_Line_Votlage_Too_High.Action_2 FaultManager.Charger_Line_Votlage_Too_High.Action_2_Condition FaultManager.Charger_Line_Votlage_Too_High.Action_3 FaultManager.Charger_Line_Votlage_Too_High.Action_3_Condition FaultManager.Charger_Line_Votlage_Too_High.Action_4 FaultManager.Charger_Line_Votlage_Too_High.Action_4_Condition FaultManager.Charger_Requested_But_No_High_Voltage.Mode FaultManager.Charger_Requested_But_No_High_Voltage.ID FaultManager.Charger_Requested_But_No_High_Voltage.Test FaultManager.Charger_Requested_But_No_High_Voltage.Faulty_Samples__X_ FaultManager.Charger_Requested_But_No_High_Voltage.Total_Samples__Y_ FaultManager.Charger_Requested_But_No_High_Voltage.Action_1 FaultManager.Charger_Requested_But_No_High_Voltage.Action_1_Condition FaultManager.Charger_Requested_But_No_High_Voltage.Action_2 FaultManager.Charger_Requested_But_No_High_Voltage.Action_2_Condition FaultManager.Charger_Requested_But_No_High_Voltage.Action_3 FaultManager.Charger_Requested_But_No_High_Voltage.Action_3_Condition FaultManager.Charger_Requested_But_No_High_Voltage.Action_4 FaultManager.Charger_Requested_But_No_High_Voltage.Action_4_Condition FaultManager.Charger_Requested_But_No_Key_Singal.Mode FaultManager.Charger_Requested_But_No_Key_Singal.ID FaultManager.Charger_Requested_But_No_Key_Singal.Test FaultManager.Charger_Requested_But_No_Key_Singal.Faulty_Samples__X_ FaultManager.Charger_Requested_But_No_Key_Singal.Total_Samples__Y_ FaultManager.Charger_Requested_But_No_Key_Singal.Action_1 FaultManager.Charger_Requested_But_No_Key_Singal.Action_1_Condition FaultManager.Charger_Requested_But_No_Key_Singal.Action_2 FaultManager.Charger_Requested_But_No_Key_Singal.Action_2_Condition FaultManager.Charger_Requested_But_No_Key_Singal.Action_3 FaultManager.Charger_Requested_But_No_Key_Singal.Action_3_Condition FaultManager.Charger_Requested_But_No_Key_Singal.Action_4 FaultManager.Charger_Requested_But_No_Key_Singal.Action_4_Condition FaultManager.Charger_Requested_Current_Too_High.Mode FaultManager.Charger_Requested_Current_Too_High.ID FaultManager.Charger_Requested_Current_Too_High.Test FaultManager.Charger_Requested_Current_Too_High.Faulty_Samples__X_ FaultManager.Charger_Requested_Current_Too_High.Total_Samples__Y_ FaultManager.Charger_Requested_Current_Too_High.Action_1 FaultManager.Charger_Requested_Current_Too_High.Action_1_Condition FaultManager.Charger_Requested_Current_Too_High.Action_2 FaultManager.Charger_Requested_Current_Too_High.Action_2_Condition FaultManager.Charger_Requested_Current_Too_High.Action_3 FaultManager.Charger_Requested_Current_Too_High.Action_3_Condition FaultManager.Charger_Requested_Current_Too_High.Action_4 FaultManager.Charger_Requested_Current_Too_High.Action_4_Condition FaultManager.Charger_Requested_Voltage_Out_of_Bounds.Mode FaultManager.Charger_Requested_Voltage_Out_of_Bounds.ID FaultManager.Charger_Requested_Voltage_Out_of_Bounds.Test FaultManager.Charger_Requested_Voltage_Out_of_Bounds.Faulty_Samples__X_ FaultManager.Charger_Requested_Voltage_Out_of_Bounds.Total_Samples__Y_ FaultManager.Charger_Requested_Voltage_Out_of_Bounds.Action_1 FaultManager.Charger_Requested_Voltage_Out_of_Bounds.Action_1_Condition FaultManager.Charger_Requested_Voltage_Out_of_Bounds.Action_2 FaultManager.Charger_Requested_Voltage_Out_of_Bounds.Action_2_Condition FaultManager.Charger_Requested_Voltage_Out_of_Bounds.Action_3 FaultManager.Charger_Requested_Voltage_Out_of_Bounds.Action_3_Condition FaultManager.Charger_Requested_Voltage_Out_of_Bounds.Action_4 FaultManager.Charger_Requested_Voltage_Out_of_Bounds.Action_4_Condition FaultManager.Cruise_Control_Brake_Switch_A_Circuit_High.Mode FaultManager.Cruise_Control_Brake_Switch_A_Circuit_High.ID FaultManager.Cruise_Control_Brake_Switch_A_Circuit_High.Test FaultManager.Cruise_Control_Brake_Switch_A_Circuit_High.Faulty_Samples__X_ FaultManager.Cruise_Control_Brake_Switch_A_Circuit_High.Total_Samples__Y_ FaultManager.Cruise_Control_Brake_Switch_A_Circuit_High.Action_1 FaultManager.Cruise_Control_Brake_Switch_A_Circuit_High.Action_1_Condition FaultManager.Cruise_Control_Brake_Switch_A_Circuit_High.Action_2 FaultManager.Cruise_Control_Brake_Switch_A_Circuit_High.Action_2_Condition FaultManager.Cruise_Control_Brake_Switch_A_Circuit_High.Action_3 FaultManager.Cruise_Control_Brake_Switch_A_Circuit_High.Action_3_Condition FaultManager.Cruise_Control_Brake_Switch_A_Circuit_High.Action_4 FaultManager.Cruise_Control_Brake_Switch_A_Circuit_High.Action_4_Condition FaultManager.Cruise_Control_Brake_Switch_A_Circuit_Low.Mode FaultManager.Cruise_Control_Brake_Switch_A_Circuit_Low.ID FaultManager.Cruise_Control_Brake_Switch_A_Circuit_Low.Test FaultManager.Cruise_Control_Brake_Switch_A_Circuit_Low.Faulty_Samples__X_ FaultManager.Cruise_Control_Brake_Switch_A_Circuit_Low.Total_Samples__Y_ FaultManager.Cruise_Control_Brake_Switch_A_Circuit_Low.Action_1 FaultManager.Cruise_Control_Brake_Switch_A_Circuit_Low.Action_1_Condition FaultManager.Cruise_Control_Brake_Switch_A_Circuit_Low.Action_2 FaultManager.Cruise_Control_Brake_Switch_A_Circuit_Low.Action_2_Condition FaultManager.Cruise_Control_Brake_Switch_A_Circuit_Low.Action_3 FaultManager.Cruise_Control_Brake_Switch_A_Circuit_Low.Action_3_Condition FaultManager.Cruise_Control_Brake_Switch_A_Circuit_Low.Action_4 FaultManager.Cruise_Control_Brake_Switch_A_Circuit_Low.Action_4_Condition FaultManager.Cruise_Control_Brake_Switch_A_Circuit_Malfunction.Mode FaultManager.Cruise_Control_Brake_Switch_A_Circuit_Malfunction.ID FaultManager.Cruise_Control_Brake_Switch_A_Circuit_Malfunction.Test FaultManager.Cruise_Control_Brake_Switch_A_Circuit_Malfunction.Faulty_Samples__X_ FaultManager.Cruise_Control_Brake_Switch_A_Circuit_Malfunction.Total_Samples__Y_ FaultManager.Cruise_Control_Brake_Switch_A_Circuit_Malfunction.Action_1 FaultManager.Cruise_Control_Brake_Switch_A_Circuit_Malfunction.Action_1_Condition FaultManager.Cruise_Control_Brake_Switch_A_Circuit_Malfunction.Action_2 FaultManager.Cruise_Control_Brake_Switch_A_Circuit_Malfunction.Action_2_Condition FaultManager.Cruise_Control_Brake_Switch_A_Circuit_Malfunction.Action_3 FaultManager.Cruise_Control_Brake_Switch_A_Circuit_Malfunction.Action_3_Condition FaultManager.Cruise_Control_Brake_Switch_A_Circuit_Malfunction.Action_4 FaultManager.Cruise_Control_Brake_Switch_A_Circuit_Malfunction.Action_4_Condition FaultManager.Cruise_Control_Coast_Signal_Malfunction.Mode FaultManager.Cruise_Control_Coast_Signal_Malfunction.ID FaultManager.Cruise_Control_Coast_Signal_Malfunction.Test FaultManager.Cruise_Control_Coast_Signal_Malfunction.Faulty_Samples__X_ FaultManager.Cruise_Control_Coast_Signal_Malfunction.Total_Samples__Y_ FaultManager.Cruise_Control_Coast_Signal_Malfunction.Action_1 FaultManager.Cruise_Control_Coast_Signal_Malfunction.Action_1_Condition FaultManager.Cruise_Control_Coast_Signal_Malfunction.Action_2 FaultManager.Cruise_Control_Coast_Signal_Malfunction.Action_2_Condition FaultManager.Cruise_Control_Coast_Signal_Malfunction.Action_3 FaultManager.Cruise_Control_Coast_Signal_Malfunction.Action_3_Condition FaultManager.Cruise_Control_Coast_Signal_Malfunction.Action_4 FaultManager.Cruise_Control_Coast_Signal_Malfunction.Action_4_Condition FaultManager.Cruise_Control_Off_Signal_Malfunction.Mode FaultManager.Cruise_Control_Off_Signal_Malfunction.ID FaultManager.Cruise_Control_Off_Signal_Malfunction.Test FaultManager.Cruise_Control_Off_Signal_Malfunction.Faulty_Samples__X_ /end DEF_CHARACTERISTIC
 /begin OUT_MEASUREMENT FaultMarquees.FaultMarquees.Current_Suspected FaultMarquees.FaultMarquees.Current_Active FaultMarquees.FaultMarquees.Current_Occurred /end OUT_MEASUREMENT
 /begin SUB_FUNCTION Action_Reasons /end SUB_FUNCTION
/end FUNCTION
/end MODULE
/end PROJECT
