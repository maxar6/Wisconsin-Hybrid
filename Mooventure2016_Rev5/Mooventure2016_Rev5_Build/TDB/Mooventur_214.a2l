ASAP2_VERSION 1 51
/begin PROJECT Project ""
/begin MODULE Mooventur_214 ""
/begin MOD_COMMON /* MOD_COMMON Comment */ "" BYTE_ORDER MSB_FIRST ALIGNMENT_BYTE 1 ALIGNMENT_FLOAT32_IEEE 1 ALIGNMENT_FLOAT64_IEEE 1 ALIGNMENT_LONG 1 ALIGNMENT_WORD 1 /end MOD_COMMON
/begin MEASUREMENT Gen_Enable_Prb "" UBYTE CompuMethod_11 1 0 0 1 ECU_ADDRESS 0x40000365 /end MEASUREMENT
/begin MEASUREMENT Gen_Load_Prb "" FLOAT32_IEEE CompuMethod_2 1 0 -1E+17 1E+17 ECU_ADDRESS 0x40000366 /end MEASUREMENT
/begin MEASUREMENT Heater_Core_Blend_Valve_Probe "" SLONG CompuMethod_6 1 0 -2147480000 2147480000 ECU_ADDRESS 0x4000039A /end MEASUREMENT
/begin MEASUREMENT Heater_Temp_Probe "" FLOAT32_IEEE CompuMethod_2 1 0 -1E+17 1E+17 ECU_ADDRESS 0x400003A5 /end MEASUREMENT
/begin MEASUREMENT Heater_Temp_Raw_Probe "" UWORD CompuMethod_5 1 0 0 65535 ECU_ADDRESS 0x400003A9 /end MEASUREMENT
/begin MEASUREMENT IPT_DutyCycle_probe "" FLOAT32_IEEE CompuMethod_2 1 0 -1E+17 1E+17 ECU_ADDRESS 0x400003FD /end MEASUREMENT
/begin MEASUREMENT IPT_Freq_probe "" FLOAT32_IEEE CompuMethod_2 1 0 -1E+17 1E+17 ECU_ADDRESS 0x40000405 /end MEASUREMENT
/begin MEASUREMENT ISR_ADCCPU "Percentage of CPU spent in eSCI interrupt servicing" UWORD CompuMethod_489 1 0 0 100 ECU_ADDRESS 0x4000043B /end MEASUREMENT
/begin MEASUREMENT ISR_CANCPU "Percentage of CPU spent in CAN interrupt servicing" UWORD CompuMethod_489 1 0 0 100 ECU_ADDRESS 0x4000043D /end MEASUREMENT
/begin MEASUREMENT ISR_DecrementorCPU "Percentage of CPU spent in the Decrementor interrupt" UWORD CompuMethod_489 1 0 0 100 ECU_ADDRESS 0x4000043F /end MEASUREMENT
/begin MEASUREMENT ISR_DMACPU "Percentage of CPU spent in DMA interrupt servicing" UWORD CompuMethod_489 1 0 0 100 ECU_ADDRESS 0x40000441 /end MEASUREMENT
/begin MEASUREMENT ISR_EMIOSCPU "Percentage of CPU spent in eMIOS interrupt servicing" UWORD CompuMethod_489 1 0 0 100 ECU_ADDRESS 0x40000443 /end MEASUREMENT
/begin MEASUREMENT ISR_SCICPU "Percentage of CPU spent in eSCI interrupt servicing" UWORD CompuMethod_489 1 0 0 100 ECU_ADDRESS 0x40000445 /end MEASUREMENT
/begin MEASUREMENT ISR_TPUCPU "Percentage of CPU spent in eTPU interrupts" UWORD CompuMethod_489 1 0 0 100 ECU_ADDRESS 0x40000447 /end MEASUREMENT
/begin MEASUREMENT Load_RPM_Prb "" FLOAT32_IEEE CompuMethod_2 1 0 -1E+17 1E+17 ECU_ADDRESS 0x4000045B /end MEASUREMENT
/begin MEASUREMENT Load_Throttle_Prb "" FLOAT32_IEEE CompuMethod_2 1 0 -1E+17 1E+17 ECU_ADDRESS 0x4000045F /end MEASUREMENT
/begin MEASUREMENT ModifiedAmpSecIdx "" UWORD CompuMethod_475 1 0 0 127.998 ECU_ADDRESS 0x400004EF /end MEASUREMENT
/begin MEASUREMENT ModifiedAmpSecIn "" FLOAT32_IEEE CompuMethod_2 1 0 -1E+17 1E+17 ECU_ADDRESS 0x400004F1 /end MEASUREMENT
/begin MEASUREMENT NonVolatileCRC "Calculated NonVolatile CRC" ULONG CompuMethod_11 1 0 0 65535 ECU_ADDRESS 0x40000673 /end MEASUREMENT
/begin MEASUREMENT NonVolatileFormatID "Unique identifier of the NonVolatile memory format.  Used to validate whether stored variables are in the correct form for the program" ULONG CompuMethod_6 1 0 0 4294970000 ECU_ADDRESS 0x40000677 /end MEASUREMENT
/begin MEASUREMENT NonVolatileStatus "Indicates how NonVolatile memory was loaded" UBYTE CompuMethod_495 1 0 0 6 ECU_ADDRESS 0x4000067B /end MEASUREMENT
/begin MEASUREMENT Overcurrent_Torque_Derate_prb "" FLOAT32_IEEE CompuMethod_2 1 0 -1E+17 1E+17 ECU_ADDRESS 0x4000068C /end MEASUREMENT
/begin MEASUREMENT overcurrentintegral_prb "" FLOAT32_IEEE CompuMethod_2 1 0 -1E+17 1E+17 ECU_ADDRESS 0x40000690 /end MEASUREMENT
/begin MEASUREMENT PowerUpStatus "This indicates the power-up state of the system." UBYTE CompuMethod_499 1 0 0 1 ECU_ADDRESS 0x400006D8 /end MEASUREMENT
/begin MEASUREMENT PSCM_80_AgeCount_Prb "" ULONG CompuMethod_6 1 0 0 4294970000 ECU_ADDRESS 0x400006F1 /end MEASUREMENT
/begin MEASUREMENT Radiator_Blend_Valve_Probe "" UWORD CompuMethod_5 1 0 0 65535 ECU_ADDRESS 0x400006FD /end MEASUREMENT
/begin MEASUREMENT RELATIVE_STR_WHL_ANGLE_Prb "" FLOAT32_IEEE CompuMethod_2 1 0 -1E+17 1E+17 ECU_ADDRESS 0x40000724 /end MEASUREMENT
/begin MEASUREMENT STR_WHL_ANGLE_CNTR_FND_Prb "" FLOAT32_IEEE CompuMethod_2 1 0 -1E+17 1E+17 ECU_ADDRESS 0x40000765 /end MEASUREMENT
/begin MEASUREMENT STR_WHL_ANGLE_Prb "" FLOAT32_IEEE CompuMethod_2 1 0 -1E+17 1E+17 ECU_ADDRESS 0x40000769 /end MEASUREMENT
/begin MEASUREMENT Throttle_Position_Prb "" UWORD CompuMethod_5 1 0 0 65535 ECU_ADDRESS 0x4000078D /end MEASUREMENT
/begin MEASUREMENT TorqueLimMultiplier "" FLOAT32_IEEE CompuMethod_2 1 0 -1E+17 1E+17 ECU_ADDRESS 0x40000795 /end MEASUREMENT
/begin MEASUREMENT Vehicle_Speed2_Prb "" FLOAT32_IEEE CompuMethod_2 1 0 -1E+17 1E+17 ECU_ADDRESS 0x400007B1 /end MEASUREMENT
/begin MEASUREMENT VSC_ActiveDischargeDisable_Prb "" FLOAT32_IEEE CompuMethod_2 1 0 -1E+17 1E+17 ECU_ADDRESS 0x400007FD /end MEASUREMENT
/begin MEASUREMENT VSC_AntishudderDisable_Prb "" FLOAT32_IEEE CompuMethod_2 1 0 -1E+17 1E+17 ECU_ADDRESS 0x40000801 /end MEASUREMENT
/begin MEASUREMENT VSC_DCDCEnable_Prb "" UBYTE CompuMethod_11 1 0 0 1 ECU_ADDRESS 0x40000805 /end MEASUREMENT
/begin MEASUREMENT VSC_DCOutputVoltageCmd_Prb "" FLOAT32_IEEE CompuMethod_2 1 0 -1E+17 1E+17 ECU_ADDRESS 0x40000806 /end MEASUREMENT
/begin MEASUREMENT VSC_IPTEnable_Prb "" UBYTE CompuMethod_11 1 0 0 1 ECU_ADDRESS 0x4000080A /end MEASUREMENT
/begin MEASUREMENT VSC_IPTWakeup_Prb "" UBYTE CompuMethod_11 1 0 0 1 ECU_ADDRESS 0x4000080B /end MEASUREMENT
/begin MEASUREMENT VSC_MaxCurrInputMotor_Prb "" FLOAT32_IEEE CompuMethod_2 1 0 -1E+17 1E+17 ECU_ADDRESS 0x4000080C /end MEASUREMENT
/begin MEASUREMENT VSC_MaxCurrOutputGen_Prb "" FLOAT32_IEEE CompuMethod_2 1 0 -1E+17 1E+17 ECU_ADDRESS 0x40000810 /end MEASUREMENT
/begin MEASUREMENT VSC_MaxDCVoltage_Prb "" FLOAT32_IEEE CompuMethod_2 1 0 -1E+17 1E+17 ECU_ADDRESS 0x40000814 /end MEASUREMENT
/begin MEASUREMENT VSC_MinDCVoltage_Prb "" FLOAT32_IEEE CompuMethod_2 1 0 -1E+17 1E+17 ECU_ADDRESS 0x40000818 /end MEASUREMENT
/begin MEASUREMENT VSC_MotorEnable_Prb "" UBYTE CompuMethod_11 1 0 0 1 ECU_ADDRESS 0x4000081C /end MEASUREMENT
/begin MEASUREMENT VSC_PowerWasteRequest_Prb "" FLOAT32_IEEE CompuMethod_2 1 0 -1E+17 1E+17 ECU_ADDRESS 0x4000081D /end MEASUREMENT
/begin MEASUREMENT VSC_SDPTActive_Prb "" FLOAT32_IEEE CompuMethod_2 1 0 -1E+17 1E+17 ECU_ADDRESS 0x40000821 /end MEASUREMENT
/begin MEASUREMENT VSC_TRSPosition_Prb "" FLOAT32_IEEE CompuMethod_2 1 0 -1E+17 1E+17 ECU_ADDRESS 0x40000825 /end MEASUREMENT
/begin MEASUREMENT VSC_WheelTorqueRequest_Prb "" FLOAT32_IEEE CompuMethod_2 1 0 -1E+17 1E+17 ECU_ADDRESS 0x40000829 /end MEASUREMENT
/begin CHARACTERISTIC FaultManager.Pedal_Position_Sensor_A_Circuit_Intermittent.Total_Samples__Y_ "Fault manager configuration.  Select up to 4 actions for each fault." VALUE 0x80001037 RecordLayout_6 0 CompuMethod_1 0 65535 /end CHARACTERISTIC
/begin CHARACTERISTIC FaultManager.Pedal_Position_Sensor_A_Circuit_Intermittent.Action_1 "Fault manager configuration.  Select up to 4 actions for each fault." VALUE 0x80001039 RecordLayout_6 0 CompuMethod_483 0 65535 /end CHARACTERISTIC
/begin CHARACTERISTIC FaultManager.Pedal_Position_Sensor_A_Circuit_Intermittent.Action_1_Condition "Fault manager configuration.  Select up to 4 actions for each fault." VALUE 0x8000103B RecordLayout_6 0 CompuMethod_484 0 65535 /end CHARACTERISTIC
/begin CHARACTERISTIC FaultManager.Pedal_Position_Sensor_A_Circuit_Intermittent.Action_2 "Fault manager configuration.  Select up to 4 actions for each fault." VALUE 0x8000103D RecordLayout_6 0 CompuMethod_483 0 65535 /end CHARACTERISTIC
/begin CHARACTERISTIC FaultManager.Pedal_Position_Sensor_A_Circuit_Intermittent.Action_2_Condition "Fault manager configuration.  Select up to 4 actions for each fault." VALUE 0x8000103F RecordLayout_6 0 CompuMethod_484 0 65535 /end CHARACTERISTIC
/begin CHARACTERISTIC FaultManager.Pedal_Position_Sensor_A_Circuit_Intermittent.Action_3 "Fault manager configuration.  Select up to 4 actions for each fault." VALUE 0x80001041 RecordLayout_6 0 CompuMethod_483 0 65535 /end CHARACTERISTIC
/begin CHARACTERISTIC FaultManager.Pedal_Position_Sensor_A_Circuit_Intermittent.Action_3_Condition "Fault manager configuration.  Select up to 4 actions for each fault." VALUE 0x80001043 RecordLayout_6 0 CompuMethod_484 0 65535 /end CHARACTERISTIC
/begin CHARACTERISTIC FaultManager.Pedal_Position_Sensor_A_Circuit_Intermittent.Action_4 "Fault manager configuration.  Select up to 4 actions for each fault." VALUE 0x80001045 RecordLayout_6 0 CompuMethod_483 0 65535 /end CHARACTERISTIC
/begin CHARACTERISTIC FaultManager.Pedal_Position_Sensor_A_Circuit_Intermittent.Action_4_Condition "Fault manager configuration.  Select up to 4 actions for each fault." VALUE 0x80001047 RecordLayout_6 0 CompuMethod_484 0 65535 /end CHARACTERISTIC
/begin CHARACTERISTIC FaultManager.Pedal_Position_Sensor_A_Circuit_Low.Mode "Fault manager configuration.  Select up to 4 actions for each fault." VALUE 0x80001049 RecordLayout_6 0 CompuMethod_481 0 65535 /end CHARACTERISTIC
/begin CHARACTERISTIC FaultManager.Pedal_Position_Sensor_A_Circuit_Low.ID "Fault manager configuration.  Select up to 4 actions for each fault." VALUE 0x8000104B RecordLayout_6 0 CompuMethod_1 0 65535 /end CHARACTERISTIC
/begin CHARACTERISTIC FaultManager.Pedal_Position_Sensor_A_Circuit_Low.Test "Fault manager configuration.  Select up to 4 actions for each fault." VALUE 0x8000104D RecordLayout_6 0 CompuMethod_482 0 65535 /end CHARACTERISTIC
/begin CHARACTERISTIC FaultManager.Pedal_Position_Sensor_A_Circuit_Low.Faulty_Samples__X_ "Fault manager configuration.  Select up to 4 actions for each fault." VALUE 0x8000104F RecordLayout_6 0 CompuMethod_1 0 65535 /end CHARACTERISTIC
/begin CHARACTERISTIC FaultManager.Pedal_Position_Sensor_A_Circuit_Low.Total_Samples__Y_ "Fault manager configuration.  Select up to 4 actions for each fault." VALUE 0x80001051 RecordLayout_6 0 CompuMethod_1 0 65535 /end CHARACTERISTIC
/begin CHARACTERISTIC FaultManager.Pedal_Position_Sensor_A_Circuit_Low.Action_1 "Fault manager configuration.  Select up to 4 actions for each fault." VALUE 0x80001053 RecordLayout_6 0 CompuMethod_483 0 65535 /end CHARACTERISTIC
/begin CHARACTERISTIC FaultManager.Pedal_Position_Sensor_A_Circuit_Low.Action_1_Condition "Fault manager configuration.  Select up to 4 actions for each fault." VALUE 0x80001055 RecordLayout_6 0 CompuMethod_484 0 65535 /end CHARACTERISTIC
/begin CHARACTERISTIC FaultManager.Pedal_Position_Sensor_A_Circuit_Low.Action_2 "Fault manager configuration.  Select up to 4 actions for each fault." VALUE 0x80001057 RecordLayout_6 0 CompuMethod_483 0 65535 /end CHARACTERISTIC
/begin CHARACTERISTIC FaultManager.Pedal_Position_Sensor_A_Circuit_Low.Action_2_Condition "Fault manager configuration.  Select up to 4 actions for each fault." VALUE 0x80001059 RecordLayout_6 0 CompuMethod_484 0 65535 /end CHARACTERISTIC
/begin CHARACTERISTIC FaultManager.Pedal_Position_Sensor_A_Circuit_Low.Action_3 "Fault manager configuration.  Select up to 4 actions for each fault." VALUE 0x8000105B RecordLayout_6 0 CompuMethod_483 0 65535 /end CHARACTERISTIC
/begin CHARACTERISTIC FaultManager.Pedal_Position_Sensor_A_Circuit_Low.Action_3_Condition "Fault manager configuration.  Select up to 4 actions for each fault." VALUE 0x8000105D RecordLayout_6 0 CompuMethod_484 0 65535 /end CHARACTERISTIC
/begin CHARACTERISTIC FaultManager.Pedal_Position_Sensor_A_Circuit_Low.Action_4 "Fault manager configuration.  Select up to 4 actions for each fault." VALUE 0x8000105F RecordLayout_6 0 CompuMethod_483 0 65535 /end CHARACTERISTIC
/begin CHARACTERISTIC FaultManager.Pedal_Position_Sensor_A_Circuit_Low.Action_4_Condition "Fault manager configuration.  Select up to 4 actions for each fault." VALUE 0x80001061 RecordLayout_6 0 CompuMethod_484 0 65535 /end CHARACTERISTIC
/begin CHARACTERISTIC FaultManager.Steering_Wheel_AgeCount.Mode "Fault manager configuration.  Select up to 4 actions for each fault." VALUE 0x80001063 RecordLayout_6 0 CompuMethod_481 0 65535 /end CHARACTERISTIC
/begin CHARACTERISTIC FaultManager.Steering_Wheel_AgeCount.ID "Fault manager configuration.  Select up to 4 actions for each fault." VALUE 0x80001065 RecordLayout_6 0 CompuMethod_1 0 65535 /end CHARACTERISTIC
/begin CHARACTERISTIC FaultManager.Steering_Wheel_AgeCount.Test "Fault manager configuration.  Select up to 4 actions for each fault." VALUE 0x80001067 RecordLayout_6 0 CompuMethod_482 0 65535 /end CHARACTERISTIC
/begin CHARACTERISTIC FaultManager.Steering_Wheel_AgeCount.Faulty_Samples__X_ "Fault manager configuration.  Select up to 4 actions for each fault." VALUE 0x80001069 RecordLayout_6 0 CompuMethod_1 0 65535 /end CHARACTERISTIC
/begin CHARACTERISTIC FaultManager.Steering_Wheel_AgeCount.Total_Samples__Y_ "Fault manager configuration.  Select up to 4 actions for each fault." VALUE 0x8000106B RecordLayout_6 0 CompuMethod_1 0 65535 /end CHARACTERISTIC
/begin CHARACTERISTIC FaultManager.Steering_Wheel_AgeCount.Action_1 "Fault manager configuration.  Select up to 4 actions for each fault." VALUE 0x8000106D RecordLayout_6 0 CompuMethod_483 0 65535 /end CHARACTERISTIC
/begin CHARACTERISTIC FaultManager.Steering_Wheel_AgeCount.Action_1_Condition "Fault manager configuration.  Select up to 4 actions for each fault." VALUE 0x8000106F RecordLayout_6 0 CompuMethod_484 0 65535 /end CHARACTERISTIC
/begin CHARACTERISTIC FaultManager.Steering_Wheel_AgeCount.Action_2 "Fault manager configuration.  Select up to 4 actions for each fault." VALUE 0x80001071 RecordLayout_6 0 CompuMethod_483 0 65535 /end CHARACTERISTIC
/begin CHARACTERISTIC FaultManager.Steering_Wheel_AgeCount.Action_2_Condition "Fault manager configuration.  Select up to 4 actions for each fault." VALUE 0x80001073 RecordLayout_6 0 CompuMethod_484 0 65535 /end CHARACTERISTIC
/begin CHARACTERISTIC FaultManager.Steering_Wheel_AgeCount.Action_3 "Fault manager configuration.  Select up to 4 actions for each fault." VALUE 0x80001075 RecordLayout_6 0 CompuMethod_483 0 65535 /end CHARACTERISTIC
/begin CHARACTERISTIC FaultManager.Steering_Wheel_AgeCount.Action_3_Condition "Fault manager configuration.  Select up to 4 actions for each fault." VALUE 0x80001077 RecordLayout_6 0 CompuMethod_484 0 65535 /end CHARACTERISTIC
/begin CHARACTERISTIC FaultManager.Steering_Wheel_AgeCount.Action_4 "Fault manager configuration.  Select up to 4 actions for each fault." VALUE 0x80001079 RecordLayout_6 0 CompuMethod_483 0 65535 /end CHARACTERISTIC
/begin CHARACTERISTIC FaultManager.Steering_Wheel_AgeCount.Action_4_Condition "Fault manager configuration.  Select up to 4 actions for each fault." VALUE 0x8000107B RecordLayout_6 0 CompuMethod_484 0 65535 /end CHARACTERISTIC
/begin CHARACTERISTIC FaultManager.System_Voltage_High.Mode "Fault manager configuration.  Select up to 4 actions for each fault." VALUE 0x8000107D RecordLayout_6 0 CompuMethod_481 0 65535 /end CHARACTERISTIC
/begin CHARACTERISTIC FaultManager.System_Voltage_High.ID "Fault manager configuration.  Select up to 4 actions for each fault." VALUE 0x8000107F RecordLayout_6 0 CompuMethod_1 0 65535 /end CHARACTERISTIC
/begin CHARACTERISTIC FaultManager.System_Voltage_High.Test "Fault manager configuration.  Select up to 4 actions for each fault." VALUE 0x80001081 RecordLayout_6 0 CompuMethod_482 0 65535 /end CHARACTERISTIC
/begin CHARACTERISTIC FaultManager.System_Voltage_High.Faulty_Samples__X_ "Fault manager configuration.  Select up to 4 actions for each fault." VALUE 0x80001083 RecordLayout_6 0 CompuMethod_1 0 65535 /end CHARACTERISTIC
/begin CHARACTERISTIC FaultManager.System_Voltage_High.Total_Samples__Y_ "Fault manager configuration.  Select up to 4 actions for each fault." VALUE 0x80001085 RecordLayout_6 0 CompuMethod_1 0 65535 /end CHARACTERISTIC
/begin CHARACTERISTIC FaultManager.System_Voltage_High.Action_1 "Fault manager configuration.  Select up to 4 actions for each fault." VALUE 0x80001087 RecordLayout_6 0 CompuMethod_483 0 65535 /end CHARACTERISTIC
/begin CHARACTERISTIC FaultManager.System_Voltage_High.Action_1_Condition "Fault manager configuration.  Select up to 4 actions for each fault." VALUE 0x80001089 RecordLayout_6 0 CompuMethod_484 0 65535 /end CHARACTERISTIC
/begin CHARACTERISTIC FaultManager.System_Voltage_High.Action_2 "Fault manager configuration.  Select up to 4 actions for each fault." VALUE 0x8000108B RecordLayout_6 0 CompuMethod_483 0 65535 /end CHARACTERISTIC
/begin CHARACTERISTIC FaultManager.System_Voltage_High.Action_2_Condition "Fault manager configuration.  Select up to 4 actions for each fault." VALUE 0x8000108D RecordLayout_6 0 CompuMethod_484 0 65535 /end CHARACTERISTIC
/begin CHARACTERISTIC FaultManager.System_Voltage_High.Action_3 "Fault manager configuration.  Select up to 4 actions for each fault." VALUE 0x8000108F RecordLayout_6 0 CompuMethod_483 0 65535 /end CHARACTERISTIC
/begin CHARACTERISTIC FaultManager.System_Voltage_High.Action_3_Condition "Fault manager configuration.  Select up to 4 actions for each fault." VALUE 0x80001091 RecordLayout_6 0 CompuMethod_484 0 65535 /end CHARACTERISTIC
/begin CHARACTERISTIC FaultManager.System_Voltage_High.Action_4 "Fault manager configuration.  Select up to 4 actions for each fault." VALUE 0x80001093 RecordLayout_6 0 CompuMethod_483 0 65535 /end CHARACTERISTIC
/begin CHARACTERISTIC FaultManager.System_Voltage_High.Action_4_Condition "Fault manager configuration.  Select up to 4 actions for each fault." VALUE 0x80001095 RecordLayout_6 0 CompuMethod_484 0 65535 /end CHARACTERISTIC
/begin CHARACTERISTIC FaultManager.System_Voltage_Low.Mode "Fault manager configuration.  Select up to 4 actions for each fault." VALUE 0x80001097 RecordLayout_6 0 CompuMethod_481 0 65535 /end CHARACTERISTIC
/begin CHARACTERISTIC FaultManager.System_Voltage_Low.ID "Fault manager configuration.  Select up to 4 actions for each fault." VALUE 0x80001099 RecordLayout_6 0 CompuMethod_1 0 65535 /end CHARACTERISTIC
/begin CHARACTERISTIC FaultManager.System_Voltage_Low.Test "Fault manager configuration.  Select up to 4 actions for each fault." VALUE 0x8000109B RecordLayout_6 0 CompuMethod_482 0 65535 /end CHARACTERISTIC
/begin CHARACTERISTIC FaultManager.System_Voltage_Low.Faulty_Samples__X_ "Fault manager configuration.  Select up to 4 actions for each fault." VALUE 0x8000109D RecordLayout_6 0 CompuMethod_1 0 65535 /end CHARACTERISTIC
/begin CHARACTERISTIC FaultManager.System_Voltage_Low.Total_Samples__Y_ "Fault manager configuration.  Select up to 4 actions for each fault." VALUE 0x8000109F RecordLayout_6 0 CompuMethod_1 0 65535 /end CHARACTERISTIC
/begin CHARACTERISTIC FaultManager.System_Voltage_Low.Action_1 "Fault manager configuration.  Select up to 4 actions for each fault." VALUE 0x800010A1 RecordLayout_6 0 CompuMethod_483 0 65535 /end CHARACTERISTIC
/begin CHARACTERISTIC FaultManager.System_Voltage_Low.Action_1_Condition "Fault manager configuration.  Select up to 4 actions for each fault." VALUE 0x800010A3 RecordLayout_6 0 CompuMethod_484 0 65535 /end CHARACTERISTIC
/begin CHARACTERISTIC FaultManager.System_Voltage_Low.Action_2 "Fault manager configuration.  Select up to 4 actions for each fault." VALUE 0x800010A5 RecordLayout_6 0 CompuMethod_483 0 65535 /end CHARACTERISTIC
/begin CHARACTERISTIC FaultManager.System_Voltage_Low.Action_2_Condition "Fault manager configuration.  Select up to 4 actions for each fault." VALUE 0x800010A7 RecordLayout_6 0 CompuMethod_484 0 65535 /end CHARACTERISTIC
/begin CHARACTERISTIC FaultManager.System_Voltage_Low.Action_3 "Fault manager configuration.  Select up to 4 actions for each fault." VALUE 0x800010A9 RecordLayout_6 0 CompuMethod_483 0 65535 /end CHARACTERISTIC
/begin CHARACTERISTIC FaultManager.System_Voltage_Low.Action_3_Condition "Fault manager configuration.  Select up to 4 actions for each fault." VALUE 0x800010AB RecordLayout_6 0 CompuMethod_484 0 65535 /end CHARACTERISTIC
/begin CHARACTERISTIC FaultManager.System_Voltage_Low.Action_4 "Fault manager configuration.  Select up to 4 actions for each fault." VALUE 0x800010AD RecordLayout_6 0 CompuMethod_483 0 65535 /end CHARACTERISTIC
/begin CHARACTERISTIC FaultManager.System_Voltage_Low.Action_4_Condition "Fault manager configuration.  Select up to 4 actions for each fault." VALUE 0x800010AF RecordLayout_6 0 CompuMethod_484 0 65535 /end CHARACTERISTIC
/begin CHARACTERISTIC FaultManager.System_Voltage_Malfunction.Mode "Fault manager configuration.  Select up to 4 actions for each fault." VALUE 0x800010B1 RecordLayout_6 0 CompuMethod_481 0 65535 /end CHARACTERISTIC
/begin CHARACTERISTIC FaultManager.System_Voltage_Malfunction.ID "Fault manager configuration.  Select up to 4 actions for each fault." VALUE 0x800010B3 RecordLayout_6 0 CompuMethod_1 0 65535 /end CHARACTERISTIC
/begin CHARACTERISTIC FaultManager.System_Voltage_Malfunction.Test "Fault manager configuration.  Select up to 4 actions for each fault." VALUE 0x800010B5 RecordLayout_6 0 CompuMethod_482 0 65535 /end CHARACTERISTIC
/begin CHARACTERISTIC FaultManager.System_Voltage_Malfunction.Faulty_Samples__X_ "Fault manager configuration.  Select up to 4 actions for each fault." VALUE 0x800010B7 RecordLayout_6 0 CompuMethod_1 0 65535 /end CHARACTERISTIC
/begin CHARACTERISTIC FaultManager.System_Voltage_Malfunction.Total_Samples__Y_ "Fault manager configuration.  Select up to 4 actions for each fault." VALUE 0x800010B9 RecordLayout_6 0 CompuMethod_1 0 65535 /end CHARACTERISTIC
/begin CHARACTERISTIC FaultManager.System_Voltage_Malfunction.Action_1 "Fault manager configuration.  Select up to 4 actions for each fault." VALUE 0x800010BB RecordLayout_6 0 CompuMethod_483 0 65535 /end CHARACTERISTIC
/begin CHARACTERISTIC FaultManager.System_Voltage_Malfunction.Action_1_Condition "Fault manager configuration.  Select up to 4 actions for each fault." VALUE 0x800010BD RecordLayout_6 0 CompuMethod_484 0 65535 /end CHARACTERISTIC
/begin CHARACTERISTIC FaultManager.System_Voltage_Malfunction.Action_2 "Fault manager configuration.  Select up to 4 actions for each fault." VALUE 0x800010BF RecordLayout_6 0 CompuMethod_483 0 65535 /end CHARACTERISTIC
/begin CHARACTERISTIC FaultManager.System_Voltage_Malfunction.Action_2_Condition "Fault manager configuration.  Select up to 4 actions for each fault." VALUE 0x800010C1 RecordLayout_6 0 CompuMethod_484 0 65535 /end CHARACTERISTIC
/begin CHARACTERISTIC FaultManager.System_Voltage_Malfunction.Action_3 "Fault manager configuration.  Select up to 4 actions for each fault." VALUE 0x800010C3 RecordLayout_6 0 CompuMethod_483 0 65535 /end CHARACTERISTIC
/begin CHARACTERISTIC FaultManager.System_Voltage_Malfunction.Action_3_Condition "Fault manager configuration.  Select up to 4 actions for each fault." VALUE 0x800010C5 RecordLayout_6 0 CompuMethod_484 0 65535 /end CHARACTERISTIC
/begin CHARACTERISTIC FaultManager.System_Voltage_Malfunction.Action_4 "Fault manager configuration.  Select up to 4 actions for each fault." VALUE 0x800010C7 RecordLayout_6 0 CompuMethod_483 0 65535 /end CHARACTERISTIC
/begin CHARACTERISTIC FaultManager.System_Voltage_Malfunction.Action_4_Condition "Fault manager configuration.  Select up to 4 actions for each fault." VALUE 0x800010C9 RecordLayout_6 0 CompuMethod_484 0 65535 /end CHARACTERISTIC
/begin CHARACTERISTIC FaultManager.System_Voltage_Unstable.Mode "Fault manager configuration.  Select up to 4 actions for each fault." VALUE 0x800010CB RecordLayout_6 0 CompuMethod_481 0 65535 /end CHARACTERISTIC
/begin CHARACTERISTIC FaultManager.System_Voltage_Unstable.ID "Fault manager configuration.  Select up to 4 actions for each fault." VALUE 0x800010CD RecordLayout_6 0 CompuMethod_1 0 65535 /end CHARACTERISTIC
/begin CHARACTERISTIC FaultManager.System_Voltage_Unstable.Test "Fault manager configuration.  Select up to 4 actions for each fault." VALUE 0x800010CF RecordLayout_6 0 CompuMethod_482 0 65535 /end CHARACTERISTIC
/begin CHARACTERISTIC FaultManager.System_Voltage_Unstable.Faulty_Samples__X_ "Fault manager configuration.  Select up to 4 actions for each fault." VALUE 0x800010D1 RecordLayout_6 0 CompuMethod_1 0 65535 /end CHARACTERISTIC
/begin CHARACTERISTIC FaultManager.System_Voltage_Unstable.Total_Samples__Y_ "Fault manager configuration.  Select up to 4 actions for each fault." VALUE 0x800010D3 RecordLayout_6 0 CompuMethod_1 0 65535 /end CHARACTERISTIC
/begin CHARACTERISTIC FaultManager.System_Voltage_Unstable.Action_1 "Fault manager configuration.  Select up to 4 actions for each fault." VALUE 0x800010D5 RecordLayout_6 0 CompuMethod_483 0 65535 /end CHARACTERISTIC
/begin CHARACTERISTIC FaultManager.System_Voltage_Unstable.Action_1_Condition "Fault manager configuration.  Select up to 4 actions for each fault." VALUE 0x800010D7 RecordLayout_6 0 CompuMethod_484 0 65535 /end CHARACTERISTIC
/begin CHARACTERISTIC FaultManager.System_Voltage_Unstable.Action_2 "Fault manager configuration.  Select up to 4 actions for each fault." VALUE 0x800010D9 RecordLayout_6 0 CompuMethod_483 0 65535 /end CHARACTERISTIC
/begin CHARACTERISTIC FaultManager.System_Voltage_Unstable.Action_2_Condition "Fault manager configuration.  Select up to 4 actions for each fault." VALUE 0x800010DB RecordLayout_6 0 CompuMethod_484 0 65535 /end CHARACTERISTIC
/begin CHARACTERISTIC FaultManager.System_Voltage_Unstable.Action_3 "Fault manager configuration.  Select up to 4 actions for each fault." VALUE 0x800010DD RecordLayout_6 0 CompuMethod_483 0 65535 /end CHARACTERISTIC
/begin CHARACTERISTIC FaultManager.System_Voltage_Unstable.Action_3_Condition "Fault manager configuration.  Select up to 4 actions for each fault." VALUE 0x800010DF RecordLayout_6 0 CompuMethod_484 0 65535 /end CHARACTERISTIC
/begin CHARACTERISTIC FaultManager.System_Voltage_Unstable.Action_4 "Fault manager configuration.  Select up to 4 actions for each fault." VALUE 0x800010E1 RecordLayout_6 0 CompuMethod_483 0 65535 /end CHARACTERISTIC
/begin CHARACTERISTIC FaultManager.System_Voltage_Unstable.Action_4_Condition "Fault manager configuration.  Select up to 4 actions for each fault." VALUE 0x800010E3 RecordLayout_6 0 CompuMethod_484 0 65535 /end CHARACTERISTIC
/begin CHARACTERISTIC FaultManager.Traction_Control_General_Fault.Mode "Fault manager configuration.  Select up to 4 actions for each fault." VALUE 0x800010E5 RecordLayout_6 0 CompuMethod_481 0 65535 /end CHARACTERISTIC
/begin CHARACTERISTIC FaultManager.Traction_Control_General_Fault.ID "Fault manager configuration.  Select up to 4 actions for each fault." VALUE 0x800010E7 RecordLayout_6 0 CompuMethod_1 0 65535 /end CHARACTERISTIC
/begin CHARACTERISTIC FaultManager.Traction_Control_General_Fault.Test "Fault manager configuration.  Select up to 4 actions for each fault." VALUE 0x800010E9 RecordLayout_6 0 CompuMethod_482 0 65535 /end CHARACTERISTIC
/begin CHARACTERISTIC FaultManager.Traction_Control_General_Fault.Faulty_Samples__X_ "Fault manager configuration.  Select up to 4 actions for each fault." VALUE 0x800010EB RecordLayout_6 0 CompuMethod_1 0 65535 /end CHARACTERISTIC
/begin CHARACTERISTIC FaultManager.Traction_Control_General_Fault.Total_Samples__Y_ "Fault manager configuration.  Select up to 4 actions for each fault." VALUE 0x800010ED RecordLayout_6 0 CompuMethod_1 0 65535 /end CHARACTERISTIC
/begin CHARACTERISTIC FaultManager.Traction_Control_General_Fault.Action_1 "Fault manager configuration.  Select up to 4 actions for each fault." VALUE 0x800010EF RecordLayout_6 0 CompuMethod_483 0 65535 /end CHARACTERISTIC
/begin CHARACTERISTIC FaultManager.Traction_Control_General_Fault.Action_1_Condition "Fault manager configuration.  Select up to 4 actions for each fault." VALUE 0x800010F1 RecordLayout_6 0 CompuMethod_484 0 65535 /end CHARACTERISTIC
/begin CHARACTERISTIC FaultManager.Traction_Control_General_Fault.Action_2 "Fault manager configuration.  Select up to 4 actions for each fault." VALUE 0x800010F3 RecordLayout_6 0 CompuMethod_483 0 65535 /end CHARACTERISTIC
/begin CHARACTERISTIC FaultManager.Traction_Control_General_Fault.Action_2_Condition "Fault manager configuration.  Select up to 4 actions for each fault." VALUE 0x800010F5 RecordLayout_6 0 CompuMethod_484 0 65535 /end CHARACTERISTIC
/begin CHARACTERISTIC FaultManager.Traction_Control_General_Fault.Action_3 "Fault manager configuration.  Select up to 4 actions for each fault." VALUE 0x800010F7 RecordLayout_6 0 CompuMethod_483 0 65535 /end CHARACTERISTIC
/begin CHARACTERISTIC FaultManager.Traction_Control_General_Fault.Action_3_Condition "Fault manager configuration.  Select up to 4 actions for each fault." VALUE 0x800010F9 RecordLayout_6 0 CompuMethod_484 0 65535 /end CHARACTERISTIC
/begin CHARACTERISTIC FaultManager.Traction_Control_General_Fault.Action_4 "Fault manager configuration.  Select up to 4 actions for each fault." VALUE 0x800010FB RecordLayout_6 0 CompuMethod_483 0 65535 /end CHARACTERISTIC
/begin CHARACTERISTIC FaultManager.Traction_Control_General_Fault.Action_4_Condition "Fault manager configuration.  Select up to 4 actions for each fault." VALUE 0x800010FD RecordLayout_6 0 CompuMethod_484 0 65535 /end CHARACTERISTIC
/begin CHARACTERISTIC FaultManager.Traction_Control_LeftFront_Malfunction.Mode "Fault manager configuration.  Select up to 4 actions for each fault." VALUE 0x800010FF RecordLayout_6 0 CompuMethod_481 0 65535 /end CHARACTERISTIC
/begin CHARACTERISTIC FaultManager.Traction_Control_LeftFront_Malfunction.ID "Fault manager configuration.  Select up to 4 actions for each fault." VALUE 0x80001101 RecordLayout_6 0 CompuMethod_1 0 65535 /end CHARACTERISTIC
/begin CHARACTERISTIC FaultManager.Traction_Control_LeftFront_Malfunction.Test "Fault manager configuration.  Select up to 4 actions for each fault." VALUE 0x80001103 RecordLayout_6 0 CompuMethod_482 0 65535 /end CHARACTERISTIC
/begin CHARACTERISTIC FaultManager.Traction_Control_LeftFront_Malfunction.Faulty_Samples__X_ "Fault manager configuration.  Select up to 4 actions for each fault." VALUE 0x80001105 RecordLayout_6 0 CompuMethod_1 0 65535 /end CHARACTERISTIC
/begin CHARACTERISTIC FaultManager.Traction_Control_LeftFront_Malfunction.Total_Samples__Y_ "Fault manager configuration.  Select up to 4 actions for each fault." VALUE 0x80001107 RecordLayout_6 0 CompuMethod_1 0 65535 /end CHARACTERISTIC
/begin CHARACTERISTIC FaultManager.Traction_Control_LeftFront_Malfunction.Action_1 "Fault manager configuration.  Select up to 4 actions for each fault." VALUE 0x80001109 RecordLayout_6 0 CompuMethod_483 0 65535 /end CHARACTERISTIC
/begin CHARACTERISTIC FaultManager.Traction_Control_LeftFront_Malfunction.Action_1_Condition "Fault manager configuration.  Select up to 4 actions for each fault." VALUE 0x8000110B RecordLayout_6 0 CompuMethod_484 0 65535 /end CHARACTERISTIC
/begin CHARACTERISTIC FaultManager.Traction_Control_LeftFront_Malfunction.Action_2 "Fault manager configuration.  Select up to 4 actions for each fault." VALUE 0x8000110D RecordLayout_6 0 CompuMethod_483 0 65535 /end CHARACTERISTIC
/begin CHARACTERISTIC FaultManager.Traction_Control_LeftFront_Malfunction.Action_2_Condition "Fault manager configuration.  Select up to 4 actions for each fault." VALUE 0x8000110F RecordLayout_6 0 CompuMethod_484 0 65535 /end CHARACTERISTIC
/begin CHARACTERISTIC FaultManager.Traction_Control_LeftFront_Malfunction.Action_3 "Fault manager configuration.  Select up to 4 actions for each fault." VALUE 0x80001111 RecordLayout_6 0 CompuMethod_483 0 65535 /end CHARACTERISTIC
/begin CHARACTERISTIC FaultManager.Traction_Control_LeftFront_Malfunction.Action_3_Condition "Fault manager configuration.  Select up to 4 actions for each fault." VALUE 0x80001113 RecordLayout_6 0 CompuMethod_484 0 65535 /end CHARACTERISTIC
/begin CHARACTERISTIC FaultManager.Traction_Control_LeftFront_Malfunction.Action_4 "Fault manager configuration.  Select up to 4 actions for each fault." VALUE 0x80001115 RecordLayout_6 0 CompuMethod_483 0 65535 /end CHARACTERISTIC
/begin CHARACTERISTIC FaultManager.Traction_Control_LeftFront_Malfunction.Action_4_Condition "Fault manager configuration.  Select up to 4 actions for each fault." VALUE 0x80001117 RecordLayout_6 0 CompuMethod_484 0 65535 /end CHARACTERISTIC
/begin CHARACTERISTIC FaultManager.Traction_Control_LeftRear_Malfunction.Mode "Fault manager configuration.  Select up to 4 actions for each fault." VALUE 0x80001119 RecordLayout_6 0 CompuMethod_481 0 65535 /end CHARACTERISTIC
/begin CHARACTERISTIC FaultManager.Traction_Control_LeftRear_Malfunction.ID "Fault manager configuration.  Select up to 4 actions for each fault." VALUE 0x8000111B RecordLayout_6 0 CompuMethod_1 0 65535 /end CHARACTERISTIC
/begin CHARACTERISTIC FaultManager.Traction_Control_LeftRear_Malfunction.Test "Fault manager configuration.  Select up to 4 actions for each fault." VALUE 0x8000111D RecordLayout_6 0 CompuMethod_482 0 65535 /end CHARACTERISTIC
/begin CHARACTERISTIC FaultManager.Traction_Control_LeftRear_Malfunction.Faulty_Samples__X_ "Fault manager configuration.  Select up to 4 actions for each fault." VALUE 0x8000111F RecordLayout_6 0 CompuMethod_1 0 65535 /end CHARACTERISTIC
/begin CHARACTERISTIC FaultManager.Traction_Control_LeftRear_Malfunction.Total_Samples__Y_ "Fault manager configuration.  Select up to 4 actions for each fault." VALUE 0x80001121 RecordLayout_6 0 CompuMethod_1 0 65535 /end CHARACTERISTIC
/begin CHARACTERISTIC FaultManager.Traction_Control_LeftRear_Malfunction.Action_1 "Fault manager configuration.  Select up to 4 actions for each fault." VALUE 0x80001123 RecordLayout_6 0 CompuMethod_483 0 65535 /end CHARACTERISTIC
/begin CHARACTERISTIC FaultManager.Traction_Control_LeftRear_Malfunction.Action_1_Condition "Fault manager configuration.  Select up to 4 actions for each fault." VALUE 0x80001125 RecordLayout_6 0 CompuMethod_484 0 65535 /end CHARACTERISTIC
/begin CHARACTERISTIC FaultManager.Traction_Control_LeftRear_Malfunction.Action_2 "Fault manager configuration.  Select up to 4 actions for each fault." VALUE 0x80001127 RecordLayout_6 0 CompuMethod_483 0 65535 /end CHARACTERISTIC
/begin CHARACTERISTIC FaultManager.Traction_Control_LeftRear_Malfunction.Action_2_Condition "Fault manager configuration.  Select up to 4 actions for each fault." VALUE 0x80001129 RecordLayout_6 0 CompuMethod_484 0 65535 /end CHARACTERISTIC
/begin CHARACTERISTIC FaultManager.Traction_Control_LeftRear_Malfunction.Action_3 "Fault manager configuration.  Select up to 4 actions for each fault." VALUE 0x8000112B RecordLayout_6 0 CompuMethod_483 0 65535 /end CHARACTERISTIC
/begin CHARACTERISTIC FaultManager.Traction_Control_LeftRear_Malfunction.Action_3_Condition "Fault manager configuration.  Select up to 4 actions for each fault." VALUE 0x8000112D RecordLayout_6 0 CompuMethod_484 0 65535 /end CHARACTERISTIC
/begin CHARACTERISTIC FaultManager.Traction_Control_LeftRear_Malfunction.Action_4 "Fault manager configuration.  Select up to 4 actions for each fault." VALUE 0x8000112F RecordLayout_6 0 CompuMethod_483 0 65535 /end CHARACTERISTIC
/begin CHARACTERISTIC FaultManager.Traction_Control_LeftRear_Malfunction.Action_4_Condition "Fault manager configuration.  Select up to 4 actions for each fault." VALUE 0x80001131 RecordLayout_6 0 CompuMethod_484 0 65535 /end CHARACTERISTIC
/begin CHARACTERISTIC FaultManager.Traction_Control_RightFront_Malfunction.Mode "Fault manager configuration.  Select up to 4 actions for each fault." VALUE 0x80001133 RecordLayout_6 0 CompuMethod_481 0 65535 /end CHARACTERISTIC
/begin CHARACTERISTIC FaultManager.Traction_Control_RightFront_Malfunction.ID "Fault manager configuration.  Select up to 4 actions for each fault." VALUE 0x80001135 RecordLayout_6 0 CompuMethod_1 0 65535 /end CHARACTERISTIC
/begin CHARACTERISTIC FaultManager.Traction_Control_RightFront_Malfunction.Test "Fault manager configuration.  Select up to 4 actions for each fault." VALUE 0x80001137 RecordLayout_6 0 CompuMethod_482 0 65535 /end CHARACTERISTIC
/begin CHARACTERISTIC FaultManager.Traction_Control_RightFront_Malfunction.Faulty_Samples__X_ "Fault manager configuration.  Select up to 4 actions for each fault." VALUE 0x80001139 RecordLayout_6 0 CompuMethod_1 0 65535 /end CHARACTERISTIC
/begin CHARACTERISTIC FaultManager.Traction_Control_RightFront_Malfunction.Total_Samples__Y_ "Fault manager configuration.  Select up to 4 actions for each fault." VALUE 0x8000113B RecordLayout_6 0 CompuMethod_1 0 65535 /end CHARACTERISTIC
/begin CHARACTERISTIC FaultManager.Traction_Control_RightFront_Malfunction.Action_1 "Fault manager configuration.  Select up to 4 actions for each fault." VALUE 0x8000113D RecordLayout_6 0 CompuMethod_483 0 65535 /end CHARACTERISTIC
/begin CHARACTERISTIC FaultManager.Traction_Control_RightFront_Malfunction.Action_1_Condition "Fault manager configuration.  Select up to 4 actions for each fault." VALUE 0x8000113F RecordLayout_6 0 CompuMethod_484 0 65535 /end CHARACTERISTIC
/begin CHARACTERISTIC FaultManager.Traction_Control_RightFront_Malfunction.Action_2 "Fault manager configuration.  Select up to 4 actions for each fault." VALUE 0x80001141 RecordLayout_6 0 CompuMethod_483 0 65535 /end CHARACTERISTIC
/begin CHARACTERISTIC FaultManager.Traction_Control_RightFront_Malfunction.Action_2_Condition "Fault manager configuration.  Select up to 4 actions for each fault." VALUE 0x80001143 RecordLayout_6 0 CompuMethod_484 0 65535 /end CHARACTERISTIC
/begin CHARACTERISTIC FaultManager.Traction_Control_RightFront_Malfunction.Action_3 "Fault manager configuration.  Select up to 4 actions for each fault." VALUE 0x80001145 RecordLayout_6 0 CompuMethod_483 0 65535 /end CHARACTERISTIC
/begin CHARACTERISTIC FaultManager.Traction_Control_RightFront_Malfunction.Action_3_Condition "Fault manager configuration.  Select up to 4 actions for each fault." VALUE 0x80001147 RecordLayout_6 0 CompuMethod_484 0 65535 /end CHARACTERISTIC
/begin CHARACTERISTIC FaultManager.Traction_Control_RightFront_Malfunction.Action_4 "Fault manager configuration.  Select up to 4 actions for each fault." VALUE 0x80001149 RecordLayout_6 0 CompuMethod_483 0 65535 /end CHARACTERISTIC
/begin CHARACTERISTIC FaultManager.Traction_Control_RightFront_Malfunction.Action_4_Condition "Fault manager configuration.  Select up to 4 actions for each fault." VALUE 0x8000114B RecordLayout_6 0 CompuMethod_484 0 65535 /end CHARACTERISTIC
/begin CHARACTERISTIC FaultManager.Traction_Control_RightRear_Malfunction.Mode "Fault manager configuration.  Select up to 4 actions for each fault." VALUE 0x8000114D RecordLayout_6 0 CompuMethod_481 0 65535 /end CHARACTERISTIC
/begin CHARACTERISTIC FaultManager.Traction_Control_RightRear_Malfunction.ID "Fault manager configuration.  Select up to 4 actions for each fault." VALUE 0x8000114F RecordLayout_6 0 CompuMethod_1 0 65535 /end CHARACTERISTIC
/begin CHARACTERISTIC FaultManager.Traction_Control_RightRear_Malfunction.Test "Fault manager configuration.  Select up to 4 actions for each fault." VALUE 0x80001151 RecordLayout_6 0 CompuMethod_482 0 65535 /end CHARACTERISTIC
/begin CHARACTERISTIC FaultManager.Traction_Control_RightRear_Malfunction.Faulty_Samples__X_ "Fault manager configuration.  Select up to 4 actions for each fault." VALUE 0x80001153 RecordLayout_6 0 CompuMethod_1 0 65535 /end CHARACTERISTIC
/begin CHARACTERISTIC FaultManager.Traction_Control_RightRear_Malfunction.Total_Samples__Y_ "Fault manager configuration.  Select up to 4 actions for each fault." VALUE 0x80001155 RecordLayout_6 0 CompuMethod_1 0 65535 /end CHARACTERISTIC
/begin CHARACTERISTIC FaultManager.Traction_Control_RightRear_Malfunction.Action_1 "Fault manager configuration.  Select up to 4 actions for each fault." VALUE 0x80001157 RecordLayout_6 0 CompuMethod_483 0 65535 /end CHARACTERISTIC
/begin CHARACTERISTIC FaultManager.Traction_Control_RightRear_Malfunction.Action_1_Condition "Fault manager configuration.  Select up to 4 actions for each fault." VALUE 0x80001159 RecordLayout_6 0 CompuMethod_484 0 65535 /end CHARACTERISTIC
/begin CHARACTERISTIC FaultManager.Traction_Control_RightRear_Malfunction.Action_2 "Fault manager configuration.  Select up to 4 actions for each fault." VALUE 0x8000115B RecordLayout_6 0 CompuMethod_483 0 65535 /end CHARACTERISTIC
/begin CHARACTERISTIC FaultManager.Traction_Control_RightRear_Malfunction.Action_2_Condition "Fault manager configuration.  Select up to 4 actions for each fault." VALUE 0x8000115D RecordLayout_6 0 CompuMethod_484 0 65535 /end CHARACTERISTIC
/begin CHARACTERISTIC FaultManager.Traction_Control_RightRear_Malfunction.Action_3 "Fault manager configuration.  Select up to 4 actions for each fault." VALUE 0x8000115F RecordLayout_6 0 CompuMethod_483 0 65535 /end CHARACTERISTIC
/begin CHARACTERISTIC FaultManager.Traction_Control_RightRear_Malfunction.Action_3_Condition "Fault manager configuration.  Select up to 4 actions for each fault." VALUE 0x80001161 RecordLayout_6 0 CompuMethod_484 0 65535 /end CHARACTERISTIC
/begin CHARACTERISTIC FaultManager.Traction_Control_RightRear_Malfunction.Action_4 "Fault manager configuration.  Select up to 4 actions for each fault." VALUE 0x80001163 RecordLayout_6 0 CompuMethod_483 0 65535 /end CHARACTERISTIC
/begin CHARACTERISTIC FaultManager.Traction_Control_RightRear_Malfunction.Action_4_Condition "Fault manager configuration.  Select up to 4 actions for each fault." VALUE 0x80001165 RecordLayout_6 0 CompuMethod_484 0 65535 /end CHARACTERISTIC
/begin CHARACTERISTIC FaultManager.Transmission_AgeCount.Mode "Fault manager configuration.  Select up to 4 actions for each fault." VALUE 0x80001167 RecordLayout_6 0 CompuMethod_481 0 65535 /end CHARACTERISTIC
/begin CHARACTERISTIC FaultManager.Transmission_AgeCount.ID "Fault manager configuration.  Select up to 4 actions for each fault." VALUE 0x80001169 RecordLayout_6 0 CompuMethod_1 0 65535 /end CHARACTERISTIC
/begin CHARACTERISTIC FaultManager.Transmission_AgeCount.Test "Fault manager configuration.  Select up to 4 actions for each fault." VALUE 0x8000116B RecordLayout_6 0 CompuMethod_482 0 65535 /end CHARACTERISTIC
/begin CHARACTERISTIC FaultManager.Transmission_AgeCount.Faulty_Samples__X_ "Fault manager configuration.  Select up to 4 actions for each fault." VALUE 0x8000116D RecordLayout_6 0 CompuMethod_1 0 65535 /end CHARACTERISTIC
/begin CHARACTERISTIC FaultManager.Transmission_AgeCount.Total_Samples__Y_ "Fault manager configuration.  Select up to 4 actions for each fault." VALUE 0x8000116F RecordLayout_6 0 CompuMethod_1 0 65535 /end CHARACTERISTIC
/begin CHARACTERISTIC FaultManager.Transmission_AgeCount.Action_1 "Fault manager configuration.  Select up to 4 actions for each fault." VALUE 0x80001171 RecordLayout_6 0 CompuMethod_483 0 65535 /end CHARACTERISTIC
/begin CHARACTERISTIC FaultManager.Transmission_AgeCount.Action_1_Condition "Fault manager configuration.  Select up to 4 actions for each fault." VALUE 0x80001173 RecordLayout_6 0 CompuMethod_484 0 65535 /end CHARACTERISTIC
/begin CHARACTERISTIC FaultManager.Transmission_AgeCount.Action_2 "Fault manager configuration.  Select up to 4 actions for each fault." VALUE 0x80001175 RecordLayout_6 0 CompuMethod_483 0 65535 /end CHARACTERISTIC
/begin CHARACTERISTIC FaultManager.Transmission_AgeCount.Action_2_Condition "Fault manager configuration.  Select up to 4 actions for each fault." VALUE 0x80001177 RecordLayout_6 0 CompuMethod_484 0 65535 /end CHARACTERISTIC
/begin CHARACTERISTIC FaultManager.Transmission_AgeCount.Action_3 "Fault manager configuration.  Select up to 4 actions for each fault." VALUE 0x80001179 RecordLayout_6 0 CompuMethod_483 0 65535 /end CHARACTERISTIC
/begin CHARACTERISTIC FaultManager.Transmission_AgeCount.Action_3_Condition "Fault manager configuration.  Select up to 4 actions for each fault." VALUE 0x8000117B RecordLayout_6 0 CompuMethod_484 0 65535 /end CHARACTERISTIC
/begin CHARACTERISTIC FaultManager.Transmission_AgeCount.Action_4 "Fault manager configuration.  Select up to 4 actions for each fault." VALUE 0x8000117D RecordLayout_6 0 CompuMethod_483 0 65535 /end CHARACTERISTIC
/begin CHARACTERISTIC FaultManager.Transmission_AgeCount.Action_4_Condition "Fault manager configuration.  Select up to 4 actions for each fault." VALUE 0x8000117F RecordLayout_6 0 CompuMethod_484 0 65535 /end CHARACTERISTIC
/begin CHARACTERISTIC FaultManager.Vehcile_Speed_Sensor_Malfunction.Mode "Fault manager configuration.  Select up to 4 actions for each fault." VALUE 0x80001181 RecordLayout_6 0 CompuMethod_481 0 65535 /end CHARACTERISTIC
/begin CHARACTERISTIC FaultManager.Vehcile_Speed_Sensor_Malfunction.ID "Fault manager configuration.  Select up to 4 actions for each fault." VALUE 0x80001183 RecordLayout_6 0 CompuMethod_1 0 65535 /end CHARACTERISTIC
/begin CHARACTERISTIC FaultManager.Vehcile_Speed_Sensor_Malfunction.Test "Fault manager configuration.  Select up to 4 actions for each fault." VALUE 0x80001185 RecordLayout_6 0 CompuMethod_482 0 65535 /end CHARACTERISTIC
/begin CHARACTERISTIC FaultManager.Vehcile_Speed_Sensor_Malfunction.Faulty_Samples__X_ "Fault manager configuration.  Select up to 4 actions for each fault." VALUE 0x80001187 RecordLayout_6 0 CompuMethod_1 0 65535 /end CHARACTERISTIC
/begin CHARACTERISTIC FaultManager.Vehcile_Speed_Sensor_Malfunction.Total_Samples__Y_ "Fault manager configuration.  Select up to 4 actions for each fault." VALUE 0x80001189 RecordLayout_6 0 CompuMethod_1 0 65535 /end CHARACTERISTIC
/begin CHARACTERISTIC FaultManager.Vehcile_Speed_Sensor_Malfunction.Action_1 "Fault manager configuration.  Select up to 4 actions for each fault." VALUE 0x8000118B RecordLayout_6 0 CompuMethod_483 0 65535 /end CHARACTERISTIC
/begin CHARACTERISTIC FaultManager.Vehcile_Speed_Sensor_Malfunction.Action_1_Condition "Fault manager configuration.  Select up to 4 actions for each fault." VALUE 0x8000118D RecordLayout_6 0 CompuMethod_484 0 65535 /end CHARACTERISTIC
/begin CHARACTERISTIC FaultManager.Vehcile_Speed_Sensor_Malfunction.Action_2 "Fault manager configuration.  Select up to 4 actions for each fault." VALUE 0x8000118F RecordLayout_6 0 CompuMethod_483 0 65535 /end CHARACTERISTIC
/begin CHARACTERISTIC FaultManager.Vehcile_Speed_Sensor_Malfunction.Action_2_Condition "Fault manager configuration.  Select up to 4 actions for each fault." VALUE 0x80001191 RecordLayout_6 0 CompuMethod_484 0 65535 /end CHARACTERISTIC
/begin CHARACTERISTIC FaultManager.Vehcile_Speed_Sensor_Malfunction.Action_3 "Fault manager configuration.  Select up to 4 actions for each fault." VALUE 0x80001193 RecordLayout_6 0 CompuMethod_483 0 65535 /end CHARACTERISTIC
/begin CHARACTERISTIC FaultManager.Vehcile_Speed_Sensor_Malfunction.Action_3_Condition "Fault manager configuration.  Select up to 4 actions for each fault." VALUE 0x80001195 RecordLayout_6 0 CompuMethod_484 0 65535 /end CHARACTERISTIC
/begin CHARACTERISTIC FaultManager.Vehcile_Speed_Sensor_Malfunction.Action_4 "Fault manager configuration.  Select up to 4 actions for each fault." VALUE 0x80001197 RecordLayout_6 0 CompuMethod_483 0 65535 /end CHARACTERISTIC
/begin CHARACTERISTIC FaultManager.Vehcile_Speed_Sensor_Malfunction.Action_4_Condition "Fault manager configuration.  Select up to 4 actions for each fault." VALUE 0x80001199 RecordLayout_6 0 CompuMethod_484 0 65535 /end CHARACTERISTIC
/begin CHARACTERISTIC FaultManager.Vehicle_Speed_Sensor_Circuit_Low.Mode "Fault manager configuration.  Select up to 4 actions for each fault." VALUE 0x8000119B RecordLayout_6 0 CompuMethod_481 0 65535 /end CHARACTERISTIC
/begin CHARACTERISTIC FaultManager.Vehicle_Speed_Sensor_Circuit_Low.ID "Fault manager configuration.  Select up to 4 actions for each fault." VALUE 0x8000119D RecordLayout_6 0 CompuMethod_1 0 65535 /end CHARACTERISTIC
/begin CHARACTERISTIC FaultManager.Vehicle_Speed_Sensor_Circuit_Low.Test "Fault manager configuration.  Select up to 4 actions for each fault." VALUE 0x8000119F RecordLayout_6 0 CompuMethod_482 0 65535 /end CHARACTERISTIC
/begin CHARACTERISTIC FaultManager.Vehicle_Speed_Sensor_Circuit_Low.Faulty_Samples__X_ "Fault manager configuration.  Select up to 4 actions for each fault." VALUE 0x800011A1 RecordLayout_6 0 CompuMethod_1 0 65535 /end CHARACTERISTIC
/begin CHARACTERISTIC FaultManager.Vehicle_Speed_Sensor_Circuit_Low.Total_Samples__Y_ "Fault manager configuration.  Select up to 4 actions for each fault." VALUE 0x800011A3 RecordLayout_6 0 CompuMethod_1 0 65535 /end CHARACTERISTIC
/begin CHARACTERISTIC FaultManager.Vehicle_Speed_Sensor_Circuit_Low.Action_1 "Fault manager configuration.  Select up to 4 actions for each fault." VALUE 0x800011A5 RecordLayout_6 0 CompuMethod_483 0 65535 /end CHARACTERISTIC
/begin CHARACTERISTIC FaultManager.Vehicle_Speed_Sensor_Circuit_Low.Action_1_Condition "Fault manager configuration.  Select up to 4 actions for each fault." VALUE 0x800011A7 RecordLayout_6 0 CompuMethod_484 0 65535 /end CHARACTERISTIC
/begin CHARACTERISTIC FaultManager.Vehicle_Speed_Sensor_Circuit_Low.Action_2 "Fault manager configuration.  Select up to 4 actions for each fault." VALUE 0x800011A9 RecordLayout_6 0 CompuMethod_483 0 65535 /end CHARACTERISTIC
/begin CHARACTERISTIC FaultManager.Vehicle_Speed_Sensor_Circuit_Low.Action_2_Condition "Fault manager configuration.  Select up to 4 actions for each fault." VALUE 0x800011AB RecordLayout_6 0 CompuMethod_484 0 65535 /end CHARACTERISTIC
/begin CHARACTERISTIC FaultManager.Vehicle_Speed_Sensor_Circuit_Low.Action_3 "Fault manager configuration.  Select up to 4 actions for each fault." VALUE 0x800011AD RecordLayout_6 0 CompuMethod_483 0 65535 /end CHARACTERISTIC
/begin CHARACTERISTIC FaultManager.Vehicle_Speed_Sensor_Circuit_Low.Action_3_Condition "Fault manager configuration.  Select up to 4 actions for each fault." VALUE 0x800011AF RecordLayout_6 0 CompuMethod_484 0 65535 /end CHARACTERISTIC
/begin CHARACTERISTIC FaultManager.Vehicle_Speed_Sensor_Circuit_Low.Action_4 "Fault manager configuration.  Select up to 4 actions for each fault." VALUE 0x800011B1 RecordLayout_6 0 CompuMethod_483 0 65535 /end CHARACTERISTIC
/begin CHARACTERISTIC FaultManager.Vehicle_Speed_Sensor_Circuit_Low.Action_4_Condition "Fault manager configuration.  Select up to 4 actions for each fault." VALUE 0x800011B3 RecordLayout_6 0 CompuMethod_484 0 65535 /end CHARACTERISTIC
/begin CHARACTERISTIC FaultManager.Vehicle_Speed_Sensor_Erratic.Mode "Fault manager configuration.  Select up to 4 actions for each fault." VALUE 0x800011B5 RecordLayout_6 0 CompuMethod_481 0 65535 /end CHARACTERISTIC
/begin CHARACTERISTIC FaultManager.Vehicle_Speed_Sensor_Erratic.ID "Fault manager configuration.  Select up to 4 actions for each fault." VALUE 0x800011B7 RecordLayout_6 0 CompuMethod_1 0 65535 /end CHARACTERISTIC
/begin CHARACTERISTIC FaultManager.Vehicle_Speed_Sensor_Erratic.Test "Fault manager configuration.  Select up to 4 actions for each fault." VALUE 0x800011B9 RecordLayout_6 0 CompuMethod_482 0 65535 /end CHARACTERISTIC
/begin CHARACTERISTIC FaultManager.Vehicle_Speed_Sensor_Erratic.Faulty_Samples__X_ "Fault manager configuration.  Select up to 4 actions for each fault." VALUE 0x800011BB RecordLayout_6 0 CompuMethod_1 0 65535 /end CHARACTERISTIC
/begin CHARACTERISTIC FaultManager.Vehicle_Speed_Sensor_Erratic.Total_Samples__Y_ "Fault manager configuration.  Select up to 4 actions for each fault." VALUE 0x800011BD RecordLayout_6 0 CompuMethod_1 0 65535 /end CHARACTERISTIC
/begin CHARACTERISTIC FaultManager.Vehicle_Speed_Sensor_Erratic.Action_1 "Fault manager configuration.  Select up to 4 actions for each fault." VALUE 0x800011BF RecordLayout_6 0 CompuMethod_483 0 65535 /end CHARACTERISTIC
/begin CHARACTERISTIC FaultManager.Vehicle_Speed_Sensor_Erratic.Action_1_Condition "Fault manager configuration.  Select up to 4 actions for each fault." VALUE 0x800011C1 RecordLayout_6 0 CompuMethod_484 0 65535 /end CHARACTERISTIC
/begin CHARACTERISTIC FaultManager.Vehicle_Speed_Sensor_Erratic.Action_2 "Fault manager configuration.  Select up to 4 actions for each fault." VALUE 0x800011C3 RecordLayout_6 0 CompuMethod_483 0 65535 /end CHARACTERISTIC
/begin CHARACTERISTIC FaultManager.Vehicle_Speed_Sensor_Erratic.Action_2_Condition "Fault manager configuration.  Select up to 4 actions for each fault." VALUE 0x800011C5 RecordLayout_6 0 CompuMethod_484 0 65535 /end CHARACTERISTIC
/begin CHARACTERISTIC FaultManager.Vehicle_Speed_Sensor_Erratic.Action_3 "Fault manager configuration.  Select up to 4 actions for each fault." VALUE 0x800011C7 RecordLayout_6 0 CompuMethod_483 0 65535 /end CHARACTERISTIC
/begin CHARACTERISTIC FaultManager.Vehicle_Speed_Sensor_Erratic.Action_3_Condition "Fault manager configuration.  Select up to 4 actions for each fault." VALUE 0x800011C9 RecordLayout_6 0 CompuMethod_484 0 65535 /end CHARACTERISTIC
/begin CHARACTERISTIC FaultManager.Vehicle_Speed_Sensor_Erratic.Action_4 "Fault manager configuration.  Select up to 4 actions for each fault." VALUE 0x800011CB RecordLayout_6 0 CompuMethod_483 0 65535 /end CHARACTERISTIC
/begin CHARACTERISTIC FaultManager.Vehicle_Speed_Sensor_Erratic.Action_4_Condition "Fault manager configuration.  Select up to 4 actions for each fault." VALUE 0x800011CD RecordLayout_6 0 CompuMethod_484 0 65535 /end CHARACTERISTIC
/begin CHARACTERISTIC FaultManager.Vehicle_Speed_Sensor_Rang_Performance.Mode "Fault manager configuration.  Select up to 4 actions for each fault." VALUE 0x800011CF RecordLayout_6 0 CompuMethod_481 0 65535 /end CHARACTERISTIC
/begin CHARACTERISTIC FaultManager.Vehicle_Speed_Sensor_Rang_Performance.ID "Fault manager configuration.  Select up to 4 actions for each fault." VALUE 0x800011D1 RecordLayout_6 0 CompuMethod_1 0 65535 /end CHARACTERISTIC
/begin CHARACTERISTIC FaultManager.Vehicle_Speed_Sensor_Rang_Performance.Test "Fault manager configuration.  Select up to 4 actions for each fault." VALUE 0x800011D3 RecordLayout_6 0 CompuMethod_482 0 65535 /end CHARACTERISTIC
/begin CHARACTERISTIC FaultManager.Vehicle_Speed_Sensor_Rang_Performance.Faulty_Samples__X_ "Fault manager configuration.  Select up to 4 actions for each fault." VALUE 0x800011D5 RecordLayout_6 0 CompuMethod_1 0 65535 /end CHARACTERISTIC
/begin CHARACTERISTIC FaultManager.Vehicle_Speed_Sensor_Rang_Performance.Total_Samples__Y_ "Fault manager configuration.  Select up to 4 actions for each fault." VALUE 0x800011D7 RecordLayout_6 0 CompuMethod_1 0 65535 /end CHARACTERISTIC
/begin CHARACTERISTIC FaultManager.Vehicle_Speed_Sensor_Rang_Performance.Action_1 "Fault manager configuration.  Select up to 4 actions for each fault." VALUE 0x800011D9 RecordLayout_6 0 CompuMethod_483 0 65535 /end CHARACTERISTIC
/begin CHARACTERISTIC FaultManager.Vehicle_Speed_Sensor_Rang_Performance.Action_1_Condition "Fault manager configuration.  Select up to 4 actions for each fault." VALUE 0x800011DB RecordLayout_6 0 CompuMethod_484 0 65535 /end CHARACTERISTIC
/begin CHARACTERISTIC FaultManager.Vehicle_Speed_Sensor_Rang_Performance.Action_2 "Fault manager configuration.  Select up to 4 actions for each fault." VALUE 0x800011DD RecordLayout_6 0 CompuMethod_483 0 65535 /end CHARACTERISTIC
/begin CHARACTERISTIC FaultManager.Vehicle_Speed_Sensor_Rang_Performance.Action_2_Condition "Fault manager configuration.  Select up to 4 actions for each fault." VALUE 0x800011DF RecordLayout_6 0 CompuMethod_484 0 65535 /end CHARACTERISTIC
/begin CHARACTERISTIC FaultManager.Vehicle_Speed_Sensor_Rang_Performance.Action_3 "Fault manager configuration.  Select up to 4 actions for each fault." VALUE 0x800011E1 RecordLayout_6 0 CompuMethod_483 0 65535 /end CHARACTERISTIC
/begin CHARACTERISTIC FaultManager.Vehicle_Speed_Sensor_Rang_Performance.Action_3_Condition "Fault manager configuration.  Select up to 4 actions for each fault." VALUE 0x800011E3 RecordLayout_6 0 CompuMethod_484 0 65535 /end CHARACTERISTIC
/begin CHARACTERISTIC FaultManager.Vehicle_Speed_Sensor_Rang_Performance.Action_4 "Fault manager configuration.  Select up to 4 actions for each fault." VALUE 0x800011E5 RecordLayout_6 0 CompuMethod_483 0 65535 /end CHARACTERISTIC
/begin CHARACTERISTIC FaultManager.Vehicle_Speed_Sensor_Rang_Performance.Action_4_Condition "Fault manager configuration.  Select up to 4 actions for each fault." VALUE 0x800011E7 RecordLayout_6 0 CompuMethod_484 0 65535 /end CHARACTERISTIC
/begin CHARACTERISTIC Freeze_Frame "" VAL_BLK 0x800011ED RecordLayout_4 0 CompuMethod_2 -1E+17 1E+17 MATRIX_DIM 6 2 1
 /begin AXIS_DESCR FIX_AXIS NO_INPUT_QUANTITY CompuMethod_486 6 0 6 /begin FIX_AXIS_PAR_LIST 0 1 2 3 4 5 /end FIX_AXIS_PAR_LIST /end AXIS_DESCR
 /begin AXIS_DESCR FIX_AXIS NO_INPUT_QUANTITY CompuMethod_487 2 0 2 /begin FIX_AXIS_PAR_LIST 0 1 /end FIX_AXIS_PAR_LIST /end AXIS_DESCR
/end CHARACTERISTIC
/begin CHARACTERISTIC Front_left_whl_speed_Ovr_new "" VALUE 0x8000121D RecordLayout_4 0 CompuMethod_2 -1E+17 1E+17 /end CHARACTERISTIC
/begin CHARACTERISTIC Front_left_whl_speed_Ovr_ovr "" VALUE 0x80001221 RecordLayout_3 0 CompuMethod_7 0 1 /end CHARACTERISTIC
/begin CHARACTERISTIC Front_right_whl_speed_Ovr_new "" VALUE 0x80001222 RecordLayout_4 0 CompuMethod_2 -1E+17 1E+17 /end CHARACTERISTIC
/begin CHARACTERISTIC Front_right_whl_speed_Ovr_ovr "" VALUE 0x80001226 RecordLayout_3 0 CompuMethod_7 0 1 /end CHARACTERISTIC
/begin CHARACTERISTIC Gen_Enable_Ovr_new "" VALUE 0x8000122B RecordLayout_3 0 CompuMethod_11 0 1 /end CHARACTERISTIC
/begin CHARACTERISTIC Gen_Enable_Ovr_ovr "" VALUE 0x8000122C RecordLayout_3 0 CompuMethod_7 0 1 /end CHARACTERISTIC
/begin CHARACTERISTIC Gen_Load_Ovr_new "" VALUE 0x8000122D RecordLayout_4 0 CompuMethod_2 -1E+17 1E+17 /end CHARACTERISTIC
/begin CHARACTERISTIC Gen_Load_Ovr_ovr "" VALUE 0x80001231 RecordLayout_3 0 CompuMethod_7 0 1 /end CHARACTERISTIC
/begin CHARACTERISTIC Genset_Enable_Ovr_new "" VALUE 0x80001232 RecordLayout_4 0 CompuMethod_2 -1E+17 1E+17 /end CHARACTERISTIC
/begin CHARACTERISTIC Genset_Enable_Ovr_ovr "" VALUE 0x80001236 RecordLayout_3 0 CompuMethod_7 0 1 /end CHARACTERISTIC
/begin CHARACTERISTIC Genset_Load_Ovr_new "" VALUE 0x80001237 RecordLayout_4 0 CompuMethod_2 -1E+17 1E+17 /end CHARACTERISTIC
/begin CHARACTERISTIC Genset_Load_Ovr_ovr "" VALUE 0x8000123B RecordLayout_3 0 CompuMethod_7 0 1 /end CHARACTERISTIC
/begin CHARACTERISTIC Genset_RPM_Ovr_new "" VALUE 0x8000123C RecordLayout_4 0 CompuMethod_2 -1E+17 1E+17 /end CHARACTERISTIC
/begin CHARACTERISTIC Genset_RPM_Ovr_ovr "" VALUE 0x80001240 RecordLayout_3 0 CompuMethod_7 0 1 /end CHARACTERISTIC
/begin CHARACTERISTIC Genset_Throttle_Ovr_new "" VALUE 0x80001241 RecordLayout_4 0 CompuMethod_2 -1E+17 1E+17 /end CHARACTERISTIC
/begin CHARACTERISTIC Genset_Throttle_Ovr_ovr "" VALUE 0x80001245 RecordLayout_3 0 CompuMethod_7 0 1 /end CHARACTERISTIC
/begin CHARACTERISTIC GPSQuality_Ovr_new "" VALUE 0x80001246 RecordLayout_4 0 CompuMethod_2 -1E+17 1E+17 /end CHARACTERISTIC
/begin CHARACTERISTIC GPSQuality_Ovr_ovr "" VALUE 0x8000124A RecordLayout_3 0 CompuMethod_7 0 1 /end CHARACTERISTIC
/begin CHARACTERISTIC Heading_Ovr_new "" VALUE 0x8000124B RecordLayout_4 0 CompuMethod_2 -1E+17 1E+17 /end CHARACTERISTIC
/begin CHARACTERISTIC Heading_Ovr_ovr "" VALUE 0x8000124F RecordLayout_3 0 CompuMethod_7 0 1 /end CHARACTERISTIC
/begin CHARACTERISTIC Heat_1_Ovr_new "" VALUE 0x80001250 RecordLayout_4 0 CompuMethod_2 -1E+17 1E+17 /end CHARACTERISTIC
/begin CHARACTERISTIC Heat_1_Ovr_ovr "" VALUE 0x80001254 RecordLayout_3 0 CompuMethod_7 0 1 /end CHARACTERISTIC
/begin CHARACTERISTIC Heat_2_Ovr_new "" VALUE 0x80001255 RecordLayout_4 0 CompuMethod_2 -1E+17 1E+17 /end CHARACTERISTIC
/begin CHARACTERISTIC Heat_2_Ovr_ovr "" VALUE 0x80001259 RecordLayout_3 0 CompuMethod_7 0 1 /end CHARACTERISTIC
/begin CHARACTERISTIC Heat_3_Ovr_new "" VALUE 0x8000125A RecordLayout_4 0 CompuMethod_2 -1E+17 1E+17 /end CHARACTERISTIC
/begin CHARACTERISTIC Heat_3_Ovr_ovr "" VALUE 0x8000125E RecordLayout_3 0 CompuMethod_7 0 1 /end CHARACTERISTIC
/begin CHARACTERISTIC Heat_4_Ovr_new "" VALUE 0x8000125F RecordLayout_4 0 CompuMethod_2 -1E+17 1E+17 /end CHARACTERISTIC
/begin CHARACTERISTIC Heat_4_Ovr_ovr "" VALUE 0x80001263 RecordLayout_3 0 CompuMethod_7 0 1 /end CHARACTERISTIC
/begin CHARACTERISTIC Heat1_Ovr_new "" VALUE 0x80001268 RecordLayout_3 0 CompuMethod_11 0 1 /end CHARACTERISTIC
/begin CHARACTERISTIC Heat1_Ovr_ovr "" VALUE 0x80001269 RecordLayout_3 0 CompuMethod_7 0 1 /end CHARACTERISTIC
/begin CHARACTERISTIC Heat2_Ovr_new "" VALUE 0x8000126E RecordLayout_3 0 CompuMethod_11 0 1 /end CHARACTERISTIC
/begin CHARACTERISTIC Heat2_Ovr_ovr "" VALUE 0x8000126F RecordLayout_3 0 CompuMethod_7 0 1 /end CHARACTERISTIC
/begin CHARACTERISTIC Heat3_Ovr_new "" VALUE 0x80001274 RecordLayout_3 0 CompuMethod_11 0 1 /end CHARACTERISTIC
/begin CHARACTERISTIC Heat3_Ovr_ovr "" VALUE 0x80001275 RecordLayout_3 0 CompuMethod_7 0 1 /end CHARACTERISTIC
/begin CHARACTERISTIC Heat4_Ovr_new "" VALUE 0x8000127A RecordLayout_3 0 CompuMethod_11 0 1 /end CHARACTERISTIC
/begin CHARACTERISTIC Heat4_Ovr_ovr "" VALUE 0x8000127B RecordLayout_3 0 CompuMethod_7 0 1 /end CHARACTERISTIC
/begin CHARACTERISTIC Heater_Core_Blend_Ovr_new "" VALUE 0x80001280 RecordLayout_4 0 CompuMethod_2 -1E+17 1E+17 /end CHARACTERISTIC
/begin CHARACTERISTIC Heater_Core_Blend_Ovr_ovr "" VALUE 0x80001284 RecordLayout_3 0 CompuMethod_7 0 1 /end CHARACTERISTIC
/begin CHARACTERISTIC Heater_Core_Blend_Valve_Ovr_new "" VALUE 0x80001285 RecordLayout_8 0 CompuMethod_6 -2147480000 2147480000 /end CHARACTERISTIC
/begin CHARACTERISTIC Heater_Core_Blend_Valve_Ovr_ovr "" VALUE 0x80001289 RecordLayout_3 0 CompuMethod_7 0 1 /end CHARACTERISTIC
/begin CHARACTERISTIC Heater_Core_Motor_Direction_Ovr_new "" VALUE 0x8000128A RecordLayout_3 0 CompuMethod_11 0 1 /end CHARACTERISTIC
/begin CHARACTERISTIC Heater_Core_Motor_Direction_Ovr_ovr "" VALUE 0x8000128B RecordLayout_3 0 CompuMethod_7 0 1 /end CHARACTERISTIC
/begin CHARACTERISTIC Heater_Core_Motor_Enable_Ovr_new "" VALUE 0x8000128C RecordLayout_3 0 CompuMethod_11 0 1 /end CHARACTERISTIC
/begin CHARACTERISTIC Heater_Core_Motor_Enable_Ovr_ovr "" VALUE 0x8000128D RecordLayout_3 0 CompuMethod_7 0 1 /end CHARACTERISTIC
/begin CHARACTERISTIC Heater_Core_Pos_Request_Ovr_new "" VALUE 0x8000128E RecordLayout_4 0 CompuMethod_2 -1E+17 1E+17 /end CHARACTERISTIC
/begin CHARACTERISTIC Heater_Core_Pos_Request_Ovr_ovr "" VALUE 0x80001292 RecordLayout_3 0 CompuMethod_7 0 1 /end CHARACTERISTIC
/begin CHARACTERISTIC Heater_Core_Pump_Ovr_new "" VALUE 0x80001293 RecordLayout_3 0 CompuMethod_11 0 1 /end CHARACTERISTIC
/begin CHARACTERISTIC Heater_Core_Pump_Ovr_ovr "" VALUE 0x80001294 RecordLayout_3 0 CompuMethod_7 0 1 /end CHARACTERISTIC
/begin CHARACTERISTIC Heater_Temp_Raw_Ovr_new "" VALUE 0x80001299 RecordLayout_6 0 CompuMethod_5 0 65535 /end CHARACTERISTIC
/begin CHARACTERISTIC Heater_Temp_Raw_Ovr_ovr "" VALUE 0x8000129B RecordLayout_3 0 CompuMethod_7 0 1 /end CHARACTERISTIC
/begin CHARACTERISTIC HtrCoreLowPass "Filter time constant" VALUE 0x800012A8 RecordLayout_4 0 CompuMethod_485 -1E+17 1E+17 /end CHARACTERISTIC
/begin CHARACTERISTIC HV_Battery_2G_BMS_Fault "" VALUE 0x800012AC RecordLayout_4 0 CompuMethod_2 -1E+17 1E+17 /end CHARACTERISTIC
/begin CHARACTERISTIC HV_Battery_48_Controller_Communication_Fault "" VALUE 0x800012B0 RecordLayout_4 0 CompuMethod_2 -1E+17 1E+17 /end CHARACTERISTIC
/begin CHARACTERISTIC HV_Battery_Above_Safe_Charge_Point "" VALUE 0x800012B4 RecordLayout_4 0 CompuMethod_2 -1E+17 1E+17 /end CHARACTERISTIC
/begin CHARACTERISTIC HV_Battery_Cell_Balancing_Required_Fault "" VALUE 0x800012B8 RecordLayout_4 0 CompuMethod_2 -1E+17 1E+17 /end CHARACTERISTIC
/begin CHARACTERISTIC HV_Battery_Pack_Above_Operating_Temperature_Fault "" VALUE 0x800012BC RecordLayout_4 0 CompuMethod_2 -1E+17 1E+17 /end CHARACTERISTIC
/begin CHARACTERISTIC HV_Battery_Pack_Below_Operating_Temperature_Fault "" VALUE 0x800012C0 RecordLayout_4 0 CompuMethod_2 -1E+17 1E+17 /end CHARACTERISTIC
/begin CHARACTERISTIC HV_Battery_Pack_High_Temperature_Fault_High "" VALUE 0x800012C4 RecordLayout_4 0 CompuMethod_2 -1E+17 1E+17 /end CHARACTERISTIC
/begin CHARACTERISTIC HV_Battery_Pack_High_Temperature_Fault_Low "" VALUE 0x800012C8 RecordLayout_4 0 CompuMethod_2 -1E+17 1E+17 /end CHARACTERISTIC
/begin CHARACTERISTIC HV_Battery_Pack_Low_Temperature_Fault_High "" VALUE 0x800012CC RecordLayout_4 0 CompuMethod_2 -1E+17 1E+17 /end CHARACTERISTIC
/begin CHARACTERISTIC HV_Battery_Pack_Low_Temperature_Fault_Low "" VALUE 0x800012D0 RecordLayout_4 0 CompuMethod_2 -1E+17 1E+17 /end CHARACTERISTIC
/begin CHARACTERISTIC HV_Battery_Precharge_Failure_Fault "" VALUE 0x800012D4 RecordLayout_4 0 CompuMethod_2 -1E+17 1E+17 /end CHARACTERISTIC
/begin CHARACTERISTIC HV_Battery_Too_Low_For_Load_Fault "" VALUE 0x800012D8 RecordLayout_4 0 CompuMethod_2 -1E+17 1E+17 /end CHARACTERISTIC
/begin CHARACTERISTIC HV_Battery_Try_To_Balance_Under_Load_Fault "" VALUE 0x800012DC RecordLayout_4 0 CompuMethod_2 -1E+17 1E+17 /end CHARACTERISTIC
/begin CHARACTERISTIC HV_Elec_Sys_Wrn_Ovr_new "" VALUE 0x800012E0 RecordLayout_3 0 CompuMethod_11 0 1 /end CHARACTERISTIC
/begin CHARACTERISTIC HV_Elec_Sys_Wrn_Ovr_ovr "" VALUE 0x800012E1 RecordLayout_3 0 CompuMethod_7 0 1 /end CHARACTERISTIC
/begin CHARACTERISTIC HV_Heater_Over_Temperature_Fault "" VALUE 0x800012E2 RecordLayout_4 0 CompuMethod_2 -1E+17 1E+17 /end CHARACTERISTIC
/begin CHARACTERISTIC HV_Heater_Temperature_Sensor_A_High_Voltage_Fault "" VALUE 0x800012E6 RecordLayout_4 0 CompuMethod_2 -1E+17 1E+17 /end CHARACTERISTIC
/begin CHARACTERISTIC HV_Heater_Temperature_Sensor_A_Intermittent_Fault "" VALUE 0x800012EA RecordLayout_4 0 CompuMethod_2 -1E+17 1E+17 /end CHARACTERISTIC
/begin CHARACTERISTIC HV_Heater_Temperature_Sensor_A_Low_Voltage_Fault "" VALUE 0x800012EE RecordLayout_4 0 CompuMethod_2 -1E+17 1E+17 /end CHARACTERISTIC
/begin CHARACTERISTIC HybridStateOverride_new "" VALUE 0x800012F6 RecordLayout_4 0 CompuMethod_2 -1E+17 1E+17 /end CHARACTERISTIC
/begin CHARACTERISTIC HybridStateOverride_ovr "" VALUE 0x800012FA RecordLayout_3 0 CompuMethod_7 0 1 /end CHARACTERISTIC
/begin CHARACTERISTIC Ignition_Status_Ovr_new "" VALUE 0x800012FF RecordLayout_3 0 CompuMethod_11 0 1 /end CHARACTERISTIC
/begin CHARACTERISTIC Ignition_Status_Ovr_ovr "" VALUE 0x80001300 RecordLayout_3 0 CompuMethod_7 0 1 /end CHARACTERISTIC
/begin CHARACTERISTIC Input_Current_Limit_Max_Ovr_new "" VALUE 0x80001301 RecordLayout_4 0 CompuMethod_2 -1E+17 1E+17 /end CHARACTERISTIC
/begin CHARACTERISTIC Input_Current_Limit_Max_Ovr_ovr "" VALUE 0x80001305 RecordLayout_3 0 CompuMethod_7 0 1 /end CHARACTERISTIC
/begin CHARACTERISTIC Input_Current_Ovr_new "" VALUE 0x80001306 RecordLayout_4 0 CompuMethod_2 -1E+17 1E+17 /end CHARACTERISTIC
/begin CHARACTERISTIC Input_Current_Ovr_ovr "" VALUE 0x8000130A RecordLayout_3 0 CompuMethod_7 0 1 /end CHARACTERISTIC
/begin CHARACTERISTIC Input_Voltage_Ovr_new "" VALUE 0x8000130B RecordLayout_4 0 CompuMethod_2 -1E+17 1E+17 /end CHARACTERISTIC
/begin CHARACTERISTIC Input_Voltage_Ovr_ovr "" VALUE 0x8000130F RecordLayout_3 0 CompuMethod_7 0 1 /end CHARACTERISTIC
/begin CHARACTERISTIC InterlockEnable_Override_new "" VALUE 0x80001314 RecordLayout_4 0 CompuMethod_2 -1E+17 1E+17 /end CHARACTERISTIC
/begin CHARACTERISTIC InterlockEnable_Override_ovr "" VALUE 0x80001318 RecordLayout_3 0 CompuMethod_7 0 1 /end CHARACTERISTIC
/begin CHARACTERISTIC Inv_Temp_Ovr_new "" VALUE 0x80001319 RecordLayout_4 0 CompuMethod_2 -1E+17 1E+17 /end CHARACTERISTIC
/begin CHARACTERISTIC Inv_Temp_Ovr_ovr "" VALUE 0x8000131D RecordLayout_3 0 CompuMethod_7 0 1 /end CHARACTERISTIC
/begin CHARACTERISTIC IPT_Antishudder_Ovr_new "" VALUE 0x8000131E RecordLayout_4 0 CompuMethod_2 -1E+17 1E+17 /end CHARACTERISTIC
/begin CHARACTERISTIC IPT_Antishudder_Ovr_ovr "" VALUE 0x80001322 RecordLayout_3 0 CompuMethod_7 0 1 /end CHARACTERISTIC
/begin CHARACTERISTIC IPT_Current_Limit_Ovr_new "" VALUE 0x80001323 RecordLayout_4 0 CompuMethod_2 -1E+17 1E+17 /end CHARACTERISTIC
/begin CHARACTERISTIC IPT_Current_Limit_Ovr_ovr "" VALUE 0x80001327 RecordLayout_3 0 CompuMethod_7 0 1 /end CHARACTERISTIC
/begin CHARACTERISTIC IPT_Current_Request_Ovr_new "" VALUE 0x80001328 RecordLayout_4 0 CompuMethod_2 -1E+17 1E+17 /end CHARACTERISTIC
/begin CHARACTERISTIC IPT_Current_Request_Ovr_ovr "" VALUE 0x8000132C RecordLayout_3 0 CompuMethod_7 0 1 /end CHARACTERISTIC
/begin CHARACTERISTIC IPT_Current_Used_Ovr_new "" VALUE 0x8000132D RecordLayout_4 0 CompuMethod_2 -1E+17 1E+17 /end CHARACTERISTIC
/begin CHARACTERISTIC IPT_Current_Used_Ovr_ovr "" VALUE 0x80001331 RecordLayout_3 0 CompuMethod_7 0 1 /end CHARACTERISTIC
/begin CHARACTERISTIC IPT_DC_Error_Category_Ovr_new "" VALUE 0x80001332 RecordLayout_4 0 CompuMethod_2 -1E+17 1E+17 /end CHARACTERISTIC
/begin CHARACTERISTIC IPT_DC_Error_Category_Ovr_ovr "" VALUE 0x80001336 RecordLayout_3 0 CompuMethod_7 0 1 /end CHARACTERISTIC
/begin CHARACTERISTIC IPT_DCHV_Bus_Current_Ovr_new "" VALUE 0x8000133B RecordLayout_4 0 CompuMethod_2 -1E+17 1E+17 /end CHARACTERISTIC
/begin CHARACTERISTIC IPT_DCHV_Bus_Current_Ovr_ovr "" VALUE 0x8000133F RecordLayout_3 0 CompuMethod_7 0 1 /end CHARACTERISTIC
/begin CHARACTERISTIC IPT_DCLV_Bus_Current_Ovr_new "" VALUE 0x80001340 RecordLayout_4 0 CompuMethod_2 -1E+17 1E+17 /end CHARACTERISTIC
/begin CHARACTERISTIC IPT_DCLV_Bus_Current_Ovr_ovr "" VALUE 0x80001344 RecordLayout_3 0 CompuMethod_7 0 1 /end CHARACTERISTIC
/begin CHARACTERISTIC IPT_DCLV_Bus_Voltage_Ovr_new "" VALUE 0x80001345 RecordLayout_4 0 CompuMethod_2 -1E+17 1E+17 /end CHARACTERISTIC
/begin CHARACTERISTIC IPT_DCLV_Bus_Voltage_Ovr_ovr "" VALUE 0x80001349 RecordLayout_3 0 CompuMethod_7 0 1 /end CHARACTERISTIC
/begin CHARACTERISTIC IPT_DCLV_General_Error_Ovr_new "" VALUE 0x8000134A RecordLayout_4 0 CompuMethod_2 -1E+17 1E+17 /end CHARACTERISTIC
/begin CHARACTERISTIC IPT_DCLV_General_Error_Ovr_ovr "" VALUE 0x8000134E RecordLayout_3 0 CompuMethod_7 0 1 /end CHARACTERISTIC
/begin CHARACTERISTIC IPT_DCLV_Max_Power_Ovr_new "" VALUE 0x8000134F RecordLayout_4 0 CompuMethod_2 -1E+17 1E+17 /end CHARACTERISTIC
/begin CHARACTERISTIC IPT_DCLV_Max_Power_Ovr_ovr "" VALUE 0x80001353 RecordLayout_3 0 CompuMethod_7 0 1 /end CHARACTERISTIC
/begin CHARACTERISTIC IPT_DCLV_On_Ovr_new "" VALUE 0x80001354 RecordLayout_4 0 CompuMethod_2 -1E+17 1E+17 /end CHARACTERISTIC
/begin CHARACTERISTIC IPT_DCLV_On_Ovr_ovr "" VALUE 0x80001358 RecordLayout_3 0 CompuMethod_7 0 1 /end CHARACTERISTIC
/begin CHARACTERISTIC IPT_Duty_Cycle "" VALUE 0x80001359 RecordLayout_4 0 CompuMethod_2 -1E+17 1E+17 /end CHARACTERISTIC
/begin CHARACTERISTIC IPT_DutyCycle_Ovr_new "" VALUE 0x8000135D RecordLayout_4 0 CompuMethod_2 -1E+17 1E+17 /end CHARACTERISTIC
/begin CHARACTERISTIC IPT_DutyCycle_Ovr_ovr "" VALUE 0x80001361 RecordLayout_3 0 CompuMethod_7 0 1 /end CHARACTERISTIC
/begin CHARACTERISTIC IPT_Error_Category_Ovr_new "" VALUE 0x80001362 RecordLayout_4 0 CompuMethod_2 -1E+17 1E+17 /end CHARACTERISTIC
/begin CHARACTERISTIC IPT_Error_Category_Ovr_ovr "" VALUE 0x80001366 RecordLayout_3 0 CompuMethod_7 0 1 /end CHARACTERISTIC
/begin CHARACTERISTIC IPT_Freq_Ovr_new "" VALUE 0x80001367 RecordLayout_4 0 CompuMethod_2 -1E+17 1E+17 /end CHARACTERISTIC
/begin CHARACTERISTIC IPT_Freq_Ovr_ovr "" VALUE 0x8000136B RecordLayout_3 0 CompuMethod_7 0 1 /end CHARACTERISTIC
/begin CHARACTERISTIC IPT_Frequency "" VALUE 0x8000136C RecordLayout_4 0 CompuMethod_2 -1E+17 1E+17 /end CHARACTERISTIC
/begin CHARACTERISTIC IPT_HVDC_Voltage_Ovr_new "" VALUE 0x80001370 RecordLayout_4 0 CompuMethod_2 -1E+17 1E+17 /end CHARACTERISTIC
/begin CHARACTERISTIC IPT_HVDC_Voltage_Ovr_ovr "" VALUE 0x80001374 RecordLayout_3 0 CompuMethod_7 0 1 /end CHARACTERISTIC
/begin CHARACTERISTIC IPT_Inverter_Temperature_Ovr_new "" VALUE 0x80001375 RecordLayout_4 0 CompuMethod_2 -1E+17 1E+17 /end CHARACTERISTIC
/begin CHARACTERISTIC IPT_Inverter_Temperature_Ovr_ovr "" VALUE 0x80001379 RecordLayout_3 0 CompuMethod_7 0 1 /end CHARACTERISTIC
/begin CHARACTERISTIC IPT_IPTAwake_Ovr_new "" VALUE 0x8000137A RecordLayout_4 0 CompuMethod_2 -1E+17 1E+17 /end CHARACTERISTIC
/begin CHARACTERISTIC IPT_IPTAwake_Ovr_ovr "" VALUE 0x8000137E RecordLayout_3 0 CompuMethod_7 0 1 /end CHARACTERISTIC
/begin CHARACTERISTIC IPT_IPTReady_Ovr_new "" VALUE 0x8000137F RecordLayout_4 0 CompuMethod_2 -1E+17 1E+17 /end CHARACTERISTIC
/begin CHARACTERISTIC IPT_IPTReady_Ovr_ovr "" VALUE 0x80001383 RecordLayout_3 0 CompuMethod_7 0 1 /end CHARACTERISTIC
/begin CHARACTERISTIC IPT_Max_Torque_Avail_Gen_Ovr_new "" VALUE 0x80001384 RecordLayout_4 0 CompuMethod_2 -1E+17 1E+17 /end CHARACTERISTIC
/begin CHARACTERISTIC IPT_Max_Torque_Avail_Gen_Ovr_ovr "" VALUE 0x80001388 RecordLayout_3 0 CompuMethod_7 0 1 /end CHARACTERISTIC
/begin CHARACTERISTIC IPT_Max_Torque_Avail_Motor_Ovr_new "" VALUE 0x80001389 RecordLayout_4 0 CompuMethod_2 -1E+17 1E+17 /end CHARACTERISTIC
/begin CHARACTERISTIC IPT_Max_Torque_Avail_Motor_Ovr_ovr "" VALUE 0x8000138D RecordLayout_3 0 CompuMethod_7 0 1 /end CHARACTERISTIC
/begin CHARACTERISTIC IPT_Max_Waste_Available_Ovr_new "" VALUE 0x8000138E RecordLayout_4 0 CompuMethod_2 -1E+17 1E+17 /end CHARACTERISTIC
/begin CHARACTERISTIC IPT_Max_Waste_Available_Ovr_ovr "" VALUE 0x80001392 RecordLayout_3 0 CompuMethod_7 0 1 /end CHARACTERISTIC
/begin CHARACTERISTIC IPT_Motor_Ready_Ovr_new "" VALUE 0x80001393 RecordLayout_3 0 CompuMethod_11 0 1 /end CHARACTERISTIC
/begin CHARACTERISTIC IPT_Motor_Ready_Ovr_ovr "" VALUE 0x80001394 RecordLayout_3 0 CompuMethod_7 0 1 /end CHARACTERISTIC
/begin CHARACTERISTIC IPT_Motor_Speed_Ovr_new "" VALUE 0x80001395 RecordLayout_4 0 CompuMethod_2 -1E+17 1E+17 /end CHARACTERISTIC
/begin CHARACTERISTIC IPT_Motor_Speed_Ovr_ovr "" VALUE 0x80001399 RecordLayout_3 0 CompuMethod_7 0 1 /end CHARACTERISTIC
/begin CHARACTERISTIC IPT_Motor_Temperature_Ovr_new "" VALUE 0x8000139A RecordLayout_4 0 CompuMethod_2 -1E+17 1E+17 /end CHARACTERISTIC
/begin CHARACTERISTIC IPT_Motor_Temperature_Ovr_ovr "" VALUE 0x8000139E RecordLayout_3 0 CompuMethod_7 0 1 /end CHARACTERISTIC
/begin CHARACTERISTIC IPT_Wheel_Torque_Delivered_Ovr_new "" VALUE 0x800013A7 RecordLayout_4 0 CompuMethod_2 -1E+17 1E+17 /end CHARACTERISTIC
/begin CHARACTERISTIC IPT_Wheel_Torque_Delivered_Ovr_ovr "" VALUE 0x800013AB RecordLayout_3 0 CompuMethod_7 0 1 /end CHARACTERISTIC
/begin CHARACTERISTIC Isolation_Measure_Enable_ovr_new "" VALUE 0x800013AC RecordLayout_3 0 CompuMethod_11 0 1 /end CHARACTERISTIC
/begin CHARACTERISTIC Isolation_Measure_Enable_ovr_ovr "" VALUE 0x800013AD RecordLayout_3 0 CompuMethod_7 0 1 /end CHARACTERISTIC
/begin CHARACTERISTIC Key_Line_Voltage_Fault "" VALUE 0x800013AE RecordLayout_4 0 CompuMethod_2 -1E+17 1E+17 /end CHARACTERISTIC
/begin CHARACTERISTIC Key_Off_Coltage_High_Fault "" VALUE 0x800013B2 RecordLayout_4 0 CompuMethod_2 -1E+17 1E+17 /end CHARACTERISTIC
/begin CHARACTERISTIC LF_Wheel_Rolling_Count_Ovr_new "" VALUE 0x800013B6 RecordLayout_4 0 CompuMethod_2 -1E+17 1E+17 /end CHARACTERISTIC
/begin CHARACTERISTIC LF_Wheel_Rolling_Count_Ovr_ovr "" VALUE 0x800013BA RecordLayout_3 0 CompuMethod_7 0 1 /end CHARACTERISTIC
/begin CHARACTERISTIC Load_On_Ovr_new "" VALUE 0x800013BF RecordLayout_4 0 CompuMethod_2 -1E+17 1E+17 /end CHARACTERISTIC
/begin CHARACTERISTIC Load_On_Ovr_ovr "" VALUE 0x800013C3 RecordLayout_3 0 CompuMethod_7 0 1 /end CHARACTERISTIC
/begin CHARACTERISTIC Load_RPM_Ovr_new "" VALUE 0x800013C4 RecordLayout_4 0 CompuMethod_2 -1E+17 1E+17 /end CHARACTERISTIC
/begin CHARACTERISTIC Load_RPM_Ovr_ovr "" VALUE 0x800013C8 RecordLayout_3 0 CompuMethod_7 0 1 /end CHARACTERISTIC
/begin CHARACTERISTIC Load_Throttle_Ovr_new "" VALUE 0x800013C9 RecordLayout_4 0 CompuMethod_2 -1E+17 1E+17 /end CHARACTERISTIC
/begin CHARACTERISTIC Load_Throttle_Ovr_ovr "" VALUE 0x800013CD RecordLayout_3 0 CompuMethod_7 0 1 /end CHARACTERISTIC
/begin CHARACTERISTIC LoadCalibrationError "Debug value for LoadCalibrationError" VALUE 0x800013CE RecordLayout_6 0 CompuMethod_12 0 65535 /end CHARACTERISTIC
/begin CHARACTERISTIC MaxAmpCal "" VALUE 0x800013EC RecordLayout_4 0 CompuMethod_2 -1E+17 1E+17 /end CHARACTERISTIC
/begin CHARACTERISTIC MaxVoltageCal "" VALUE 0x800013F0 RecordLayout_4 0 CompuMethod_2 -1E+17 1E+17 /end CHARACTERISTIC
/begin CHARACTERISTIC Me_Cool_Temp_Ovr_new "" VALUE 0x800013F4 RecordLayout_4 0 CompuMethod_2 -1E+17 1E+17 /end CHARACTERISTIC
/begin CHARACTERISTIC Me_Cool_Temp_Ovr_ovr "" VALUE 0x800013F8 RecordLayout_3 0 CompuMethod_7 0 1 /end CHARACTERISTIC
/begin CHARACTERISTIC Mode_1_Ovr_new "" VALUE 0x80001419 RecordLayout_4 0 CompuMethod_2 -1E+17 1E+17 /end CHARACTERISTIC
/begin CHARACTERISTIC Mode_1_Ovr_ovr "" VALUE 0x8000141D RecordLayout_3 0 CompuMethod_7 0 1 /end CHARACTERISTIC
/begin CHARACTERISTIC Mode_2_Ovr_new "" VALUE 0x80001422 RecordLayout_4 0 CompuMethod_2 -1E+17 1E+17 /end CHARACTERISTIC
/begin CHARACTERISTIC Mode_2_Ovr_ovr "" VALUE 0x80001426 RecordLayout_3 0 CompuMethod_7 0 1 /end CHARACTERISTIC
/begin CHARACTERISTIC Mode_3_Ovr_new "" VALUE 0x8000142B RecordLayout_4 0 CompuMethod_2 -1E+17 1E+17 /end CHARACTERISTIC
/begin CHARACTERISTIC Mode_3_Ovr_ovr "" VALUE 0x8000142F RecordLayout_3 0 CompuMethod_7 0 1 /end CHARACTERISTIC
/begin CHARACTERISTIC Mode_4_Ovr_new "" VALUE 0x80001434 RecordLayout_4 0 CompuMethod_2 -1E+17 1E+17 /end CHARACTERISTIC
/begin CHARACTERISTIC Mode_4_Ovr_ovr "" VALUE 0x80001438 RecordLayout_3 0 CompuMethod_7 0 1 /end CHARACTERISTIC
/begin CHARACTERISTIC Motor_Speed_High_Fault "" VALUE 0x80001449 RecordLayout_4 0 CompuMethod_2 -1E+17 1E+17 /end CHARACTERISTIC
/begin CHARACTERISTIC Motor_Speed_Low_Fault "" VALUE 0x8000144D RecordLayout_4 0 CompuMethod_2 -1E+17 1E+17 /end CHARACTERISTIC
/begin CHARACTERISTIC Motor_Speed_Torque_Fault "" VALUE 0x80001451 RecordLayout_4 0 CompuMethod_2 -1E+17 1E+17 /end CHARACTERISTIC
/begin CHARACTERISTIC Motor_Speed_TorqueRPM_Fault "" VALUE 0x80001455 RecordLayout_4 0 CompuMethod_2 -1E+17 1E+17 /end CHARACTERISTIC
/begin CHARACTERISTIC Motor_Startup_Delay "" VALUE 0x80001459 RecordLayout_4 0 CompuMethod_2 -1E+17 1E+17 /end CHARACTERISTIC
/begin CHARACTERISTIC MPRD_new "Directly Override Main Power Relay" VALUE 0x80001466 RecordLayout_3 0 CompuMethod_493 0 1 /end CHARACTERISTIC
/begin CHARACTERISTIC MPRD_ovr "" VALUE 0x80001467 RecordLayout_3 0 CompuMethod_7 0 1 /end CHARACTERISTIC
/begin CHARACTERISTIC NonVolatileRestoreOnFirstStartup "Selects whether to restore from factory defaults the first time an application boots" VALUE 0x80001468 RecordLayout_3 0 CompuMethod_494 0 1 /end CHARACTERISTIC
/begin CHARACTERISTIC NonVolatileRestoreOnStartup "Selects whether to restore from factory defaults on next startup" VALUE 0x80001469 RecordLayout_3 0 CompuMethod_494 0 1 /end CHARACTERISTIC
/begin CHARACTERISTIC ODO_Count_Ovr_new "" VALUE 0x8000146A RecordLayout_4 0 CompuMethod_496 0 0.0508 /end CHARACTERISTIC
/begin CHARACTERISTIC ODO_Count_Ovr_ovr "" VALUE 0x8000146E RecordLayout_3 0 CompuMethod_7 0 1 /end CHARACTERISTIC
/begin CHARACTERISTIC Oil_Pressure_Ovr_new "" VALUE 0x80001477 RecordLayout_4 0 CompuMethod_2 -1E+17 1E+17 /end CHARACTERISTIC
/begin CHARACTERISTIC Oil_Pressure_Ovr_ovr "" VALUE 0x8000147B RecordLayout_3 0 CompuMethod_7 0 1 /end CHARACTERISTIC
/begin CHARACTERISTIC Output_Current_Ovr_new "" VALUE 0x80001480 RecordLayout_4 0 CompuMethod_2 -1E+17 1E+17 /end CHARACTERISTIC
/begin CHARACTERISTIC Output_Current_Ovr_ovr "" VALUE 0x80001484 RecordLayout_3 0 CompuMethod_7 0 1 /end CHARACTERISTIC
/begin CHARACTERISTIC Output_Voltage_Ovr_new "" VALUE 0x80001485 RecordLayout_4 0 CompuMethod_2 -1E+17 1E+17 /end CHARACTERISTIC
/begin CHARACTERISTIC Output_Voltage_Ovr_ovr "" VALUE 0x80001489 RecordLayout_3 0 CompuMethod_7 0 1 /end CHARACTERISTIC
/begin CHARACTERISTIC Overcurrent_Tq_Lim_Filter "Filter time constant" VALUE 0x8000148A RecordLayout_4 0 CompuMethod_485 -1E+17 1E+17 /end CHARACTERISTIC
/begin CHARACTERISTIC Pack_State_ovr_new "" VALUE 0x8000148E RecordLayout_4 0 CompuMethod_2 0 8 /end CHARACTERISTIC
/begin CHARACTERISTIC Pack_State_ovr_ovr "" VALUE 0x80001492 RecordLayout_3 0 CompuMethod_7 0 1 /end CHARACTERISTIC
/begin CHARACTERISTIC Passenger_1_Ovr_new "" VALUE 0x8000149B RecordLayout_4 0 CompuMethod_2 -1E+17 1E+17 /end CHARACTERISTIC
/begin CHARACTERISTIC Passenger_1_Ovr_ovr "" VALUE 0x8000149F RecordLayout_3 0 CompuMethod_7 0 1 /end CHARACTERISTIC
/begin CHARACTERISTIC Passenger_10_Ovr_new "" VALUE 0x800014A0 RecordLayout_4 0 CompuMethod_2 -1E+17 1E+17 /end CHARACTERISTIC
/begin CHARACTERISTIC Passenger_10_Ovr_ovr "" VALUE 0x800014A4 RecordLayout_3 0 CompuMethod_7 0 1 /end CHARACTERISTIC
/begin CHARACTERISTIC Passenger_Temp_Ovr_new "" VALUE 0x800014A5 RecordLayout_4 0 CompuMethod_2 -1E+17 1E+17 /end CHARACTERISTIC
/begin CHARACTERISTIC Passenger_Temp_Ovr_ovr "" VALUE 0x800014A9 RecordLayout_3 0 CompuMethod_7 0 1 /end CHARACTERISTIC
/begin CHARACTERISTIC Pct_whl_trq_desired_ovr_new "" VALUE 0x800014AA RecordLayout_4 0 CompuMethod_2 0 4 /end CHARACTERISTIC
/begin CHARACTERISTIC Pct_whl_trq_desired_ovr_ovr "" VALUE 0x800014AE RecordLayout_3 0 CompuMethod_7 0 1 /end CHARACTERISTIC
/begin CHARACTERISTIC Pedal_Poition_Sensor_A_Intermittent "" VALUE 0x800014AF RecordLayout_4 0 CompuMethod_2 -1E+17 1E+17 /end CHARACTERISTIC
/begin CHARACTERISTIC Pedal_Position_Sensor_A_Circuit_High "" VALUE 0x800014B3 RecordLayout_4 0 CompuMethod_2 -1E+17 1E+17 /end CHARACTERISTIC
/begin CHARACTERISTIC Pedal_Position_Sensor_A_Circuit_Low "" VALUE 0x800014B7 RecordLayout_4 0 CompuMethod_2 -1E+17 1E+17 /end CHARACTERISTIC
/begin CHARACTERISTIC Power_train_torq_actual_ovr_new "" VALUE 0x800014BB RecordLayout_4 0 CompuMethod_2 0 4 /end CHARACTERISTIC
/begin CHARACTERISTIC Power_train_torq_actual_ovr_ovr "" VALUE 0x800014BF RecordLayout_3 0 CompuMethod_7 0 1 /end CHARACTERISTIC
/begin CHARACTERISTIC prndl_dir_ovr_new "" VALUE 0x800014C0 RecordLayout_4 0 CompuMethod_2 0 4 /end CHARACTERISTIC
/begin CHARACTERISTIC prndl_dir_ovr_ovr "" VALUE 0x800014C4 RecordLayout_3 0 CompuMethod_7 0 1 /end CHARACTERISTIC
/begin CHARACTERISTIC PSCM_80_AgeCount_Ovr_new "" VALUE 0x800014C6 RecordLayout_2 0 CompuMethod_6 0 4294970000 /end CHARACTERISTIC
/begin CHARACTERISTIC PSCM_80_AgeCount_Ovr_ovr "" VALUE 0x800014CA RecordLayout_3 0 CompuMethod_7 0 1 /end CHARACTERISTIC
/begin CHARACTERISTIC Radiator_Blend_Ovr_new "" VALUE 0x800014D3 RecordLayout_4 0 CompuMethod_2 -1E+17 1E+17 /end CHARACTERISTIC
/begin CHARACTERISTIC Radiator_Blend_Ovr_ovr "" VALUE 0x800014D7 RecordLayout_3 0 CompuMethod_7 0 1 /end CHARACTERISTIC
/begin CHARACTERISTIC Radiator_Blend_Valve_Ovr_new "" VALUE 0x800014D8 RecordLayout_6 0 CompuMethod_5 0 65535 /end CHARACTERISTIC
/begin CHARACTERISTIC Radiator_Blend_Valve_Ovr_ovr "" VALUE 0x800014DA RecordLayout_3 0 CompuMethod_7 0 1 /end CHARACTERISTIC
/begin CHARACTERISTIC Radiator_Fan_Ovr_new "" VALUE 0x800014DB RecordLayout_4 0 CompuMethod_2 -1E+17 1E+17 /end CHARACTERISTIC
/begin CHARACTERISTIC Radiator_Fan_Ovr_ovr "" VALUE 0x800014DF RecordLayout_3 0 CompuMethod_7 0 1 /end CHARACTERISTIC
/begin CHARACTERISTIC Radiator_Motor_Direction_Ovr_new "" VALUE 0x800014E0 RecordLayout_3 0 CompuMethod_11 0 1 /end CHARACTERISTIC
/begin CHARACTERISTIC Radiator_Motor_Direction_Ovr_ovr "" VALUE 0x800014E1 RecordLayout_3 0 CompuMethod_7 0 1 /end CHARACTERISTIC
/begin CHARACTERISTIC Radiator_Motor_Enable_Ovr_new "" VALUE 0x800014E2 RecordLayout_3 0 CompuMethod_11 0 1 /end CHARACTERISTIC
/begin CHARACTERISTIC Radiator_Motor_Enable_Ovr_ovr "" VALUE 0x800014E3 RecordLayout_3 0 CompuMethod_7 0 1 /end CHARACTERISTIC
/begin CHARACTERISTIC Radiator_Pos_Request_Ovr_new "" VALUE 0x800014E4 RecordLayout_4 0 CompuMethod_2 -1E+17 1E+17 /end CHARACTERISTIC
/begin CHARACTERISTIC Radiator_Pos_Request_Ovr_ovr "" VALUE 0x800014E8 RecordLayout_3 0 CompuMethod_7 0 1 /end CHARACTERISTIC
/begin CHARACTERISTIC Radiator_Pump_Ovr_new "" VALUE 0x800014E9 RecordLayout_3 0 CompuMethod_11 0 1 /end CHARACTERISTIC
/begin CHARACTERISTIC Radiator_Pump_Ovr_ovr "" VALUE 0x800014EA RecordLayout_3 0 CompuMethod_7 0 1 /end CHARACTERISTIC
/begin CHARACTERISTIC RadLowPass "Filter time constant" VALUE 0x800014EB RecordLayout_4 0 CompuMethod_485 -1E+17 1E+17 /end CHARACTERISTIC
/begin CHARACTERISTIC Ready_Light_Ovr_new "" VALUE 0x800014FF RecordLayout_3 0 CompuMethod_11 0 1 /end CHARACTERISTIC
/begin CHARACTERISTIC Ready_Light_Ovr_ovr "" VALUE 0x80001500 RecordLayout_3 0 CompuMethod_7 0 1 /end CHARACTERISTIC
/begin CHARACTERISTIC Rear_left_whl_speed_Ovr_new "" VALUE 0x80001501 RecordLayout_4 0 CompuMethod_2 -1E+17 1E+17 /end CHARACTERISTIC
/begin CHARACTERISTIC Rear_left_whl_speed_Ovr_ovr "" VALUE 0x80001505 RecordLayout_3 0 CompuMethod_7 0 1 /end CHARACTERISTIC
/begin CHARACTERISTIC Rear_right_whl_speed_Ovr_new "" VALUE 0x80001506 RecordLayout_4 0 CompuMethod_2 -1E+17 1E+17 /end CHARACTERISTIC
/begin CHARACTERISTIC Rear_right_whl_speed_Ovr_ovr "" VALUE 0x8000150A RecordLayout_3 0 CompuMethod_7 0 1 /end CHARACTERISTIC
/begin CHARACTERISTIC Regen_Brakes_Disabled_Ovr_new "" VALUE 0x8000150B RecordLayout_3 0 CompuMethod_11 0 1 /end CHARACTERISTIC
/begin CHARACTERISTIC Regen_Brakes_Disabled_Ovr_ovr "" VALUE 0x8000150C RecordLayout_3 0 CompuMethod_7 0 1 /end CHARACTERISTIC
/begin CHARACTERISTIC regen_torq_limit_ovr_new "" VALUE 0x8000150D RecordLayout_4 0 CompuMethod_2 0 4 /end CHARACTERISTIC
/begin CHARACTERISTIC regen_torq_limit_ovr_ovr "" VALUE 0x80001511 RecordLayout_3 0 CompuMethod_7 0 1 /end CHARACTERISTIC
/begin CHARACTERISTIC RELATIVE_STR_WHL_ANGLE_Ovr_new "" VALUE 0x80001536 RecordLayout_4 0 CompuMethod_2 -1E+17 1E+17 /end CHARACTERISTIC
/begin CHARACTERISTIC RELATIVE_STR_WHL_ANGLE_Ovr_ovr "" VALUE 0x8000153A RecordLayout_3 0 CompuMethod_7 0 1 /end CHARACTERISTIC
/begin CHARACTERISTIC Repair_Wrench_Ovr_new "" VALUE 0x8000153B RecordLayout_3 0 CompuMethod_11 0 1 /end CHARACTERISTIC
/begin CHARACTERISTIC Repair_Wrench_Ovr_ovr "" VALUE 0x8000153C RecordLayout_3 0 CompuMethod_7 0 1 /end CHARACTERISTIC
/begin CHARACTERISTIC RestoreNVFactoryDefaults "Restores NonVolatile Memory to Factory Defaults" VALUE 0x8000153D RecordLayout_3 0 CompuMethod_502 0 1 /end CHARACTERISTIC
/begin CHARACTERISTIC RPM_Ovr_new "" VALUE 0x8000153E RecordLayout_4 0 CompuMethod_2 -1E+17 1E+17 /end CHARACTERISTIC
/begin CHARACTERISTIC RPM_Ovr_ovr "" VALUE 0x80001542 RecordLayout_3 0 CompuMethod_7 0 1 /end CHARACTERISTIC
/begin CHARACTERISTIC RPM_to_Wheel_Speed_Multiplier3 "" VALUE 0x80001557 RecordLayout_4 0 CompuMethod_2 -1E+17 1E+17 /end CHARACTERISTIC
/begin CHARACTERISTIC RT_Wheel_Rolling_Count_Ovr_new "" VALUE 0x80001563 RecordLayout_4 0 CompuMethod_2 -1E+17 1E+17 /end CHARACTERISTIC
/begin CHARACTERISTIC RT_Wheel_Rolling_Count_Ovr_ovr "" VALUE 0x80001567 RecordLayout_3 0 CompuMethod_7 0 1 /end CHARACTERISTIC
/begin CHARACTERISTIC Saturated_Sensor_Discharge "" VALUE 0x800016BC RecordLayout_4 0 CompuMethod_2 -1E+17 1E+17 /end CHARACTERISTIC
/begin CHARACTERISTIC Saturated_Sensor_Regen "" VALUE 0x800016C0 RecordLayout_4 0 CompuMethod_2 -1E+17 1E+17 /end CHARACTERISTIC
/begin CHARACTERISTIC SaveCalibrationError "Debug value for SaveCalibrationError" VALUE 0x800016C4 RecordLayout_6 0 CompuMethod_12 0 65535 /end CHARACTERISTIC
/begin CHARACTERISTIC Shift_Position_Raw_Ovr_new "" VALUE 0x800016CE RecordLayout_4 0 CompuMethod_2 -1E+17 1E+17 /end CHARACTERISTIC
/begin CHARACTERISTIC Shift_Position_Raw_Ovr_ovr "" VALUE 0x800016D2 RecordLayout_3 0 CompuMethod_7 0 1 /end CHARACTERISTIC
/begin CHARACTERISTIC Shutdown_ovr_new "" VALUE 0x800016D3 RecordLayout_3 0 CompuMethod_11 0 1 /end CHARACTERISTIC
/begin CHARACTERISTIC Shutdown_ovr_ovr "" VALUE 0x800016D4 RecordLayout_3 0 CompuMethod_7 0 1 /end CHARACTERISTIC
/begin CHARACTERISTIC SOC_Critical "" VALUE 0x800016D6 RecordLayout_4 0 CompuMethod_2 -1E+17 1E+17 /end CHARACTERISTIC
/begin CHARACTERISTIC SOC_High "" VALUE 0x800016DA RecordLayout_4 0 CompuMethod_2 -1E+17 1E+17 /end CHARACTERISTIC
/begin CHARACTERISTIC SOC_Low "" VALUE 0x800016DE RecordLayout_4 0 CompuMethod_2 -1E+17 1E+17 /end CHARACTERISTIC
/begin CHARACTERISTIC SOC_Time_Threshold "" VALUE 0x800016EA RecordLayout_4 0 CompuMethod_2 -1E+17 1E+17 /end CHARACTERISTIC
/begin CHARACTERISTIC SOCFilt "Filter time constant" VALUE 0x800016EE RecordLayout_4 0 CompuMethod_485 -1E+17 1E+17 /end CHARACTERISTIC
/begin CHARACTERISTIC Speed_Ovr_new "" VALUE 0x800016F2 RecordLayout_4 0 CompuMethod_2 -1E+17 1E+17 /end CHARACTERISTIC
/begin CHARACTERISTIC Speed_Ovr_ovr "" VALUE 0x800016F6 RecordLayout_3 0 CompuMethod_7 0 1 /end CHARACTERISTIC
/begin CHARACTERISTIC StoreNV "Stores RAM-Shadowed memory to serial EEPROM" VALUE 0x800016FF RecordLayout_3 0 CompuMethod_503 0 1 /end CHARACTERISTIC
/begin CHARACTERISTIC STR_WHL_ANGLE_CNTR_FND_Ovr_new "" VALUE 0x80001700 RecordLayout_4 0 CompuMethod_2 -1E+17 1E+17 /end CHARACTERISTIC
/begin CHARACTERISTIC STR_WHL_ANGLE_CNTR_FND_Ovr_ovr "" VALUE 0x80001704 RecordLayout_3 0 CompuMethod_7 0 1 /end CHARACTERISTIC
/begin CHARACTERISTIC STR_WHL_ANGLE_Ovr_new "" VALUE 0x80001705 RecordLayout_4 0 CompuMethod_2 -1E+17 1E+17 /end CHARACTERISTIC
/begin CHARACTERISTIC STR_WHL_ANGLE_Ovr_ovr "" VALUE 0x80001709 RecordLayout_3 0 CompuMethod_7 0 1 /end CHARACTERISTIC
/begin CHARACTERISTIC TCS_ENG_EVNT_IN_PROGRESS_Ovr_new "" VALUE 0x80001862 RecordLayout_4 0 CompuMethod_2 -1E+17 1E+17 /end CHARACTERISTIC
/begin CHARACTERISTIC TCS_ENG_EVNT_IN_PROGRESS_Ovr_ovr "" VALUE 0x80001866 RecordLayout_3 0 CompuMethod_7 0 1 /end CHARACTERISTIC
/begin CHARACTERISTIC Temp_Fault_Hyst "" VALUE 0x80001867 RecordLayout_4 0 CompuMethod_2 -1E+17 1E+17 /end CHARACTERISTIC
/begin CHARACTERISTIC Temp_Flash "" VALUE 0x8000186B RecordLayout_4 0 CompuMethod_504 -5E+15 5E+15 /end CHARACTERISTIC
/begin CHARACTERISTIC Temp_Guage_Ovr_new "" VALUE 0x8000186F RecordLayout_4 0 CompuMethod_2 -1E+17 1E+17 /end CHARACTERISTIC
/begin CHARACTERISTIC Temp_Guage_Ovr_ovr "" VALUE 0x80001873 RecordLayout_3 0 CompuMethod_7 0 1 /end CHARACTERISTIC
/begin CHARACTERISTIC Throttle_Position_Ovr_new "" VALUE 0x80001874 RecordLayout_6 0 CompuMethod_5 0 65535 /end CHARACTERISTIC
/begin CHARACTERISTIC Throttle_Position_Ovr_ovr "" VALUE 0x80001876 RecordLayout_3 0 CompuMethod_7 0 1 /end CHARACTERISTIC
/begin CHARACTERISTIC Throttle_Position_Raw_Ovr_new "" VALUE 0x80001877 RecordLayout_6 0 CompuMethod_5 0 65535 /end CHARACTERISTIC
/begin CHARACTERISTIC Throttle_Position_Raw_Ovr_ovr "" VALUE 0x80001879 RecordLayout_3 0 CompuMethod_7 0 1 /end CHARACTERISTIC
/begin CHARACTERISTIC Torque_Request_Override_new "" VALUE 0x8000187F RecordLayout_4 0 CompuMethod_2 -1E+17 1E+17 /end CHARACTERISTIC
/begin CHARACTERISTIC Torque_Request_Override_ovr "" VALUE 0x80001883 RecordLayout_3 0 CompuMethod_7 0 1 /end CHARACTERISTIC
/begin CHARACTERISTIC Torque_Reverse_Override_new "" VALUE 0x80001884 RecordLayout_4 0 CompuMethod_2 -1E+17 1E+17 /end CHARACTERISTIC
/begin CHARACTERISTIC Torque_Reverse_Override_ovr "" VALUE 0x80001888 RecordLayout_3 0 CompuMethod_7 0 1 /end CHARACTERISTIC
/begin CHARACTERISTIC Torque_Reverse_Override69_new "" VALUE 0x80001889 RecordLayout_4 0 CompuMethod_2 -1E+17 1E+17 /end CHARACTERISTIC
/begin CHARACTERISTIC Torque_Reverse_Override69_ovr "" VALUE 0x8000188D RecordLayout_3 0 CompuMethod_7 0 1 /end CHARACTERISTIC
/begin CHARACTERISTIC TorqueLimMultiplierTbl "" CURVE 0x8000188E RecordLayout_4 0 CompuMethod_2 -1E+17 1E+17
 /begin AXIS_DESCR COM_AXIS ModifiedAmpSecIn CompuMethod_2 4 -1E+17 1E+17 AXIS_PTS_REF ModifiedAmpSecIdxArr /end AXIS_DESCR
/end CHARACTERISTIC
/begin CHARACTERISTIC TorqueRecoveryValue "Determines indirectly rate/sec at which torque recovers. More negative faster recovery" VALUE 0x8000189E RecordLayout_4 0 CompuMethod_505 -1E+17 1E+17 /end CHARACTERISTIC
/begin CHARACTERISTIC Traction_Control_System_Maulfunction_Fault "" VALUE 0x800018A3 RecordLayout_4 0 CompuMethod_2 -1E+17 1E+17 /end CHARACTERISTIC
/begin CHARACTERISTIC Traction_Control_Vehicle_Moving "" VALUE 0x800018A7 RecordLayout_4 0 CompuMethod_2 -1E+17 1E+17 /end CHARACTERISTIC
/begin CHARACTERISTIC Transmission_AgeCount_Ovr_new "" VALUE 0x800018AF RecordLayout_2 0 CompuMethod_6 0 4294970000 /end CHARACTERISTIC
/begin CHARACTERISTIC Transmission_AgeCount_Ovr_ovr "" VALUE 0x800018B3 RecordLayout_3 0 CompuMethod_7 0 1 /end CHARACTERISTIC
/begin CHARACTERISTIC V12_Battery_Erratic_Fault "" VALUE 0x800018B4 RecordLayout_4 0 CompuMethod_2 -1E+17 1E+17 /end CHARACTERISTIC
/begin CHARACTERISTIC V12_High "" VALUE 0x800018B8 RecordLayout_4 0 CompuMethod_2 -1E+17 1E+17 /end CHARACTERISTIC
/begin CHARACTERISTIC V12_Low "" VALUE 0x800018BC RecordLayout_4 0 CompuMethod_2 -1E+17 1E+17 /end CHARACTERISTIC
/begin CHARACTERISTIC VEH_ID_Ovr_new "" VALUE 0x800018C4 RecordLayout_4 0 CompuMethod_2 -1E+17 1E+17 /end CHARACTERISTIC
/begin CHARACTERISTIC VEH_ID_Ovr_ovr "" VALUE 0x800018C8 RecordLayout_3 0 CompuMethod_7 0 1 /end CHARACTERISTIC
/begin CHARACTERISTIC Vehicle_Speed_Off "" VALUE 0x800018CB RecordLayout_4 0 CompuMethod_2 -1E+17 1E+17 /end CHARACTERISTIC
/begin CHARACTERISTIC Vehicle_Speed_On "" VALUE 0x800018CF RecordLayout_4 0 CompuMethod_2 -1E+17 1E+17 /end CHARACTERISTIC
/begin CHARACTERISTIC Vehicle_Speed_Ovr_new "" VALUE 0x800018D3 RecordLayout_4 0 CompuMethod_2 -1E+17 1E+17 /end CHARACTERISTIC
/begin CHARACTERISTIC Vehicle_Speed_Ovr_ovr "" VALUE 0x800018D7 RecordLayout_3 0 CompuMethod_7 0 1 /end CHARACTERISTIC
/begin CHARACTERISTIC Vehicle_Speed_Sensor_Circuit_Low_Fault "" VALUE 0x800018D8 RecordLayout_4 0 CompuMethod_2 -1E+17 1E+17 /end CHARACTERISTIC
/begin CHARACTERISTIC Vehicle_Speed_Time_Threshold "" VALUE 0x800018DC RecordLayout_4 0 CompuMethod_2 -1E+17 1E+17 /end CHARACTERISTIC
/begin CHARACTERISTIC Vehicle_Speed2_Ovr_new "" VALUE 0x800018E0 RecordLayout_4 0 CompuMethod_2 -1E+17 1E+17 /end CHARACTERISTIC
/begin CHARACTERISTIC Vehicle_Speed2_Ovr_ovr "" VALUE 0x800018E4 RecordLayout_3 0 CompuMethod_7 0 1 /end CHARACTERISTIC
/begin CHARACTERISTIC VFilt "Filter time constant" VALUE 0x800018E5 RecordLayout_4 0 CompuMethod_485 -1E+17 1E+17 /end CHARACTERISTIC
/begin CHARACTERISTIC VIN_DATA_BYTE_1_Ovr_new "" VALUE 0x800018ED RecordLayout_4 0 CompuMethod_2 -1E+17 1E+17 /end CHARACTERISTIC
/begin CHARACTERISTIC VIN_DATA_BYTE_1_Ovr_ovr "" VALUE 0x800018F1 RecordLayout_3 0 CompuMethod_7 0 1 /end CHARACTERISTIC
/begin CHARACTERISTIC VIN_DATA_BYTE_10_Ovr_new "" VALUE 0x800018F6 RecordLayout_4 0 CompuMethod_2 -1E+17 1E+17 /end CHARACTERISTIC
/begin CHARACTERISTIC VIN_DATA_BYTE_10_Ovr_ovr "" VALUE 0x800018FA RecordLayout_3 0 CompuMethod_7 0 1 /end CHARACTERISTIC
/begin CHARACTERISTIC VIN_DATA_BYTE_11_Ovr_new "" VALUE 0x800018FF RecordLayout_4 0 CompuMethod_2 -1E+17 1E+17 /end CHARACTERISTIC
/begin CHARACTERISTIC VIN_DATA_BYTE_11_Ovr_ovr "" VALUE 0x80001903 RecordLayout_3 0 CompuMethod_7 0 1 /end CHARACTERISTIC
/begin CHARACTERISTIC VIN_DATA_BYTE_12_Ovr_new "" VALUE 0x80001908 RecordLayout_4 0 CompuMethod_2 -1E+17 1E+17 /end CHARACTERISTIC
/begin CHARACTERISTIC VIN_DATA_BYTE_12_Ovr_ovr "" VALUE 0x8000190C RecordLayout_3 0 CompuMethod_7 0 1 /end CHARACTERISTIC
/begin CHARACTERISTIC VIN_DATA_BYTE_13_Ovr_new "" VALUE 0x80001911 RecordLayout_4 0 CompuMethod_2 -1E+17 1E+17 /end CHARACTERISTIC
/begin CHARACTERISTIC VIN_DATA_BYTE_13_Ovr_ovr "" VALUE 0x80001915 RecordLayout_3 0 CompuMethod_7 0 1 /end CHARACTERISTIC
/begin CHARACTERISTIC VIN_DATA_BYTE_14_Ovr_new "" VALUE 0x8000191A RecordLayout_4 0 CompuMethod_2 -1E+17 1E+17 /end CHARACTERISTIC
/begin CHARACTERISTIC VIN_DATA_BYTE_14_Ovr_ovr "" VALUE 0x8000191E RecordLayout_3 0 CompuMethod_7 0 1 /end CHARACTERISTIC
/begin CHARACTERISTIC VIN_DATA_BYTE_15_Ovr_new "" VALUE 0x80001923 RecordLayout_4 0 CompuMethod_2 -1E+17 1E+17 /end CHARACTERISTIC
/begin CHARACTERISTIC VIN_DATA_BYTE_15_Ovr_ovr "" VALUE 0x80001927 RecordLayout_3 0 CompuMethod_7 0 1 /end CHARACTERISTIC
/begin CHARACTERISTIC VIN_DATA_BYTE_16_Ovr_new "" VALUE 0x8000192C RecordLayout_4 0 CompuMethod_2 -1E+17 1E+17 /end CHARACTERISTIC
/begin CHARACTERISTIC VIN_DATA_BYTE_16_Ovr_ovr "" VALUE 0x80001930 RecordLayout_3 0 CompuMethod_7 0 1 /end CHARACTERISTIC
/begin CHARACTERISTIC VIN_DATA_BYTE_17_Ovr_new "" VALUE 0x80001935 RecordLayout_4 0 CompuMethod_2 -1E+17 1E+17 /end CHARACTERISTIC
/begin CHARACTERISTIC VIN_DATA_BYTE_17_Ovr_ovr "" VALUE 0x80001939 RecordLayout_3 0 CompuMethod_7 0 1 /end CHARACTERISTIC
/begin CHARACTERISTIC VIN_DATA_BYTE_2_Ovr_new "" VALUE 0x8000193E RecordLayout_4 0 CompuMethod_2 -1E+17 1E+17 /end CHARACTERISTIC
/begin CHARACTERISTIC VIN_DATA_BYTE_2_Ovr_ovr "" VALUE 0x80001942 RecordLayout_3 0 CompuMethod_7 0 1 /end CHARACTERISTIC
/begin CHARACTERISTIC VIN_DATA_BYTE_3_Ovr_new "" VALUE 0x80001947 RecordLayout_4 0 CompuMethod_2 -1E+17 1E+17 /end CHARACTERISTIC
/begin CHARACTERISTIC VIN_DATA_BYTE_3_Ovr_ovr "" VALUE 0x8000194B RecordLayout_3 0 CompuMethod_7 0 1 /end CHARACTERISTIC
/begin CHARACTERISTIC VIN_DATA_BYTE_4_Ovr_new "" VALUE 0x80001950 RecordLayout_4 0 CompuMethod_2 -1E+17 1E+17 /end CHARACTERISTIC
/begin CHARACTERISTIC VIN_DATA_BYTE_4_Ovr_ovr "" VALUE 0x80001954 RecordLayout_3 0 CompuMethod_7 0 1 /end CHARACTERISTIC
/begin CHARACTERISTIC VIN_DATA_BYTE_5_Ovr_new "" VALUE 0x80001959 RecordLayout_4 0 CompuMethod_2 -1E+17 1E+17 /end CHARACTERISTIC
/begin CHARACTERISTIC VIN_DATA_BYTE_5_Ovr_ovr "" VALUE 0x8000195D RecordLayout_3 0 CompuMethod_7 0 1 /end CHARACTERISTIC
/begin CHARACTERISTIC VIN_DATA_BYTE_6_Ovr_new "" VALUE 0x80001962 RecordLayout_4 0 CompuMethod_2 -1E+17 1E+17 /end CHARACTERISTIC
/begin CHARACTERISTIC VIN_DATA_BYTE_6_Ovr_ovr "" VALUE 0x80001966 RecordLayout_3 0 CompuMethod_7 0 1 /end CHARACTERISTIC
/begin CHARACTERISTIC VIN_DATA_BYTE_7_Ovr_new "" VALUE 0x8000196B RecordLayout_4 0 CompuMethod_2 -1E+17 1E+17 /end CHARACTERISTIC
/begin CHARACTERISTIC VIN_DATA_BYTE_7_Ovr_ovr "" VALUE 0x8000196F RecordLayout_3 0 CompuMethod_7 0 1 /end CHARACTERISTIC
/begin CHARACTERISTIC VIN_DATA_BYTE_8_Ovr_new "" VALUE 0x80001974 RecordLayout_4 0 CompuMethod_2 -1E+17 1E+17 /end CHARACTERISTIC
/begin CHARACTERISTIC VIN_DATA_BYTE_8_Ovr_ovr "" VALUE 0x80001978 RecordLayout_3 0 CompuMethod_7 0 1 /end CHARACTERISTIC
/begin CHARACTERISTIC VIN_DATA_BYTE_9_Ovr_new "" VALUE 0x8000197D RecordLayout_4 0 CompuMethod_2 -1E+17 1E+17 /end CHARACTERISTIC
/begin CHARACTERISTIC VIN_DATA_BYTE_9_Ovr_ovr "" VALUE 0x80001981 RecordLayout_3 0 CompuMethod_7 0 1 /end CHARACTERISTIC
/begin CHARACTERISTIC Voltage_Limit_Override_new "" VALUE 0x80001986 RecordLayout_4 0 CompuMethod_2 -1E+17 1E+17 /end CHARACTERISTIC
/begin CHARACTERISTIC Voltage_Limit_Override_ovr "" VALUE 0x8000198A RecordLayout_3 0 CompuMethod_7 0 1 /end CHARACTERISTIC
/begin CHARACTERISTIC VSC_ActiveDischargeDisable_Cal "" VALUE 0x8000198B RecordLayout_4 0 CompuMethod_2 -1E+17 1E+17 /end CHARACTERISTIC
/begin CHARACTERISTIC VSC_ActiveDischargeDisable_Ovr_new "" VALUE 0x8000198F RecordLayout_4 0 CompuMethod_2 -1E+17 1E+17 /end CHARACTERISTIC
/begin CHARACTERISTIC VSC_ActiveDischargeDisable_Ovr_ovr "" VALUE 0x80001993 RecordLayout_3 0 CompuMethod_7 0 1 /end CHARACTERISTIC
/begin CHARACTERISTIC VSC_AntishudderDisable_Cal "" VALUE 0x80001994 RecordLayout_4 0 CompuMethod_2 -1E+17 1E+17 /end CHARACTERISTIC
/begin CHARACTERISTIC VSC_AntishudderDisable_Ovr_new "" VALUE 0x80001998 RecordLayout_4 0 CompuMethod_2 -1E+17 1E+17 /end CHARACTERISTIC
/begin CHARACTERISTIC VSC_AntishudderDisable_Ovr_ovr "" VALUE 0x8000199C RecordLayout_3 0 CompuMethod_7 0 1 /end CHARACTERISTIC
/begin CHARACTERISTIC VSC_DCDCEnable_Ovr_new "" VALUE 0x8000199D RecordLayout_3 0 CompuMethod_11 0 1 /end CHARACTERISTIC
/begin CHARACTERISTIC VSC_DCDCEnable_Ovr_ovr "" VALUE 0x8000199E RecordLayout_3 0 CompuMethod_7 0 1 /end CHARACTERISTIC
/begin CHARACTERISTIC VSC_DCOutputVoltage_Cal "" VALUE 0x8000199F RecordLayout_4 0 CompuMethod_2 -1E+17 1E+17 /end CHARACTERISTIC
/begin CHARACTERISTIC VSC_DCOutputVoltageCmd_Ovr_new "" VALUE 0x800019A3 RecordLayout_4 0 CompuMethod_2 -1E+17 1E+17 /end CHARACTERISTIC
/begin CHARACTERISTIC VSC_DCOutputVoltageCmd_Ovr_ovr "" VALUE 0x800019A7 RecordLayout_3 0 CompuMethod_7 0 1 /end CHARACTERISTIC
/begin CHARACTERISTIC VSC_IPTEnable_Ovr_new "" VALUE 0x800019A8 RecordLayout_3 0 CompuMethod_11 0 1 /end CHARACTERISTIC
/begin CHARACTERISTIC VSC_IPTEnable_Ovr_ovr "" VALUE 0x800019A9 RecordLayout_3 0 CompuMethod_7 0 1 /end CHARACTERISTIC
/begin CHARACTERISTIC VSC_IPTWakeup_Ovr_new "" VALUE 0x800019AA RecordLayout_3 0 CompuMethod_11 0 1 /end CHARACTERISTIC
/begin CHARACTERISTIC VSC_IPTWakeup_Ovr_ovr "" VALUE 0x800019AB RecordLayout_3 0 CompuMethod_7 0 1 /end CHARACTERISTIC
/begin CHARACTERISTIC VSC_MaxCurrInputMotor_Ovr_new "" VALUE 0x800019AC RecordLayout_4 0 CompuMethod_2 -1E+17 1E+17 /end CHARACTERISTIC
/begin CHARACTERISTIC VSC_MaxCurrInputMotor_Ovr_ovr "" VALUE 0x800019B0 RecordLayout_3 0 CompuMethod_7 0 1 /end CHARACTERISTIC
/begin CHARACTERISTIC VSC_MaxCurrOutputGen_Ovr_new "" VALUE 0x800019B1 RecordLayout_4 0 CompuMethod_2 -1E+17 1E+17 /end CHARACTERISTIC
/begin CHARACTERISTIC VSC_MaxCurrOutputGen_Ovr_ovr "" VALUE 0x800019B5 RecordLayout_3 0 CompuMethod_7 0 1 /end CHARACTERISTIC
/begin CHARACTERISTIC VSC_MaxDCVoltage_Cal "" VALUE 0x800019B6 RecordLayout_4 0 CompuMethod_2 -1E+17 1E+17 /end CHARACTERISTIC
/begin CHARACTERISTIC VSC_MaxDCVoltage_Ovr_new "" VALUE 0x800019BA RecordLayout_4 0 CompuMethod_2 -1E+17 1E+17 /end CHARACTERISTIC
/begin CHARACTERISTIC VSC_MaxDCVoltage_Ovr_ovr "" VALUE 0x800019BE RecordLayout_3 0 CompuMethod_7 0 1 /end CHARACTERISTIC
/begin CHARACTERISTIC VSC_MinDCVoltage_Cal "" VALUE 0x800019BF RecordLayout_4 0 CompuMethod_2 -1E+17 1E+17 /end CHARACTERISTIC
/begin CHARACTERISTIC VSC_MinDCVoltage_Ovr_new "" VALUE 0x800019C3 RecordLayout_4 0 CompuMethod_2 -1E+17 1E+17 /end CHARACTERISTIC
/begin CHARACTERISTIC VSC_MinDCVoltage_Ovr_ovr "" VALUE 0x800019C7 RecordLayout_3 0 CompuMethod_7 0 1 /end CHARACTERISTIC
/begin CHARACTERISTIC VSC_MotorEnable_Ovr_new "" VALUE 0x800019C8 RecordLayout_3 0 CompuMethod_11 0 1 /end CHARACTERISTIC
/begin CHARACTERISTIC VSC_MotorEnable_Ovr_ovr "" VALUE 0x800019C9 RecordLayout_3 0 CompuMethod_7 0 1 /end CHARACTERISTIC
/begin CHARACTERISTIC VSC_PowerWasteRequest_Cal "" VALUE 0x800019CA RecordLayout_4 0 CompuMethod_2 -1E+17 1E+17 /end CHARACTERISTIC
/begin CHARACTERISTIC VSC_PowerWasteRequest_Ovr_new "" VALUE 0x800019CE RecordLayout_4 0 CompuMethod_2 -1E+17 1E+17 /end CHARACTERISTIC
/begin CHARACTERISTIC VSC_PowerWasteRequest_Ovr_ovr "" VALUE 0x800019D2 RecordLayout_3 0 CompuMethod_7 0 1 /end CHARACTERISTIC
/begin CHARACTERISTIC VSC_SDPTActive_Cal "" VALUE 0x800019D3 RecordLayout_4 0 CompuMethod_2 -1E+17 1E+17 /end CHARACTERISTIC
/begin CHARACTERISTIC VSC_SDPTActive_Ovr_new "" VALUE 0x800019D7 RecordLayout_4 0 CompuMethod_2 -1E+17 1E+17 /end CHARACTERISTIC
/begin CHARACTERISTIC VSC_SDPTActive_Ovr_ovr "" VALUE 0x800019DB RecordLayout_3 0 CompuMethod_7 0 1 /end CHARACTERISTIC
/begin CHARACTERISTIC VSC_TRSPosition_Ovr_new "" VALUE 0x800019DC RecordLayout_4 0 CompuMethod_2 -1E+17 1E+17 /end CHARACTERISTIC
/begin CHARACTERISTIC VSC_TRSPosition_Ovr_ovr "" VALUE 0x800019E0 RecordLayout_3 0 CompuMethod_7 0 1 /end CHARACTERISTIC
/begin CHARACTERISTIC VSC_WheelTorqueRequest_Ovr_new "" VALUE 0x800019E1 RecordLayout_4 0 CompuMethod_2 -1E+17 1E+17 /end CHARACTERISTIC
/begin CHARACTERISTIC VSC_WheelTorqueRequest_Ovr_ovr "" VALUE 0x800019E5 RecordLayout_3 0 CompuMethod_7 0 1 /end CHARACTERISTIC
/begin CHARACTERISTIC Wheel_Rolling_Timestamp_Ovr_new "" VALUE 0x800019EA RecordLayout_4 0 CompuMethod_2 -1E+17 1E+17 /end CHARACTERISTIC
/begin CHARACTERISTIC Wheel_Rolling_Timestamp_Ovr_ovr "" VALUE 0x800019EE RecordLayout_3 0 CompuMethod_7 0 1 /end CHARACTERISTIC
/begin AXIS_PTS ModifiedAmpSecIdxArr "" 0x80001439 ModifiedAmpSecIn RecordLayout_7 0 CompuMethod_2 4 -1E+17 1E+17 DEPOSIT ABSOLUTE /end AXIS_PTS
/begin RECORD_LAYOUT RecordLayout_2 FNC_VALUES 1 ULONG ROW_DIR DIRECT /end RECORD_LAYOUT
/begin RECORD_LAYOUT RecordLayout_3 FNC_VALUES 1 UBYTE ROW_DIR DIRECT /end RECORD_LAYOUT
/begin RECORD_LAYOUT RecordLayout_4 FNC_VALUES 1 FLOAT32_IEEE ROW_DIR DIRECT /end RECORD_LAYOUT
/begin RECORD_LAYOUT RecordLayout_6 FNC_VALUES 1 UWORD ROW_DIR DIRECT /end RECORD_LAYOUT
/begin RECORD_LAYOUT RecordLayout_7 AXIS_PTS_X 1 FLOAT32_IEEE /* IndexIncr */ INDEX_INCR /* Addressing */ DIRECT /end RECORD_LAYOUT
/begin RECORD_LAYOUT RecordLayout_8 FNC_VALUES 1 SLONG ROW_DIR DIRECT /end RECORD_LAYOUT
/*~~~~~~~~~ 6.3.31 COMPU_METHODs ~~~~~~~~~*/
/begin COMPU_METHOD CompuMethod_1 "" RAT_FUNC "%3.0" "" COEFFS 0 1 0 0 0 1 /end COMPU_METHOD
/begin COMPU_METHOD CompuMethod_2 "" RAT_FUNC "%6.2" "" COEFFS 0 1 0 0 0 1 /end COMPU_METHOD
/begin COMPU_METHOD CompuMethod_5 "" RAT_FUNC "%5.0" "" COEFFS 0 1 0 0 0 1 /end COMPU_METHOD
/begin COMPU_METHOD CompuMethod_6 "" RAT_FUNC "%8.0" "" COEFFS 0 1 0 0 0 1 /end COMPU_METHOD
/begin COMPU_METHOD CompuMethod_7 "" TAB_VERB "%1.0" "" COMPU_TAB_REF CompuVtab_2 /end COMPU_METHOD
/begin COMPU_METHOD CompuMethod_11 "" RAT_FUNC "%1.0" "" COEFFS 0 1 0 0 0 1 /end COMPU_METHOD
/begin COMPU_METHOD CompuMethod_12 "" TAB_VERB "%5.0" "" COMPU_TAB_REF CompuVtab_3 /end COMPU_METHOD
/begin COMPU_METHOD CompuMethod_475 "" RAT_FUNC "%6.2" "idx.frac" COEFFS 0 1 0 0 0 0.00195313 /end COMPU_METHOD
/begin COMPU_METHOD CompuMethod_481 "" TAB_VERB "%3.0" "" COMPU_TAB_REF CompuVtab_467 /end COMPU_METHOD
/begin COMPU_METHOD CompuMethod_482 "" TAB_VERB "%3.0" "" COMPU_TAB_REF CompuVtab_468 /end COMPU_METHOD
/begin COMPU_METHOD CompuMethod_483 "" TAB_VERB "%3.0" "" COMPU_TAB_REF CompuVtab_469 /end COMPU_METHOD
/begin COMPU_METHOD CompuMethod_484 "" TAB_VERB "%3.0" "" COMPU_TAB_REF CompuVtab_470 /end COMPU_METHOD
/begin COMPU_METHOD CompuMethod_485 "" RAT_FUNC "%6.2" "sec" COEFFS 0 1 0 0 0 1 /end COMPU_METHOD
/begin COMPU_METHOD CompuMethod_486 "" TAB_VERB "%6.2" "" COMPU_TAB_REF CompuVtab_471 /end COMPU_METHOD
/begin COMPU_METHOD CompuMethod_487 "" TAB_VERB "%6.2" "" COMPU_TAB_REF CompuVtab_472 /end COMPU_METHOD
/begin COMPU_METHOD CompuMethod_489 "" RAT_FUNC "%7.2" "%" COEFFS 0 1 0 0 0 0.0015259 /end COMPU_METHOD
/begin COMPU_METHOD CompuMethod_493 "" TAB_VERB "%1.0" "boolean" COMPU_TAB_REF CompuVtab_475 /end COMPU_METHOD
/begin COMPU_METHOD CompuMethod_494 "" TAB_VERB "%1.0" "" COMPU_TAB_REF CompuVtab_476 /end COMPU_METHOD
/begin COMPU_METHOD CompuMethod_495 "" TAB_VERB "%1.0" "" COMPU_TAB_REF CompuVtab_477 /end COMPU_METHOD
/begin COMPU_METHOD CompuMethod_496 "" RAT_FUNC "%6.5" "km" COEFFS 0 1 0 0 0 1 /end COMPU_METHOD
/begin COMPU_METHOD CompuMethod_499 "" TAB_VERB "%1.0" "" COMPU_TAB_REF CompuVtab_478 /end COMPU_METHOD
/begin COMPU_METHOD CompuMethod_502 "" TAB_VERB "%1.0" "" COMPU_TAB_REF CompuVtab_480 /end COMPU_METHOD
/begin COMPU_METHOD CompuMethod_503 "" TAB_VERB "%1.0" "" COMPU_TAB_REF CompuVtab_481 /end COMPU_METHOD
/begin COMPU_METHOD CompuMethod_504 "" RAT_FUNC "%6.2" "" COEFFS 0 1 0 0 0 0.05 /end COMPU_METHOD
/begin COMPU_METHOD CompuMethod_505 "" RAT_FUNC "%6.2" "ModifiedAmps" COEFFS 0 1 0 0 0 1 /end COMPU_METHOD
/begin COMPU_VTAB CompuVtab_2 "" TAB_VERB 2 0 "Pass-Through" 1 "Override" /end COMPU_VTAB
/begin COMPU_VTAB CompuVtab_3 "" TAB_VERB 41 0 "Normal Operation" 1 "Task Kernel API Usage" 2 "Bad Attribute Data" 3 "Operation timed out" 4 "Operation aborted" 5 "Access from an ISR" 6 "Illegal Handle" 7 "Out of free store memory" 8 "The supplied task information is not valid." 9 "Missing Attribute" 10 "Insufficient FW resource" 11 "TPU Mask incompatible with the eTPU" 12 "Resource Busy" 13 "Data Unavailable" 14 "Function Not Supported" 15 "Flash is not blank" 16 "Flash Prog Voltage Unavailable" 17 "Memory verify" 18 "Uncreated Resource access" 19 "Illegal address" 20 "Hardware overrun" 21 "Alignment" 22 "Hardware timeout" 23 "TPU Function not in mask" 24 "TPU coprocessor not succesfully opened" 25 "Required dependants were not located" 26 "SPI Bus Integrity check failed." 27 "Insufficient param ram for TPU primitive" 28 "Dependent ASIC not created" 29 "Resource Not Capable." 30 "Software overrun" 31 "A Write attempted failed but OK to continue" 32 "Heap free-list distroyed; found while allocating" 33 "Heap freeing already freed or distroyed block" 34 "Heap freeing block outside of pool" 35 "Heap free list crashed; found while reallocating" 36 "An operation to the host operating system failed" 37 "Data Alignment" 38 "Attempt to create resource that is already created" 39 "Attempt to attach an ISR handler that is in use" 40 "Attempt to attach an ISR IRQ that is out of range" /end COMPU_VTAB
/begin COMPU_VTAB CompuVtab_467 "" TAB_VERB 6 0 "Disabled" 1 "Enabled" 2 "Sticky" 3 "Enabled - Persistent" 4 "Sticky - Persistent" 5 "Save Occurred" /end COMPU_VTAB
/begin COMPU_VTAB CompuVtab_468 "" TAB_VERB 2 0 "-" 1 "Test" /end COMPU_VTAB
/begin COMPU_VTAB CompuVtab_469 "" TAB_VERB 17 0 "Batt_Light" 1 "Batt_Shutdown" 2 "Cell_Voltage_Max" 3 "Check_Engine_Light" 4 "Check_Engine_Light_Flashing" 5 "Cooling_Max" 6 "Cruise" 7 "Dyno_Shutdown" 8 "EatonChargerFault" 9 "HV_Light" 10 "Pump_On" 11 "Regen_Brakes_Disabled" 12 "Set_Crawl_Home" 13 "Temperature_Flash" 14 "Temperature_Solid" 15 "Wrench_Light" 16 "(None)" /end COMPU_VTAB
/begin COMPU_VTAB CompuVtab_470 "" TAB_VERB 8 0 "(None)" 1 "Suspected" 2 "Active" 3 "Suspected or Active" 4 "Occurred" 5 "Suspected or Occurred" 6 "Active or Occurred" 7 "Suspected or Active or Occurred" /end COMPU_VTAB
/begin COMPU_VTAB CompuVtab_471 "" TAB_VERB 6 0 "SYS_TIME" 1 "Voltage" 2 "Speed" 3 "Torque_Request" 4 "Torque_Delivered" 5 "Coolant_Temp" /end COMPU_VTAB
/begin COMPU_VTAB CompuVtab_472 "" TAB_VERB 2 0 "_" 1 "_" /end COMPU_VTAB
/begin COMPU_VTAB CompuVtab_475 "" TAB_VERB 2 0 "Off" 1 "On" /end COMPU_VTAB
/begin COMPU_VTAB CompuVtab_476 "" TAB_VERB 2 0 "Load saved application values on next startup" 1 "Load factory defaults on next startup" /end COMPU_VTAB
/begin COMPU_VTAB CompuVtab_477 "" TAB_VERB 7 0 "Currently loading NV from Factory FLASH to RAM" 1 "Currently loading NV from EEPROM to RAM" 2 "Currently storing NV from RAM to EEPROM" 3 "Detected new program.  Loaded Factory Defaults from FLASH" 4 "CRC failure.  Loaded Factory Defaults from FLASH" 5 "User requested refresh from Factory Defaults in FLASH." 6 "Successful refresh of EEPROM values from last shutdown" /end COMPU_VTAB
/begin COMPU_VTAB CompuVtab_478 "" TAB_VERB 2 0 "Cold Powerup" 1 "Warm Powerup" /end COMPU_VTAB
/begin COMPU_VTAB CompuVtab_480 "" TAB_VERB 2 0 "Run" 1 "Restore To Defaults" /end COMPU_VTAB
/begin COMPU_VTAB CompuVtab_481 "" TAB_VERB 2 0 "Run" 1 "Store To EEPROM" /end COMPU_VTAB
/begin FUNCTION Faults_1 ""
 /begin DEF_CHARACTERISTIC FaultManager.Pedal_Position_Sensor_A_Circuit_Intermittent.Total_Samples__Y_ FaultManager.Pedal_Position_Sensor_A_Circuit_Intermittent.Action_1 FaultManager.Pedal_Position_Sensor_A_Circuit_Intermittent.Action_1_Condition FaultManager.Pedal_Position_Sensor_A_Circuit_Intermittent.Action_2 FaultManager.Pedal_Position_Sensor_A_Circuit_Intermittent.Action_2_Condition FaultManager.Pedal_Position_Sensor_A_Circuit_Intermittent.Action_3 FaultManager.Pedal_Position_Sensor_A_Circuit_Intermittent.Action_3_Condition FaultManager.Pedal_Position_Sensor_A_Circuit_Intermittent.Action_4 FaultManager.Pedal_Position_Sensor_A_Circuit_Intermittent.Action_4_Condition FaultManager.Pedal_Position_Sensor_A_Circuit_Low.Mode FaultManager.Pedal_Position_Sensor_A_Circuit_Low.ID FaultManager.Pedal_Position_Sensor_A_Circuit_Low.Test FaultManager.Pedal_Position_Sensor_A_Circuit_Low.Faulty_Samples__X_ FaultManager.Pedal_Position_Sensor_A_Circuit_Low.Total_Samples__Y_ FaultManager.Pedal_Position_Sensor_A_Circuit_Low.Action_1 FaultManager.Pedal_Position_Sensor_A_Circuit_Low.Action_1_Condition FaultManager.Pedal_Position_Sensor_A_Circuit_Low.Action_2 FaultManager.Pedal_Position_Sensor_A_Circuit_Low.Action_2_Condition FaultManager.Pedal_Position_Sensor_A_Circuit_Low.Action_3 FaultManager.Pedal_Position_Sensor_A_Circuit_Low.Action_3_Condition FaultManager.Pedal_Position_Sensor_A_Circuit_Low.Action_4 FaultManager.Pedal_Position_Sensor_A_Circuit_Low.Action_4_Condition FaultManager.Steering_Wheel_AgeCount.Mode FaultManager.Steering_Wheel_AgeCount.ID FaultManager.Steering_Wheel_AgeCount.Test FaultManager.Steering_Wheel_AgeCount.Faulty_Samples__X_ FaultManager.Steering_Wheel_AgeCount.Total_Samples__Y_ FaultManager.Steering_Wheel_AgeCount.Action_1 FaultManager.Steering_Wheel_AgeCount.Action_1_Condition FaultManager.Steering_Wheel_AgeCount.Action_2 FaultManager.Steering_Wheel_AgeCount.Action_2_Condition FaultManager.Steering_Wheel_AgeCount.Action_3 FaultManager.Steering_Wheel_AgeCount.Action_3_Condition FaultManager.Steering_Wheel_AgeCount.Action_4 FaultManager.Steering_Wheel_AgeCount.Action_4_Condition FaultManager.System_Voltage_High.Mode FaultManager.System_Voltage_High.ID FaultManager.System_Voltage_High.Test FaultManager.System_Voltage_High.Faulty_Samples__X_ FaultManager.System_Voltage_High.Total_Samples__Y_ FaultManager.System_Voltage_High.Action_1 FaultManager.System_Voltage_High.Action_1_Condition FaultManager.System_Voltage_High.Action_2 FaultManager.System_Voltage_High.Action_2_Condition FaultManager.System_Voltage_High.Action_3 FaultManager.System_Voltage_High.Action_3_Condition FaultManager.System_Voltage_High.Action_4 FaultManager.System_Voltage_High.Action_4_Condition FaultManager.System_Voltage_Low.Mode FaultManager.System_Voltage_Low.ID FaultManager.System_Voltage_Low.Test FaultManager.System_Voltage_Low.Faulty_Samples__X_ FaultManager.System_Voltage_Low.Total_Samples__Y_ FaultManager.System_Voltage_Low.Action_1 FaultManager.System_Voltage_Low.Action_1_Condition FaultManager.System_Voltage_Low.Action_2 FaultManager.System_Voltage_Low.Action_2_Condition FaultManager.System_Voltage_Low.Action_3 FaultManager.System_Voltage_Low.Action_3_Condition FaultManager.System_Voltage_Low.Action_4 FaultManager.System_Voltage_Low.Action_4_Condition FaultManager.System_Voltage_Malfunction.Mode FaultManager.System_Voltage_Malfunction.ID FaultManager.System_Voltage_Malfunction.Test FaultManager.System_Voltage_Malfunction.Faulty_Samples__X_ FaultManager.System_Voltage_Malfunction.Total_Samples__Y_ FaultManager.System_Voltage_Malfunction.Action_1 FaultManager.System_Voltage_Malfunction.Action_1_Condition FaultManager.System_Voltage_Malfunction.Action_2 FaultManager.System_Voltage_Malfunction.Action_2_Condition FaultManager.System_Voltage_Malfunction.Action_3 FaultManager.System_Voltage_Malfunction.Action_3_Condition FaultManager.System_Voltage_Malfunction.Action_4 FaultManager.System_Voltage_Malfunction.Action_4_Condition FaultManager.System_Voltage_Unstable.Mode FaultManager.System_Voltage_Unstable.ID FaultManager.System_Voltage_Unstable.Test FaultManager.System_Voltage_Unstable.Faulty_Samples__X_ FaultManager.System_Voltage_Unstable.Total_Samples__Y_ FaultManager.System_Voltage_Unstable.Action_1 FaultManager.System_Voltage_Unstable.Action_1_Condition FaultManager.System_Voltage_Unstable.Action_2 FaultManager.System_Voltage_Unstable.Action_2_Condition FaultManager.System_Voltage_Unstable.Action_3 FaultManager.System_Voltage_Unstable.Action_3_Condition FaultManager.System_Voltage_Unstable.Action_4 FaultManager.System_Voltage_Unstable.Action_4_Condition FaultManager.Traction_Control_General_Fault.Mode FaultManager.Traction_Control_General_Fault.ID FaultManager.Traction_Control_General_Fault.Test FaultManager.Traction_Control_General_Fault.Faulty_Samples__X_ FaultManager.Traction_Control_General_Fault.Total_Samples__Y_ FaultManager.Traction_Control_General_Fault.Action_1 FaultManager.Traction_Control_General_Fault.Action_1_Condition FaultManager.Traction_Control_General_Fault.Action_2 FaultManager.Traction_Control_General_Fault.Action_2_Condition FaultManager.Traction_Control_General_Fault.Action_3 FaultManager.Traction_Control_General_Fault.Action_3_Condition FaultManager.Traction_Control_General_Fault.Action_4 FaultManager.Traction_Control_General_Fault.Action_4_Condition FaultManager.Traction_Control_LeftFront_Malfunction.Mode FaultManager.Traction_Control_LeftFront_Malfunction.ID FaultManager.Traction_Control_LeftFront_Malfunction.Test FaultManager.Traction_Control_LeftFront_Malfunction.Faulty_Samples__X_ FaultManager.Traction_Control_LeftFront_Malfunction.Total_Samples__Y_ FaultManager.Traction_Control_LeftFront_Malfunction.Action_1 FaultManager.Traction_Control_LeftFront_Malfunction.Action_1_Condition FaultManager.Traction_Control_LeftFront_Malfunction.Action_2 FaultManager.Traction_Control_LeftFront_Malfunction.Action_2_Condition FaultManager.Traction_Control_LeftFront_Malfunction.Action_3 FaultManager.Traction_Control_LeftFront_Malfunction.Action_3_Condition FaultManager.Traction_Control_LeftFront_Malfunction.Action_4 FaultManager.Traction_Control_LeftFront_Malfunction.Action_4_Condition FaultManager.Traction_Control_LeftRear_Malfunction.Mode FaultManager.Traction_Control_LeftRear_Malfunction.ID FaultManager.Traction_Control_LeftRear_Malfunction.Test FaultManager.Traction_Control_LeftRear_Malfunction.Faulty_Samples__X_ FaultManager.Traction_Control_LeftRear_Malfunction.Total_Samples__Y_ FaultManager.Traction_Control_LeftRear_Malfunction.Action_1 FaultManager.Traction_Control_LeftRear_Malfunction.Action_1_Condition FaultManager.Traction_Control_LeftRear_Malfunction.Action_2 FaultManager.Traction_Control_LeftRear_Malfunction.Action_2_Condition FaultManager.Traction_Control_LeftRear_Malfunction.Action_3 FaultManager.Traction_Control_LeftRear_Malfunction.Action_3_Condition FaultManager.Traction_Control_LeftRear_Malfunction.Action_4 FaultManager.Traction_Control_LeftRear_Malfunction.Action_4_Condition FaultManager.Traction_Control_RightFront_Malfunction.Mode FaultManager.Traction_Control_RightFront_Malfunction.ID FaultManager.Traction_Control_RightFront_Malfunction.Test FaultManager.Traction_Control_RightFront_Malfunction.Faulty_Samples__X_ FaultManager.Traction_Control_RightFront_Malfunction.Total_Samples__Y_ FaultManager.Traction_Control_RightFront_Malfunction.Action_1 FaultManager.Traction_Control_RightFront_Malfunction.Action_1_Condition FaultManager.Traction_Control_RightFront_Malfunction.Action_2 FaultManager.Traction_Control_RightFront_Malfunction.Action_2_Condition FaultManager.Traction_Control_RightFront_Malfunction.Action_3 FaultManager.Traction_Control_RightFront_Malfunction.Action_3_Condition FaultManager.Traction_Control_RightFront_Malfunction.Action_4 FaultManager.Traction_Control_RightFront_Malfunction.Action_4_Condition FaultManager.Traction_Control_RightRear_Malfunction.Mode FaultManager.Traction_Control_RightRear_Malfunction.ID FaultManager.Traction_Control_RightRear_Malfunction.Test FaultManager.Traction_Control_RightRear_Malfunction.Faulty_Samples__X_ FaultManager.Traction_Control_RightRear_Malfunction.Total_Samples__Y_ FaultManager.Traction_Control_RightRear_Malfunction.Action_1 FaultManager.Traction_Control_RightRear_Malfunction.Action_1_Condition FaultManager.Traction_Control_RightRear_Malfunction.Action_2 FaultManager.Traction_Control_RightRear_Malfunction.Action_2_Condition FaultManager.Traction_Control_RightRear_Malfunction.Action_3 FaultManager.Traction_Control_RightRear_Malfunction.Action_3_Condition FaultManager.Traction_Control_RightRear_Malfunction.Action_4 FaultManager.Traction_Control_RightRear_Malfunction.Action_4_Condition FaultManager.Transmission_AgeCount.Mode FaultManager.Transmission_AgeCount.ID FaultManager.Transmission_AgeCount.Test FaultManager.Transmission_AgeCount.Faulty_Samples__X_ FaultManager.Transmission_AgeCount.Total_Samples__Y_ FaultManager.Transmission_AgeCount.Action_1 FaultManager.Transmission_AgeCount.Action_1_Condition FaultManager.Transmission_AgeCount.Action_2 FaultManager.Transmission_AgeCount.Action_2_Condition FaultManager.Transmission_AgeCount.Action_3 FaultManager.Transmission_AgeCount.Action_3_Condition FaultManager.Transmission_AgeCount.Action_4 FaultManager.Transmission_AgeCount.Action_4_Condition FaultManager.Vehcile_Speed_Sensor_Malfunction.Mode FaultManager.Vehcile_Speed_Sensor_Malfunction.ID FaultManager.Vehcile_Speed_Sensor_Malfunction.Test FaultManager.Vehcile_Speed_Sensor_Malfunction.Faulty_Samples__X_ FaultManager.Vehcile_Speed_Sensor_Malfunction.Total_Samples__Y_ FaultManager.Vehcile_Speed_Sensor_Malfunction.Action_1 FaultManager.Vehcile_Speed_Sensor_Malfunction.Action_1_Condition FaultManager.Vehcile_Speed_Sensor_Malfunction.Action_2 FaultManager.Vehcile_Speed_Sensor_Malfunction.Action_2_Condition FaultManager.Vehcile_Speed_Sensor_Malfunction.Action_3 FaultManager.Vehcile_Speed_Sensor_Malfunction.Action_3_Condition FaultManager.Vehcile_Speed_Sensor_Malfunction.Action_4 FaultManager.Vehcile_Speed_Sensor_Malfunction.Action_4_Condition FaultManager.Vehicle_Speed_Sensor_Circuit_Low.Mode FaultManager.Vehicle_Speed_Sensor_Circuit_Low.ID FaultManager.Vehicle_Speed_Sensor_Circuit_Low.Test FaultManager.Vehicle_Speed_Sensor_Circuit_Low.Faulty_Samples__X_ FaultManager.Vehicle_Speed_Sensor_Circuit_Low.Total_Samples__Y_ FaultManager.Vehicle_Speed_Sensor_Circuit_Low.Action_1 FaultManager.Vehicle_Speed_Sensor_Circuit_Low.Action_1_Condition FaultManager.Vehicle_Speed_Sensor_Circuit_Low.Action_2 FaultManager.Vehicle_Speed_Sensor_Circuit_Low.Action_2_Condition FaultManager.Vehicle_Speed_Sensor_Circuit_Low.Action_3 FaultManager.Vehicle_Speed_Sensor_Circuit_Low.Action_3_Condition FaultManager.Vehicle_Speed_Sensor_Circuit_Low.Action_4 FaultManager.Vehicle_Speed_Sensor_Circuit_Low.Action_4_Condition FaultManager.Vehicle_Speed_Sensor_Erratic.Mode FaultManager.Vehicle_Speed_Sensor_Erratic.ID FaultManager.Vehicle_Speed_Sensor_Erratic.Test FaultManager.Vehicle_Speed_Sensor_Erratic.Faulty_Samples__X_ FaultManager.Vehicle_Speed_Sensor_Erratic.Total_Samples__Y_ FaultManager.Vehicle_Speed_Sensor_Erratic.Action_1 FaultManager.Vehicle_Speed_Sensor_Erratic.Action_1_Condition FaultManager.Vehicle_Speed_Sensor_Erratic.Action_2 FaultManager.Vehicle_Speed_Sensor_Erratic.Action_2_Condition FaultManager.Vehicle_Speed_Sensor_Erratic.Action_3 FaultManager.Vehicle_Speed_Sensor_Erratic.Action_3_Condition FaultManager.Vehicle_Speed_Sensor_Erratic.Action_4 FaultManager.Vehicle_Speed_Sensor_Erratic.Action_4_Condition FaultManager.Vehicle_Speed_Sensor_Rang_Performance.Mode FaultManager.Vehicle_Speed_Sensor_Rang_Performance.ID FaultManager.Vehicle_Speed_Sensor_Rang_Performance.Test FaultManager.Vehicle_Speed_Sensor_Rang_Performance.Faulty_Samples__X_ FaultManager.Vehicle_Speed_Sensor_Rang_Performance.Total_Samples__Y_ FaultManager.Vehicle_Speed_Sensor_Rang_Performance.Action_1 FaultManager.Vehicle_Speed_Sensor_Rang_Performance.Action_1_Condition FaultManager.Vehicle_Speed_Sensor_Rang_Performance.Action_2 FaultManager.Vehicle_Speed_Sensor_Rang_Performance.Action_2_Condition FaultManager.Vehicle_Speed_Sensor_Rang_Performance.Action_3 FaultManager.Vehicle_Speed_Sensor_Rang_Performance.Action_3_Condition FaultManager.Vehicle_Speed_Sensor_Rang_Performance.Action_4 FaultManager.Vehicle_Speed_Sensor_Rang_Performance.Action_4_Condition /end DEF_CHARACTERISTIC
/end FUNCTION
/begin FUNCTION Freeze_Frame "" /begin DEF_CHARACTERISTIC Freeze_Frame /end DEF_CHARACTERISTIC /end FUNCTION
/begin FUNCTION Front_left_whl_speed_Ovr_Override "" /begin DEF_CHARACTERISTIC Front_left_whl_speed_Ovr_new Front_left_whl_speed_Ovr_ovr /end DEF_CHARACTERISTIC /end FUNCTION
/begin FUNCTION Front_right_whl_speed_Ovr_Override ""
 /begin DEF_CHARACTERISTIC Front_right_whl_speed_Ovr_new Front_right_whl_speed_Ovr_ovr /end DEF_CHARACTERISTIC
/end FUNCTION
/begin FUNCTION Gen_Enable_Ovr_Override "" /begin DEF_CHARACTERISTIC Gen_Enable_Ovr_new Gen_Enable_Ovr_ovr /end DEF_CHARACTERISTIC /end FUNCTION
/begin FUNCTION Engine_Outputs "" /begin DEF_CHARACTERISTIC RPM_to_Wheel_Speed_Multiplier3 /end DEF_CHARACTERISTIC
 /begin OUT_MEASUREMENT Gen_Enable_Prb Gen_Load_Prb Load_RPM_Prb Load_Throttle_Prb Vehicle_Speed2_Prb /end OUT_MEASUREMENT
 /begin SUB_FUNCTION Gen_Enable_Ovr_Override Gen_Load_Ovr_Override Load_RPM_Ovr_Override Load_Throttle_Ovr_Override Vehicle_Speed2_Ovr_Override /end SUB_FUNCTION
/end FUNCTION
/begin FUNCTION Gen_Load_Ovr_Override "" /begin DEF_CHARACTERISTIC Gen_Load_Ovr_new Gen_Load_Ovr_ovr /end DEF_CHARACTERISTIC /end FUNCTION
/begin FUNCTION Genset_Enable_Ovr_Override "" /begin DEF_CHARACTERISTIC Genset_Enable_Ovr_new Genset_Enable_Ovr_ovr /end DEF_CHARACTERISTIC /end FUNCTION
/begin FUNCTION Genset_Load_Ovr_Override "" /begin DEF_CHARACTERISTIC Genset_Load_Ovr_new Genset_Load_Ovr_ovr /end DEF_CHARACTERISTIC /end FUNCTION
/begin FUNCTION Genset_RPM_Ovr_Override "" /begin DEF_CHARACTERISTIC Genset_RPM_Ovr_new Genset_RPM_Ovr_ovr /end DEF_CHARACTERISTIC /end FUNCTION
/begin FUNCTION Genset_Throttle_Ovr_Override "" /begin DEF_CHARACTERISTIC Genset_Throttle_Ovr_new Genset_Throttle_Ovr_ovr /end DEF_CHARACTERISTIC /end FUNCTION
/begin FUNCTION GPSQuality_Ovr_Override "" /begin DEF_CHARACTERISTIC GPSQuality_Ovr_new GPSQuality_Ovr_ovr /end DEF_CHARACTERISTIC /end FUNCTION
/begin FUNCTION Heading_Ovr_Override "" /begin DEF_CHARACTERISTIC Heading_Ovr_new Heading_Ovr_ovr /end DEF_CHARACTERISTIC /end FUNCTION
/begin FUNCTION Heat_1_Ovr_Override "" /begin DEF_CHARACTERISTIC Heat_1_Ovr_new Heat_1_Ovr_ovr /end DEF_CHARACTERISTIC /end FUNCTION
/begin FUNCTION Heat_2_Ovr_Override "" /begin DEF_CHARACTERISTIC Heat_2_Ovr_new Heat_2_Ovr_ovr /end DEF_CHARACTERISTIC /end FUNCTION
/begin FUNCTION Heat_3_Ovr_Override "" /begin DEF_CHARACTERISTIC Heat_3_Ovr_new Heat_3_Ovr_ovr /end DEF_CHARACTERISTIC /end FUNCTION
/begin FUNCTION Heat_4_Ovr_Override "" /begin DEF_CHARACTERISTIC Heat_4_Ovr_new Heat_4_Ovr_ovr /end DEF_CHARACTERISTIC /end FUNCTION
/begin FUNCTION Heat1_Ovr_Override "" /begin DEF_CHARACTERISTIC Heat1_Ovr_new Heat1_Ovr_ovr /end DEF_CHARACTERISTIC /end FUNCTION
/begin FUNCTION Heat2_Ovr_Override "" /begin DEF_CHARACTERISTIC Heat2_Ovr_new Heat2_Ovr_ovr /end DEF_CHARACTERISTIC /end FUNCTION
/begin FUNCTION Heat3_Ovr_Override "" /begin DEF_CHARACTERISTIC Heat3_Ovr_new Heat3_Ovr_ovr /end DEF_CHARACTERISTIC /end FUNCTION
/begin FUNCTION Heat4_Ovr_Override "" /begin DEF_CHARACTERISTIC Heat4_Ovr_new Heat4_Ovr_ovr /end DEF_CHARACTERISTIC /end FUNCTION
/begin FUNCTION Heater_Core_Blend_Ovr_Override "" /begin DEF_CHARACTERISTIC Heater_Core_Blend_Ovr_new Heater_Core_Blend_Ovr_ovr /end DEF_CHARACTERISTIC /end FUNCTION
/begin FUNCTION Heater_Core_Blend_Valve_Ovr_Override ""
 /begin DEF_CHARACTERISTIC Heater_Core_Blend_Valve_Ovr_new Heater_Core_Blend_Valve_Ovr_ovr /end DEF_CHARACTERISTIC
/end FUNCTION
/begin FUNCTION Coolant "" /begin DEF_CHARACTERISTIC HtrCoreLowPass RadLowPass /end DEF_CHARACTERISTIC
 /begin OUT_MEASUREMENT Heater_Core_Blend_Valve_Probe Heater_Temp_Probe Heater_Temp_Raw_Probe Radiator_Blend_Valve_Probe /end OUT_MEASUREMENT
 /begin SUB_FUNCTION Heater_Core_Blend_Valve_Ovr_Override Heater_Temp_Raw_Ovr_Override Radiator_Blend_Valve_Ovr_Override /end SUB_FUNCTION
/end FUNCTION
/begin FUNCTION Heater_Core_Motor_Direction_Ovr_Override ""
 /begin DEF_CHARACTERISTIC Heater_Core_Motor_Direction_Ovr_new Heater_Core_Motor_Direction_Ovr_ovr /end DEF_CHARACTERISTIC
/end FUNCTION
/begin FUNCTION Heater_Core_Motor_Enable_Ovr_Override ""
 /begin DEF_CHARACTERISTIC Heater_Core_Motor_Enable_Ovr_new Heater_Core_Motor_Enable_Ovr_ovr /end DEF_CHARACTERISTIC
/end FUNCTION
/begin FUNCTION Heater_Core_Pos_Request_Ovr_Override ""
 /begin DEF_CHARACTERISTIC Heater_Core_Pos_Request_Ovr_new Heater_Core_Pos_Request_Ovr_ovr /end DEF_CHARACTERISTIC
/end FUNCTION
/begin FUNCTION Heater_Core_Pump_Ovr_Override "" /begin DEF_CHARACTERISTIC Heater_Core_Pump_Ovr_new Heater_Core_Pump_Ovr_ovr /end DEF_CHARACTERISTIC /end FUNCTION
/begin FUNCTION Heater_Temp_Raw_Ovr_Override "" /begin DEF_CHARACTERISTIC Heater_Temp_Raw_Ovr_new Heater_Temp_Raw_Ovr_ovr /end DEF_CHARACTERISTIC /end FUNCTION
/begin FUNCTION _2G_BMS___Comms ""
 /begin DEF_CHARACTERISTIC HV_Battery_2G_BMS_Fault HV_Battery_48_Controller_Communication_Fault HV_Battery_Above_Safe_Charge_Point HV_Battery_Cell_Balancing_Required_Fault HV_Battery_Too_Low_For_Load_Fault HV_Battery_Try_To_Balance_Under_Load_Fault /end DEF_CHARACTERISTIC
/end FUNCTION
/begin FUNCTION Battery_1 "" /begin SUB_FUNCTION _2G_BMS___Comms Temperature Precharge /end SUB_FUNCTION /end FUNCTION
/begin FUNCTION Temperature ""
 /begin DEF_CHARACTERISTIC HV_Battery_Pack_Above_Operating_Temperature_Fault HV_Battery_Pack_Below_Operating_Temperature_Fault HV_Battery_Pack_High_Temperature_Fault_High HV_Battery_Pack_High_Temperature_Fault_Low HV_Battery_Pack_Low_Temperature_Fault_High HV_Battery_Pack_Low_Temperature_Fault_Low /end DEF_CHARACTERISTIC
/end FUNCTION
/begin FUNCTION Precharge "" /begin DEF_CHARACTERISTIC HV_Battery_Precharge_Failure_Fault /end DEF_CHARACTERISTIC /end FUNCTION
/begin FUNCTION HV_Elec_Sys_Wrn_Ovr_Override "" /begin DEF_CHARACTERISTIC HV_Elec_Sys_Wrn_Ovr_new HV_Elec_Sys_Wrn_Ovr_ovr /end DEF_CHARACTERISTIC /end FUNCTION
/begin FUNCTION HV_Heater_System ""
 /begin DEF_CHARACTERISTIC HV_Heater_Over_Temperature_Fault HV_Heater_Temperature_Sensor_A_High_Voltage_Fault HV_Heater_Temperature_Sensor_A_Intermittent_Fault HV_Heater_Temperature_Sensor_A_Low_Voltage_Fault Temp_Fault_Hyst /end DEF_CHARACTERISTIC
/end FUNCTION
/begin FUNCTION HybridStateOverride_Override "" /begin DEF_CHARACTERISTIC HybridStateOverride_new HybridStateOverride_ovr /end DEF_CHARACTERISTIC /end FUNCTION
/begin FUNCTION Ignition_Status_Ovr_Override "" /begin DEF_CHARACTERISTIC Ignition_Status_Ovr_new Ignition_Status_Ovr_ovr /end DEF_CHARACTERISTIC /end FUNCTION
/begin FUNCTION Input_Current_Limit_Max_Ovr_Override ""
 /begin DEF_CHARACTERISTIC Input_Current_Limit_Max_Ovr_new Input_Current_Limit_Max_Ovr_ovr /end DEF_CHARACTERISTIC
/end FUNCTION
/begin FUNCTION Input_Current_Ovr_Override "" /begin DEF_CHARACTERISTIC Input_Current_Ovr_new Input_Current_Ovr_ovr /end DEF_CHARACTERISTIC /end FUNCTION
/begin FUNCTION Input_Voltage_Ovr_Override "" /begin DEF_CHARACTERISTIC Input_Voltage_Ovr_new Input_Voltage_Ovr_ovr /end DEF_CHARACTERISTIC /end FUNCTION
/begin FUNCTION InterlockEnable_Override_Override "" /begin DEF_CHARACTERISTIC InterlockEnable_Override_new InterlockEnable_Override_ovr /end DEF_CHARACTERISTIC /end FUNCTION
/begin FUNCTION Inv_Temp_Ovr_Override "" /begin DEF_CHARACTERISTIC Inv_Temp_Ovr_new Inv_Temp_Ovr_ovr /end DEF_CHARACTERISTIC /end FUNCTION
/begin FUNCTION IPT_Antishudder_Ovr_Override "" /begin DEF_CHARACTERISTIC IPT_Antishudder_Ovr_new IPT_Antishudder_Ovr_ovr /end DEF_CHARACTERISTIC /end FUNCTION
/begin FUNCTION IPT_Current_Limit_Ovr_Override "" /begin DEF_CHARACTERISTIC IPT_Current_Limit_Ovr_new IPT_Current_Limit_Ovr_ovr /end DEF_CHARACTERISTIC /end FUNCTION
/begin FUNCTION IPT_Current_Request_Ovr_Override "" /begin DEF_CHARACTERISTIC IPT_Current_Request_Ovr_new IPT_Current_Request_Ovr_ovr /end DEF_CHARACTERISTIC /end FUNCTION
/begin FUNCTION IPT_Current_Used_Ovr_Override "" /begin DEF_CHARACTERISTIC IPT_Current_Used_Ovr_new IPT_Current_Used_Ovr_ovr /end DEF_CHARACTERISTIC /end FUNCTION
/begin FUNCTION IPT_DC_Error_Category_Ovr_Override ""
 /begin DEF_CHARACTERISTIC IPT_DC_Error_Category_Ovr_new IPT_DC_Error_Category_Ovr_ovr /end DEF_CHARACTERISTIC
/end FUNCTION
/begin FUNCTION IPT_DCHV_Bus_Current_Ovr_Override "" /begin DEF_CHARACTERISTIC IPT_DCHV_Bus_Current_Ovr_new IPT_DCHV_Bus_Current_Ovr_ovr /end DEF_CHARACTERISTIC /end FUNCTION
/begin FUNCTION IPT_DCLV_Bus_Current_Ovr_Override "" /begin DEF_CHARACTERISTIC IPT_DCLV_Bus_Current_Ovr_new IPT_DCLV_Bus_Current_Ovr_ovr /end DEF_CHARACTERISTIC /end FUNCTION
/begin FUNCTION IPT_DCLV_Bus_Voltage_Ovr_Override "" /begin DEF_CHARACTERISTIC IPT_DCLV_Bus_Voltage_Ovr_new IPT_DCLV_Bus_Voltage_Ovr_ovr /end DEF_CHARACTERISTIC /end FUNCTION
/begin FUNCTION IPT_DCLV_General_Error_Ovr_Override ""
 /begin DEF_CHARACTERISTIC IPT_DCLV_General_Error_Ovr_new IPT_DCLV_General_Error_Ovr_ovr /end DEF_CHARACTERISTIC
/end FUNCTION
/begin FUNCTION IPT_DCLV_Max_Power_Ovr_Override "" /begin DEF_CHARACTERISTIC IPT_DCLV_Max_Power_Ovr_new IPT_DCLV_Max_Power_Ovr_ovr /end DEF_CHARACTERISTIC /end FUNCTION
/begin FUNCTION IPT_DCLV_On_Ovr_Override "" /begin DEF_CHARACTERISTIC IPT_DCLV_On_Ovr_new IPT_DCLV_On_Ovr_ovr /end DEF_CHARACTERISTIC /end FUNCTION
/begin FUNCTION IPT_Outputs ""
 /begin DEF_CHARACTERISTIC IPT_Duty_Cycle IPT_Frequency Motor_Startup_Delay VSC_ActiveDischargeDisable_Cal VSC_AntishudderDisable_Cal VSC_DCOutputVoltage_Cal VSC_MaxDCVoltage_Cal VSC_MinDCVoltage_Cal VSC_PowerWasteRequest_Cal VSC_SDPTActive_Cal /end DEF_CHARACTERISTIC
 /begin OUT_MEASUREMENT IPT_DutyCycle_probe IPT_Freq_probe VSC_ActiveDischargeDisable_Prb VSC_AntishudderDisable_Prb VSC_DCDCEnable_Prb VSC_DCOutputVoltageCmd_Prb VSC_IPTEnable_Prb VSC_IPTWakeup_Prb VSC_MaxCurrInputMotor_Prb VSC_MaxCurrOutputGen_Prb VSC_MaxDCVoltage_Prb VSC_MinDCVoltage_Prb VSC_MotorEnable_Prb VSC_PowerWasteRequest_Prb VSC_SDPTActive_Prb VSC_TRSPosition_Prb VSC_WheelTorqueRequest_Prb /end OUT_MEASUREMENT
 /begin SUB_FUNCTION IPT_DutyCycle_Ovr_Override IPT_Freq_Ovr_Override Max_InputCurrent Max_OutputCurrent VSC_ActiveDischargeDisable_Ovr_Override VSC_AntishudderDisable_Ovr_Override VSC_DCDCEnable_Ovr_Override VSC_DCOutputVoltageCmd_Ovr_Override VSC_IPTEnable_Ovr_Override VSC_IPTWakeup_Ovr_Override VSC_MaxCurrInputMotor_Ovr_Override VSC_MaxCurrOutputGen_Ovr_Override VSC_MaxDCVoltage_Ovr_Override VSC_MinDCVoltage_Ovr_Override VSC_MotorEnable_Ovr_Override VSC_PowerWasteRequest_Ovr_Override VSC_SDPTActive_Ovr_Override VSC_TRSPosition_Ovr_Override VSC_WheelTorqueRequest_Ovr_Override /end SUB_FUNCTION
/end FUNCTION
/begin FUNCTION IPT_DutyCycle_Ovr_Override "" /begin DEF_CHARACTERISTIC IPT_DutyCycle_Ovr_new IPT_DutyCycle_Ovr_ovr /end DEF_CHARACTERISTIC /end FUNCTION
/begin FUNCTION IPT_Error_Category_Ovr_Override "" /begin DEF_CHARACTERISTIC IPT_Error_Category_Ovr_new IPT_Error_Category_Ovr_ovr /end DEF_CHARACTERISTIC /end FUNCTION
/begin FUNCTION IPT_Freq_Ovr_Override "" /begin DEF_CHARACTERISTIC IPT_Freq_Ovr_new IPT_Freq_Ovr_ovr /end DEF_CHARACTERISTIC /end FUNCTION
/begin FUNCTION IPT_HVDC_Voltage_Ovr_Override "" /begin DEF_CHARACTERISTIC IPT_HVDC_Voltage_Ovr_new IPT_HVDC_Voltage_Ovr_ovr /end DEF_CHARACTERISTIC /end FUNCTION
/begin FUNCTION IPT_Inverter_Temperature_Ovr_Override ""
 /begin DEF_CHARACTERISTIC IPT_Inverter_Temperature_Ovr_new IPT_Inverter_Temperature_Ovr_ovr /end DEF_CHARACTERISTIC
/end FUNCTION
/begin FUNCTION IPT_IPTAwake_Ovr_Override "" /begin DEF_CHARACTERISTIC IPT_IPTAwake_Ovr_new IPT_IPTAwake_Ovr_ovr /end DEF_CHARACTERISTIC /end FUNCTION
/begin FUNCTION IPT_IPTReady_Ovr_Override "" /begin DEF_CHARACTERISTIC IPT_IPTReady_Ovr_new IPT_IPTReady_Ovr_ovr /end DEF_CHARACTERISTIC /end FUNCTION
/begin FUNCTION IPT_Max_Torque_Avail_Gen_Ovr_Override ""
 /begin DEF_CHARACTERISTIC IPT_Max_Torque_Avail_Gen_Ovr_new IPT_Max_Torque_Avail_Gen_Ovr_ovr /end DEF_CHARACTERISTIC
/end FUNCTION
/begin FUNCTION IPT_Max_Torque_Avail_Motor_Ovr_Override ""
 /begin DEF_CHARACTERISTIC IPT_Max_Torque_Avail_Motor_Ovr_new IPT_Max_Torque_Avail_Motor_Ovr_ovr /end DEF_CHARACTERISTIC
/end FUNCTION
/begin FUNCTION IPT_Max_Waste_Available_Ovr_Override ""
 /begin DEF_CHARACTERISTIC IPT_Max_Waste_Available_Ovr_new IPT_Max_Waste_Available_Ovr_ovr /end DEF_CHARACTERISTIC
/end FUNCTION
/begin FUNCTION IPT_Motor_Ready_Ovr_Override "" /begin DEF_CHARACTERISTIC IPT_Motor_Ready_Ovr_new IPT_Motor_Ready_Ovr_ovr /end DEF_CHARACTERISTIC /end FUNCTION
/begin FUNCTION IPT_Motor_Speed_Ovr_Override "" /begin DEF_CHARACTERISTIC IPT_Motor_Speed_Ovr_new IPT_Motor_Speed_Ovr_ovr /end DEF_CHARACTERISTIC /end FUNCTION
/begin FUNCTION IPT_Motor_Temperature_Ovr_Override ""
 /begin DEF_CHARACTERISTIC IPT_Motor_Temperature_Ovr_new IPT_Motor_Temperature_Ovr_ovr /end DEF_CHARACTERISTIC
/end FUNCTION
/begin FUNCTION IPT_Wheel_Torque_Delivered_Ovr_Override ""
 /begin DEF_CHARACTERISTIC IPT_Wheel_Torque_Delivered_Ovr_new IPT_Wheel_Torque_Delivered_Ovr_ovr /end DEF_CHARACTERISTIC
/end FUNCTION
/begin FUNCTION Isolation_Measure_Enable_ovr_Override ""
 /begin DEF_CHARACTERISTIC Isolation_Measure_Enable_ovr_new Isolation_Measure_Enable_ovr_ovr /end DEF_CHARACTERISTIC
/end FUNCTION
/begin FUNCTION ISR ""
 /begin OUT_MEASUREMENT ISR_ADCCPU ISR_CANCPU ISR_DecrementorCPU ISR_DMACPU ISR_EMIOSCPU ISR_SCICPU ISR_TPUCPU /end OUT_MEASUREMENT
/end FUNCTION
/begin FUNCTION Ignition_Key "" /begin DEF_CHARACTERISTIC Key_Line_Voltage_Fault Key_Off_Coltage_High_Fault /end DEF_CHARACTERISTIC /end FUNCTION
/begin FUNCTION LF_Wheel_Rolling_Count_Ovr_Override ""
 /begin DEF_CHARACTERISTIC LF_Wheel_Rolling_Count_Ovr_new LF_Wheel_Rolling_Count_Ovr_ovr /end DEF_CHARACTERISTIC
/end FUNCTION
/begin FUNCTION Load_On_Ovr_Override "" /begin DEF_CHARACTERISTIC Load_On_Ovr_new Load_On_Ovr_ovr /end DEF_CHARACTERISTIC /end FUNCTION
/begin FUNCTION Load_RPM_Ovr_Override "" /begin DEF_CHARACTERISTIC Load_RPM_Ovr_new Load_RPM_Ovr_ovr /end DEF_CHARACTERISTIC /end FUNCTION
/begin FUNCTION Load_Throttle_Ovr_Override "" /begin DEF_CHARACTERISTIC Load_Throttle_Ovr_new Load_Throttle_Ovr_ovr /end DEF_CHARACTERISTIC /end FUNCTION
/begin FUNCTION Memory_1 "" /begin DEF_CHARACTERISTIC LoadCalibrationError SaveCalibrationError /end DEF_CHARACTERISTIC /end FUNCTION
/begin FUNCTION Charger_Param "" /begin DEF_CHARACTERISTIC MaxAmpCal MaxVoltageCal /end DEF_CHARACTERISTIC /end FUNCTION
/begin FUNCTION Me_Cool_Temp_Ovr_Override "" /begin DEF_CHARACTERISTIC Me_Cool_Temp_Ovr_new Me_Cool_Temp_Ovr_ovr /end DEF_CHARACTERISTIC /end FUNCTION
/begin FUNCTION Mode_1_Ovr_Override "" /begin DEF_CHARACTERISTIC Mode_1_Ovr_new Mode_1_Ovr_ovr /end DEF_CHARACTERISTIC /end FUNCTION
/begin FUNCTION Mode_2_Ovr_Override "" /begin DEF_CHARACTERISTIC Mode_2_Ovr_new Mode_2_Ovr_ovr /end DEF_CHARACTERISTIC /end FUNCTION
/begin FUNCTION Mode_3_Ovr_Override "" /begin DEF_CHARACTERISTIC Mode_3_Ovr_new Mode_3_Ovr_ovr /end DEF_CHARACTERISTIC /end FUNCTION
/begin FUNCTION Mode_4_Ovr_Override "" /begin DEF_CHARACTERISTIC Mode_4_Ovr_new Mode_4_Ovr_ovr /end DEF_CHARACTERISTIC /end FUNCTION
/begin FUNCTION CurrentLimiting_TurboRequest "" /begin DEF_CHARACTERISTIC Overcurrent_Tq_Lim_Filter TorqueLimMultiplierTbl /end DEF_CHARACTERISTIC
 /begin OUT_MEASUREMENT ModifiedAmpSecIdx ModifiedAmpSecIn Overcurrent_Torque_Derate_prb overcurrentintegral_prb TorqueLimMultiplier /end OUT_MEASUREMENT
 /begin SUB_FUNCTION OvercurrentIntegralGenerator /end SUB_FUNCTION
/end FUNCTION
/begin FUNCTION Vehicle_Speed_Sensor ""
 /begin DEF_CHARACTERISTIC Motor_Speed_High_Fault Motor_Speed_Low_Fault Motor_Speed_Torque_Fault Motor_Speed_TorqueRPM_Fault Vehicle_Speed_Sensor_Circuit_Low_Fault /end DEF_CHARACTERISTIC
/end FUNCTION
/begin FUNCTION MPRD_Override "" /begin DEF_CHARACTERISTIC MPRD_new MPRD_ovr /end DEF_CHARACTERISTIC /end FUNCTION
/begin FUNCTION NonVolatile_Storage "" /begin DEF_CHARACTERISTIC RestoreNVFactoryDefaults StoreNV /end DEF_CHARACTERISTIC /begin OUT_MEASUREMENT NonVolatileCRC NonVolatileFormatID NonVolatileStatus /end OUT_MEASUREMENT /begin SUB_FUNCTION NonVolatile_Storage_Config /end SUB_FUNCTION /end FUNCTION
/begin FUNCTION NonVolatile_Storage_Config ""
 /begin DEF_CHARACTERISTIC NonVolatileRestoreOnFirstStartup NonVolatileRestoreOnStartup /end DEF_CHARACTERISTIC
/end FUNCTION
/begin FUNCTION ODO_Count_Ovr_Override "" /begin DEF_CHARACTERISTIC ODO_Count_Ovr_new ODO_Count_Ovr_ovr /end DEF_CHARACTERISTIC /end FUNCTION
/begin FUNCTION Oil_Pressure_Ovr_Override "" /begin DEF_CHARACTERISTIC Oil_Pressure_Ovr_new Oil_Pressure_Ovr_ovr /end DEF_CHARACTERISTIC /end FUNCTION
/begin FUNCTION Output_Current_Ovr_Override "" /begin DEF_CHARACTERISTIC Output_Current_Ovr_new Output_Current_Ovr_ovr /end DEF_CHARACTERISTIC /end FUNCTION
/begin FUNCTION Output_Voltage_Ovr_Override "" /begin DEF_CHARACTERISTIC Output_Voltage_Ovr_new Output_Voltage_Ovr_ovr /end DEF_CHARACTERISTIC /end FUNCTION
/begin FUNCTION Pack_State_ovr_Override "" /begin DEF_CHARACTERISTIC Pack_State_ovr_new Pack_State_ovr_ovr /end DEF_CHARACTERISTIC /end FUNCTION
/begin FUNCTION Passenger_1_Ovr_Override "" /begin DEF_CHARACTERISTIC Passenger_1_Ovr_new Passenger_1_Ovr_ovr /end DEF_CHARACTERISTIC /end FUNCTION
/begin FUNCTION Passenger_10_Ovr_Override "" /begin DEF_CHARACTERISTIC Passenger_10_Ovr_new Passenger_10_Ovr_ovr /end DEF_CHARACTERISTIC /end FUNCTION
/begin FUNCTION Passenger_Temp_Ovr_Override "" /begin DEF_CHARACTERISTIC Passenger_Temp_Ovr_new Passenger_Temp_Ovr_ovr /end DEF_CHARACTERISTIC /end FUNCTION
/begin FUNCTION Pct_whl_trq_desired_ovr_Override "" /begin DEF_CHARACTERISTIC Pct_whl_trq_desired_ovr_new Pct_whl_trq_desired_ovr_ovr /end DEF_CHARACTERISTIC /end FUNCTION
/begin FUNCTION Gas_Pedal ""
 /begin DEF_CHARACTERISTIC Pedal_Poition_Sensor_A_Intermittent Pedal_Position_Sensor_A_Circuit_High Pedal_Position_Sensor_A_Circuit_Low /end DEF_CHARACTERISTIC
/end FUNCTION
/begin FUNCTION Power_train_torq_actual_ovr_Override ""
 /begin DEF_CHARACTERISTIC Power_train_torq_actual_ovr_new Power_train_torq_actual_ovr_ovr /end DEF_CHARACTERISTIC
/end FUNCTION
/begin FUNCTION Status "" /begin OUT_MEASUREMENT PowerUpStatus /end OUT_MEASUREMENT /end FUNCTION
/begin FUNCTION prndl_dir_ovr_Override "" /begin DEF_CHARACTERISTIC prndl_dir_ovr_new prndl_dir_ovr_ovr /end DEF_CHARACTERISTIC /end FUNCTION
/begin FUNCTION PSCM_80_AgeCount_Ovr_Override "" /begin DEF_CHARACTERISTIC PSCM_80_AgeCount_Ovr_new PSCM_80_AgeCount_Ovr_ovr /end DEF_CHARACTERISTIC /end FUNCTION
/begin FUNCTION Steering_Wheel ""
 /begin OUT_MEASUREMENT PSCM_80_AgeCount_Prb RELATIVE_STR_WHL_ANGLE_Prb STR_WHL_ANGLE_CNTR_FND_Prb STR_WHL_ANGLE_Prb /end OUT_MEASUREMENT
 /begin SUB_FUNCTION PSCM_80_AgeCount_Ovr_Override RELATIVE_STR_WHL_ANGLE_Ovr_Override STR_WHL_ANGLE_CNTR_FND_Ovr_Override STR_WHL_ANGLE_Ovr_Override /end SUB_FUNCTION
/end FUNCTION
/begin FUNCTION Radiator_Blend_Ovr_Override "" /begin DEF_CHARACTERISTIC Radiator_Blend_Ovr_new Radiator_Blend_Ovr_ovr /end DEF_CHARACTERISTIC /end FUNCTION
/begin FUNCTION Radiator_Blend_Valve_Ovr_Override "" /begin DEF_CHARACTERISTIC Radiator_Blend_Valve_Ovr_new Radiator_Blend_Valve_Ovr_ovr /end DEF_CHARACTERISTIC /end FUNCTION
/begin FUNCTION Radiator_Fan_Ovr_Override "" /begin DEF_CHARACTERISTIC Radiator_Fan_Ovr_new Radiator_Fan_Ovr_ovr /end DEF_CHARACTERISTIC /end FUNCTION
/begin FUNCTION Radiator_Motor_Direction_Ovr_Override ""
 /begin DEF_CHARACTERISTIC Radiator_Motor_Direction_Ovr_new Radiator_Motor_Direction_Ovr_ovr /end DEF_CHARACTERISTIC
/end FUNCTION
/begin FUNCTION Radiator_Motor_Enable_Ovr_Override ""
 /begin DEF_CHARACTERISTIC Radiator_Motor_Enable_Ovr_new Radiator_Motor_Enable_Ovr_ovr /end DEF_CHARACTERISTIC
/end FUNCTION
/begin FUNCTION Radiator_Pos_Request_Ovr_Override "" /begin DEF_CHARACTERISTIC Radiator_Pos_Request_Ovr_new Radiator_Pos_Request_Ovr_ovr /end DEF_CHARACTERISTIC /end FUNCTION
/begin FUNCTION Radiator_Pump_Ovr_Override "" /begin DEF_CHARACTERISTIC Radiator_Pump_Ovr_new Radiator_Pump_Ovr_ovr /end DEF_CHARACTERISTIC /end FUNCTION
/begin FUNCTION Ready_Light_Ovr_Override "" /begin DEF_CHARACTERISTIC Ready_Light_Ovr_new Ready_Light_Ovr_ovr /end DEF_CHARACTERISTIC /end FUNCTION
/begin FUNCTION Rear_left_whl_speed_Ovr_Override "" /begin DEF_CHARACTERISTIC Rear_left_whl_speed_Ovr_new Rear_left_whl_speed_Ovr_ovr /end DEF_CHARACTERISTIC /end FUNCTION
/begin FUNCTION Rear_right_whl_speed_Ovr_Override "" /begin DEF_CHARACTERISTIC Rear_right_whl_speed_Ovr_new Rear_right_whl_speed_Ovr_ovr /end DEF_CHARACTERISTIC /end FUNCTION
/begin FUNCTION Regen_Brakes_Disabled_Ovr_Override ""
 /begin DEF_CHARACTERISTIC Regen_Brakes_Disabled_Ovr_new Regen_Brakes_Disabled_Ovr_ovr /end DEF_CHARACTERISTIC
/end FUNCTION
/begin FUNCTION regen_torq_limit_ovr_Override "" /begin DEF_CHARACTERISTIC regen_torq_limit_ovr_new regen_torq_limit_ovr_ovr /end DEF_CHARACTERISTIC /end FUNCTION
/begin FUNCTION RELATIVE_STR_WHL_ANGLE_Ovr_Override ""
 /begin DEF_CHARACTERISTIC RELATIVE_STR_WHL_ANGLE_Ovr_new RELATIVE_STR_WHL_ANGLE_Ovr_ovr /end DEF_CHARACTERISTIC
/end FUNCTION
/begin FUNCTION Repair_Wrench_Ovr_Override "" /begin DEF_CHARACTERISTIC Repair_Wrench_Ovr_new Repair_Wrench_Ovr_ovr /end DEF_CHARACTERISTIC /end FUNCTION
/begin FUNCTION RPM_Ovr_Override "" /begin DEF_CHARACTERISTIC RPM_Ovr_new RPM_Ovr_ovr /end DEF_CHARACTERISTIC /end FUNCTION
/begin FUNCTION RT_Wheel_Rolling_Count_Ovr_Override ""
 /begin DEF_CHARACTERISTIC RT_Wheel_Rolling_Count_Ovr_new RT_Wheel_Rolling_Count_Ovr_ovr /end DEF_CHARACTERISTIC
/end FUNCTION
/begin FUNCTION Max_InputCurrent "" /begin DEF_CHARACTERISTIC Saturated_Sensor_Discharge /end DEF_CHARACTERISTIC /end FUNCTION
/begin FUNCTION Max_OutputCurrent "" /begin DEF_CHARACTERISTIC Saturated_Sensor_Regen /end DEF_CHARACTERISTIC /end FUNCTION
/begin FUNCTION Shift_Position_Raw_Ovr_Override "" /begin DEF_CHARACTERISTIC Shift_Position_Raw_Ovr_new Shift_Position_Raw_Ovr_ovr /end DEF_CHARACTERISTIC /end FUNCTION
/begin FUNCTION Shutdown_ovr_Override "" /begin DEF_CHARACTERISTIC Shutdown_ovr_new Shutdown_ovr_ovr /end DEF_CHARACTERISTIC /end FUNCTION
/begin FUNCTION SOC_States "" /begin DEF_CHARACTERISTIC SOC_Critical SOC_High SOC_Low SOC_Time_Threshold /end DEF_CHARACTERISTIC /end FUNCTION
/begin FUNCTION SOC_Filter "" /begin DEF_CHARACTERISTIC SOCFilt /end DEF_CHARACTERISTIC /end FUNCTION
/begin FUNCTION Speed_Ovr_Override "" /begin DEF_CHARACTERISTIC Speed_Ovr_new Speed_Ovr_ovr /end DEF_CHARACTERISTIC /end FUNCTION
/begin FUNCTION STR_WHL_ANGLE_CNTR_FND_Ovr_Override ""
 /begin DEF_CHARACTERISTIC STR_WHL_ANGLE_CNTR_FND_Ovr_new STR_WHL_ANGLE_CNTR_FND_Ovr_ovr /end DEF_CHARACTERISTIC
/end FUNCTION
/begin FUNCTION STR_WHL_ANGLE_Ovr_Override "" /begin DEF_CHARACTERISTIC STR_WHL_ANGLE_Ovr_new STR_WHL_ANGLE_Ovr_ovr /end DEF_CHARACTERISTIC /end FUNCTION
/begin FUNCTION TCS_ENG_EVNT_IN_PROGRESS_Ovr_Override ""
 /begin DEF_CHARACTERISTIC TCS_ENG_EVNT_IN_PROGRESS_Ovr_new TCS_ENG_EVNT_IN_PROGRESS_Ovr_ovr /end DEF_CHARACTERISTIC
/end FUNCTION
/begin FUNCTION Enabled_Subsystem "" /begin DEF_CHARACTERISTIC Temp_Flash /end DEF_CHARACTERISTIC /end FUNCTION
/begin FUNCTION Temp_Guage_Ovr_Override "" /begin DEF_CHARACTERISTIC Temp_Guage_Ovr_new Temp_Guage_Ovr_ovr /end DEF_CHARACTERISTIC /end FUNCTION
/begin FUNCTION Throttle_Position_Ovr_Override "" /begin DEF_CHARACTERISTIC Throttle_Position_Ovr_new Throttle_Position_Ovr_ovr /end DEF_CHARACTERISTIC /end FUNCTION
/begin FUNCTION Throttle_Position "" /begin OUT_MEASUREMENT Throttle_Position_Prb /end OUT_MEASUREMENT /begin SUB_FUNCTION Throttle_Position_Ovr_Override /end SUB_FUNCTION /end FUNCTION
/begin FUNCTION Throttle_Position_Raw_Ovr_Override ""
 /begin DEF_CHARACTERISTIC Throttle_Position_Raw_Ovr_new Throttle_Position_Raw_Ovr_ovr /end DEF_CHARACTERISTIC
/end FUNCTION
/begin FUNCTION Torque_Request_Override_Override "" /begin DEF_CHARACTERISTIC Torque_Request_Override_new Torque_Request_Override_ovr /end DEF_CHARACTERISTIC /end FUNCTION
/begin FUNCTION Torque_Reverse_Override_Override "" /begin DEF_CHARACTERISTIC Torque_Reverse_Override_new Torque_Reverse_Override_ovr /end DEF_CHARACTERISTIC /end FUNCTION
/begin FUNCTION Drive "" /begin SUB_FUNCTION Torque_Reverse_Override_Override /end SUB_FUNCTION /end FUNCTION
/begin FUNCTION Torque_Reverse_Override69_Override ""
 /begin DEF_CHARACTERISTIC Torque_Reverse_Override69_new Torque_Reverse_Override69_ovr /end DEF_CHARACTERISTIC
/end FUNCTION
/begin FUNCTION Reverse "" /begin SUB_FUNCTION Torque_Reverse_Override69_Override /end SUB_FUNCTION /end FUNCTION
/begin FUNCTION CurrentModifier "" /begin DEF_CHARACTERISTIC TorqueRecoveryValue /end DEF_CHARACTERISTIC /end FUNCTION
/begin FUNCTION OvercurrentIntegralGenerator "" /begin SUB_FUNCTION CurrentModifier /end SUB_FUNCTION /end FUNCTION
/begin FUNCTION Traction_Control_1 ""
 /begin DEF_CHARACTERISTIC Traction_Control_System_Maulfunction_Fault Traction_Control_Vehicle_Moving /end DEF_CHARACTERISTIC
/end FUNCTION
/begin FUNCTION Transmission_AgeCount_Ovr_Override ""
 /begin DEF_CHARACTERISTIC Transmission_AgeCount_Ovr_new Transmission_AgeCount_Ovr_ovr /end DEF_CHARACTERISTIC
/end FUNCTION
/begin FUNCTION _12V_Battery "" /begin DEF_CHARACTERISTIC V12_Battery_Erratic_Fault V12_High V12_Low /end DEF_CHARACTERISTIC /end FUNCTION
/begin FUNCTION VEH_ID_Ovr_Override "" /begin DEF_CHARACTERISTIC VEH_ID_Ovr_new VEH_ID_Ovr_ovr /end DEF_CHARACTERISTIC /end FUNCTION
/begin FUNCTION Vehicle_Speed_States ""
 /begin DEF_CHARACTERISTIC Vehicle_Speed_Off Vehicle_Speed_On Vehicle_Speed_Time_Threshold /end DEF_CHARACTERISTIC
/end FUNCTION
/begin FUNCTION Vehicle_Speed_Ovr_Override "" /begin DEF_CHARACTERISTIC Vehicle_Speed_Ovr_new Vehicle_Speed_Ovr_ovr /end DEF_CHARACTERISTIC /end FUNCTION
/begin FUNCTION Vehicle_Speed2_Ovr_Override "" /begin DEF_CHARACTERISTIC Vehicle_Speed2_Ovr_new Vehicle_Speed2_Ovr_ovr /end DEF_CHARACTERISTIC /end FUNCTION
/begin FUNCTION Voltage_Filter "" /begin DEF_CHARACTERISTIC VFilt /end DEF_CHARACTERISTIC /end FUNCTION
/begin FUNCTION VIN_DATA_BYTE_1_Ovr_Override "" /begin DEF_CHARACTERISTIC VIN_DATA_BYTE_1_Ovr_new VIN_DATA_BYTE_1_Ovr_ovr /end DEF_CHARACTERISTIC /end FUNCTION
/begin FUNCTION VIN_DATA_BYTE_10_Ovr_Override "" /begin DEF_CHARACTERISTIC VIN_DATA_BYTE_10_Ovr_new VIN_DATA_BYTE_10_Ovr_ovr /end DEF_CHARACTERISTIC /end FUNCTION
/begin FUNCTION VIN_DATA_BYTE_11_Ovr_Override "" /begin DEF_CHARACTERISTIC VIN_DATA_BYTE_11_Ovr_new VIN_DATA_BYTE_11_Ovr_ovr /end DEF_CHARACTERISTIC /end FUNCTION
/begin FUNCTION VIN_DATA_BYTE_12_Ovr_Override "" /begin DEF_CHARACTERISTIC VIN_DATA_BYTE_12_Ovr_new VIN_DATA_BYTE_12_Ovr_ovr /end DEF_CHARACTERISTIC /end FUNCTION
/begin FUNCTION VIN_DATA_BYTE_13_Ovr_Override "" /begin DEF_CHARACTERISTIC VIN_DATA_BYTE_13_Ovr_new VIN_DATA_BYTE_13_Ovr_ovr /end DEF_CHARACTERISTIC /end FUNCTION
/begin FUNCTION VIN_DATA_BYTE_14_Ovr_Override "" /begin DEF_CHARACTERISTIC VIN_DATA_BYTE_14_Ovr_new VIN_DATA_BYTE_14_Ovr_ovr /end DEF_CHARACTERISTIC /end FUNCTION
/begin FUNCTION VIN_DATA_BYTE_15_Ovr_Override "" /begin DEF_CHARACTERISTIC VIN_DATA_BYTE_15_Ovr_new VIN_DATA_BYTE_15_Ovr_ovr /end DEF_CHARACTERISTIC /end FUNCTION
/begin FUNCTION VIN_DATA_BYTE_16_Ovr_Override "" /begin DEF_CHARACTERISTIC VIN_DATA_BYTE_16_Ovr_new VIN_DATA_BYTE_16_Ovr_ovr /end DEF_CHARACTERISTIC /end FUNCTION
/begin FUNCTION VIN_DATA_BYTE_17_Ovr_Override "" /begin DEF_CHARACTERISTIC VIN_DATA_BYTE_17_Ovr_new VIN_DATA_BYTE_17_Ovr_ovr /end DEF_CHARACTERISTIC /end FUNCTION
/begin FUNCTION VIN_DATA_BYTE_2_Ovr_Override "" /begin DEF_CHARACTERISTIC VIN_DATA_BYTE_2_Ovr_new VIN_DATA_BYTE_2_Ovr_ovr /end DEF_CHARACTERISTIC /end FUNCTION
/begin FUNCTION VIN_DATA_BYTE_3_Ovr_Override "" /begin DEF_CHARACTERISTIC VIN_DATA_BYTE_3_Ovr_new VIN_DATA_BYTE_3_Ovr_ovr /end DEF_CHARACTERISTIC /end FUNCTION
/begin FUNCTION VIN_DATA_BYTE_4_Ovr_Override "" /begin DEF_CHARACTERISTIC VIN_DATA_BYTE_4_Ovr_new VIN_DATA_BYTE_4_Ovr_ovr /end DEF_CHARACTERISTIC /end FUNCTION
/begin FUNCTION VIN_DATA_BYTE_5_Ovr_Override "" /begin DEF_CHARACTERISTIC VIN_DATA_BYTE_5_Ovr_new VIN_DATA_BYTE_5_Ovr_ovr /end DEF_CHARACTERISTIC /end FUNCTION
/begin FUNCTION VIN_DATA_BYTE_6_Ovr_Override "" /begin DEF_CHARACTERISTIC VIN_DATA_BYTE_6_Ovr_new VIN_DATA_BYTE_6_Ovr_ovr /end DEF_CHARACTERISTIC /end FUNCTION
/begin FUNCTION VIN_DATA_BYTE_7_Ovr_Override "" /begin DEF_CHARACTERISTIC VIN_DATA_BYTE_7_Ovr_new VIN_DATA_BYTE_7_Ovr_ovr /end DEF_CHARACTERISTIC /end FUNCTION
/begin FUNCTION VIN_DATA_BYTE_8_Ovr_Override "" /begin DEF_CHARACTERISTIC VIN_DATA_BYTE_8_Ovr_new VIN_DATA_BYTE_8_Ovr_ovr /end DEF_CHARACTERISTIC /end FUNCTION
/begin FUNCTION VIN_DATA_BYTE_9_Ovr_Override "" /begin DEF_CHARACTERISTIC VIN_DATA_BYTE_9_Ovr_new VIN_DATA_BYTE_9_Ovr_ovr /end DEF_CHARACTERISTIC /end FUNCTION
/begin FUNCTION Voltage_Limit_Override_Override "" /begin DEF_CHARACTERISTIC Voltage_Limit_Override_new Voltage_Limit_Override_ovr /end DEF_CHARACTERISTIC /end FUNCTION
/begin FUNCTION VSC_ActiveDischargeDisable_Ovr_Override ""
 /begin DEF_CHARACTERISTIC VSC_ActiveDischargeDisable_Ovr_new VSC_ActiveDischargeDisable_Ovr_ovr /end DEF_CHARACTERISTIC
/end FUNCTION
/begin FUNCTION VSC_AntishudderDisable_Ovr_Override ""
 /begin DEF_CHARACTERISTIC VSC_AntishudderDisable_Ovr_new VSC_AntishudderDisable_Ovr_ovr /end DEF_CHARACTERISTIC
/end FUNCTION
/begin FUNCTION VSC_DCDCEnable_Ovr_Override "" /begin DEF_CHARACTERISTIC VSC_DCDCEnable_Ovr_new VSC_DCDCEnable_Ovr_ovr /end DEF_CHARACTERISTIC /end FUNCTION
/begin FUNCTION VSC_DCOutputVoltageCmd_Ovr_Override ""
 /begin DEF_CHARACTERISTIC VSC_DCOutputVoltageCmd_Ovr_new VSC_DCOutputVoltageCmd_Ovr_ovr /end DEF_CHARACTERISTIC
/end FUNCTION
/begin FUNCTION VSC_IPTEnable_Ovr_Override "" /begin DEF_CHARACTERISTIC VSC_IPTEnable_Ovr_new VSC_IPTEnable_Ovr_ovr /end DEF_CHARACTERISTIC /end FUNCTION
/begin FUNCTION VSC_IPTWakeup_Ovr_Override "" /begin DEF_CHARACTERISTIC VSC_IPTWakeup_Ovr_new VSC_IPTWakeup_Ovr_ovr /end DEF_CHARACTERISTIC /end FUNCTION
/begin FUNCTION VSC_MaxCurrInputMotor_Ovr_Override ""
 /begin DEF_CHARACTERISTIC VSC_MaxCurrInputMotor_Ovr_new VSC_MaxCurrInputMotor_Ovr_ovr /end DEF_CHARACTERISTIC
/end FUNCTION
/begin FUNCTION VSC_MaxCurrOutputGen_Ovr_Override "" /begin DEF_CHARACTERISTIC VSC_MaxCurrOutputGen_Ovr_new VSC_MaxCurrOutputGen_Ovr_ovr /end DEF_CHARACTERISTIC /end FUNCTION
/begin FUNCTION VSC_MaxDCVoltage_Ovr_Override "" /begin DEF_CHARACTERISTIC VSC_MaxDCVoltage_Ovr_new VSC_MaxDCVoltage_Ovr_ovr /end DEF_CHARACTERISTIC /end FUNCTION
/begin FUNCTION VSC_MinDCVoltage_Ovr_Override "" /begin DEF_CHARACTERISTIC VSC_MinDCVoltage_Ovr_new VSC_MinDCVoltage_Ovr_ovr /end DEF_CHARACTERISTIC /end FUNCTION
/begin FUNCTION VSC_MotorEnable_Ovr_Override "" /begin DEF_CHARACTERISTIC VSC_MotorEnable_Ovr_new VSC_MotorEnable_Ovr_ovr /end DEF_CHARACTERISTIC /end FUNCTION
/begin FUNCTION VSC_PowerWasteRequest_Ovr_Override ""
 /begin DEF_CHARACTERISTIC VSC_PowerWasteRequest_Ovr_new VSC_PowerWasteRequest_Ovr_ovr /end DEF_CHARACTERISTIC
/end FUNCTION
/begin FUNCTION VSC_SDPTActive_Ovr_Override "" /begin DEF_CHARACTERISTIC VSC_SDPTActive_Ovr_new VSC_SDPTActive_Ovr_ovr /end DEF_CHARACTERISTIC /end FUNCTION
/begin FUNCTION VSC_TRSPosition_Ovr_Override "" /begin DEF_CHARACTERISTIC VSC_TRSPosition_Ovr_new VSC_TRSPosition_Ovr_ovr /end DEF_CHARACTERISTIC /end FUNCTION
/begin FUNCTION VSC_WheelTorqueRequest_Ovr_Override ""
 /begin DEF_CHARACTERISTIC VSC_WheelTorqueRequest_Ovr_new VSC_WheelTorqueRequest_Ovr_ovr /end DEF_CHARACTERISTIC
/end FUNCTION
/begin FUNCTION Wheel_Rolling_Timestamp_Ovr_Override ""
 /begin DEF_CHARACTERISTIC Wheel_Rolling_Timestamp_Ovr_new Wheel_Rolling_Timestamp_Ovr_ovr /end DEF_CHARACTERISTIC
/end FUNCTION
/end MODULE
/end PROJECT
