ASAP2_VERSION 1 51
/begin PROJECT Project ""
/begin MODULE Mooventur_219 ""
/begin MOD_COMMON /* MOD_COMMON Comment */ "" BYTE_ORDER MSB_FIRST ALIGNMENT_BYTE 1 ALIGNMENT_FLOAT32_IEEE 1 ALIGNMENT_FLOAT64_IEEE 1 ALIGNMENT_LONG 1 ALIGNMENT_WORD 1 /end MOD_COMMON
/begin CHARACTERISTIC FaultManager.Cruise_Control_Brake_Switch_A_Circuit_Malfunction.Action_4_Condition "Fault manager configuration.  Select up to 4 actions for each fault." VALUE 0x80000AB6 RecordLayout_7 0 CompuMethod_492 0 65535 /end CHARACTERISTIC
/begin CHARACTERISTIC FaultManager.Cruise_Control_Coast_Signal_Malfunction.Mode "Fault manager configuration.  Select up to 4 actions for each fault." VALUE 0x80000AB8 RecordLayout_7 0 CompuMethod_489 0 65535 /end CHARACTERISTIC
/begin CHARACTERISTIC FaultManager.Cruise_Control_Coast_Signal_Malfunction.ID "Fault manager configuration.  Select up to 4 actions for each fault." VALUE 0x80000ABA RecordLayout_7 0 CompuMethod_1 0 65535 /end CHARACTERISTIC
/begin CHARACTERISTIC FaultManager.Cruise_Control_Coast_Signal_Malfunction.Test "Fault manager configuration.  Select up to 4 actions for each fault." VALUE 0x80000ABC RecordLayout_7 0 CompuMethod_490 0 65535 /end CHARACTERISTIC
/begin CHARACTERISTIC FaultManager.Cruise_Control_Coast_Signal_Malfunction.Faulty_Samples__X_ "Fault manager configuration.  Select up to 4 actions for each fault." VALUE 0x80000ABE RecordLayout_7 0 CompuMethod_1 0 65535 /end CHARACTERISTIC
/begin CHARACTERISTIC FaultManager.Cruise_Control_Coast_Signal_Malfunction.Total_Samples__Y_ "Fault manager configuration.  Select up to 4 actions for each fault." VALUE 0x80000AC0 RecordLayout_7 0 CompuMethod_1 0 65535 /end CHARACTERISTIC
/begin CHARACTERISTIC FaultManager.Cruise_Control_Coast_Signal_Malfunction.Action_1 "Fault manager configuration.  Select up to 4 actions for each fault." VALUE 0x80000AC2 RecordLayout_7 0 CompuMethod_491 0 65535 /end CHARACTERISTIC
/begin CHARACTERISTIC FaultManager.Cruise_Control_Coast_Signal_Malfunction.Action_1_Condition "Fault manager configuration.  Select up to 4 actions for each fault." VALUE 0x80000AC4 RecordLayout_7 0 CompuMethod_492 0 65535 /end CHARACTERISTIC
/begin CHARACTERISTIC FaultManager.Cruise_Control_Coast_Signal_Malfunction.Action_2 "Fault manager configuration.  Select up to 4 actions for each fault." VALUE 0x80000AC6 RecordLayout_7 0 CompuMethod_491 0 65535 /end CHARACTERISTIC
/begin CHARACTERISTIC FaultManager.Cruise_Control_Coast_Signal_Malfunction.Action_2_Condition "Fault manager configuration.  Select up to 4 actions for each fault." VALUE 0x80000AC8 RecordLayout_7 0 CompuMethod_492 0 65535 /end CHARACTERISTIC
/begin CHARACTERISTIC FaultManager.Cruise_Control_Coast_Signal_Malfunction.Action_3 "Fault manager configuration.  Select up to 4 actions for each fault." VALUE 0x80000ACA RecordLayout_7 0 CompuMethod_491 0 65535 /end CHARACTERISTIC
/begin CHARACTERISTIC FaultManager.Cruise_Control_Coast_Signal_Malfunction.Action_3_Condition "Fault manager configuration.  Select up to 4 actions for each fault." VALUE 0x80000ACC RecordLayout_7 0 CompuMethod_492 0 65535 /end CHARACTERISTIC
/begin CHARACTERISTIC FaultManager.Cruise_Control_Coast_Signal_Malfunction.Action_4 "Fault manager configuration.  Select up to 4 actions for each fault." VALUE 0x80000ACE RecordLayout_7 0 CompuMethod_491 0 65535 /end CHARACTERISTIC
/begin CHARACTERISTIC FaultManager.Cruise_Control_Coast_Signal_Malfunction.Action_4_Condition "Fault manager configuration.  Select up to 4 actions for each fault." VALUE 0x80000AD0 RecordLayout_7 0 CompuMethod_492 0 65535 /end CHARACTERISTIC
/begin CHARACTERISTIC FaultManager.Cruise_Control_Off_Signal_Malfunction.Mode "Fault manager configuration.  Select up to 4 actions for each fault." VALUE 0x80000AD2 RecordLayout_7 0 CompuMethod_489 0 65535 /end CHARACTERISTIC
/begin CHARACTERISTIC FaultManager.Cruise_Control_Off_Signal_Malfunction.ID "Fault manager configuration.  Select up to 4 actions for each fault." VALUE 0x80000AD4 RecordLayout_7 0 CompuMethod_1 0 65535 /end CHARACTERISTIC
/begin CHARACTERISTIC FaultManager.Cruise_Control_Off_Signal_Malfunction.Test "Fault manager configuration.  Select up to 4 actions for each fault." VALUE 0x80000AD6 RecordLayout_7 0 CompuMethod_490 0 65535 /end CHARACTERISTIC
/begin CHARACTERISTIC FaultManager.Cruise_Control_Off_Signal_Malfunction.Faulty_Samples__X_ "Fault manager configuration.  Select up to 4 actions for each fault." VALUE 0x80000AD8 RecordLayout_7 0 CompuMethod_1 0 65535 /end CHARACTERISTIC
/begin CHARACTERISTIC FaultManager.Cruise_Control_Off_Signal_Malfunction.Total_Samples__Y_ "Fault manager configuration.  Select up to 4 actions for each fault." VALUE 0x80000ADA RecordLayout_7 0 CompuMethod_1 0 65535 /end CHARACTERISTIC
/begin CHARACTERISTIC FaultManager.Cruise_Control_Off_Signal_Malfunction.Action_1 "Fault manager configuration.  Select up to 4 actions for each fault." VALUE 0x80000ADC RecordLayout_7 0 CompuMethod_491 0 65535 /end CHARACTERISTIC
/begin CHARACTERISTIC FaultManager.Cruise_Control_Off_Signal_Malfunction.Action_1_Condition "Fault manager configuration.  Select up to 4 actions for each fault." VALUE 0x80000ADE RecordLayout_7 0 CompuMethod_492 0 65535 /end CHARACTERISTIC
/begin CHARACTERISTIC FaultManager.Cruise_Control_Off_Signal_Malfunction.Action_2 "Fault manager configuration.  Select up to 4 actions for each fault." VALUE 0x80000AE0 RecordLayout_7 0 CompuMethod_491 0 65535 /end CHARACTERISTIC
/begin CHARACTERISTIC FaultManager.Cruise_Control_Off_Signal_Malfunction.Action_2_Condition "Fault manager configuration.  Select up to 4 actions for each fault." VALUE 0x80000AE2 RecordLayout_7 0 CompuMethod_492 0 65535 /end CHARACTERISTIC
/begin CHARACTERISTIC FaultManager.Cruise_Control_Off_Signal_Malfunction.Action_3 "Fault manager configuration.  Select up to 4 actions for each fault." VALUE 0x80000AE4 RecordLayout_7 0 CompuMethod_491 0 65535 /end CHARACTERISTIC
/begin CHARACTERISTIC FaultManager.Cruise_Control_Off_Signal_Malfunction.Action_3_Condition "Fault manager configuration.  Select up to 4 actions for each fault." VALUE 0x80000AE6 RecordLayout_7 0 CompuMethod_492 0 65535 /end CHARACTERISTIC
/begin CHARACTERISTIC FaultManager.Cruise_Control_Off_Signal_Malfunction.Action_4 "Fault manager configuration.  Select up to 4 actions for each fault." VALUE 0x80000AE8 RecordLayout_7 0 CompuMethod_491 0 65535 /end CHARACTERISTIC
/begin CHARACTERISTIC FaultManager.Cruise_Control_Off_Signal_Malfunction.Action_4_Condition "Fault manager configuration.  Select up to 4 actions for each fault." VALUE 0x80000AEA RecordLayout_7 0 CompuMethod_492 0 65535 /end CHARACTERISTIC
/begin CHARACTERISTIC FaultManager.Cruise_Control_On_Signal_Malfunction.Mode "Fault manager configuration.  Select up to 4 actions for each fault." VALUE 0x80000AEC RecordLayout_7 0 CompuMethod_489 0 65535 /end CHARACTERISTIC
/begin CHARACTERISTIC FaultManager.Cruise_Control_On_Signal_Malfunction.ID "Fault manager configuration.  Select up to 4 actions for each fault." VALUE 0x80000AEE RecordLayout_7 0 CompuMethod_1 0 65535 /end CHARACTERISTIC
/begin CHARACTERISTIC FaultManager.Cruise_Control_On_Signal_Malfunction.Test "Fault manager configuration.  Select up to 4 actions for each fault." VALUE 0x80000AF0 RecordLayout_7 0 CompuMethod_490 0 65535 /end CHARACTERISTIC
/begin CHARACTERISTIC FaultManager.Cruise_Control_On_Signal_Malfunction.Faulty_Samples__X_ "Fault manager configuration.  Select up to 4 actions for each fault." VALUE 0x80000AF2 RecordLayout_7 0 CompuMethod_1 0 65535 /end CHARACTERISTIC
/begin CHARACTERISTIC FaultManager.Cruise_Control_On_Signal_Malfunction.Total_Samples__Y_ "Fault manager configuration.  Select up to 4 actions for each fault." VALUE 0x80000AF4 RecordLayout_7 0 CompuMethod_1 0 65535 /end CHARACTERISTIC
/begin CHARACTERISTIC FaultManager.Cruise_Control_On_Signal_Malfunction.Action_1 "Fault manager configuration.  Select up to 4 actions for each fault." VALUE 0x80000AF6 RecordLayout_7 0 CompuMethod_491 0 65535 /end CHARACTERISTIC
/begin CHARACTERISTIC FaultManager.Cruise_Control_On_Signal_Malfunction.Action_1_Condition "Fault manager configuration.  Select up to 4 actions for each fault." VALUE 0x80000AF8 RecordLayout_7 0 CompuMethod_492 0 65535 /end CHARACTERISTIC
/begin CHARACTERISTIC FaultManager.Cruise_Control_On_Signal_Malfunction.Action_2 "Fault manager configuration.  Select up to 4 actions for each fault." VALUE 0x80000AFA RecordLayout_7 0 CompuMethod_491 0 65535 /end CHARACTERISTIC
/begin CHARACTERISTIC FaultManager.Cruise_Control_On_Signal_Malfunction.Action_2_Condition "Fault manager configuration.  Select up to 4 actions for each fault." VALUE 0x80000AFC RecordLayout_7 0 CompuMethod_492 0 65535 /end CHARACTERISTIC
/begin CHARACTERISTIC FaultManager.Cruise_Control_On_Signal_Malfunction.Action_3 "Fault manager configuration.  Select up to 4 actions for each fault." VALUE 0x80000AFE RecordLayout_7 0 CompuMethod_491 0 65535 /end CHARACTERISTIC
/begin CHARACTERISTIC FaultManager.Cruise_Control_On_Signal_Malfunction.Action_3_Condition "Fault manager configuration.  Select up to 4 actions for each fault." VALUE 0x80000B00 RecordLayout_7 0 CompuMethod_492 0 65535 /end CHARACTERISTIC
/begin CHARACTERISTIC FaultManager.Cruise_Control_On_Signal_Malfunction.Action_4 "Fault manager configuration.  Select up to 4 actions for each fault." VALUE 0x80000B02 RecordLayout_7 0 CompuMethod_491 0 65535 /end CHARACTERISTIC
/begin CHARACTERISTIC FaultManager.Cruise_Control_On_Signal_Malfunction.Action_4_Condition "Fault manager configuration.  Select up to 4 actions for each fault." VALUE 0x80000B04 RecordLayout_7 0 CompuMethod_492 0 65535 /end CHARACTERISTIC
/begin CHARACTERISTIC FaultManager.Cruise_Control_Resume_Signal_Malfunction.Mode "Fault manager configuration.  Select up to 4 actions for each fault." VALUE 0x80000B06 RecordLayout_7 0 CompuMethod_489 0 65535 /end CHARACTERISTIC
/begin CHARACTERISTIC FaultManager.Cruise_Control_Resume_Signal_Malfunction.ID "Fault manager configuration.  Select up to 4 actions for each fault." VALUE 0x80000B08 RecordLayout_7 0 CompuMethod_1 0 65535 /end CHARACTERISTIC
/begin CHARACTERISTIC FaultManager.Cruise_Control_Resume_Signal_Malfunction.Test "Fault manager configuration.  Select up to 4 actions for each fault." VALUE 0x80000B0A RecordLayout_7 0 CompuMethod_490 0 65535 /end CHARACTERISTIC
/begin CHARACTERISTIC FaultManager.Cruise_Control_Resume_Signal_Malfunction.Faulty_Samples__X_ "Fault manager configuration.  Select up to 4 actions for each fault." VALUE 0x80000B0C RecordLayout_7 0 CompuMethod_1 0 65535 /end CHARACTERISTIC
/begin CHARACTERISTIC FaultManager.Cruise_Control_Resume_Signal_Malfunction.Total_Samples__Y_ "Fault manager configuration.  Select up to 4 actions for each fault." VALUE 0x80000B0E RecordLayout_7 0 CompuMethod_1 0 65535 /end CHARACTERISTIC
/begin CHARACTERISTIC FaultManager.Cruise_Control_Resume_Signal_Malfunction.Action_1 "Fault manager configuration.  Select up to 4 actions for each fault." VALUE 0x80000B10 RecordLayout_7 0 CompuMethod_491 0 65535 /end CHARACTERISTIC
/begin CHARACTERISTIC FaultManager.Cruise_Control_Resume_Signal_Malfunction.Action_1_Condition "Fault manager configuration.  Select up to 4 actions for each fault." VALUE 0x80000B12 RecordLayout_7 0 CompuMethod_492 0 65535 /end CHARACTERISTIC
/begin CHARACTERISTIC FaultManager.Cruise_Control_Resume_Signal_Malfunction.Action_2 "Fault manager configuration.  Select up to 4 actions for each fault." VALUE 0x80000B14 RecordLayout_7 0 CompuMethod_491 0 65535 /end CHARACTERISTIC
/begin CHARACTERISTIC FaultManager.Cruise_Control_Resume_Signal_Malfunction.Action_2_Condition "Fault manager configuration.  Select up to 4 actions for each fault." VALUE 0x80000B16 RecordLayout_7 0 CompuMethod_492 0 65535 /end CHARACTERISTIC
/begin CHARACTERISTIC FaultManager.Cruise_Control_Resume_Signal_Malfunction.Action_3 "Fault manager configuration.  Select up to 4 actions for each fault." VALUE 0x80000B18 RecordLayout_7 0 CompuMethod_491 0 65535 /end CHARACTERISTIC
/begin CHARACTERISTIC FaultManager.Cruise_Control_Resume_Signal_Malfunction.Action_3_Condition "Fault manager configuration.  Select up to 4 actions for each fault." VALUE 0x80000B1A RecordLayout_7 0 CompuMethod_492 0 65535 /end CHARACTERISTIC
/begin CHARACTERISTIC FaultManager.Cruise_Control_Resume_Signal_Malfunction.Action_4 "Fault manager configuration.  Select up to 4 actions for each fault." VALUE 0x80000B1C RecordLayout_7 0 CompuMethod_491 0 65535 /end CHARACTERISTIC
/begin CHARACTERISTIC FaultManager.Cruise_Control_Resume_Signal_Malfunction.Action_4_Condition "Fault manager configuration.  Select up to 4 actions for each fault." VALUE 0x80000B1E RecordLayout_7 0 CompuMethod_492 0 65535 /end CHARACTERISTIC
/begin CHARACTERISTIC FaultManager.Cruise_Control_Set_Signal_Malfunction.Mode "Fault manager configuration.  Select up to 4 actions for each fault." VALUE 0x80000B20 RecordLayout_7 0 CompuMethod_489 0 65535 /end CHARACTERISTIC
/begin CHARACTERISTIC FaultManager.Cruise_Control_Set_Signal_Malfunction.ID "Fault manager configuration.  Select up to 4 actions for each fault." VALUE 0x80000B22 RecordLayout_7 0 CompuMethod_1 0 65535 /end CHARACTERISTIC
/begin CHARACTERISTIC FaultManager.Cruise_Control_Set_Signal_Malfunction.Test "Fault manager configuration.  Select up to 4 actions for each fault." VALUE 0x80000B24 RecordLayout_7 0 CompuMethod_490 0 65535 /end CHARACTERISTIC
/begin CHARACTERISTIC FaultManager.Cruise_Control_Set_Signal_Malfunction.Faulty_Samples__X_ "Fault manager configuration.  Select up to 4 actions for each fault." VALUE 0x80000B26 RecordLayout_7 0 CompuMethod_1 0 65535 /end CHARACTERISTIC
/begin CHARACTERISTIC FaultManager.Cruise_Control_Set_Signal_Malfunction.Total_Samples__Y_ "Fault manager configuration.  Select up to 4 actions for each fault." VALUE 0x80000B28 RecordLayout_7 0 CompuMethod_1 0 65535 /end CHARACTERISTIC
/begin CHARACTERISTIC FaultManager.Cruise_Control_Set_Signal_Malfunction.Action_1 "Fault manager configuration.  Select up to 4 actions for each fault." VALUE 0x80000B2A RecordLayout_7 0 CompuMethod_491 0 65535 /end CHARACTERISTIC
/begin CHARACTERISTIC FaultManager.Cruise_Control_Set_Signal_Malfunction.Action_1_Condition "Fault manager configuration.  Select up to 4 actions for each fault." VALUE 0x80000B2C RecordLayout_7 0 CompuMethod_492 0 65535 /end CHARACTERISTIC
/begin CHARACTERISTIC FaultManager.Cruise_Control_Set_Signal_Malfunction.Action_2 "Fault manager configuration.  Select up to 4 actions for each fault." VALUE 0x80000B2E RecordLayout_7 0 CompuMethod_491 0 65535 /end CHARACTERISTIC
/begin CHARACTERISTIC FaultManager.Cruise_Control_Set_Signal_Malfunction.Action_2_Condition "Fault manager configuration.  Select up to 4 actions for each fault." VALUE 0x80000B30 RecordLayout_7 0 CompuMethod_492 0 65535 /end CHARACTERISTIC
/begin CHARACTERISTIC FaultManager.Cruise_Control_Set_Signal_Malfunction.Action_3 "Fault manager configuration.  Select up to 4 actions for each fault." VALUE 0x80000B32 RecordLayout_7 0 CompuMethod_491 0 65535 /end CHARACTERISTIC
/begin CHARACTERISTIC FaultManager.Cruise_Control_Set_Signal_Malfunction.Action_3_Condition "Fault manager configuration.  Select up to 4 actions for each fault." VALUE 0x80000B34 RecordLayout_7 0 CompuMethod_492 0 65535 /end CHARACTERISTIC
/begin CHARACTERISTIC FaultManager.Cruise_Control_Set_Signal_Malfunction.Action_4 "Fault manager configuration.  Select up to 4 actions for each fault." VALUE 0x80000B36 RecordLayout_7 0 CompuMethod_491 0 65535 /end CHARACTERISTIC
/begin CHARACTERISTIC FaultManager.Cruise_Control_Set_Signal_Malfunction.Action_4_Condition "Fault manager configuration.  Select up to 4 actions for each fault." VALUE 0x80000B38 RecordLayout_7 0 CompuMethod_492 0 65535 /end CHARACTERISTIC
/begin CHARACTERISTIC FaultManager.DCDC_Converter_Not_Running.Mode "Fault manager configuration.  Select up to 4 actions for each fault." VALUE 0x80000B3A RecordLayout_7 0 CompuMethod_489 0 65535 /end CHARACTERISTIC
/begin CHARACTERISTIC FaultManager.DCDC_Converter_Not_Running.ID "Fault manager configuration.  Select up to 4 actions for each fault." VALUE 0x80000B3C RecordLayout_7 0 CompuMethod_1 0 65535 /end CHARACTERISTIC
/begin CHARACTERISTIC FaultManager.DCDC_Converter_Not_Running.Test "Fault manager configuration.  Select up to 4 actions for each fault." VALUE 0x80000B3E RecordLayout_7 0 CompuMethod_490 0 65535 /end CHARACTERISTIC
/begin CHARACTERISTIC FaultManager.DCDC_Converter_Not_Running.Faulty_Samples__X_ "Fault manager configuration.  Select up to 4 actions for each fault." VALUE 0x80000B40 RecordLayout_7 0 CompuMethod_1 0 65535 /end CHARACTERISTIC
/begin CHARACTERISTIC FaultManager.DCDC_Converter_Not_Running.Total_Samples__Y_ "Fault manager configuration.  Select up to 4 actions for each fault." VALUE 0x80000B42 RecordLayout_7 0 CompuMethod_1 0 65535 /end CHARACTERISTIC
/begin CHARACTERISTIC FaultManager.DCDC_Converter_Not_Running.Action_1 "Fault manager configuration.  Select up to 4 actions for each fault." VALUE 0x80000B44 RecordLayout_7 0 CompuMethod_491 0 65535 /end CHARACTERISTIC
/begin CHARACTERISTIC FaultManager.DCDC_Converter_Not_Running.Action_1_Condition "Fault manager configuration.  Select up to 4 actions for each fault." VALUE 0x80000B46 RecordLayout_7 0 CompuMethod_492 0 65535 /end CHARACTERISTIC
/begin CHARACTERISTIC FaultManager.DCDC_Converter_Not_Running.Action_2 "Fault manager configuration.  Select up to 4 actions for each fault." VALUE 0x80000B48 RecordLayout_7 0 CompuMethod_491 0 65535 /end CHARACTERISTIC
/begin CHARACTERISTIC FaultManager.DCDC_Converter_Not_Running.Action_2_Condition "Fault manager configuration.  Select up to 4 actions for each fault." VALUE 0x80000B4A RecordLayout_7 0 CompuMethod_492 0 65535 /end CHARACTERISTIC
/begin CHARACTERISTIC FaultManager.DCDC_Converter_Not_Running.Action_3 "Fault manager configuration.  Select up to 4 actions for each fault." VALUE 0x80000B4C RecordLayout_7 0 CompuMethod_491 0 65535 /end CHARACTERISTIC
/begin CHARACTERISTIC FaultManager.DCDC_Converter_Not_Running.Action_3_Condition "Fault manager configuration.  Select up to 4 actions for each fault." VALUE 0x80000B4E RecordLayout_7 0 CompuMethod_492 0 65535 /end CHARACTERISTIC
/begin CHARACTERISTIC FaultManager.DCDC_Converter_Not_Running.Action_4 "Fault manager configuration.  Select up to 4 actions for each fault." VALUE 0x80000B50 RecordLayout_7 0 CompuMethod_491 0 65535 /end CHARACTERISTIC
/begin CHARACTERISTIC FaultManager.DCDC_Converter_Not_Running.Action_4_Condition "Fault manager configuration.  Select up to 4 actions for each fault." VALUE 0x80000B52 RecordLayout_7 0 CompuMethod_492 0 65535 /end CHARACTERISTIC
/begin CHARACTERISTIC FaultManager.Drive_Switch_Input_Circuit.Mode "Fault manager configuration.  Select up to 4 actions for each fault." VALUE 0x80000B54 RecordLayout_7 0 CompuMethod_489 0 65535 /end CHARACTERISTIC
/begin CHARACTERISTIC FaultManager.Drive_Switch_Input_Circuit.ID "Fault manager configuration.  Select up to 4 actions for each fault." VALUE 0x80000B56 RecordLayout_7 0 CompuMethod_1 0 65535 /end CHARACTERISTIC
/begin CHARACTERISTIC FaultManager.Drive_Switch_Input_Circuit.Test "Fault manager configuration.  Select up to 4 actions for each fault." VALUE 0x80000B58 RecordLayout_7 0 CompuMethod_490 0 65535 /end CHARACTERISTIC
/begin CHARACTERISTIC FaultManager.Drive_Switch_Input_Circuit.Faulty_Samples__X_ "Fault manager configuration.  Select up to 4 actions for each fault." VALUE 0x80000B5A RecordLayout_7 0 CompuMethod_1 0 65535 /end CHARACTERISTIC
/begin CHARACTERISTIC FaultManager.Drive_Switch_Input_Circuit.Total_Samples__Y_ "Fault manager configuration.  Select up to 4 actions for each fault." VALUE 0x80000B5C RecordLayout_7 0 CompuMethod_1 0 65535 /end CHARACTERISTIC
/begin CHARACTERISTIC FaultManager.Drive_Switch_Input_Circuit.Action_1 "Fault manager configuration.  Select up to 4 actions for each fault." VALUE 0x80000B5E RecordLayout_7 0 CompuMethod_491 0 65535 /end CHARACTERISTIC
/begin CHARACTERISTIC FaultManager.Drive_Switch_Input_Circuit.Action_1_Condition "Fault manager configuration.  Select up to 4 actions for each fault." VALUE 0x80000B60 RecordLayout_7 0 CompuMethod_492 0 65535 /end CHARACTERISTIC
/begin CHARACTERISTIC FaultManager.Drive_Switch_Input_Circuit.Action_2 "Fault manager configuration.  Select up to 4 actions for each fault." VALUE 0x80000B62 RecordLayout_7 0 CompuMethod_491 0 65535 /end CHARACTERISTIC
/begin CHARACTERISTIC FaultManager.Drive_Switch_Input_Circuit.Action_2_Condition "Fault manager configuration.  Select up to 4 actions for each fault." VALUE 0x80000B64 RecordLayout_7 0 CompuMethod_492 0 65535 /end CHARACTERISTIC
/begin CHARACTERISTIC FaultManager.Drive_Switch_Input_Circuit.Action_3 "Fault manager configuration.  Select up to 4 actions for each fault." VALUE 0x80000B66 RecordLayout_7 0 CompuMethod_491 0 65535 /end CHARACTERISTIC
/begin CHARACTERISTIC FaultManager.Drive_Switch_Input_Circuit.Action_3_Condition "Fault manager configuration.  Select up to 4 actions for each fault." VALUE 0x80000B68 RecordLayout_7 0 CompuMethod_492 0 65535 /end CHARACTERISTIC
/begin CHARACTERISTIC FaultManager.Drive_Switch_Input_Circuit.Action_4 "Fault manager configuration.  Select up to 4 actions for each fault." VALUE 0x80000B6A RecordLayout_7 0 CompuMethod_491 0 65535 /end CHARACTERISTIC
/begin CHARACTERISTIC FaultManager.Drive_Switch_Input_Circuit.Action_4_Condition "Fault manager configuration.  Select up to 4 actions for each fault." VALUE 0x80000B6C RecordLayout_7 0 CompuMethod_492 0 65535 /end CHARACTERISTIC
/begin CHARACTERISTIC FaultManager.Drive_Switch_Input_High.Mode "Fault manager configuration.  Select up to 4 actions for each fault." VALUE 0x80000B6E RecordLayout_7 0 CompuMethod_489 0 65535 /end CHARACTERISTIC
/begin CHARACTERISTIC FaultManager.Drive_Switch_Input_High.ID "Fault manager configuration.  Select up to 4 actions for each fault." VALUE 0x80000B70 RecordLayout_7 0 CompuMethod_1 0 65535 /end CHARACTERISTIC
/begin CHARACTERISTIC FaultManager.Drive_Switch_Input_High.Test "Fault manager configuration.  Select up to 4 actions for each fault." VALUE 0x80000B72 RecordLayout_7 0 CompuMethod_490 0 65535 /end CHARACTERISTIC
/begin CHARACTERISTIC FaultManager.Drive_Switch_Input_High.Faulty_Samples__X_ "Fault manager configuration.  Select up to 4 actions for each fault." VALUE 0x80000B74 RecordLayout_7 0 CompuMethod_1 0 65535 /end CHARACTERISTIC
/begin CHARACTERISTIC FaultManager.Drive_Switch_Input_High.Total_Samples__Y_ "Fault manager configuration.  Select up to 4 actions for each fault." VALUE 0x80000B76 RecordLayout_7 0 CompuMethod_1 0 65535 /end CHARACTERISTIC
/begin CHARACTERISTIC FaultManager.Drive_Switch_Input_High.Action_1 "Fault manager configuration.  Select up to 4 actions for each fault." VALUE 0x80000B78 RecordLayout_7 0 CompuMethod_491 0 65535 /end CHARACTERISTIC
/begin CHARACTERISTIC FaultManager.Drive_Switch_Input_High.Action_1_Condition "Fault manager configuration.  Select up to 4 actions for each fault." VALUE 0x80000B7A RecordLayout_7 0 CompuMethod_492 0 65535 /end CHARACTERISTIC
/begin CHARACTERISTIC FaultManager.Drive_Switch_Input_High.Action_2 "Fault manager configuration.  Select up to 4 actions for each fault." VALUE 0x80000B7C RecordLayout_7 0 CompuMethod_491 0 65535 /end CHARACTERISTIC
/begin CHARACTERISTIC FaultManager.Drive_Switch_Input_High.Action_2_Condition "Fault manager configuration.  Select up to 4 actions for each fault." VALUE 0x80000B7E RecordLayout_7 0 CompuMethod_492 0 65535 /end CHARACTERISTIC
/begin CHARACTERISTIC FaultManager.Drive_Switch_Input_High.Action_3 "Fault manager configuration.  Select up to 4 actions for each fault." VALUE 0x80000B80 RecordLayout_7 0 CompuMethod_491 0 65535 /end CHARACTERISTIC
/begin CHARACTERISTIC FaultManager.Drive_Switch_Input_High.Action_3_Condition "Fault manager configuration.  Select up to 4 actions for each fault." VALUE 0x80000B82 RecordLayout_7 0 CompuMethod_492 0 65535 /end CHARACTERISTIC
/begin CHARACTERISTIC FaultManager.Drive_Switch_Input_High.Action_4 "Fault manager configuration.  Select up to 4 actions for each fault." VALUE 0x80000B84 RecordLayout_7 0 CompuMethod_491 0 65535 /end CHARACTERISTIC
/begin CHARACTERISTIC FaultManager.Drive_Switch_Input_High.Action_4_Condition "Fault manager configuration.  Select up to 4 actions for each fault." VALUE 0x80000B86 RecordLayout_7 0 CompuMethod_492 0 65535 /end CHARACTERISTIC
/begin CHARACTERISTIC FaultManager.Drive_Switch_Input_Low.Mode "Fault manager configuration.  Select up to 4 actions for each fault." VALUE 0x80000B88 RecordLayout_7 0 CompuMethod_489 0 65535 /end CHARACTERISTIC
/begin CHARACTERISTIC FaultManager.Drive_Switch_Input_Low.ID "Fault manager configuration.  Select up to 4 actions for each fault." VALUE 0x80000B8A RecordLayout_7 0 CompuMethod_1 0 65535 /end CHARACTERISTIC
/begin CHARACTERISTIC FaultManager.Drive_Switch_Input_Low.Test "Fault manager configuration.  Select up to 4 actions for each fault." VALUE 0x80000B8C RecordLayout_7 0 CompuMethod_490 0 65535 /end CHARACTERISTIC
/begin CHARACTERISTIC FaultManager.Drive_Switch_Input_Low.Faulty_Samples__X_ "Fault manager configuration.  Select up to 4 actions for each fault." VALUE 0x80000B8E RecordLayout_7 0 CompuMethod_1 0 65535 /end CHARACTERISTIC
/begin CHARACTERISTIC FaultManager.Drive_Switch_Input_Low.Total_Samples__Y_ "Fault manager configuration.  Select up to 4 actions for each fault." VALUE 0x80000B90 RecordLayout_7 0 CompuMethod_1 0 65535 /end CHARACTERISTIC
/begin CHARACTERISTIC FaultManager.Drive_Switch_Input_Low.Action_1 "Fault manager configuration.  Select up to 4 actions for each fault." VALUE 0x80000B92 RecordLayout_7 0 CompuMethod_491 0 65535 /end CHARACTERISTIC
/begin CHARACTERISTIC FaultManager.Drive_Switch_Input_Low.Action_1_Condition "Fault manager configuration.  Select up to 4 actions for each fault." VALUE 0x80000B94 RecordLayout_7 0 CompuMethod_492 0 65535 /end CHARACTERISTIC
/begin CHARACTERISTIC FaultManager.Drive_Switch_Input_Low.Action_2 "Fault manager configuration.  Select up to 4 actions for each fault." VALUE 0x80000B96 RecordLayout_7 0 CompuMethod_491 0 65535 /end CHARACTERISTIC
/begin CHARACTERISTIC FaultManager.Drive_Switch_Input_Low.Action_2_Condition "Fault manager configuration.  Select up to 4 actions for each fault." VALUE 0x80000B98 RecordLayout_7 0 CompuMethod_492 0 65535 /end CHARACTERISTIC
/begin CHARACTERISTIC FaultManager.Drive_Switch_Input_Low.Action_3 "Fault manager configuration.  Select up to 4 actions for each fault." VALUE 0x80000B9A RecordLayout_7 0 CompuMethod_491 0 65535 /end CHARACTERISTIC
/begin CHARACTERISTIC FaultManager.Drive_Switch_Input_Low.Action_3_Condition "Fault manager configuration.  Select up to 4 actions for each fault." VALUE 0x80000B9C RecordLayout_7 0 CompuMethod_492 0 65535 /end CHARACTERISTIC
/begin CHARACTERISTIC FaultManager.Drive_Switch_Input_Low.Action_4 "Fault manager configuration.  Select up to 4 actions for each fault." VALUE 0x80000B9E RecordLayout_7 0 CompuMethod_491 0 65535 /end CHARACTERISTIC
/begin CHARACTERISTIC FaultManager.Drive_Switch_Input_Low.Action_4_Condition "Fault manager configuration.  Select up to 4 actions for each fault." VALUE 0x80000BA0 RecordLayout_7 0 CompuMethod_492 0 65535 /end CHARACTERISTIC
/begin CHARACTERISTIC FaultManager.Eaton_Charger_AgeCount.Mode "Fault manager configuration.  Select up to 4 actions for each fault." VALUE 0x80000BA2 RecordLayout_7 0 CompuMethod_489 0 65535 /end CHARACTERISTIC
/begin CHARACTERISTIC FaultManager.Eaton_Charger_AgeCount.ID "Fault manager configuration.  Select up to 4 actions for each fault." VALUE 0x80000BA4 RecordLayout_7 0 CompuMethod_1 0 65535 /end CHARACTERISTIC
/begin CHARACTERISTIC FaultManager.Eaton_Charger_AgeCount.Test "Fault manager configuration.  Select up to 4 actions for each fault." VALUE 0x80000BA6 RecordLayout_7 0 CompuMethod_490 0 65535 /end CHARACTERISTIC
/begin CHARACTERISTIC FaultManager.Eaton_Charger_AgeCount.Faulty_Samples__X_ "Fault manager configuration.  Select up to 4 actions for each fault." VALUE 0x80000BA8 RecordLayout_7 0 CompuMethod_1 0 65535 /end CHARACTERISTIC
/begin CHARACTERISTIC FaultManager.Eaton_Charger_AgeCount.Total_Samples__Y_ "Fault manager configuration.  Select up to 4 actions for each fault." VALUE 0x80000BAA RecordLayout_7 0 CompuMethod_1 0 65535 /end CHARACTERISTIC
/begin CHARACTERISTIC FaultManager.Eaton_Charger_AgeCount.Action_1 "Fault manager configuration.  Select up to 4 actions for each fault." VALUE 0x80000BAC RecordLayout_7 0 CompuMethod_491 0 65535 /end CHARACTERISTIC
/begin CHARACTERISTIC FaultManager.Eaton_Charger_AgeCount.Action_1_Condition "Fault manager configuration.  Select up to 4 actions for each fault." VALUE 0x80000BAE RecordLayout_7 0 CompuMethod_492 0 65535 /end CHARACTERISTIC
/begin CHARACTERISTIC FaultManager.Eaton_Charger_AgeCount.Action_2 "Fault manager configuration.  Select up to 4 actions for each fault." VALUE 0x80000BB0 RecordLayout_7 0 CompuMethod_491 0 65535 /end CHARACTERISTIC
/begin CHARACTERISTIC FaultManager.Eaton_Charger_AgeCount.Action_2_Condition "Fault manager configuration.  Select up to 4 actions for each fault." VALUE 0x80000BB2 RecordLayout_7 0 CompuMethod_492 0 65535 /end CHARACTERISTIC
/begin CHARACTERISTIC FaultManager.Eaton_Charger_AgeCount.Action_3 "Fault manager configuration.  Select up to 4 actions for each fault." VALUE 0x80000BB4 RecordLayout_7 0 CompuMethod_491 0 65535 /end CHARACTERISTIC
/begin CHARACTERISTIC FaultManager.Eaton_Charger_AgeCount.Action_3_Condition "Fault manager configuration.  Select up to 4 actions for each fault." VALUE 0x80000BB6 RecordLayout_7 0 CompuMethod_492 0 65535 /end CHARACTERISTIC
/begin CHARACTERISTIC FaultManager.Eaton_Charger_AgeCount.Action_4 "Fault manager configuration.  Select up to 4 actions for each fault." VALUE 0x80000BB8 RecordLayout_7 0 CompuMethod_491 0 65535 /end CHARACTERISTIC
/begin CHARACTERISTIC FaultManager.Eaton_Charger_AgeCount.Action_4_Condition "Fault manager configuration.  Select up to 4 actions for each fault." VALUE 0x80000BBA RecordLayout_7 0 CompuMethod_492 0 65535 /end CHARACTERISTIC
/begin CHARACTERISTIC FaultManager.Electric_Motor_Approaching_Over_Temperature.Mode "Fault manager configuration.  Select up to 4 actions for each fault." VALUE 0x80000BBC RecordLayout_7 0 CompuMethod_489 0 65535 /end CHARACTERISTIC
/begin CHARACTERISTIC FaultManager.Electric_Motor_Approaching_Over_Temperature.ID "Fault manager configuration.  Select up to 4 actions for each fault." VALUE 0x80000BBE RecordLayout_7 0 CompuMethod_1 0 65535 /end CHARACTERISTIC
/begin CHARACTERISTIC FaultManager.Electric_Motor_Approaching_Over_Temperature.Test "Fault manager configuration.  Select up to 4 actions for each fault." VALUE 0x80000BC0 RecordLayout_7 0 CompuMethod_490 0 65535 /end CHARACTERISTIC
/begin CHARACTERISTIC FaultManager.Electric_Motor_Approaching_Over_Temperature.Faulty_Samples__X_ "Fault manager configuration.  Select up to 4 actions for each fault." VALUE 0x80000BC2 RecordLayout_7 0 CompuMethod_1 0 65535 /end CHARACTERISTIC
/begin CHARACTERISTIC FaultManager.Electric_Motor_Approaching_Over_Temperature.Total_Samples__Y_ "Fault manager configuration.  Select up to 4 actions for each fault." VALUE 0x80000BC4 RecordLayout_7 0 CompuMethod_1 0 65535 /end CHARACTERISTIC
/begin CHARACTERISTIC FaultManager.Electric_Motor_Approaching_Over_Temperature.Action_1 "Fault manager configuration.  Select up to 4 actions for each fault." VALUE 0x80000BC6 RecordLayout_7 0 CompuMethod_491 0 65535 /end CHARACTERISTIC
/begin CHARACTERISTIC FaultManager.Electric_Motor_Approaching_Over_Temperature.Action_1_Condition "Fault manager configuration.  Select up to 4 actions for each fault." VALUE 0x80000BC8 RecordLayout_7 0 CompuMethod_492 0 65535 /end CHARACTERISTIC
/begin CHARACTERISTIC FaultManager.Electric_Motor_Approaching_Over_Temperature.Action_2 "Fault manager configuration.  Select up to 4 actions for each fault." VALUE 0x80000BCA RecordLayout_7 0 CompuMethod_491 0 65535 /end CHARACTERISTIC
/begin CHARACTERISTIC FaultManager.Electric_Motor_Approaching_Over_Temperature.Action_2_Condition "Fault manager configuration.  Select up to 4 actions for each fault." VALUE 0x80000BCC RecordLayout_7 0 CompuMethod_492 0 65535 /end CHARACTERISTIC
/begin CHARACTERISTIC FaultManager.Electric_Motor_Approaching_Over_Temperature.Action_3 "Fault manager configuration.  Select up to 4 actions for each fault." VALUE 0x80000BCE RecordLayout_7 0 CompuMethod_491 0 65535 /end CHARACTERISTIC
/begin CHARACTERISTIC FaultManager.Electric_Motor_Approaching_Over_Temperature.Action_3_Condition "Fault manager configuration.  Select up to 4 actions for each fault." VALUE 0x80000BD0 RecordLayout_7 0 CompuMethod_492 0 65535 /end CHARACTERISTIC
/begin CHARACTERISTIC FaultManager.Electric_Motor_Approaching_Over_Temperature.Action_4 "Fault manager configuration.  Select up to 4 actions for each fault." VALUE 0x80000BD2 RecordLayout_7 0 CompuMethod_491 0 65535 /end CHARACTERISTIC
/begin CHARACTERISTIC FaultManager.Electric_Motor_Approaching_Over_Temperature.Action_4_Condition "Fault manager configuration.  Select up to 4 actions for each fault." VALUE 0x80000BD4 RecordLayout_7 0 CompuMethod_492 0 65535 /end CHARACTERISTIC
/begin CHARACTERISTIC FaultManager.Electric_Motor_Derated_Over_Temperature.Mode "Fault manager configuration.  Select up to 4 actions for each fault." VALUE 0x80000BD6 RecordLayout_7 0 CompuMethod_489 0 65535 /end CHARACTERISTIC
/begin CHARACTERISTIC FaultManager.Electric_Motor_Derated_Over_Temperature.ID "Fault manager configuration.  Select up to 4 actions for each fault." VALUE 0x80000BD8 RecordLayout_7 0 CompuMethod_1 0 65535 /end CHARACTERISTIC
/begin CHARACTERISTIC FaultManager.Electric_Motor_Derated_Over_Temperature.Test "Fault manager configuration.  Select up to 4 actions for each fault." VALUE 0x80000BDA RecordLayout_7 0 CompuMethod_490 0 65535 /end CHARACTERISTIC
/begin CHARACTERISTIC FaultManager.Electric_Motor_Derated_Over_Temperature.Faulty_Samples__X_ "Fault manager configuration.  Select up to 4 actions for each fault." VALUE 0x80000BDC RecordLayout_7 0 CompuMethod_1 0 65535 /end CHARACTERISTIC
/begin CHARACTERISTIC FaultManager.Electric_Motor_Derated_Over_Temperature.Total_Samples__Y_ "Fault manager configuration.  Select up to 4 actions for each fault." VALUE 0x80000BDE RecordLayout_7 0 CompuMethod_1 0 65535 /end CHARACTERISTIC
/begin CHARACTERISTIC FaultManager.Electric_Motor_Derated_Over_Temperature.Action_1 "Fault manager configuration.  Select up to 4 actions for each fault." VALUE 0x80000BE0 RecordLayout_7 0 CompuMethod_491 0 65535 /end CHARACTERISTIC
/begin CHARACTERISTIC FaultManager.Electric_Motor_Derated_Over_Temperature.Action_1_Condition "Fault manager configuration.  Select up to 4 actions for each fault." VALUE 0x80000BE2 RecordLayout_7 0 CompuMethod_492 0 65535 /end CHARACTERISTIC
/begin CHARACTERISTIC FaultManager.Electric_Motor_Derated_Over_Temperature.Action_2 "Fault manager configuration.  Select up to 4 actions for each fault." VALUE 0x80000BE4 RecordLayout_7 0 CompuMethod_491 0 65535 /end CHARACTERISTIC
/begin CHARACTERISTIC FaultManager.Electric_Motor_Derated_Over_Temperature.Action_2_Condition "Fault manager configuration.  Select up to 4 actions for each fault." VALUE 0x80000BE6 RecordLayout_7 0 CompuMethod_492 0 65535 /end CHARACTERISTIC
/begin CHARACTERISTIC FaultManager.Electric_Motor_Derated_Over_Temperature.Action_3 "Fault manager configuration.  Select up to 4 actions for each fault." VALUE 0x80000BE8 RecordLayout_7 0 CompuMethod_491 0 65535 /end CHARACTERISTIC
/begin CHARACTERISTIC FaultManager.Electric_Motor_Derated_Over_Temperature.Action_3_Condition "Fault manager configuration.  Select up to 4 actions for each fault." VALUE 0x80000BEA RecordLayout_7 0 CompuMethod_492 0 65535 /end CHARACTERISTIC
/begin CHARACTERISTIC FaultManager.Electric_Motor_Derated_Over_Temperature.Action_4 "Fault manager configuration.  Select up to 4 actions for each fault." VALUE 0x80000BEC RecordLayout_7 0 CompuMethod_491 0 65535 /end CHARACTERISTIC
/begin CHARACTERISTIC FaultManager.Electric_Motor_Derated_Over_Temperature.Action_4_Condition "Fault manager configuration.  Select up to 4 actions for each fault." VALUE 0x80000BEE RecordLayout_7 0 CompuMethod_492 0 65535 /end CHARACTERISTIC
/begin CHARACTERISTIC FaultManager.Electric_Motor_Derated_Over_Voltage.Mode "Fault manager configuration.  Select up to 4 actions for each fault." VALUE 0x80000BF0 RecordLayout_7 0 CompuMethod_489 0 65535 /end CHARACTERISTIC
/begin CHARACTERISTIC FaultManager.Electric_Motor_Derated_Over_Voltage.ID "Fault manager configuration.  Select up to 4 actions for each fault." VALUE 0x80000BF2 RecordLayout_7 0 CompuMethod_1 0 65535 /end CHARACTERISTIC
/begin CHARACTERISTIC FaultManager.Electric_Motor_Derated_Over_Voltage.Test "Fault manager configuration.  Select up to 4 actions for each fault." VALUE 0x80000BF4 RecordLayout_7 0 CompuMethod_490 0 65535 /end CHARACTERISTIC
/begin CHARACTERISTIC FaultManager.Electric_Motor_Derated_Over_Voltage.Faulty_Samples__X_ "Fault manager configuration.  Select up to 4 actions for each fault." VALUE 0x80000BF6 RecordLayout_7 0 CompuMethod_1 0 65535 /end CHARACTERISTIC
/begin CHARACTERISTIC FaultManager.Electric_Motor_Derated_Over_Voltage.Total_Samples__Y_ "Fault manager configuration.  Select up to 4 actions for each fault." VALUE 0x80000BF8 RecordLayout_7 0 CompuMethod_1 0 65535 /end CHARACTERISTIC
/begin CHARACTERISTIC FaultManager.Electric_Motor_Derated_Over_Voltage.Action_1 "Fault manager configuration.  Select up to 4 actions for each fault." VALUE 0x80000BFA RecordLayout_7 0 CompuMethod_491 0 65535 /end CHARACTERISTIC
/begin CHARACTERISTIC FaultManager.Electric_Motor_Derated_Over_Voltage.Action_1_Condition "Fault manager configuration.  Select up to 4 actions for each fault." VALUE 0x80000BFC RecordLayout_7 0 CompuMethod_492 0 65535 /end CHARACTERISTIC
/begin CHARACTERISTIC FaultManager.Electric_Motor_Derated_Over_Voltage.Action_2 "Fault manager configuration.  Select up to 4 actions for each fault." VALUE 0x80000BFE RecordLayout_7 0 CompuMethod_491 0 65535 /end CHARACTERISTIC
/begin CHARACTERISTIC FaultManager.Electric_Motor_Derated_Over_Voltage.Action_2_Condition "Fault manager configuration.  Select up to 4 actions for each fault." VALUE 0x80000C00 RecordLayout_7 0 CompuMethod_492 0 65535 /end CHARACTERISTIC
/begin CHARACTERISTIC FaultManager.Electric_Motor_Derated_Over_Voltage.Action_3 "Fault manager configuration.  Select up to 4 actions for each fault." VALUE 0x80000C02 RecordLayout_7 0 CompuMethod_491 0 65535 /end CHARACTERISTIC
/begin CHARACTERISTIC FaultManager.Electric_Motor_Derated_Over_Voltage.Action_3_Condition "Fault manager configuration.  Select up to 4 actions for each fault." VALUE 0x80000C04 RecordLayout_7 0 CompuMethod_492 0 65535 /end CHARACTERISTIC
/begin CHARACTERISTIC FaultManager.Electric_Motor_Derated_Over_Voltage.Action_4 "Fault manager configuration.  Select up to 4 actions for each fault." VALUE 0x80000C06 RecordLayout_7 0 CompuMethod_491 0 65535 /end CHARACTERISTIC
/begin CHARACTERISTIC FaultManager.Electric_Motor_Derated_Over_Voltage.Action_4_Condition "Fault manager configuration.  Select up to 4 actions for each fault." VALUE 0x80000C08 RecordLayout_7 0 CompuMethod_492 0 65535 /end CHARACTERISTIC
/begin CHARACTERISTIC FaultManager.Electric_Motor_Derated_Under_Temperature.Mode "Fault manager configuration.  Select up to 4 actions for each fault." VALUE 0x80000C0A RecordLayout_7 0 CompuMethod_489 0 65535 /end CHARACTERISTIC
/begin CHARACTERISTIC FaultManager.Electric_Motor_Derated_Under_Temperature.ID "Fault manager configuration.  Select up to 4 actions for each fault." VALUE 0x80000C0C RecordLayout_7 0 CompuMethod_1 0 65535 /end CHARACTERISTIC
/begin CHARACTERISTIC FaultManager.Electric_Motor_Derated_Under_Temperature.Test "Fault manager configuration.  Select up to 4 actions for each fault." VALUE 0x80000C0E RecordLayout_7 0 CompuMethod_490 0 65535 /end CHARACTERISTIC
/begin CHARACTERISTIC FaultManager.Electric_Motor_Derated_Under_Temperature.Faulty_Samples__X_ "Fault manager configuration.  Select up to 4 actions for each fault." VALUE 0x80000C10 RecordLayout_7 0 CompuMethod_1 0 65535 /end CHARACTERISTIC
/begin CHARACTERISTIC FaultManager.Electric_Motor_Derated_Under_Temperature.Total_Samples__Y_ "Fault manager configuration.  Select up to 4 actions for each fault." VALUE 0x80000C12 RecordLayout_7 0 CompuMethod_1 0 65535 /end CHARACTERISTIC
/begin CHARACTERISTIC FaultManager.Electric_Motor_Derated_Under_Temperature.Action_1 "Fault manager configuration.  Select up to 4 actions for each fault." VALUE 0x80000C14 RecordLayout_7 0 CompuMethod_491 0 65535 /end CHARACTERISTIC
/begin CHARACTERISTIC FaultManager.Electric_Motor_Derated_Under_Temperature.Action_1_Condition "Fault manager configuration.  Select up to 4 actions for each fault." VALUE 0x80000C16 RecordLayout_7 0 CompuMethod_492 0 65535 /end CHARACTERISTIC
/begin CHARACTERISTIC FaultManager.Electric_Motor_Derated_Under_Temperature.Action_2 "Fault manager configuration.  Select up to 4 actions for each fault." VALUE 0x80000C18 RecordLayout_7 0 CompuMethod_491 0 65535 /end CHARACTERISTIC
/begin CHARACTERISTIC FaultManager.Electric_Motor_Derated_Under_Temperature.Action_2_Condition "Fault manager configuration.  Select up to 4 actions for each fault." VALUE 0x80000C1A RecordLayout_7 0 CompuMethod_492 0 65535 /end CHARACTERISTIC
/begin CHARACTERISTIC FaultManager.Electric_Motor_Derated_Under_Temperature.Action_3 "Fault manager configuration.  Select up to 4 actions for each fault." VALUE 0x80000C1C RecordLayout_7 0 CompuMethod_491 0 65535 /end CHARACTERISTIC
/begin CHARACTERISTIC FaultManager.Electric_Motor_Derated_Under_Temperature.Action_3_Condition "Fault manager configuration.  Select up to 4 actions for each fault." VALUE 0x80000C1E RecordLayout_7 0 CompuMethod_492 0 65535 /end CHARACTERISTIC
/begin CHARACTERISTIC FaultManager.Electric_Motor_Derated_Under_Temperature.Action_4 "Fault manager configuration.  Select up to 4 actions for each fault." VALUE 0x80000C20 RecordLayout_7 0 CompuMethod_491 0 65535 /end CHARACTERISTIC
/begin CHARACTERISTIC FaultManager.Electric_Motor_Derated_Under_Temperature.Action_4_Condition "Fault manager configuration.  Select up to 4 actions for each fault." VALUE 0x80000C22 RecordLayout_7 0 CompuMethod_492 0 65535 /end CHARACTERISTIC
/begin CHARACTERISTIC FaultManager.Electric_Motor_Derated_Under_Voltage.Mode "Fault manager configuration.  Select up to 4 actions for each fault." VALUE 0x80000C24 RecordLayout_7 0 CompuMethod_489 0 65535 /end CHARACTERISTIC
/begin CHARACTERISTIC FaultManager.Electric_Motor_Derated_Under_Voltage.ID "Fault manager configuration.  Select up to 4 actions for each fault." VALUE 0x80000C26 RecordLayout_7 0 CompuMethod_1 0 65535 /end CHARACTERISTIC
/begin CHARACTERISTIC FaultManager.Electric_Motor_Derated_Under_Voltage.Test "Fault manager configuration.  Select up to 4 actions for each fault." VALUE 0x80000C28 RecordLayout_7 0 CompuMethod_490 0 65535 /end CHARACTERISTIC
/begin CHARACTERISTIC FaultManager.Electric_Motor_Derated_Under_Voltage.Faulty_Samples__X_ "Fault manager configuration.  Select up to 4 actions for each fault." VALUE 0x80000C2A RecordLayout_7 0 CompuMethod_1 0 65535 /end CHARACTERISTIC
/begin CHARACTERISTIC FaultManager.Electric_Motor_Derated_Under_Voltage.Total_Samples__Y_ "Fault manager configuration.  Select up to 4 actions for each fault." VALUE 0x80000C2C RecordLayout_7 0 CompuMethod_1 0 65535 /end CHARACTERISTIC
/begin CHARACTERISTIC FaultManager.Electric_Motor_Derated_Under_Voltage.Action_1 "Fault manager configuration.  Select up to 4 actions for each fault." VALUE 0x80000C2E RecordLayout_7 0 CompuMethod_491 0 65535 /end CHARACTERISTIC
/begin CHARACTERISTIC FaultManager.Electric_Motor_Derated_Under_Voltage.Action_1_Condition "Fault manager configuration.  Select up to 4 actions for each fault." VALUE 0x80000C30 RecordLayout_7 0 CompuMethod_492 0 65535 /end CHARACTERISTIC
/begin CHARACTERISTIC FaultManager.Electric_Motor_Derated_Under_Voltage.Action_2 "Fault manager configuration.  Select up to 4 actions for each fault." VALUE 0x80000C32 RecordLayout_7 0 CompuMethod_491 0 65535 /end CHARACTERISTIC
/begin CHARACTERISTIC FaultManager.Electric_Motor_Derated_Under_Voltage.Action_2_Condition "Fault manager configuration.  Select up to 4 actions for each fault." VALUE 0x80000C34 RecordLayout_7 0 CompuMethod_492 0 65535 /end CHARACTERISTIC
/begin CHARACTERISTIC FaultManager.Electric_Motor_Derated_Under_Voltage.Action_3 "Fault manager configuration.  Select up to 4 actions for each fault." VALUE 0x80000C36 RecordLayout_7 0 CompuMethod_491 0 65535 /end CHARACTERISTIC
/begin CHARACTERISTIC FaultManager.Electric_Motor_Derated_Under_Voltage.Action_3_Condition "Fault manager configuration.  Select up to 4 actions for each fault." VALUE 0x80000C38 RecordLayout_7 0 CompuMethod_492 0 65535 /end CHARACTERISTIC
/begin CHARACTERISTIC FaultManager.Electric_Motor_Derated_Under_Voltage.Action_4 "Fault manager configuration.  Select up to 4 actions for each fault." VALUE 0x80000C3A RecordLayout_7 0 CompuMethod_491 0 65535 /end CHARACTERISTIC
/begin CHARACTERISTIC FaultManager.Electric_Motor_Derated_Under_Voltage.Action_4_Condition "Fault manager configuration.  Select up to 4 actions for each fault." VALUE 0x80000C3C RecordLayout_7 0 CompuMethod_492 0 65535 /end CHARACTERISTIC
/begin CHARACTERISTIC FaultManager.Electric_Motor_General_Error.Mode "Fault manager configuration.  Select up to 4 actions for each fault." VALUE 0x80000C3E RecordLayout_7 0 CompuMethod_489 0 65535 /end CHARACTERISTIC
/begin CHARACTERISTIC FaultManager.Electric_Motor_General_Error.ID "Fault manager configuration.  Select up to 4 actions for each fault." VALUE 0x80000C40 RecordLayout_7 0 CompuMethod_1 0 65535 /end CHARACTERISTIC
/begin CHARACTERISTIC FaultManager.Electric_Motor_General_Error.Test "Fault manager configuration.  Select up to 4 actions for each fault." VALUE 0x80000C42 RecordLayout_7 0 CompuMethod_490 0 65535 /end CHARACTERISTIC
/begin CHARACTERISTIC FaultManager.Electric_Motor_General_Error.Faulty_Samples__X_ "Fault manager configuration.  Select up to 4 actions for each fault." VALUE 0x80000C44 RecordLayout_7 0 CompuMethod_1 0 65535 /end CHARACTERISTIC
/begin CHARACTERISTIC FaultManager.Electric_Motor_General_Error.Total_Samples__Y_ "Fault manager configuration.  Select up to 4 actions for each fault." VALUE 0x80000C46 RecordLayout_7 0 CompuMethod_1 0 65535 /end CHARACTERISTIC
/begin CHARACTERISTIC FaultManager.Electric_Motor_General_Error.Action_1 "Fault manager configuration.  Select up to 4 actions for each fault." VALUE 0x80000C48 RecordLayout_7 0 CompuMethod_491 0 65535 /end CHARACTERISTIC
/begin CHARACTERISTIC FaultManager.Electric_Motor_General_Error.Action_1_Condition "Fault manager configuration.  Select up to 4 actions for each fault." VALUE 0x80000C4A RecordLayout_7 0 CompuMethod_492 0 65535 /end CHARACTERISTIC
/begin CHARACTERISTIC FaultManager.Electric_Motor_General_Error.Action_2 "Fault manager configuration.  Select up to 4 actions for each fault." VALUE 0x80000C4C RecordLayout_7 0 CompuMethod_491 0 65535 /end CHARACTERISTIC
/begin CHARACTERISTIC FaultManager.Electric_Motor_General_Error.Action_2_Condition "Fault manager configuration.  Select up to 4 actions for each fault." VALUE 0x80000C4E RecordLayout_7 0 CompuMethod_492 0 65535 /end CHARACTERISTIC
/begin CHARACTERISTIC FaultManager.Electric_Motor_General_Error.Action_3 "Fault manager configuration.  Select up to 4 actions for each fault." VALUE 0x80000C50 RecordLayout_7 0 CompuMethod_491 0 65535 /end CHARACTERISTIC
/begin CHARACTERISTIC FaultManager.Electric_Motor_General_Error.Action_3_Condition "Fault manager configuration.  Select up to 4 actions for each fault." VALUE 0x80000C52 RecordLayout_7 0 CompuMethod_492 0 65535 /end CHARACTERISTIC
/begin CHARACTERISTIC FaultManager.Electric_Motor_General_Error.Action_4 "Fault manager configuration.  Select up to 4 actions for each fault." VALUE 0x80000C54 RecordLayout_7 0 CompuMethod_491 0 65535 /end CHARACTERISTIC
/begin CHARACTERISTIC FaultManager.Electric_Motor_General_Error.Action_4_Condition "Fault manager configuration.  Select up to 4 actions for each fault." VALUE 0x80000C56 RecordLayout_7 0 CompuMethod_492 0 65535 /end CHARACTERISTIC
/begin CHARACTERISTIC FaultManager.Electric_Motor_Over_Speed_Forward.Mode "Fault manager configuration.  Select up to 4 actions for each fault." VALUE 0x80000C58 RecordLayout_7 0 CompuMethod_489 0 65535 /end CHARACTERISTIC
/begin CHARACTERISTIC FaultManager.Electric_Motor_Over_Speed_Forward.ID "Fault manager configuration.  Select up to 4 actions for each fault." VALUE 0x80000C5A RecordLayout_7 0 CompuMethod_1 0 65535 /end CHARACTERISTIC
/begin CHARACTERISTIC FaultManager.Electric_Motor_Over_Speed_Forward.Test "Fault manager configuration.  Select up to 4 actions for each fault." VALUE 0x80000C5C RecordLayout_7 0 CompuMethod_490 0 65535 /end CHARACTERISTIC
/begin CHARACTERISTIC FaultManager.Electric_Motor_Over_Speed_Forward.Faulty_Samples__X_ "Fault manager configuration.  Select up to 4 actions for each fault." VALUE 0x80000C5E RecordLayout_7 0 CompuMethod_1 0 65535 /end CHARACTERISTIC
/begin CHARACTERISTIC FaultManager.Electric_Motor_Over_Speed_Forward.Total_Samples__Y_ "Fault manager configuration.  Select up to 4 actions for each fault." VALUE 0x80000C60 RecordLayout_7 0 CompuMethod_1 0 65535 /end CHARACTERISTIC
/begin CHARACTERISTIC FaultManager.Electric_Motor_Over_Speed_Forward.Action_1 "Fault manager configuration.  Select up to 4 actions for each fault." VALUE 0x80000C62 RecordLayout_7 0 CompuMethod_491 0 65535 /end CHARACTERISTIC
/begin CHARACTERISTIC FaultManager.Electric_Motor_Over_Speed_Forward.Action_1_Condition "Fault manager configuration.  Select up to 4 actions for each fault." VALUE 0x80000C64 RecordLayout_7 0 CompuMethod_492 0 65535 /end CHARACTERISTIC
/begin CHARACTERISTIC FaultManager.Electric_Motor_Over_Speed_Forward.Action_2 "Fault manager configuration.  Select up to 4 actions for each fault." VALUE 0x80000C66 RecordLayout_7 0 CompuMethod_491 0 65535 /end CHARACTERISTIC
/begin CHARACTERISTIC FaultManager.Electric_Motor_Over_Speed_Forward.Action_2_Condition "Fault manager configuration.  Select up to 4 actions for each fault." VALUE 0x80000C68 RecordLayout_7 0 CompuMethod_492 0 65535 /end CHARACTERISTIC
/begin CHARACTERISTIC FaultManager.Electric_Motor_Over_Speed_Forward.Action_3 "Fault manager configuration.  Select up to 4 actions for each fault." VALUE 0x80000C6A RecordLayout_7 0 CompuMethod_491 0 65535 /end CHARACTERISTIC
/begin CHARACTERISTIC FaultManager.Electric_Motor_Over_Speed_Forward.Action_3_Condition "Fault manager configuration.  Select up to 4 actions for each fault." VALUE 0x80000C6C RecordLayout_7 0 CompuMethod_492 0 65535 /end CHARACTERISTIC
/begin CHARACTERISTIC FaultManager.Electric_Motor_Over_Speed_Forward.Action_4 "Fault manager configuration.  Select up to 4 actions for each fault." VALUE 0x80000C6E RecordLayout_7 0 CompuMethod_491 0 65535 /end CHARACTERISTIC
/begin CHARACTERISTIC FaultManager.Electric_Motor_Over_Speed_Forward.Action_4_Condition "Fault manager configuration.  Select up to 4 actions for each fault." VALUE 0x80000C70 RecordLayout_7 0 CompuMethod_492 0 65535 /end CHARACTERISTIC
/begin CHARACTERISTIC FaultManager.Electric_Motor_Over_Speed_Reverse.Mode "Fault manager configuration.  Select up to 4 actions for each fault." VALUE 0x80000C72 RecordLayout_7 0 CompuMethod_489 0 65535 /end CHARACTERISTIC
/begin CHARACTERISTIC FaultManager.Electric_Motor_Over_Speed_Reverse.ID "Fault manager configuration.  Select up to 4 actions for each fault." VALUE 0x80000C74 RecordLayout_7 0 CompuMethod_1 0 65535 /end CHARACTERISTIC
/begin CHARACTERISTIC FaultManager.Electric_Motor_Over_Speed_Reverse.Test "Fault manager configuration.  Select up to 4 actions for each fault." VALUE 0x80000C76 RecordLayout_7 0 CompuMethod_490 0 65535 /end CHARACTERISTIC
/begin CHARACTERISTIC FaultManager.Electric_Motor_Over_Speed_Reverse.Faulty_Samples__X_ "Fault manager configuration.  Select up to 4 actions for each fault." VALUE 0x80000C78 RecordLayout_7 0 CompuMethod_1 0 65535 /end CHARACTERISTIC
/begin CHARACTERISTIC FaultManager.Electric_Motor_Over_Speed_Reverse.Total_Samples__Y_ "Fault manager configuration.  Select up to 4 actions for each fault." VALUE 0x80000C7A RecordLayout_7 0 CompuMethod_1 0 65535 /end CHARACTERISTIC
/begin CHARACTERISTIC FaultManager.Electric_Motor_Over_Speed_Reverse.Action_1 "Fault manager configuration.  Select up to 4 actions for each fault." VALUE 0x80000C7C RecordLayout_7 0 CompuMethod_491 0 65535 /end CHARACTERISTIC
/begin CHARACTERISTIC FaultManager.Electric_Motor_Over_Speed_Reverse.Action_1_Condition "Fault manager configuration.  Select up to 4 actions for each fault." VALUE 0x80000C7E RecordLayout_7 0 CompuMethod_492 0 65535 /end CHARACTERISTIC
/begin CHARACTERISTIC FaultManager.Electric_Motor_Over_Speed_Reverse.Action_2 "Fault manager configuration.  Select up to 4 actions for each fault." VALUE 0x80000C80 RecordLayout_7 0 CompuMethod_491 0 65535 /end CHARACTERISTIC
/begin CHARACTERISTIC FaultManager.Electric_Motor_Over_Speed_Reverse.Action_2_Condition "Fault manager configuration.  Select up to 4 actions for each fault." VALUE 0x80000C82 RecordLayout_7 0 CompuMethod_492 0 65535 /end CHARACTERISTIC
/begin CHARACTERISTIC FaultManager.Electric_Motor_Over_Speed_Reverse.Action_3 "Fault manager configuration.  Select up to 4 actions for each fault." VALUE 0x80000C84 RecordLayout_7 0 CompuMethod_491 0 65535 /end CHARACTERISTIC
/begin CHARACTERISTIC FaultManager.Electric_Motor_Over_Speed_Reverse.Action_3_Condition "Fault manager configuration.  Select up to 4 actions for each fault." VALUE 0x80000C86 RecordLayout_7 0 CompuMethod_492 0 65535 /end CHARACTERISTIC
/begin CHARACTERISTIC FaultManager.Electric_Motor_Over_Speed_Reverse.Action_4 "Fault manager configuration.  Select up to 4 actions for each fault." VALUE 0x80000C88 RecordLayout_7 0 CompuMethod_491 0 65535 /end CHARACTERISTIC
/begin CHARACTERISTIC FaultManager.Electric_Motor_Over_Speed_Reverse.Action_4_Condition "Fault manager configuration.  Select up to 4 actions for each fault." VALUE 0x80000C8A RecordLayout_7 0 CompuMethod_492 0 65535 /end CHARACTERISTIC
/begin CHARACTERISTIC FaultManager.Electric_Motor_Shutodwn_Error.Mode "Fault manager configuration.  Select up to 4 actions for each fault." VALUE 0x80000C8C RecordLayout_7 0 CompuMethod_489 0 65535 /end CHARACTERISTIC
/begin CHARACTERISTIC FaultManager.Electric_Motor_Shutodwn_Error.ID "Fault manager configuration.  Select up to 4 actions for each fault." VALUE 0x80000C8E RecordLayout_7 0 CompuMethod_1 0 65535 /end CHARACTERISTIC
/begin CHARACTERISTIC FaultManager.Electric_Motor_Shutodwn_Error.Test "Fault manager configuration.  Select up to 4 actions for each fault." VALUE 0x80000C90 RecordLayout_7 0 CompuMethod_490 0 65535 /end CHARACTERISTIC
/begin CHARACTERISTIC FaultManager.Electric_Motor_Shutodwn_Error.Faulty_Samples__X_ "Fault manager configuration.  Select up to 4 actions for each fault." VALUE 0x80000C92 RecordLayout_7 0 CompuMethod_1 0 65535 /end CHARACTERISTIC
/begin CHARACTERISTIC FaultManager.Electric_Motor_Shutodwn_Error.Total_Samples__Y_ "Fault manager configuration.  Select up to 4 actions for each fault." VALUE 0x80000C94 RecordLayout_7 0 CompuMethod_1 0 65535 /end CHARACTERISTIC
/begin CHARACTERISTIC FaultManager.Electric_Motor_Shutodwn_Error.Action_1 "Fault manager configuration.  Select up to 4 actions for each fault." VALUE 0x80000C96 RecordLayout_7 0 CompuMethod_491 0 65535 /end CHARACTERISTIC
/begin CHARACTERISTIC FaultManager.Electric_Motor_Shutodwn_Error.Action_1_Condition "Fault manager configuration.  Select up to 4 actions for each fault." VALUE 0x80000C98 RecordLayout_7 0 CompuMethod_492 0 65535 /end CHARACTERISTIC
/begin CHARACTERISTIC FaultManager.Electric_Motor_Shutodwn_Error.Action_2 "Fault manager configuration.  Select up to 4 actions for each fault." VALUE 0x80000C9A RecordLayout_7 0 CompuMethod_491 0 65535 /end CHARACTERISTIC
/begin CHARACTERISTIC FaultManager.Electric_Motor_Shutodwn_Error.Action_2_Condition "Fault manager configuration.  Select up to 4 actions for each fault." VALUE 0x80000C9C RecordLayout_7 0 CompuMethod_492 0 65535 /end CHARACTERISTIC
/begin CHARACTERISTIC FaultManager.Electric_Motor_Shutodwn_Error.Action_3 "Fault manager configuration.  Select up to 4 actions for each fault." VALUE 0x80000C9E RecordLayout_7 0 CompuMethod_491 0 65535 /end CHARACTERISTIC
/begin CHARACTERISTIC FaultManager.Electric_Motor_Shutodwn_Error.Action_3_Condition "Fault manager configuration.  Select up to 4 actions for each fault." VALUE 0x80000CA0 RecordLayout_7 0 CompuMethod_492 0 65535 /end CHARACTERISTIC
/begin CHARACTERISTIC FaultManager.Electric_Motor_Shutodwn_Error.Action_4 "Fault manager configuration.  Select up to 4 actions for each fault." VALUE 0x80000CA2 RecordLayout_7 0 CompuMethod_491 0 65535 /end CHARACTERISTIC
/begin CHARACTERISTIC FaultManager.Electric_Motor_Shutodwn_Error.Action_4_Condition "Fault manager configuration.  Select up to 4 actions for each fault." VALUE 0x80000CA4 RecordLayout_7 0 CompuMethod_492 0 65535 /end CHARACTERISTIC
/begin CHARACTERISTIC FaultManager.Electric_Motor_Torque_Output_Fault.Mode "Fault manager configuration.  Select up to 4 actions for each fault." VALUE 0x80000CA6 RecordLayout_7 0 CompuMethod_489 0 65535 /end CHARACTERISTIC
/begin CHARACTERISTIC FaultManager.Electric_Motor_Torque_Output_Fault.ID "Fault manager configuration.  Select up to 4 actions for each fault." VALUE 0x80000CA8 RecordLayout_7 0 CompuMethod_1 0 65535 /end CHARACTERISTIC
/begin CHARACTERISTIC FaultManager.Electric_Motor_Torque_Output_Fault.Test "Fault manager configuration.  Select up to 4 actions for each fault." VALUE 0x80000CAA RecordLayout_7 0 CompuMethod_490 0 65535 /end CHARACTERISTIC
/begin CHARACTERISTIC FaultManager.Electric_Motor_Torque_Output_Fault.Faulty_Samples__X_ "Fault manager configuration.  Select up to 4 actions for each fault." VALUE 0x80000CAC RecordLayout_7 0 CompuMethod_1 0 65535 /end CHARACTERISTIC
/begin CHARACTERISTIC FaultManager.Electric_Motor_Torque_Output_Fault.Total_Samples__Y_ "Fault manager configuration.  Select up to 4 actions for each fault." VALUE 0x80000CAE RecordLayout_7 0 CompuMethod_1 0 65535 /end CHARACTERISTIC
/begin CHARACTERISTIC FaultManager.Electric_Motor_Torque_Output_Fault.Action_1 "Fault manager configuration.  Select up to 4 actions for each fault." VALUE 0x80000CB0 RecordLayout_7 0 CompuMethod_491 0 65535 /end CHARACTERISTIC
/begin CHARACTERISTIC FaultManager.Electric_Motor_Torque_Output_Fault.Action_1_Condition "Fault manager configuration.  Select up to 4 actions for each fault." VALUE 0x80000CB2 RecordLayout_7 0 CompuMethod_492 0 65535 /end CHARACTERISTIC
/begin CHARACTERISTIC FaultManager.Electric_Motor_Torque_Output_Fault.Action_2 "Fault manager configuration.  Select up to 4 actions for each fault." VALUE 0x80000CB4 RecordLayout_7 0 CompuMethod_491 0 65535 /end CHARACTERISTIC
/begin CHARACTERISTIC FaultManager.Electric_Motor_Torque_Output_Fault.Action_2_Condition "Fault manager configuration.  Select up to 4 actions for each fault." VALUE 0x80000CB6 RecordLayout_7 0 CompuMethod_492 0 65535 /end CHARACTERISTIC
/begin CHARACTERISTIC FaultManager.Electric_Motor_Torque_Output_Fault.Action_3 "Fault manager configuration.  Select up to 4 actions for each fault." VALUE 0x80000CB8 RecordLayout_7 0 CompuMethod_491 0 65535 /end CHARACTERISTIC
/begin CHARACTERISTIC FaultManager.Electric_Motor_Torque_Output_Fault.Action_3_Condition "Fault manager configuration.  Select up to 4 actions for each fault." VALUE 0x80000CBA RecordLayout_7 0 CompuMethod_492 0 65535 /end CHARACTERISTIC
/begin CHARACTERISTIC FaultManager.Electric_Motor_Torque_Output_Fault.Action_4 "Fault manager configuration.  Select up to 4 actions for each fault." VALUE 0x80000CBC RecordLayout_7 0 CompuMethod_491 0 65535 /end CHARACTERISTIC
/begin CHARACTERISTIC FaultManager.Electric_Motor_Torque_Output_Fault.Action_4_Condition "Fault manager configuration.  Select up to 4 actions for each fault." VALUE 0x80000CBE RecordLayout_7 0 CompuMethod_492 0 65535 /end CHARACTERISTIC
/begin CHARACTERISTIC FaultManager.Gear_Shift_Communication_Circuit.Mode "Fault manager configuration.  Select up to 4 actions for each fault." VALUE 0x80000CC0 RecordLayout_7 0 CompuMethod_489 0 65535 /end CHARACTERISTIC
/begin CHARACTERISTIC FaultManager.Gear_Shift_Communication_Circuit.ID "Fault manager configuration.  Select up to 4 actions for each fault." VALUE 0x80000CC2 RecordLayout_7 0 CompuMethod_1 0 65535 /end CHARACTERISTIC
/begin CHARACTERISTIC FaultManager.Gear_Shift_Communication_Circuit.Test "Fault manager configuration.  Select up to 4 actions for each fault." VALUE 0x80000CC4 RecordLayout_7 0 CompuMethod_490 0 65535 /end CHARACTERISTIC
/begin CHARACTERISTIC FaultManager.Gear_Shift_Communication_Circuit.Faulty_Samples__X_ "Fault manager configuration.  Select up to 4 actions for each fault." VALUE 0x80000CC6 RecordLayout_7 0 CompuMethod_1 0 65535 /end CHARACTERISTIC
/begin CHARACTERISTIC FaultManager.Gear_Shift_Communication_Circuit.Total_Samples__Y_ "Fault manager configuration.  Select up to 4 actions for each fault." VALUE 0x80000CC8 RecordLayout_7 0 CompuMethod_1 0 65535 /end CHARACTERISTIC
/begin CHARACTERISTIC FaultManager.Gear_Shift_Communication_Circuit.Action_1 "Fault manager configuration.  Select up to 4 actions for each fault." VALUE 0x80000CCA RecordLayout_7 0 CompuMethod_491 0 65535 /end CHARACTERISTIC
/begin CHARACTERISTIC FaultManager.Gear_Shift_Communication_Circuit.Action_1_Condition "Fault manager configuration.  Select up to 4 actions for each fault." VALUE 0x80000CCC RecordLayout_7 0 CompuMethod_492 0 65535 /end CHARACTERISTIC
/begin CHARACTERISTIC FaultManager.Gear_Shift_Communication_Circuit.Action_2 "Fault manager configuration.  Select up to 4 actions for each fault." VALUE 0x80000CCE RecordLayout_7 0 CompuMethod_491 0 65535 /end CHARACTERISTIC
/begin CHARACTERISTIC FaultManager.Gear_Shift_Communication_Circuit.Action_2_Condition "Fault manager configuration.  Select up to 4 actions for each fault." VALUE 0x80000CD0 RecordLayout_7 0 CompuMethod_492 0 65535 /end CHARACTERISTIC
/begin CHARACTERISTIC FaultManager.Gear_Shift_Communication_Circuit.Action_3 "Fault manager configuration.  Select up to 4 actions for each fault." VALUE 0x80000CD2 RecordLayout_7 0 CompuMethod_491 0 65535 /end CHARACTERISTIC
/begin CHARACTERISTIC FaultManager.Gear_Shift_Communication_Circuit.Action_3_Condition "Fault manager configuration.  Select up to 4 actions for each fault." VALUE 0x80000CD4 RecordLayout_7 0 CompuMethod_492 0 65535 /end CHARACTERISTIC
/begin CHARACTERISTIC FaultManager.Gear_Shift_Communication_Circuit.Action_4 "Fault manager configuration.  Select up to 4 actions for each fault." VALUE 0x80000CD6 RecordLayout_7 0 CompuMethod_491 0 65535 /end CHARACTERISTIC
/begin CHARACTERISTIC FaultManager.Gear_Shift_Communication_Circuit.Action_4_Condition "Fault manager configuration.  Select up to 4 actions for each fault." VALUE 0x80000CD8 RecordLayout_7 0 CompuMethod_492 0 65535 /end CHARACTERISTIC
/begin CHARACTERISTIC FaultManager.HV_Battery_2G_BMS_Fault.Mode "Fault manager configuration.  Select up to 4 actions for each fault." VALUE 0x80000CDA RecordLayout_7 0 CompuMethod_489 0 65535 /end CHARACTERISTIC
/begin CHARACTERISTIC FaultManager.HV_Battery_2G_BMS_Fault.ID "Fault manager configuration.  Select up to 4 actions for each fault." VALUE 0x80000CDC RecordLayout_7 0 CompuMethod_1 0 65535 /end CHARACTERISTIC
/begin CHARACTERISTIC FaultManager.HV_Battery_2G_BMS_Fault.Test "Fault manager configuration.  Select up to 4 actions for each fault." VALUE 0x80000CDE RecordLayout_7 0 CompuMethod_490 0 65535 /end CHARACTERISTIC
/begin CHARACTERISTIC FaultManager.HV_Battery_2G_BMS_Fault.Faulty_Samples__X_ "Fault manager configuration.  Select up to 4 actions for each fault." VALUE 0x80000CE0 RecordLayout_7 0 CompuMethod_1 0 65535 /end CHARACTERISTIC
/begin CHARACTERISTIC FaultManager.HV_Battery_2G_BMS_Fault.Total_Samples__Y_ "Fault manager configuration.  Select up to 4 actions for each fault." VALUE 0x80000CE2 RecordLayout_7 0 CompuMethod_1 0 65535 /end CHARACTERISTIC
/begin CHARACTERISTIC FaultManager.HV_Battery_2G_BMS_Fault.Action_1 "Fault manager configuration.  Select up to 4 actions for each fault." VALUE 0x80000CE4 RecordLayout_7 0 CompuMethod_491 0 65535 /end CHARACTERISTIC
/begin CHARACTERISTIC FaultManager.HV_Battery_2G_BMS_Fault.Action_1_Condition "Fault manager configuration.  Select up to 4 actions for each fault." VALUE 0x80000CE6 RecordLayout_7 0 CompuMethod_492 0 65535 /end CHARACTERISTIC
/begin CHARACTERISTIC FaultManager.HV_Battery_2G_BMS_Fault.Action_2 "Fault manager configuration.  Select up to 4 actions for each fault." VALUE 0x80000CE8 RecordLayout_7 0 CompuMethod_491 0 65535 /end CHARACTERISTIC
/begin CHARACTERISTIC FaultManager.HV_Battery_2G_BMS_Fault.Action_2_Condition "Fault manager configuration.  Select up to 4 actions for each fault." VALUE 0x80000CEA RecordLayout_7 0 CompuMethod_492 0 65535 /end CHARACTERISTIC
/begin CHARACTERISTIC FaultManager.HV_Battery_2G_BMS_Fault.Action_3 "Fault manager configuration.  Select up to 4 actions for each fault." VALUE 0x80000CEC RecordLayout_7 0 CompuMethod_491 0 65535 /end CHARACTERISTIC
/begin CHARACTERISTIC FaultManager.HV_Battery_2G_BMS_Fault.Action_3_Condition "Fault manager configuration.  Select up to 4 actions for each fault." VALUE 0x80000CEE RecordLayout_7 0 CompuMethod_492 0 65535 /end CHARACTERISTIC
/begin CHARACTERISTIC FaultManager.HV_Battery_2G_BMS_Fault.Action_4 "Fault manager configuration.  Select up to 4 actions for each fault." VALUE 0x80000CF0 RecordLayout_7 0 CompuMethod_491 0 65535 /end CHARACTERISTIC
/begin CHARACTERISTIC FaultManager.HV_Battery_2G_BMS_Fault.Action_4_Condition "Fault manager configuration.  Select up to 4 actions for each fault." VALUE 0x80000CF2 RecordLayout_7 0 CompuMethod_492 0 65535 /end CHARACTERISTIC
/begin CHARACTERISTIC FaultManager.HV_Battery_48_Controller_Communication_Fault.Mode "Fault manager configuration.  Select up to 4 actions for each fault." VALUE 0x80000CF4 RecordLayout_7 0 CompuMethod_489 0 65535 /end CHARACTERISTIC
/begin CHARACTERISTIC FaultManager.HV_Battery_48_Controller_Communication_Fault.ID "Fault manager configuration.  Select up to 4 actions for each fault." VALUE 0x80000CF6 RecordLayout_7 0 CompuMethod_1 0 65535 /end CHARACTERISTIC
/begin CHARACTERISTIC FaultManager.HV_Battery_48_Controller_Communication_Fault.Test "Fault manager configuration.  Select up to 4 actions for each fault." VALUE 0x80000CF8 RecordLayout_7 0 CompuMethod_490 0 65535 /end CHARACTERISTIC
/begin CHARACTERISTIC FaultManager.HV_Battery_48_Controller_Communication_Fault.Faulty_Samples__X_ "Fault manager configuration.  Select up to 4 actions for each fault." VALUE 0x80000CFA RecordLayout_7 0 CompuMethod_1 0 65535 /end CHARACTERISTIC
/begin CHARACTERISTIC FaultManager.HV_Battery_48_Controller_Communication_Fault.Total_Samples__Y_ "Fault manager configuration.  Select up to 4 actions for each fault." VALUE 0x80000CFC RecordLayout_7 0 CompuMethod_1 0 65535 /end CHARACTERISTIC
/begin CHARACTERISTIC FaultManager.HV_Battery_48_Controller_Communication_Fault.Action_1 "Fault manager configuration.  Select up to 4 actions for each fault." VALUE 0x80000CFE RecordLayout_7 0 CompuMethod_491 0 65535 /end CHARACTERISTIC
/begin CHARACTERISTIC FaultManager.HV_Battery_48_Controller_Communication_Fault.Action_1_Condition "Fault manager configuration.  Select up to 4 actions for each fault." VALUE 0x80000D00 RecordLayout_7 0 CompuMethod_492 0 65535 /end CHARACTERISTIC
/begin CHARACTERISTIC FaultManager.HV_Battery_48_Controller_Communication_Fault.Action_2 "Fault manager configuration.  Select up to 4 actions for each fault." VALUE 0x80000D02 RecordLayout_7 0 CompuMethod_491 0 65535 /end CHARACTERISTIC
/begin CHARACTERISTIC FaultManager.HV_Battery_48_Controller_Communication_Fault.Action_2_Condition "Fault manager configuration.  Select up to 4 actions for each fault." VALUE 0x80000D04 RecordLayout_7 0 CompuMethod_492 0 65535 /end CHARACTERISTIC
/begin CHARACTERISTIC FaultManager.HV_Battery_48_Controller_Communication_Fault.Action_3 "Fault manager configuration.  Select up to 4 actions for each fault." VALUE 0x80000D06 RecordLayout_7 0 CompuMethod_491 0 65535 /end CHARACTERISTIC
/begin CHARACTERISTIC FaultManager.HV_Battery_48_Controller_Communication_Fault.Action_3_Condition "Fault manager configuration.  Select up to 4 actions for each fault." VALUE 0x80000D08 RecordLayout_7 0 CompuMethod_492 0 65535 /end CHARACTERISTIC
/begin CHARACTERISTIC FaultManager.HV_Battery_48_Controller_Communication_Fault.Action_4 "Fault manager configuration.  Select up to 4 actions for each fault." VALUE 0x80000D0A RecordLayout_7 0 CompuMethod_491 0 65535 /end CHARACTERISTIC
/begin CHARACTERISTIC FaultManager.HV_Battery_48_Controller_Communication_Fault.Action_4_Condition "Fault manager configuration.  Select up to 4 actions for each fault." VALUE 0x80000D0C RecordLayout_7 0 CompuMethod_492 0 65535 /end CHARACTERISTIC
/begin CHARACTERISTIC FaultManager.HV_Battery_Above_Safe_Charge_Point.Mode "Fault manager configuration.  Select up to 4 actions for each fault." VALUE 0x80000D0E RecordLayout_7 0 CompuMethod_489 0 65535 /end CHARACTERISTIC
/begin CHARACTERISTIC FaultManager.HV_Battery_Above_Safe_Charge_Point.ID "Fault manager configuration.  Select up to 4 actions for each fault." VALUE 0x80000D10 RecordLayout_7 0 CompuMethod_1 0 65535 /end CHARACTERISTIC
/begin CHARACTERISTIC FaultManager.HV_Battery_Above_Safe_Charge_Point.Test "Fault manager configuration.  Select up to 4 actions for each fault." VALUE 0x80000D12 RecordLayout_7 0 CompuMethod_490 0 65535 /end CHARACTERISTIC
/begin CHARACTERISTIC FaultManager.HV_Battery_Above_Safe_Charge_Point.Faulty_Samples__X_ "Fault manager configuration.  Select up to 4 actions for each fault." VALUE 0x80000D14 RecordLayout_7 0 CompuMethod_1 0 65535 /end CHARACTERISTIC
/begin CHARACTERISTIC FaultManager.HV_Battery_Above_Safe_Charge_Point.Total_Samples__Y_ "Fault manager configuration.  Select up to 4 actions for each fault." VALUE 0x80000D16 RecordLayout_7 0 CompuMethod_1 0 65535 /end CHARACTERISTIC
/begin CHARACTERISTIC FaultManager.HV_Battery_Above_Safe_Charge_Point.Action_1 "Fault manager configuration.  Select up to 4 actions for each fault." VALUE 0x80000D18 RecordLayout_7 0 CompuMethod_491 0 65535 /end CHARACTERISTIC
/begin CHARACTERISTIC FaultManager.HV_Battery_Above_Safe_Charge_Point.Action_1_Condition "Fault manager configuration.  Select up to 4 actions for each fault." VALUE 0x80000D1A RecordLayout_7 0 CompuMethod_492 0 65535 /end CHARACTERISTIC
/begin CHARACTERISTIC FaultManager.HV_Battery_Above_Safe_Charge_Point.Action_2 "Fault manager configuration.  Select up to 4 actions for each fault." VALUE 0x80000D1C RecordLayout_7 0 CompuMethod_491 0 65535 /end CHARACTERISTIC
/begin CHARACTERISTIC FaultManager.HV_Battery_Above_Safe_Charge_Point.Action_2_Condition "Fault manager configuration.  Select up to 4 actions for each fault." VALUE 0x80000D1E RecordLayout_7 0 CompuMethod_492 0 65535 /end CHARACTERISTIC
/begin CHARACTERISTIC FaultManager.HV_Battery_Above_Safe_Charge_Point.Action_3 "Fault manager configuration.  Select up to 4 actions for each fault." VALUE 0x80000D20 RecordLayout_7 0 CompuMethod_491 0 65535 /end CHARACTERISTIC
/begin CHARACTERISTIC FaultManager.HV_Battery_Above_Safe_Charge_Point.Action_3_Condition "Fault manager configuration.  Select up to 4 actions for each fault." VALUE 0x80000D22 RecordLayout_7 0 CompuMethod_492 0 65535 /end CHARACTERISTIC
/begin CHARACTERISTIC FaultManager.HV_Battery_Above_Safe_Charge_Point.Action_4 "Fault manager configuration.  Select up to 4 actions for each fault." VALUE 0x80000D24 RecordLayout_7 0 CompuMethod_491 0 65535 /end CHARACTERISTIC
/begin CHARACTERISTIC FaultManager.HV_Battery_Above_Safe_Charge_Point.Action_4_Condition "Fault manager configuration.  Select up to 4 actions for each fault." VALUE 0x80000D26 RecordLayout_7 0 CompuMethod_492 0 65535 /end CHARACTERISTIC
/begin CHARACTERISTIC FaultManager.HV_Battery_Cell_Balancing_Required_Fault.Mode "Fault manager configuration.  Select up to 4 actions for each fault." VALUE 0x80000D28 RecordLayout_7 0 CompuMethod_489 0 65535 /end CHARACTERISTIC
/begin CHARACTERISTIC FaultManager.HV_Battery_Cell_Balancing_Required_Fault.ID "Fault manager configuration.  Select up to 4 actions for each fault." VALUE 0x80000D2A RecordLayout_7 0 CompuMethod_1 0 65535 /end CHARACTERISTIC
/begin CHARACTERISTIC FaultManager.HV_Battery_Cell_Balancing_Required_Fault.Test "Fault manager configuration.  Select up to 4 actions for each fault." VALUE 0x80000D2C RecordLayout_7 0 CompuMethod_490 0 65535 /end CHARACTERISTIC
/begin CHARACTERISTIC FaultManager.HV_Battery_Cell_Balancing_Required_Fault.Faulty_Samples__X_ "Fault manager configuration.  Select up to 4 actions for each fault." VALUE 0x80000D2E RecordLayout_7 0 CompuMethod_1 0 65535 /end CHARACTERISTIC
/begin CHARACTERISTIC FaultManager.HV_Battery_Cell_Balancing_Required_Fault.Total_Samples__Y_ "Fault manager configuration.  Select up to 4 actions for each fault." VALUE 0x80000D30 RecordLayout_7 0 CompuMethod_1 0 65535 /end CHARACTERISTIC
/begin CHARACTERISTIC FaultManager.HV_Battery_Cell_Balancing_Required_Fault.Action_1 "Fault manager configuration.  Select up to 4 actions for each fault." VALUE 0x80000D32 RecordLayout_7 0 CompuMethod_491 0 65535 /end CHARACTERISTIC
/begin CHARACTERISTIC FaultManager.HV_Battery_Cell_Balancing_Required_Fault.Action_1_Condition "Fault manager configuration.  Select up to 4 actions for each fault." VALUE 0x80000D34 RecordLayout_7 0 CompuMethod_492 0 65535 /end CHARACTERISTIC
/begin CHARACTERISTIC FaultManager.HV_Battery_Cell_Balancing_Required_Fault.Action_2 "Fault manager configuration.  Select up to 4 actions for each fault." VALUE 0x80000D36 RecordLayout_7 0 CompuMethod_491 0 65535 /end CHARACTERISTIC
/begin CHARACTERISTIC FaultManager.HV_Battery_Cell_Balancing_Required_Fault.Action_2_Condition "Fault manager configuration.  Select up to 4 actions for each fault." VALUE 0x80000D38 RecordLayout_7 0 CompuMethod_492 0 65535 /end CHARACTERISTIC
/begin CHARACTERISTIC FaultManager.HV_Battery_Cell_Balancing_Required_Fault.Action_3 "Fault manager configuration.  Select up to 4 actions for each fault." VALUE 0x80000D3A RecordLayout_7 0 CompuMethod_491 0 65535 /end CHARACTERISTIC
/begin CHARACTERISTIC FaultManager.HV_Battery_Cell_Balancing_Required_Fault.Action_3_Condition "Fault manager configuration.  Select up to 4 actions for each fault." VALUE 0x80000D3C RecordLayout_7 0 CompuMethod_492 0 65535 /end CHARACTERISTIC
/begin CHARACTERISTIC FaultManager.HV_Battery_Cell_Balancing_Required_Fault.Action_4 "Fault manager configuration.  Select up to 4 actions for each fault." VALUE 0x80000D3E RecordLayout_7 0 CompuMethod_491 0 65535 /end CHARACTERISTIC
/begin CHARACTERISTIC FaultManager.HV_Battery_Cell_Balancing_Required_Fault.Action_4_Condition "Fault manager configuration.  Select up to 4 actions for each fault." VALUE 0x80000D40 RecordLayout_7 0 CompuMethod_492 0 65535 /end CHARACTERISTIC
/begin CHARACTERISTIC FaultManager.HV_Battery_Pack_Above_Operating_Temperature.Mode "Fault manager configuration.  Select up to 4 actions for each fault." VALUE 0x80000D42 RecordLayout_7 0 CompuMethod_489 0 65535 /end CHARACTERISTIC
/begin CHARACTERISTIC FaultManager.HV_Battery_Pack_Above_Operating_Temperature.ID "Fault manager configuration.  Select up to 4 actions for each fault." VALUE 0x80000D44 RecordLayout_7 0 CompuMethod_1 0 65535 /end CHARACTERISTIC
/begin CHARACTERISTIC FaultManager.HV_Battery_Pack_Above_Operating_Temperature.Test "Fault manager configuration.  Select up to 4 actions for each fault." VALUE 0x80000D46 RecordLayout_7 0 CompuMethod_490 0 65535 /end CHARACTERISTIC
/begin CHARACTERISTIC FaultManager.HV_Battery_Pack_Above_Operating_Temperature.Faulty_Samples__X_ "Fault manager configuration.  Select up to 4 actions for each fault." VALUE 0x80000D48 RecordLayout_7 0 CompuMethod_1 0 65535 /end CHARACTERISTIC
/begin CHARACTERISTIC FaultManager.HV_Battery_Pack_Above_Operating_Temperature.Total_Samples__Y_ "Fault manager configuration.  Select up to 4 actions for each fault." VALUE 0x80000D4A RecordLayout_7 0 CompuMethod_1 0 65535 /end CHARACTERISTIC
/begin CHARACTERISTIC FaultManager.HV_Battery_Pack_Above_Operating_Temperature.Action_1 "Fault manager configuration.  Select up to 4 actions for each fault." VALUE 0x80000D4C RecordLayout_7 0 CompuMethod_491 0 65535 /end CHARACTERISTIC
/begin CHARACTERISTIC FaultManager.HV_Battery_Pack_Above_Operating_Temperature.Action_1_Condition "Fault manager configuration.  Select up to 4 actions for each fault." VALUE 0x80000D4E RecordLayout_7 0 CompuMethod_492 0 65535 /end CHARACTERISTIC
/begin CHARACTERISTIC FaultManager.HV_Battery_Pack_Above_Operating_Temperature.Action_2 "Fault manager configuration.  Select up to 4 actions for each fault." VALUE 0x80000D50 RecordLayout_7 0 CompuMethod_491 0 65535 /end CHARACTERISTIC
/begin CHARACTERISTIC FaultManager.HV_Battery_Pack_Above_Operating_Temperature.Action_2_Condition "Fault manager configuration.  Select up to 4 actions for each fault." VALUE 0x80000D52 RecordLayout_7 0 CompuMethod_492 0 65535 /end CHARACTERISTIC
/begin CHARACTERISTIC FaultManager.HV_Battery_Pack_Above_Operating_Temperature.Action_3 "Fault manager configuration.  Select up to 4 actions for each fault." VALUE 0x80000D54 RecordLayout_7 0 CompuMethod_491 0 65535 /end CHARACTERISTIC
/begin CHARACTERISTIC FaultManager.HV_Battery_Pack_Above_Operating_Temperature.Action_3_Condition "Fault manager configuration.  Select up to 4 actions for each fault." VALUE 0x80000D56 RecordLayout_7 0 CompuMethod_492 0 65535 /end CHARACTERISTIC
/begin CHARACTERISTIC FaultManager.HV_Battery_Pack_Above_Operating_Temperature.Action_4 "Fault manager configuration.  Select up to 4 actions for each fault." VALUE 0x80000D58 RecordLayout_7 0 CompuMethod_491 0 65535 /end CHARACTERISTIC
/begin CHARACTERISTIC FaultManager.HV_Battery_Pack_Above_Operating_Temperature.Action_4_Condition "Fault manager configuration.  Select up to 4 actions for each fault." VALUE 0x80000D5A RecordLayout_7 0 CompuMethod_492 0 65535 /end CHARACTERISTIC
/begin CHARACTERISTIC FaultManager.HV_Battery_Pack_Below_Operating_Temperature.Mode "Fault manager configuration.  Select up to 4 actions for each fault." VALUE 0x80000D5C RecordLayout_7 0 CompuMethod_489 0 65535 /end CHARACTERISTIC
/begin CHARACTERISTIC FaultManager.HV_Battery_Pack_Below_Operating_Temperature.ID "Fault manager configuration.  Select up to 4 actions for each fault." VALUE 0x80000D5E RecordLayout_7 0 CompuMethod_1 0 65535 /end CHARACTERISTIC
/begin CHARACTERISTIC FaultManager.HV_Battery_Pack_Below_Operating_Temperature.Test "Fault manager configuration.  Select up to 4 actions for each fault." VALUE 0x80000D60 RecordLayout_7 0 CompuMethod_490 0 65535 /end CHARACTERISTIC
/begin CHARACTERISTIC FaultManager.HV_Battery_Pack_Below_Operating_Temperature.Faulty_Samples__X_ "Fault manager configuration.  Select up to 4 actions for each fault." VALUE 0x80000D62 RecordLayout_7 0 CompuMethod_1 0 65535 /end CHARACTERISTIC
/begin CHARACTERISTIC FaultManager.HV_Battery_Pack_Below_Operating_Temperature.Total_Samples__Y_ "Fault manager configuration.  Select up to 4 actions for each fault." VALUE 0x80000D64 RecordLayout_7 0 CompuMethod_1 0 65535 /end CHARACTERISTIC
/begin CHARACTERISTIC FaultManager.HV_Battery_Pack_Below_Operating_Temperature.Action_1 "Fault manager configuration.  Select up to 4 actions for each fault." VALUE 0x80000D66 RecordLayout_7 0 CompuMethod_491 0 65535 /end CHARACTERISTIC
/begin CHARACTERISTIC FaultManager.HV_Battery_Pack_Below_Operating_Temperature.Action_1_Condition "Fault manager configuration.  Select up to 4 actions for each fault." VALUE 0x80000D68 RecordLayout_7 0 CompuMethod_492 0 65535 /end CHARACTERISTIC
/begin CHARACTERISTIC FaultManager.HV_Battery_Pack_Below_Operating_Temperature.Action_2 "Fault manager configuration.  Select up to 4 actions for each fault." VALUE 0x80000D6A RecordLayout_7 0 CompuMethod_491 0 65535 /end CHARACTERISTIC
/begin CHARACTERISTIC FaultManager.HV_Battery_Pack_Below_Operating_Temperature.Action_2_Condition "Fault manager configuration.  Select up to 4 actions for each fault." VALUE 0x80000D6C RecordLayout_7 0 CompuMethod_492 0 65535 /end CHARACTERISTIC
/begin CHARACTERISTIC FaultManager.HV_Battery_Pack_Below_Operating_Temperature.Action_3 "Fault manager configuration.  Select up to 4 actions for each fault." VALUE 0x80000D6E RecordLayout_7 0 CompuMethod_491 0 65535 /end CHARACTERISTIC
/begin CHARACTERISTIC FaultManager.HV_Battery_Pack_Below_Operating_Temperature.Action_3_Condition "Fault manager configuration.  Select up to 4 actions for each fault." VALUE 0x80000D70 RecordLayout_7 0 CompuMethod_492 0 65535 /end CHARACTERISTIC
/begin CHARACTERISTIC FaultManager.HV_Battery_Pack_Below_Operating_Temperature.Action_4 "Fault manager configuration.  Select up to 4 actions for each fault." VALUE 0x80000D72 RecordLayout_7 0 CompuMethod_491 0 65535 /end CHARACTERISTIC
/begin CHARACTERISTIC FaultManager.HV_Battery_Pack_Below_Operating_Temperature.Action_4_Condition "Fault manager configuration.  Select up to 4 actions for each fault." VALUE 0x80000D74 RecordLayout_7 0 CompuMethod_492 0 65535 /end CHARACTERISTIC
/begin CHARACTERISTIC FaultManager.HV_Battery_Pack_High_Temperature.Mode "Fault manager configuration.  Select up to 4 actions for each fault." VALUE 0x80000D76 RecordLayout_7 0 CompuMethod_489 0 65535 /end CHARACTERISTIC
/begin CHARACTERISTIC FaultManager.HV_Battery_Pack_High_Temperature.ID "Fault manager configuration.  Select up to 4 actions for each fault." VALUE 0x80000D78 RecordLayout_7 0 CompuMethod_1 0 65535 /end CHARACTERISTIC
/begin CHARACTERISTIC FaultManager.HV_Battery_Pack_High_Temperature.Test "Fault manager configuration.  Select up to 4 actions for each fault." VALUE 0x80000D7A RecordLayout_7 0 CompuMethod_490 0 65535 /end CHARACTERISTIC
/begin CHARACTERISTIC FaultManager.HV_Battery_Pack_High_Temperature.Faulty_Samples__X_ "Fault manager configuration.  Select up to 4 actions for each fault." VALUE 0x80000D7C RecordLayout_7 0 CompuMethod_1 0 65535 /end CHARACTERISTIC
/begin CHARACTERISTIC FaultManager.HV_Battery_Pack_High_Temperature.Total_Samples__Y_ "Fault manager configuration.  Select up to 4 actions for each fault." VALUE 0x80000D7E RecordLayout_7 0 CompuMethod_1 0 65535 /end CHARACTERISTIC
/begin CHARACTERISTIC FaultManager.HV_Battery_Pack_High_Temperature.Action_1 "Fault manager configuration.  Select up to 4 actions for each fault." VALUE 0x80000D80 RecordLayout_7 0 CompuMethod_491 0 65535 /end CHARACTERISTIC
/begin CHARACTERISTIC FaultManager.HV_Battery_Pack_High_Temperature.Action_1_Condition "Fault manager configuration.  Select up to 4 actions for each fault." VALUE 0x80000D82 RecordLayout_7 0 CompuMethod_492 0 65535 /end CHARACTERISTIC
/begin CHARACTERISTIC FaultManager.HV_Battery_Pack_High_Temperature.Action_2 "Fault manager configuration.  Select up to 4 actions for each fault." VALUE 0x80000D84 RecordLayout_7 0 CompuMethod_491 0 65535 /end CHARACTERISTIC
/begin CHARACTERISTIC FaultManager.HV_Battery_Pack_High_Temperature.Action_2_Condition "Fault manager configuration.  Select up to 4 actions for each fault." VALUE 0x80000D86 RecordLayout_7 0 CompuMethod_492 0 65535 /end CHARACTERISTIC
/begin CHARACTERISTIC FaultManager.HV_Battery_Pack_High_Temperature.Action_3 "Fault manager configuration.  Select up to 4 actions for each fault." VALUE 0x80000D88 RecordLayout_7 0 CompuMethod_491 0 65535 /end CHARACTERISTIC
/begin CHARACTERISTIC FaultManager.HV_Battery_Pack_High_Temperature.Action_3_Condition "Fault manager configuration.  Select up to 4 actions for each fault." VALUE 0x80000D8A RecordLayout_7 0 CompuMethod_492 0 65535 /end CHARACTERISTIC
/begin CHARACTERISTIC FaultManager.HV_Battery_Pack_High_Temperature.Action_4 "Fault manager configuration.  Select up to 4 actions for each fault." VALUE 0x80000D8C RecordLayout_7 0 CompuMethod_491 0 65535 /end CHARACTERISTIC
/begin CHARACTERISTIC FaultManager.HV_Battery_Pack_High_Temperature.Action_4_Condition "Fault manager configuration.  Select up to 4 actions for each fault." VALUE 0x80000D8E RecordLayout_7 0 CompuMethod_492 0 65535 /end CHARACTERISTIC
/begin CHARACTERISTIC FaultManager.HV_Battery_Pack_Low_Temperature.Mode "Fault manager configuration.  Select up to 4 actions for each fault." VALUE 0x80000D90 RecordLayout_7 0 CompuMethod_489 0 65535 /end CHARACTERISTIC
/begin CHARACTERISTIC FaultManager.HV_Battery_Pack_Low_Temperature.ID "Fault manager configuration.  Select up to 4 actions for each fault." VALUE 0x80000D92 RecordLayout_7 0 CompuMethod_1 0 65535 /end CHARACTERISTIC
/begin CHARACTERISTIC FaultManager.HV_Battery_Pack_Low_Temperature.Test "Fault manager configuration.  Select up to 4 actions for each fault." VALUE 0x80000D94 RecordLayout_7 0 CompuMethod_490 0 65535 /end CHARACTERISTIC
/begin CHARACTERISTIC FaultManager.HV_Battery_Pack_Low_Temperature.Faulty_Samples__X_ "Fault manager configuration.  Select up to 4 actions for each fault." VALUE 0x80000D96 RecordLayout_7 0 CompuMethod_1 0 65535 /end CHARACTERISTIC
/begin CHARACTERISTIC FaultManager.HV_Battery_Pack_Low_Temperature.Total_Samples__Y_ "Fault manager configuration.  Select up to 4 actions for each fault." VALUE 0x80000D98 RecordLayout_7 0 CompuMethod_1 0 65535 /end CHARACTERISTIC
/begin CHARACTERISTIC FaultManager.HV_Battery_Pack_Low_Temperature.Action_1 "Fault manager configuration.  Select up to 4 actions for each fault." VALUE 0x80000D9A RecordLayout_7 0 CompuMethod_491 0 65535 /end CHARACTERISTIC
/begin CHARACTERISTIC FaultManager.HV_Battery_Pack_Low_Temperature.Action_1_Condition "Fault manager configuration.  Select up to 4 actions for each fault." VALUE 0x80000D9C RecordLayout_7 0 CompuMethod_492 0 65535 /end CHARACTERISTIC
/begin CHARACTERISTIC FaultManager.HV_Battery_Pack_Low_Temperature.Action_2 "Fault manager configuration.  Select up to 4 actions for each fault." VALUE 0x80000D9E RecordLayout_7 0 CompuMethod_491 0 65535 /end CHARACTERISTIC
/begin CHARACTERISTIC FaultManager.HV_Battery_Pack_Low_Temperature.Action_2_Condition "Fault manager configuration.  Select up to 4 actions for each fault." VALUE 0x80000DA0 RecordLayout_7 0 CompuMethod_492 0 65535 /end CHARACTERISTIC
/begin CHARACTERISTIC FaultManager.HV_Battery_Pack_Low_Temperature.Action_3 "Fault manager configuration.  Select up to 4 actions for each fault." VALUE 0x80000DA2 RecordLayout_7 0 CompuMethod_491 0 65535 /end CHARACTERISTIC
/begin CHARACTERISTIC FaultManager.HV_Battery_Pack_Low_Temperature.Action_3_Condition "Fault manager configuration.  Select up to 4 actions for each fault." VALUE 0x80000DA4 RecordLayout_7 0 CompuMethod_492 0 65535 /end CHARACTERISTIC
/begin CHARACTERISTIC FaultManager.HV_Battery_Pack_Low_Temperature.Action_4 "Fault manager configuration.  Select up to 4 actions for each fault." VALUE 0x80000DA6 RecordLayout_7 0 CompuMethod_491 0 65535 /end CHARACTERISTIC
/begin CHARACTERISTIC FaultManager.HV_Battery_Pack_Low_Temperature.Action_4_Condition "Fault manager configuration.  Select up to 4 actions for each fault." VALUE 0x80000DA8 RecordLayout_7 0 CompuMethod_492 0 65535 /end CHARACTERISTIC
/begin CHARACTERISTIC FaultManager.HV_Battery_Precharge_Failure.Mode "Fault manager configuration.  Select up to 4 actions for each fault." VALUE 0x80000DAA RecordLayout_7 0 CompuMethod_489 0 65535 /end CHARACTERISTIC
/begin CHARACTERISTIC FaultManager.HV_Battery_Precharge_Failure.ID "Fault manager configuration.  Select up to 4 actions for each fault." VALUE 0x80000DAC RecordLayout_7 0 CompuMethod_1 0 65535 /end CHARACTERISTIC
/begin CHARACTERISTIC FaultManager.HV_Battery_Precharge_Failure.Test "Fault manager configuration.  Select up to 4 actions for each fault." VALUE 0x80000DAE RecordLayout_7 0 CompuMethod_490 0 65535 /end CHARACTERISTIC
/begin CHARACTERISTIC FaultManager.HV_Battery_Precharge_Failure.Faulty_Samples__X_ "Fault manager configuration.  Select up to 4 actions for each fault." VALUE 0x80000DB0 RecordLayout_7 0 CompuMethod_1 0 65535 /end CHARACTERISTIC
/begin CHARACTERISTIC FaultManager.HV_Battery_Precharge_Failure.Total_Samples__Y_ "Fault manager configuration.  Select up to 4 actions for each fault." VALUE 0x80000DB2 RecordLayout_7 0 CompuMethod_1 0 65535 /end CHARACTERISTIC
/begin CHARACTERISTIC FaultManager.HV_Battery_Precharge_Failure.Action_1 "Fault manager configuration.  Select up to 4 actions for each fault." VALUE 0x80000DB4 RecordLayout_7 0 CompuMethod_491 0 65535 /end CHARACTERISTIC
/begin CHARACTERISTIC FaultManager.HV_Battery_Precharge_Failure.Action_1_Condition "Fault manager configuration.  Select up to 4 actions for each fault." VALUE 0x80000DB6 RecordLayout_7 0 CompuMethod_492 0 65535 /end CHARACTERISTIC
/begin CHARACTERISTIC FaultManager.HV_Battery_Precharge_Failure.Action_2 "Fault manager configuration.  Select up to 4 actions for each fault." VALUE 0x80000DB8 RecordLayout_7 0 CompuMethod_491 0 65535 /end CHARACTERISTIC
/begin CHARACTERISTIC FaultManager.HV_Battery_Precharge_Failure.Action_2_Condition "Fault manager configuration.  Select up to 4 actions for each fault." VALUE 0x80000DBA RecordLayout_7 0 CompuMethod_492 0 65535 /end CHARACTERISTIC
/begin CHARACTERISTIC FaultManager.HV_Battery_Precharge_Failure.Action_3 "Fault manager configuration.  Select up to 4 actions for each fault." VALUE 0x80000DBC RecordLayout_7 0 CompuMethod_491 0 65535 /end CHARACTERISTIC
/begin CHARACTERISTIC FaultManager.HV_Battery_Precharge_Failure.Action_3_Condition "Fault manager configuration.  Select up to 4 actions for each fault." VALUE 0x80000DBE RecordLayout_7 0 CompuMethod_492 0 65535 /end CHARACTERISTIC
/begin CHARACTERISTIC FaultManager.HV_Battery_Precharge_Failure.Action_4 "Fault manager configuration.  Select up to 4 actions for each fault." VALUE 0x80000DC0 RecordLayout_7 0 CompuMethod_491 0 65535 /end CHARACTERISTIC
/begin CHARACTERISTIC FaultManager.HV_Battery_Precharge_Failure.Action_4_Condition "Fault manager configuration.  Select up to 4 actions for each fault." VALUE 0x80000DC2 RecordLayout_7 0 CompuMethod_492 0 65535 /end CHARACTERISTIC
/begin CHARACTERISTIC FaultManager.HV_Battery_Too_Low_For_Load.Mode "Fault manager configuration.  Select up to 4 actions for each fault." VALUE 0x80000DC4 RecordLayout_7 0 CompuMethod_489 0 65535 /end CHARACTERISTIC
/begin CHARACTERISTIC FaultManager.HV_Battery_Too_Low_For_Load.ID "Fault manager configuration.  Select up to 4 actions for each fault." VALUE 0x80000DC6 RecordLayout_7 0 CompuMethod_1 0 65535 /end CHARACTERISTIC
/begin CHARACTERISTIC FaultManager.HV_Battery_Too_Low_For_Load.Test "Fault manager configuration.  Select up to 4 actions for each fault." VALUE 0x80000DC8 RecordLayout_7 0 CompuMethod_490 0 65535 /end CHARACTERISTIC
/begin CHARACTERISTIC FaultManager.HV_Battery_Too_Low_For_Load.Faulty_Samples__X_ "Fault manager configuration.  Select up to 4 actions for each fault." VALUE 0x80000DCA RecordLayout_7 0 CompuMethod_1 0 65535 /end CHARACTERISTIC
/begin CHARACTERISTIC FaultManager.HV_Battery_Too_Low_For_Load.Total_Samples__Y_ "Fault manager configuration.  Select up to 4 actions for each fault." VALUE 0x80000DCC RecordLayout_7 0 CompuMethod_1 0 65535 /end CHARACTERISTIC
/begin CHARACTERISTIC FaultManager.HV_Battery_Too_Low_For_Load.Action_1 "Fault manager configuration.  Select up to 4 actions for each fault." VALUE 0x80000DCE RecordLayout_7 0 CompuMethod_491 0 65535 /end CHARACTERISTIC
/begin CHARACTERISTIC FaultManager.HV_Battery_Too_Low_For_Load.Action_1_Condition "Fault manager configuration.  Select up to 4 actions for each fault." VALUE 0x80000DD0 RecordLayout_7 0 CompuMethod_492 0 65535 /end CHARACTERISTIC
/begin CHARACTERISTIC FaultManager.HV_Battery_Too_Low_For_Load.Action_2 "Fault manager configuration.  Select up to 4 actions for each fault." VALUE 0x80000DD2 RecordLayout_7 0 CompuMethod_491 0 65535 /end CHARACTERISTIC
/begin CHARACTERISTIC FaultManager.HV_Battery_Too_Low_For_Load.Action_2_Condition "Fault manager configuration.  Select up to 4 actions for each fault." VALUE 0x80000DD4 RecordLayout_7 0 CompuMethod_492 0 65535 /end CHARACTERISTIC
/begin CHARACTERISTIC FaultManager.HV_Battery_Too_Low_For_Load.Action_3 "Fault manager configuration.  Select up to 4 actions for each fault." VALUE 0x80000DD6 RecordLayout_7 0 CompuMethod_491 0 65535 /end CHARACTERISTIC
/begin CHARACTERISTIC FaultManager.HV_Battery_Too_Low_For_Load.Action_3_Condition "Fault manager configuration.  Select up to 4 actions for each fault." VALUE 0x80000DD8 RecordLayout_7 0 CompuMethod_492 0 65535 /end CHARACTERISTIC
/begin CHARACTERISTIC FaultManager.HV_Battery_Too_Low_For_Load.Action_4 "Fault manager configuration.  Select up to 4 actions for each fault." VALUE 0x80000DDA RecordLayout_7 0 CompuMethod_491 0 65535 /end CHARACTERISTIC
/begin CHARACTERISTIC FaultManager.HV_Battery_Too_Low_For_Load.Action_4_Condition "Fault manager configuration.  Select up to 4 actions for each fault." VALUE 0x80000DDC RecordLayout_7 0 CompuMethod_492 0 65535 /end CHARACTERISTIC
/begin CHARACTERISTIC FaultManager.HV_Battery_Try_To_Balance_Under_Load.Mode "Fault manager configuration.  Select up to 4 actions for each fault." VALUE 0x80000DDE RecordLayout_7 0 CompuMethod_489 0 65535 /end CHARACTERISTIC
/begin CHARACTERISTIC FaultManager.HV_Battery_Try_To_Balance_Under_Load.ID "Fault manager configuration.  Select up to 4 actions for each fault." VALUE 0x80000DE0 RecordLayout_7 0 CompuMethod_1 0 65535 /end CHARACTERISTIC
/begin CHARACTERISTIC FaultManager.HV_Battery_Try_To_Balance_Under_Load.Test "Fault manager configuration.  Select up to 4 actions for each fault." VALUE 0x80000DE2 RecordLayout_7 0 CompuMethod_490 0 65535 /end CHARACTERISTIC
/begin CHARACTERISTIC FaultManager.HV_Battery_Try_To_Balance_Under_Load.Faulty_Samples__X_ "Fault manager configuration.  Select up to 4 actions for each fault." VALUE 0x80000DE4 RecordLayout_7 0 CompuMethod_1 0 65535 /end CHARACTERISTIC
/begin CHARACTERISTIC FaultManager.HV_Battery_Try_To_Balance_Under_Load.Total_Samples__Y_ "Fault manager configuration.  Select up to 4 actions for each fault." VALUE 0x80000DE6 RecordLayout_7 0 CompuMethod_1 0 65535 /end CHARACTERISTIC
/begin CHARACTERISTIC FaultManager.HV_Battery_Try_To_Balance_Under_Load.Action_1 "Fault manager configuration.  Select up to 4 actions for each fault." VALUE 0x80000DE8 RecordLayout_7 0 CompuMethod_491 0 65535 /end CHARACTERISTIC
/begin CHARACTERISTIC FaultManager.HV_Battery_Try_To_Balance_Under_Load.Action_1_Condition "Fault manager configuration.  Select up to 4 actions for each fault." VALUE 0x80000DEA RecordLayout_7 0 CompuMethod_492 0 65535 /end CHARACTERISTIC
/begin CHARACTERISTIC FaultManager.HV_Battery_Try_To_Balance_Under_Load.Action_2 "Fault manager configuration.  Select up to 4 actions for each fault." VALUE 0x80000DEC RecordLayout_7 0 CompuMethod_491 0 65535 /end CHARACTERISTIC
/begin CHARACTERISTIC FaultManager.HV_Battery_Try_To_Balance_Under_Load.Action_2_Condition "Fault manager configuration.  Select up to 4 actions for each fault." VALUE 0x80000DEE RecordLayout_7 0 CompuMethod_492 0 65535 /end CHARACTERISTIC
/begin CHARACTERISTIC FaultManager.HV_Battery_Try_To_Balance_Under_Load.Action_3 "Fault manager configuration.  Select up to 4 actions for each fault." VALUE 0x80000DF0 RecordLayout_7 0 CompuMethod_491 0 65535 /end CHARACTERISTIC
/begin CHARACTERISTIC FaultManager.HV_Battery_Try_To_Balance_Under_Load.Action_3_Condition "Fault manager configuration.  Select up to 4 actions for each fault." VALUE 0x80000DF2 RecordLayout_7 0 CompuMethod_492 0 65535 /end CHARACTERISTIC
/begin CHARACTERISTIC FaultManager.HV_Battery_Try_To_Balance_Under_Load.Action_4 "Fault manager configuration.  Select up to 4 actions for each fault." VALUE 0x80000DF4 RecordLayout_7 0 CompuMethod_491 0 65535 /end CHARACTERISTIC
/begin CHARACTERISTIC FaultManager.HV_Battery_Try_To_Balance_Under_Load.Action_4_Condition "Fault manager configuration.  Select up to 4 actions for each fault." VALUE 0x80000DF6 RecordLayout_7 0 CompuMethod_492 0 65535 /end CHARACTERISTIC
/begin CHARACTERISTIC FaultManager.HV_Heater_Over_Temperature.Mode "Fault manager configuration.  Select up to 4 actions for each fault." VALUE 0x80000DF8 RecordLayout_7 0 CompuMethod_489 0 65535 /end CHARACTERISTIC
/begin CHARACTERISTIC FaultManager.HV_Heater_Over_Temperature.ID "Fault manager configuration.  Select up to 4 actions for each fault." VALUE 0x80000DFA RecordLayout_7 0 CompuMethod_1 0 65535 /end CHARACTERISTIC
/begin CHARACTERISTIC FaultManager.HV_Heater_Over_Temperature.Test "Fault manager configuration.  Select up to 4 actions for each fault." VALUE 0x80000DFC RecordLayout_7 0 CompuMethod_490 0 65535 /end CHARACTERISTIC
/begin CHARACTERISTIC FaultManager.HV_Heater_Over_Temperature.Faulty_Samples__X_ "Fault manager configuration.  Select up to 4 actions for each fault." VALUE 0x80000DFE RecordLayout_7 0 CompuMethod_1 0 65535 /end CHARACTERISTIC
/begin CHARACTERISTIC FaultManager.HV_Heater_Over_Temperature.Total_Samples__Y_ "Fault manager configuration.  Select up to 4 actions for each fault." VALUE 0x80000E00 RecordLayout_7 0 CompuMethod_1 0 65535 /end CHARACTERISTIC
/begin CHARACTERISTIC FaultManager.HV_Heater_Over_Temperature.Action_1 "Fault manager configuration.  Select up to 4 actions for each fault." VALUE 0x80000E02 RecordLayout_7 0 CompuMethod_491 0 65535 /end CHARACTERISTIC
/begin CHARACTERISTIC FaultManager.HV_Heater_Over_Temperature.Action_1_Condition "Fault manager configuration.  Select up to 4 actions for each fault." VALUE 0x80000E04 RecordLayout_7 0 CompuMethod_492 0 65535 /end CHARACTERISTIC
/begin CHARACTERISTIC FaultManager.HV_Heater_Over_Temperature.Action_2 "Fault manager configuration.  Select up to 4 actions for each fault." VALUE 0x80000E06 RecordLayout_7 0 CompuMethod_491 0 65535 /end CHARACTERISTIC
/begin CHARACTERISTIC FaultManager.HV_Heater_Over_Temperature.Action_2_Condition "Fault manager configuration.  Select up to 4 actions for each fault." VALUE 0x80000E08 RecordLayout_7 0 CompuMethod_492 0 65535 /end CHARACTERISTIC
/begin CHARACTERISTIC FaultManager.HV_Heater_Over_Temperature.Action_3 "Fault manager configuration.  Select up to 4 actions for each fault." VALUE 0x80000E0A RecordLayout_7 0 CompuMethod_491 0 65535 /end CHARACTERISTIC
/begin CHARACTERISTIC FaultManager.HV_Heater_Over_Temperature.Action_3_Condition "Fault manager configuration.  Select up to 4 actions for each fault." VALUE 0x80000E0C RecordLayout_7 0 CompuMethod_492 0 65535 /end CHARACTERISTIC
/begin CHARACTERISTIC FaultManager.HV_Heater_Over_Temperature.Action_4 "Fault manager configuration.  Select up to 4 actions for each fault." VALUE 0x80000E0E RecordLayout_7 0 CompuMethod_491 0 65535 /end CHARACTERISTIC
/begin CHARACTERISTIC FaultManager.HV_Heater_Over_Temperature.Action_4_Condition "Fault manager configuration.  Select up to 4 actions for each fault." VALUE 0x80000E10 RecordLayout_7 0 CompuMethod_492 0 65535 /end CHARACTERISTIC
/begin CHARACTERISTIC FaultManager.HV_Heater_Poor_Performance.Mode "Fault manager configuration.  Select up to 4 actions for each fault." VALUE 0x80000E12 RecordLayout_7 0 CompuMethod_489 0 65535 /end CHARACTERISTIC
/begin CHARACTERISTIC FaultManager.HV_Heater_Poor_Performance.ID "Fault manager configuration.  Select up to 4 actions for each fault." VALUE 0x80000E14 RecordLayout_7 0 CompuMethod_1 0 65535 /end CHARACTERISTIC
/begin CHARACTERISTIC FaultManager.HV_Heater_Poor_Performance.Test "Fault manager configuration.  Select up to 4 actions for each fault." VALUE 0x80000E16 RecordLayout_7 0 CompuMethod_490 0 65535 /end CHARACTERISTIC
/begin CHARACTERISTIC FaultManager.HV_Heater_Poor_Performance.Faulty_Samples__X_ "Fault manager configuration.  Select up to 4 actions for each fault." VALUE 0x80000E18 RecordLayout_7 0 CompuMethod_1 0 65535 /end CHARACTERISTIC
/begin CHARACTERISTIC FaultManager.HV_Heater_Poor_Performance.Total_Samples__Y_ "Fault manager configuration.  Select up to 4 actions for each fault." VALUE 0x80000E1A RecordLayout_7 0 CompuMethod_1 0 65535 /end CHARACTERISTIC
/begin CHARACTERISTIC FaultManager.HV_Heater_Poor_Performance.Action_1 "Fault manager configuration.  Select up to 4 actions for each fault." VALUE 0x80000E1C RecordLayout_7 0 CompuMethod_491 0 65535 /end CHARACTERISTIC
/begin CHARACTERISTIC FaultManager.HV_Heater_Poor_Performance.Action_1_Condition "Fault manager configuration.  Select up to 4 actions for each fault." VALUE 0x80000E1E RecordLayout_7 0 CompuMethod_492 0 65535 /end CHARACTERISTIC
/begin CHARACTERISTIC FaultManager.HV_Heater_Poor_Performance.Action_2 "Fault manager configuration.  Select up to 4 actions for each fault." VALUE 0x80000E20 RecordLayout_7 0 CompuMethod_491 0 65535 /end CHARACTERISTIC
/begin CHARACTERISTIC FaultManager.HV_Heater_Poor_Performance.Action_2_Condition "Fault manager configuration.  Select up to 4 actions for each fault." VALUE 0x80000E22 RecordLayout_7 0 CompuMethod_492 0 65535 /end CHARACTERISTIC
/begin CHARACTERISTIC FaultManager.HV_Heater_Poor_Performance.Action_3 "Fault manager configuration.  Select up to 4 actions for each fault." VALUE 0x80000E24 RecordLayout_7 0 CompuMethod_491 0 65535 /end CHARACTERISTIC
/begin CHARACTERISTIC FaultManager.HV_Heater_Poor_Performance.Action_3_Condition "Fault manager configuration.  Select up to 4 actions for each fault." VALUE 0x80000E26 RecordLayout_7 0 CompuMethod_492 0 65535 /end CHARACTERISTIC
/begin CHARACTERISTIC FaultManager.HV_Heater_Poor_Performance.Action_4 "Fault manager configuration.  Select up to 4 actions for each fault." VALUE 0x80000E28 RecordLayout_7 0 CompuMethod_491 0 65535 /end CHARACTERISTIC
/begin CHARACTERISTIC FaultManager.HV_Heater_Poor_Performance.Action_4_Condition "Fault manager configuration.  Select up to 4 actions for each fault." VALUE 0x80000E2A RecordLayout_7 0 CompuMethod_492 0 65535 /end CHARACTERISTIC
/begin CHARACTERISTIC FaultManager.HV_Heater_Temperature_Sensor_A_High_Voltage.Mode "Fault manager configuration.  Select up to 4 actions for each fault." VALUE 0x80000E2C RecordLayout_7 0 CompuMethod_489 0 65535 /end CHARACTERISTIC
/begin CHARACTERISTIC FaultManager.HV_Heater_Temperature_Sensor_A_High_Voltage.ID "Fault manager configuration.  Select up to 4 actions for each fault." VALUE 0x80000E2E RecordLayout_7 0 CompuMethod_1 0 65535 /end CHARACTERISTIC
/begin CHARACTERISTIC FaultManager.HV_Heater_Temperature_Sensor_A_High_Voltage.Test "Fault manager configuration.  Select up to 4 actions for each fault." VALUE 0x80000E30 RecordLayout_7 0 CompuMethod_490 0 65535 /end CHARACTERISTIC
/begin CHARACTERISTIC FaultManager.HV_Heater_Temperature_Sensor_A_High_Voltage.Faulty_Samples__X_ "Fault manager configuration.  Select up to 4 actions for each fault." VALUE 0x80000E32 RecordLayout_7 0 CompuMethod_1 0 65535 /end CHARACTERISTIC
/begin CHARACTERISTIC FaultManager.HV_Heater_Temperature_Sensor_A_High_Voltage.Total_Samples__Y_ "Fault manager configuration.  Select up to 4 actions for each fault." VALUE 0x80000E34 RecordLayout_7 0 CompuMethod_1 0 65535 /end CHARACTERISTIC
/begin CHARACTERISTIC FaultManager.HV_Heater_Temperature_Sensor_A_High_Voltage.Action_1 "Fault manager configuration.  Select up to 4 actions for each fault." VALUE 0x80000E36 RecordLayout_7 0 CompuMethod_491 0 65535 /end CHARACTERISTIC
/begin CHARACTERISTIC FaultManager.HV_Heater_Temperature_Sensor_A_High_Voltage.Action_1_Condition "Fault manager configuration.  Select up to 4 actions for each fault." VALUE 0x80000E38 RecordLayout_7 0 CompuMethod_492 0 65535 /end CHARACTERISTIC
/begin CHARACTERISTIC FaultManager.HV_Heater_Temperature_Sensor_A_High_Voltage.Action_2 "Fault manager configuration.  Select up to 4 actions for each fault." VALUE 0x80000E3A RecordLayout_7 0 CompuMethod_491 0 65535 /end CHARACTERISTIC
/begin CHARACTERISTIC FaultManager.HV_Heater_Temperature_Sensor_A_High_Voltage.Action_2_Condition "Fault manager configuration.  Select up to 4 actions for each fault." VALUE 0x80000E3C RecordLayout_7 0 CompuMethod_492 0 65535 /end CHARACTERISTIC
/begin CHARACTERISTIC FaultManager.HV_Heater_Temperature_Sensor_A_High_Voltage.Action_3 "Fault manager configuration.  Select up to 4 actions for each fault." VALUE 0x80000E3E RecordLayout_7 0 CompuMethod_491 0 65535 /end CHARACTERISTIC
/begin CHARACTERISTIC FaultManager.HV_Heater_Temperature_Sensor_A_High_Voltage.Action_3_Condition "Fault manager configuration.  Select up to 4 actions for each fault." VALUE 0x80000E40 RecordLayout_7 0 CompuMethod_492 0 65535 /end CHARACTERISTIC
/begin CHARACTERISTIC FaultManager.HV_Heater_Temperature_Sensor_A_High_Voltage.Action_4 "Fault manager configuration.  Select up to 4 actions for each fault." VALUE 0x80000E42 RecordLayout_7 0 CompuMethod_491 0 65535 /end CHARACTERISTIC
/begin CHARACTERISTIC FaultManager.HV_Heater_Temperature_Sensor_A_High_Voltage.Action_4_Condition "Fault manager configuration.  Select up to 4 actions for each fault." VALUE 0x80000E44 RecordLayout_7 0 CompuMethod_492 0 65535 /end CHARACTERISTIC
/begin CHARACTERISTIC FaultManager.HV_Heater_Temperature_Sensor_A_Intermittent.Mode "Fault manager configuration.  Select up to 4 actions for each fault." VALUE 0x80000E46 RecordLayout_7 0 CompuMethod_489 0 65535 /end CHARACTERISTIC
/begin CHARACTERISTIC FaultManager.HV_Heater_Temperature_Sensor_A_Intermittent.ID "Fault manager configuration.  Select up to 4 actions for each fault." VALUE 0x80000E48 RecordLayout_7 0 CompuMethod_1 0 65535 /end CHARACTERISTIC
/begin CHARACTERISTIC FaultManager.HV_Heater_Temperature_Sensor_A_Intermittent.Test "Fault manager configuration.  Select up to 4 actions for each fault." VALUE 0x80000E4A RecordLayout_7 0 CompuMethod_490 0 65535 /end CHARACTERISTIC
/begin CHARACTERISTIC FaultManager.HV_Heater_Temperature_Sensor_A_Intermittent.Faulty_Samples__X_ "Fault manager configuration.  Select up to 4 actions for each fault." VALUE 0x80000E4C RecordLayout_7 0 CompuMethod_1 0 65535 /end CHARACTERISTIC
/begin CHARACTERISTIC FaultManager.HV_Heater_Temperature_Sensor_A_Intermittent.Total_Samples__Y_ "Fault manager configuration.  Select up to 4 actions for each fault." VALUE 0x80000E4E RecordLayout_7 0 CompuMethod_1 0 65535 /end CHARACTERISTIC
/begin CHARACTERISTIC FaultManager.HV_Heater_Temperature_Sensor_A_Intermittent.Action_1 "Fault manager configuration.  Select up to 4 actions for each fault." VALUE 0x80000E50 RecordLayout_7 0 CompuMethod_491 0 65535 /end CHARACTERISTIC
/begin CHARACTERISTIC FaultManager.HV_Heater_Temperature_Sensor_A_Intermittent.Action_1_Condition "Fault manager configuration.  Select up to 4 actions for each fault." VALUE 0x80000E52 RecordLayout_7 0 CompuMethod_492 0 65535 /end CHARACTERISTIC
/begin CHARACTERISTIC FaultManager.HV_Heater_Temperature_Sensor_A_Intermittent.Action_2 "Fault manager configuration.  Select up to 4 actions for each fault." VALUE 0x80000E54 RecordLayout_7 0 CompuMethod_491 0 65535 /end CHARACTERISTIC
/begin CHARACTERISTIC FaultManager.HV_Heater_Temperature_Sensor_A_Intermittent.Action_2_Condition "Fault manager configuration.  Select up to 4 actions for each fault." VALUE 0x80000E56 RecordLayout_7 0 CompuMethod_492 0 65535 /end CHARACTERISTIC
/begin CHARACTERISTIC FaultManager.HV_Heater_Temperature_Sensor_A_Intermittent.Action_3 "Fault manager configuration.  Select up to 4 actions for each fault." VALUE 0x80000E58 RecordLayout_7 0 CompuMethod_491 0 65535 /end CHARACTERISTIC
/begin CHARACTERISTIC FaultManager.HV_Heater_Temperature_Sensor_A_Intermittent.Action_3_Condition "Fault manager configuration.  Select up to 4 actions for each fault." VALUE 0x80000E5A RecordLayout_7 0 CompuMethod_492 0 65535 /end CHARACTERISTIC
/begin CHARACTERISTIC FaultManager.HV_Heater_Temperature_Sensor_A_Intermittent.Action_4 "Fault manager configuration.  Select up to 4 actions for each fault." VALUE 0x80000E5C RecordLayout_7 0 CompuMethod_491 0 65535 /end CHARACTERISTIC
/begin CHARACTERISTIC FaultManager.HV_Heater_Temperature_Sensor_A_Intermittent.Action_4_Condition "Fault manager configuration.  Select up to 4 actions for each fault." VALUE 0x80000E5E RecordLayout_7 0 CompuMethod_492 0 65535 /end CHARACTERISTIC
/begin CHARACTERISTIC FaultManager.HV_Heater_Temperature_Sensor_A_Low_Voltage.Mode "Fault manager configuration.  Select up to 4 actions for each fault." VALUE 0x80000E60 RecordLayout_7 0 CompuMethod_489 0 65535 /end CHARACTERISTIC
/begin CHARACTERISTIC FaultManager.HV_Heater_Temperature_Sensor_A_Low_Voltage.ID "Fault manager configuration.  Select up to 4 actions for each fault." VALUE 0x80000E62 RecordLayout_7 0 CompuMethod_1 0 65535 /end CHARACTERISTIC
/begin CHARACTERISTIC FaultManager.HV_Heater_Temperature_Sensor_A_Low_Voltage.Test "Fault manager configuration.  Select up to 4 actions for each fault." VALUE 0x80000E64 RecordLayout_7 0 CompuMethod_490 0 65535 /end CHARACTERISTIC
/begin CHARACTERISTIC FaultManager.HV_Heater_Temperature_Sensor_A_Low_Voltage.Faulty_Samples__X_ "Fault manager configuration.  Select up to 4 actions for each fault." VALUE 0x80000E66 RecordLayout_7 0 CompuMethod_1 0 65535 /end CHARACTERISTIC
/begin CHARACTERISTIC FaultManager.HV_Heater_Temperature_Sensor_A_Low_Voltage.Total_Samples__Y_ "Fault manager configuration.  Select up to 4 actions for each fault." VALUE 0x80000E68 RecordLayout_7 0 CompuMethod_1 0 65535 /end CHARACTERISTIC
/begin CHARACTERISTIC FaultManager.HV_Heater_Temperature_Sensor_A_Low_Voltage.Action_1 "Fault manager configuration.  Select up to 4 actions for each fault." VALUE 0x80000E6A RecordLayout_7 0 CompuMethod_491 0 65535 /end CHARACTERISTIC
/begin CHARACTERISTIC FaultManager.HV_Heater_Temperature_Sensor_A_Low_Voltage.Action_1_Condition "Fault manager configuration.  Select up to 4 actions for each fault." VALUE 0x80000E6C RecordLayout_7 0 CompuMethod_492 0 65535 /end CHARACTERISTIC
/begin CHARACTERISTIC FaultManager.HV_Heater_Temperature_Sensor_A_Low_Voltage.Action_2 "Fault manager configuration.  Select up to 4 actions for each fault." VALUE 0x80000E6E RecordLayout_7 0 CompuMethod_491 0 65535 /end CHARACTERISTIC
/begin CHARACTERISTIC FaultManager.HV_Heater_Temperature_Sensor_A_Low_Voltage.Action_2_Condition "Fault manager configuration.  Select up to 4 actions for each fault." VALUE 0x80000E70 RecordLayout_7 0 CompuMethod_492 0 65535 /end CHARACTERISTIC
/begin CHARACTERISTIC FaultManager.HV_Heater_Temperature_Sensor_A_Low_Voltage.Action_3 "Fault manager configuration.  Select up to 4 actions for each fault." VALUE 0x80000E72 RecordLayout_7 0 CompuMethod_491 0 65535 /end CHARACTERISTIC
/begin CHARACTERISTIC FaultManager.HV_Heater_Temperature_Sensor_A_Low_Voltage.Action_3_Condition "Fault manager configuration.  Select up to 4 actions for each fault." VALUE 0x80000E74 RecordLayout_7 0 CompuMethod_492 0 65535 /end CHARACTERISTIC
/begin CHARACTERISTIC FaultManager.HV_Heater_Temperature_Sensor_A_Low_Voltage.Action_4 "Fault manager configuration.  Select up to 4 actions for each fault." VALUE 0x80000E76 RecordLayout_7 0 CompuMethod_491 0 65535 /end CHARACTERISTIC
/begin CHARACTERISTIC FaultManager.HV_Heater_Temperature_Sensor_A_Low_Voltage.Action_4_Condition "Fault manager configuration.  Select up to 4 actions for each fault." VALUE 0x80000E78 RecordLayout_7 0 CompuMethod_492 0 65535 /end CHARACTERISTIC
/begin CHARACTERISTIC FaultManager.IPT_DCDC_AgeCount.Mode "Fault manager configuration.  Select up to 4 actions for each fault." VALUE 0x80000E7A RecordLayout_7 0 CompuMethod_489 0 65535 /end CHARACTERISTIC
/begin CHARACTERISTIC FaultManager.IPT_DCDC_AgeCount.ID "Fault manager configuration.  Select up to 4 actions for each fault." VALUE 0x80000E7C RecordLayout_7 0 CompuMethod_1 0 65535 /end CHARACTERISTIC
/begin CHARACTERISTIC FaultManager.IPT_DCDC_AgeCount.Test "Fault manager configuration.  Select up to 4 actions for each fault." VALUE 0x80000E7E RecordLayout_7 0 CompuMethod_490 0 65535 /end CHARACTERISTIC
/begin CHARACTERISTIC FaultManager.IPT_DCDC_AgeCount.Faulty_Samples__X_ "Fault manager configuration.  Select up to 4 actions for each fault." VALUE 0x80000E80 RecordLayout_7 0 CompuMethod_1 0 65535 /end CHARACTERISTIC
/begin CHARACTERISTIC FaultManager.IPT_DCDC_AgeCount.Total_Samples__Y_ "Fault manager configuration.  Select up to 4 actions for each fault." VALUE 0x80000E82 RecordLayout_7 0 CompuMethod_1 0 65535 /end CHARACTERISTIC
/begin CHARACTERISTIC FaultManager.IPT_DCDC_AgeCount.Action_1 "Fault manager configuration.  Select up to 4 actions for each fault." VALUE 0x80000E84 RecordLayout_7 0 CompuMethod_491 0 65535 /end CHARACTERISTIC
/begin CHARACTERISTIC FaultManager.IPT_DCDC_AgeCount.Action_1_Condition "Fault manager configuration.  Select up to 4 actions for each fault." VALUE 0x80000E86 RecordLayout_7 0 CompuMethod_492 0 65535 /end CHARACTERISTIC
/begin CHARACTERISTIC FaultManager.IPT_DCDC_AgeCount.Action_2 "Fault manager configuration.  Select up to 4 actions for each fault." VALUE 0x80000E88 RecordLayout_7 0 CompuMethod_491 0 65535 /end CHARACTERISTIC
/begin CHARACTERISTIC FaultManager.IPT_DCDC_AgeCount.Action_2_Condition "Fault manager configuration.  Select up to 4 actions for each fault." VALUE 0x80000E8A RecordLayout_7 0 CompuMethod_492 0 65535 /end CHARACTERISTIC
/begin CHARACTERISTIC FaultManager.IPT_DCDC_AgeCount.Action_3 "Fault manager configuration.  Select up to 4 actions for each fault." VALUE 0x80000E8C RecordLayout_7 0 CompuMethod_491 0 65535 /end CHARACTERISTIC
/begin CHARACTERISTIC FaultManager.IPT_DCDC_AgeCount.Action_3_Condition "Fault manager configuration.  Select up to 4 actions for each fault." VALUE 0x80000E8E RecordLayout_7 0 CompuMethod_492 0 65535 /end CHARACTERISTIC
/begin CHARACTERISTIC FaultManager.IPT_DCDC_AgeCount.Action_4 "Fault manager configuration.  Select up to 4 actions for each fault." VALUE 0x80000E90 RecordLayout_7 0 CompuMethod_491 0 65535 /end CHARACTERISTIC
/begin CHARACTERISTIC FaultManager.IPT_DCDC_AgeCount.Action_4_Condition "Fault manager configuration.  Select up to 4 actions for each fault." VALUE 0x80000E92 RecordLayout_7 0 CompuMethod_492 0 65535 /end CHARACTERISTIC
/begin CHARACTERISTIC FaultManager.IPT_Status1_AgeCount.Mode "Fault manager configuration.  Select up to 4 actions for each fault." VALUE 0x80000E94 RecordLayout_7 0 CompuMethod_489 0 65535 /end CHARACTERISTIC
/begin CHARACTERISTIC FaultManager.IPT_Status1_AgeCount.ID "Fault manager configuration.  Select up to 4 actions for each fault." VALUE 0x80000E96 RecordLayout_7 0 CompuMethod_1 0 65535 /end CHARACTERISTIC
/begin CHARACTERISTIC FaultManager.IPT_Status1_AgeCount.Test "Fault manager configuration.  Select up to 4 actions for each fault." VALUE 0x80000E98 RecordLayout_7 0 CompuMethod_490 0 65535 /end CHARACTERISTIC
/begin CHARACTERISTIC FaultManager.IPT_Status1_AgeCount.Faulty_Samples__X_ "Fault manager configuration.  Select up to 4 actions for each fault." VALUE 0x80000E9A RecordLayout_7 0 CompuMethod_1 0 65535 /end CHARACTERISTIC
/begin CHARACTERISTIC FaultManager.IPT_Status1_AgeCount.Total_Samples__Y_ "Fault manager configuration.  Select up to 4 actions for each fault." VALUE 0x80000E9C RecordLayout_7 0 CompuMethod_1 0 65535 /end CHARACTERISTIC
/begin CHARACTERISTIC FaultManager.IPT_Status1_AgeCount.Action_1 "Fault manager configuration.  Select up to 4 actions for each fault." VALUE 0x80000E9E RecordLayout_7 0 CompuMethod_491 0 65535 /end CHARACTERISTIC
/begin CHARACTERISTIC FaultManager.IPT_Status1_AgeCount.Action_1_Condition "Fault manager configuration.  Select up to 4 actions for each fault." VALUE 0x80000EA0 RecordLayout_7 0 CompuMethod_492 0 65535 /end CHARACTERISTIC
/begin CHARACTERISTIC FaultManager.IPT_Status1_AgeCount.Action_2 "Fault manager configuration.  Select up to 4 actions for each fault." VALUE 0x80000EA2 RecordLayout_7 0 CompuMethod_491 0 65535 /end CHARACTERISTIC
/begin CHARACTERISTIC FaultManager.IPT_Status1_AgeCount.Action_2_Condition "Fault manager configuration.  Select up to 4 actions for each fault." VALUE 0x80000EA4 RecordLayout_7 0 CompuMethod_492 0 65535 /end CHARACTERISTIC
/begin CHARACTERISTIC FaultManager.IPT_Status1_AgeCount.Action_3 "Fault manager configuration.  Select up to 4 actions for each fault." VALUE 0x80000EA6 RecordLayout_7 0 CompuMethod_491 0 65535 /end CHARACTERISTIC
/begin CHARACTERISTIC FaultManager.IPT_Status1_AgeCount.Action_3_Condition "Fault manager configuration.  Select up to 4 actions for each fault." VALUE 0x80000EA8 RecordLayout_7 0 CompuMethod_492 0 65535 /end CHARACTERISTIC
/begin CHARACTERISTIC FaultManager.IPT_Status1_AgeCount.Action_4 "Fault manager configuration.  Select up to 4 actions for each fault." VALUE 0x80000EAA RecordLayout_7 0 CompuMethod_491 0 65535 /end CHARACTERISTIC
/begin CHARACTERISTIC FaultManager.IPT_Status1_AgeCount.Action_4_Condition "Fault manager configuration.  Select up to 4 actions for each fault." VALUE 0x80000EAC RecordLayout_7 0 CompuMethod_492 0 65535 /end CHARACTERISTIC
/begin CHARACTERISTIC FaultManager.IPT_Status2_AgeCount.Mode "Fault manager configuration.  Select up to 4 actions for each fault." VALUE 0x80000EAE RecordLayout_7 0 CompuMethod_489 0 65535 /end CHARACTERISTIC
/begin CHARACTERISTIC FaultManager.IPT_Status2_AgeCount.ID "Fault manager configuration.  Select up to 4 actions for each fault." VALUE 0x80000EB0 RecordLayout_7 0 CompuMethod_1 0 65535 /end CHARACTERISTIC
/begin CHARACTERISTIC FaultManager.IPT_Status2_AgeCount.Test "Fault manager configuration.  Select up to 4 actions for each fault." VALUE 0x80000EB2 RecordLayout_7 0 CompuMethod_490 0 65535 /end CHARACTERISTIC
/begin CHARACTERISTIC FaultManager.IPT_Status2_AgeCount.Faulty_Samples__X_ "Fault manager configuration.  Select up to 4 actions for each fault." VALUE 0x80000EB4 RecordLayout_7 0 CompuMethod_1 0 65535 /end CHARACTERISTIC
/begin CHARACTERISTIC FaultManager.IPT_Status2_AgeCount.Total_Samples__Y_ "Fault manager configuration.  Select up to 4 actions for each fault." VALUE 0x80000EB6 RecordLayout_7 0 CompuMethod_1 0 65535 /end CHARACTERISTIC
/begin CHARACTERISTIC FaultManager.IPT_Status2_AgeCount.Action_1 "Fault manager configuration.  Select up to 4 actions for each fault." VALUE 0x80000EB8 RecordLayout_7 0 CompuMethod_491 0 65535 /end CHARACTERISTIC
/begin CHARACTERISTIC FaultManager.IPT_Status2_AgeCount.Action_1_Condition "Fault manager configuration.  Select up to 4 actions for each fault." VALUE 0x80000EBA RecordLayout_7 0 CompuMethod_492 0 65535 /end CHARACTERISTIC
/begin CHARACTERISTIC FaultManager.IPT_Status2_AgeCount.Action_2 "Fault manager configuration.  Select up to 4 actions for each fault." VALUE 0x80000EBC RecordLayout_7 0 CompuMethod_491 0 65535 /end CHARACTERISTIC
/begin CHARACTERISTIC FaultManager.IPT_Status2_AgeCount.Action_2_Condition "Fault manager configuration.  Select up to 4 actions for each fault." VALUE 0x80000EBE RecordLayout_7 0 CompuMethod_492 0 65535 /end CHARACTERISTIC
/begin CHARACTERISTIC FaultManager.IPT_Status2_AgeCount.Action_3 "Fault manager configuration.  Select up to 4 actions for each fault." VALUE 0x80000EC0 RecordLayout_7 0 CompuMethod_491 0 65535 /end CHARACTERISTIC
/begin CHARACTERISTIC FaultManager.IPT_Status2_AgeCount.Action_3_Condition "Fault manager configuration.  Select up to 4 actions for each fault." VALUE 0x80000EC2 RecordLayout_7 0 CompuMethod_492 0 65535 /end CHARACTERISTIC
/begin CHARACTERISTIC FaultManager.IPT_Status2_AgeCount.Action_4 "Fault manager configuration.  Select up to 4 actions for each fault." VALUE 0x80000EC4 RecordLayout_7 0 CompuMethod_491 0 65535 /end CHARACTERISTIC
/begin CHARACTERISTIC FaultManager.IPT_Status2_AgeCount.Action_4_Condition "Fault manager configuration.  Select up to 4 actions for each fault." VALUE 0x80000EC6 RecordLayout_7 0 CompuMethod_492 0 65535 /end CHARACTERISTIC
/begin CHARACTERISTIC FaultManager.Key_Line_Voltage.Mode "Fault manager configuration.  Select up to 4 actions for each fault." VALUE 0x80000EC8 RecordLayout_7 0 CompuMethod_489 0 65535 /end CHARACTERISTIC
/begin CHARACTERISTIC FaultManager.Key_Line_Voltage.ID "Fault manager configuration.  Select up to 4 actions for each fault." VALUE 0x80000ECA RecordLayout_7 0 CompuMethod_1 0 65535 /end CHARACTERISTIC
/begin CHARACTERISTIC FaultManager.Key_Line_Voltage.Test "Fault manager configuration.  Select up to 4 actions for each fault." VALUE 0x80000ECC RecordLayout_7 0 CompuMethod_490 0 65535 /end CHARACTERISTIC
/begin CHARACTERISTIC FaultManager.Key_Line_Voltage.Faulty_Samples__X_ "Fault manager configuration.  Select up to 4 actions for each fault." VALUE 0x80000ECE RecordLayout_7 0 CompuMethod_1 0 65535 /end CHARACTERISTIC
/begin CHARACTERISTIC FaultManager.Key_Line_Voltage.Total_Samples__Y_ "Fault manager configuration.  Select up to 4 actions for each fault." VALUE 0x80000ED0 RecordLayout_7 0 CompuMethod_1 0 65535 /end CHARACTERISTIC
/begin CHARACTERISTIC FaultManager.Key_Line_Voltage.Action_1 "Fault manager configuration.  Select up to 4 actions for each fault." VALUE 0x80000ED2 RecordLayout_7 0 CompuMethod_491 0 65535 /end CHARACTERISTIC
/begin CHARACTERISTIC FaultManager.Key_Line_Voltage.Action_1_Condition "Fault manager configuration.  Select up to 4 actions for each fault." VALUE 0x80000ED4 RecordLayout_7 0 CompuMethod_492 0 65535 /end CHARACTERISTIC
/begin CHARACTERISTIC FaultManager.Key_Line_Voltage.Action_2 "Fault manager configuration.  Select up to 4 actions for each fault." VALUE 0x80000ED6 RecordLayout_7 0 CompuMethod_491 0 65535 /end CHARACTERISTIC
/begin CHARACTERISTIC FaultManager.Key_Line_Voltage.Action_2_Condition "Fault manager configuration.  Select up to 4 actions for each fault." VALUE 0x80000ED8 RecordLayout_7 0 CompuMethod_492 0 65535 /end CHARACTERISTIC
/begin CHARACTERISTIC FaultManager.Key_Line_Voltage.Action_3 "Fault manager configuration.  Select up to 4 actions for each fault." VALUE 0x80000EDA RecordLayout_7 0 CompuMethod_491 0 65535 /end CHARACTERISTIC
/begin CHARACTERISTIC FaultManager.Key_Line_Voltage.Action_3_Condition "Fault manager configuration.  Select up to 4 actions for each fault." VALUE 0x80000EDC RecordLayout_7 0 CompuMethod_492 0 65535 /end CHARACTERISTIC
/begin CHARACTERISTIC FaultManager.Key_Line_Voltage.Action_4 "Fault manager configuration.  Select up to 4 actions for each fault." VALUE 0x80000EDE RecordLayout_7 0 CompuMethod_491 0 65535 /end CHARACTERISTIC
/begin CHARACTERISTIC FaultManager.Key_Line_Voltage.Action_4_Condition "Fault manager configuration.  Select up to 4 actions for each fault." VALUE 0x80000EE0 RecordLayout_7 0 CompuMethod_492 0 65535 /end CHARACTERISTIC
/begin CHARACTERISTIC FaultManager.Key_Off_Voltage_High.Mode "Fault manager configuration.  Select up to 4 actions for each fault." VALUE 0x80000EE2 RecordLayout_7 0 CompuMethod_489 0 65535 /end CHARACTERISTIC
/begin CHARACTERISTIC FaultManager.Key_Off_Voltage_High.ID "Fault manager configuration.  Select up to 4 actions for each fault." VALUE 0x80000EE4 RecordLayout_7 0 CompuMethod_1 0 65535 /end CHARACTERISTIC
/begin CHARACTERISTIC FaultManager.Key_Off_Voltage_High.Test "Fault manager configuration.  Select up to 4 actions for each fault." VALUE 0x80000EE6 RecordLayout_7 0 CompuMethod_490 0 65535 /end CHARACTERISTIC
/begin CHARACTERISTIC FaultManager.Key_Off_Voltage_High.Faulty_Samples__X_ "Fault manager configuration.  Select up to 4 actions for each fault." VALUE 0x80000EE8 RecordLayout_7 0 CompuMethod_1 0 65535 /end CHARACTERISTIC
/begin CHARACTERISTIC FaultManager.Key_Off_Voltage_High.Total_Samples__Y_ "Fault manager configuration.  Select up to 4 actions for each fault." VALUE 0x80000EEA RecordLayout_7 0 CompuMethod_1 0 65535 /end CHARACTERISTIC
/begin CHARACTERISTIC FaultManager.Key_Off_Voltage_High.Action_1 "Fault manager configuration.  Select up to 4 actions for each fault." VALUE 0x80000EEC RecordLayout_7 0 CompuMethod_491 0 65535 /end CHARACTERISTIC
/begin CHARACTERISTIC FaultManager.Key_Off_Voltage_High.Action_1_Condition "Fault manager configuration.  Select up to 4 actions for each fault." VALUE 0x80000EEE RecordLayout_7 0 CompuMethod_492 0 65535 /end CHARACTERISTIC
/begin CHARACTERISTIC FaultManager.Key_Off_Voltage_High.Action_2 "Fault manager configuration.  Select up to 4 actions for each fault." VALUE 0x80000EF0 RecordLayout_7 0 CompuMethod_491 0 65535 /end CHARACTERISTIC
/begin CHARACTERISTIC FaultManager.Key_Off_Voltage_High.Action_2_Condition "Fault manager configuration.  Select up to 4 actions for each fault." VALUE 0x80000EF2 RecordLayout_7 0 CompuMethod_492 0 65535 /end CHARACTERISTIC
/begin CHARACTERISTIC FaultManager.Key_Off_Voltage_High.Action_3 "Fault manager configuration.  Select up to 4 actions for each fault." VALUE 0x80000EF4 RecordLayout_7 0 CompuMethod_491 0 65535 /end CHARACTERISTIC
/begin CHARACTERISTIC FaultManager.Key_Off_Voltage_High.Action_3_Condition "Fault manager configuration.  Select up to 4 actions for each fault." VALUE 0x80000EF6 RecordLayout_7 0 CompuMethod_492 0 65535 /end CHARACTERISTIC
/begin CHARACTERISTIC FaultManager.Key_Off_Voltage_High.Action_4 "Fault manager configuration.  Select up to 4 actions for each fault." VALUE 0x80000EF8 RecordLayout_7 0 CompuMethod_491 0 65535 /end CHARACTERISTIC
/begin CHARACTERISTIC FaultManager.Key_Off_Voltage_High.Action_4_Condition "Fault manager configuration.  Select up to 4 actions for each fault." VALUE 0x80000EFA RecordLayout_7 0 CompuMethod_492 0 65535 /end CHARACTERISTIC
/begin CHARACTERISTIC FaultManager.Park_Nuetral_Switch_Input_Circuit.Mode "Fault manager configuration.  Select up to 4 actions for each fault." VALUE 0x80000EFC RecordLayout_7 0 CompuMethod_489 0 65535 /end CHARACTERISTIC
/begin CHARACTERISTIC FaultManager.Park_Nuetral_Switch_Input_Circuit.ID "Fault manager configuration.  Select up to 4 actions for each fault." VALUE 0x80000EFE RecordLayout_7 0 CompuMethod_1 0 65535 /end CHARACTERISTIC
/begin CHARACTERISTIC FaultManager.Park_Nuetral_Switch_Input_Circuit.Test "Fault manager configuration.  Select up to 4 actions for each fault." VALUE 0x80000F00 RecordLayout_7 0 CompuMethod_490 0 65535 /end CHARACTERISTIC
/begin CHARACTERISTIC FaultManager.Park_Nuetral_Switch_Input_Circuit.Faulty_Samples__X_ "Fault manager configuration.  Select up to 4 actions for each fault." VALUE 0x80000F02 RecordLayout_7 0 CompuMethod_1 0 65535 /end CHARACTERISTIC
/begin CHARACTERISTIC FaultManager.Park_Nuetral_Switch_Input_Circuit.Total_Samples__Y_ "Fault manager configuration.  Select up to 4 actions for each fault." VALUE 0x80000F04 RecordLayout_7 0 CompuMethod_1 0 65535 /end CHARACTERISTIC
/begin CHARACTERISTIC FaultManager.Park_Nuetral_Switch_Input_Circuit.Action_1 "Fault manager configuration.  Select up to 4 actions for each fault." VALUE 0x80000F06 RecordLayout_7 0 CompuMethod_491 0 65535 /end CHARACTERISTIC
/begin CHARACTERISTIC FaultManager.Park_Nuetral_Switch_Input_Circuit.Action_1_Condition "Fault manager configuration.  Select up to 4 actions for each fault." VALUE 0x80000F08 RecordLayout_7 0 CompuMethod_492 0 65535 /end CHARACTERISTIC
/begin CHARACTERISTIC FaultManager.Park_Nuetral_Switch_Input_Circuit.Action_2 "Fault manager configuration.  Select up to 4 actions for each fault." VALUE 0x80000F0A RecordLayout_7 0 CompuMethod_491 0 65535 /end CHARACTERISTIC
/begin CHARACTERISTIC FaultManager.Park_Nuetral_Switch_Input_Circuit.Action_2_Condition "Fault manager configuration.  Select up to 4 actions for each fault." VALUE 0x80000F0C RecordLayout_7 0 CompuMethod_492 0 65535 /end CHARACTERISTIC
/begin CHARACTERISTIC FaultManager.Park_Nuetral_Switch_Input_Circuit.Action_3 "Fault manager configuration.  Select up to 4 actions for each fault." VALUE 0x80000F0E RecordLayout_7 0 CompuMethod_491 0 65535 /end CHARACTERISTIC
/begin CHARACTERISTIC FaultManager.Park_Nuetral_Switch_Input_Circuit.Action_3_Condition "Fault manager configuration.  Select up to 4 actions for each fault." VALUE 0x80000F10 RecordLayout_7 0 CompuMethod_492 0 65535 /end CHARACTERISTIC
/begin CHARACTERISTIC FaultManager.Park_Nuetral_Switch_Input_Circuit.Action_4 "Fault manager configuration.  Select up to 4 actions for each fault." VALUE 0x80000F12 RecordLayout_7 0 CompuMethod_491 0 65535 /end CHARACTERISTIC
/begin CHARACTERISTIC FaultManager.Park_Nuetral_Switch_Input_Circuit.Action_4_Condition "Fault manager configuration.  Select up to 4 actions for each fault." VALUE 0x80000F14 RecordLayout_7 0 CompuMethod_492 0 65535 /end CHARACTERISTIC
/begin CHARACTERISTIC FaultManager.Park_Nuetral_Switch_Input_High.Mode "Fault manager configuration.  Select up to 4 actions for each fault." VALUE 0x80000F16 RecordLayout_7 0 CompuMethod_489 0 65535 /end CHARACTERISTIC
/begin CHARACTERISTIC FaultManager.Park_Nuetral_Switch_Input_High.ID "Fault manager configuration.  Select up to 4 actions for each fault." VALUE 0x80000F18 RecordLayout_7 0 CompuMethod_1 0 65535 /end CHARACTERISTIC
/begin CHARACTERISTIC FaultManager.Park_Nuetral_Switch_Input_High.Test "Fault manager configuration.  Select up to 4 actions for each fault." VALUE 0x80000F1A RecordLayout_7 0 CompuMethod_490 0 65535 /end CHARACTERISTIC
/begin CHARACTERISTIC FaultManager.Park_Nuetral_Switch_Input_High.Faulty_Samples__X_ "Fault manager configuration.  Select up to 4 actions for each fault." VALUE 0x80000F1C RecordLayout_7 0 CompuMethod_1 0 65535 /end CHARACTERISTIC
/begin CHARACTERISTIC FaultManager.Park_Nuetral_Switch_Input_High.Total_Samples__Y_ "Fault manager configuration.  Select up to 4 actions for each fault." VALUE 0x80000F1E RecordLayout_7 0 CompuMethod_1 0 65535 /end CHARACTERISTIC
/begin CHARACTERISTIC FaultManager.Park_Nuetral_Switch_Input_High.Action_1 "Fault manager configuration.  Select up to 4 actions for each fault." VALUE 0x80000F20 RecordLayout_7 0 CompuMethod_491 0 65535 /end CHARACTERISTIC
/begin CHARACTERISTIC FaultManager.Park_Nuetral_Switch_Input_High.Action_1_Condition "Fault manager configuration.  Select up to 4 actions for each fault." VALUE 0x80000F22 RecordLayout_7 0 CompuMethod_492 0 65535 /end CHARACTERISTIC
/begin CHARACTERISTIC FaultManager.Park_Nuetral_Switch_Input_High.Action_2 "Fault manager configuration.  Select up to 4 actions for each fault." VALUE 0x80000F24 RecordLayout_7 0 CompuMethod_491 0 65535 /end CHARACTERISTIC
/begin CHARACTERISTIC FaultManager.Park_Nuetral_Switch_Input_High.Action_2_Condition "Fault manager configuration.  Select up to 4 actions for each fault." VALUE 0x80000F26 RecordLayout_7 0 CompuMethod_492 0 65535 /end CHARACTERISTIC
/begin CHARACTERISTIC FaultManager.Park_Nuetral_Switch_Input_High.Action_3 "Fault manager configuration.  Select up to 4 actions for each fault." VALUE 0x80000F28 RecordLayout_7 0 CompuMethod_491 0 65535 /end CHARACTERISTIC
/begin CHARACTERISTIC FaultManager.Park_Nuetral_Switch_Input_High.Action_3_Condition "Fault manager configuration.  Select up to 4 actions for each fault." VALUE 0x80000F2A RecordLayout_7 0 CompuMethod_492 0 65535 /end CHARACTERISTIC
/begin CHARACTERISTIC FaultManager.Park_Nuetral_Switch_Input_High.Action_4 "Fault manager configuration.  Select up to 4 actions for each fault." VALUE 0x80000F2C RecordLayout_7 0 CompuMethod_491 0 65535 /end CHARACTERISTIC
/begin CHARACTERISTIC FaultManager.Park_Nuetral_Switch_Input_High.Action_4_Condition "Fault manager configuration.  Select up to 4 actions for each fault." VALUE 0x80000F2E RecordLayout_7 0 CompuMethod_492 0 65535 /end CHARACTERISTIC
/begin CHARACTERISTIC FaultManager.Park_Nuetral_Switch_Input_Low.Mode "Fault manager configuration.  Select up to 4 actions for each fault." VALUE 0x80000F30 RecordLayout_7 0 CompuMethod_489 0 65535 /end CHARACTERISTIC
/begin CHARACTERISTIC FaultManager.Park_Nuetral_Switch_Input_Low.ID "Fault manager configuration.  Select up to 4 actions for each fault." VALUE 0x80000F32 RecordLayout_7 0 CompuMethod_1 0 65535 /end CHARACTERISTIC
/begin CHARACTERISTIC FaultManager.Park_Nuetral_Switch_Input_Low.Test "Fault manager configuration.  Select up to 4 actions for each fault." VALUE 0x80000F34 RecordLayout_7 0 CompuMethod_490 0 65535 /end CHARACTERISTIC
/begin CHARACTERISTIC FaultManager.Park_Nuetral_Switch_Input_Low.Faulty_Samples__X_ "Fault manager configuration.  Select up to 4 actions for each fault." VALUE 0x80000F36 RecordLayout_7 0 CompuMethod_1 0 65535 /end CHARACTERISTIC
/begin CHARACTERISTIC FaultManager.Park_Nuetral_Switch_Input_Low.Total_Samples__Y_ "Fault manager configuration.  Select up to 4 actions for each fault." VALUE 0x80000F38 RecordLayout_7 0 CompuMethod_1 0 65535 /end CHARACTERISTIC
/begin CHARACTERISTIC FaultManager.Park_Nuetral_Switch_Input_Low.Action_1 "Fault manager configuration.  Select up to 4 actions for each fault." VALUE 0x80000F3A RecordLayout_7 0 CompuMethod_491 0 65535 /end CHARACTERISTIC
/begin CHARACTERISTIC FaultManager.Park_Nuetral_Switch_Input_Low.Action_1_Condition "Fault manager configuration.  Select up to 4 actions for each fault." VALUE 0x80000F3C RecordLayout_7 0 CompuMethod_492 0 65535 /end CHARACTERISTIC
/begin CHARACTERISTIC FaultManager.Park_Nuetral_Switch_Input_Low.Action_2 "Fault manager configuration.  Select up to 4 actions for each fault." VALUE 0x80000F3E RecordLayout_7 0 CompuMethod_491 0 65535 /end CHARACTERISTIC
/begin CHARACTERISTIC FaultManager.Park_Nuetral_Switch_Input_Low.Action_2_Condition "Fault manager configuration.  Select up to 4 actions for each fault." VALUE 0x80000F40 RecordLayout_7 0 CompuMethod_492 0 65535 /end CHARACTERISTIC
/begin CHARACTERISTIC FaultManager.Park_Nuetral_Switch_Input_Low.Action_3 "Fault manager configuration.  Select up to 4 actions for each fault." VALUE 0x80000F42 RecordLayout_7 0 CompuMethod_491 0 65535 /end CHARACTERISTIC
/begin CHARACTERISTIC FaultManager.Park_Nuetral_Switch_Input_Low.Action_3_Condition "Fault manager configuration.  Select up to 4 actions for each fault." VALUE 0x80000F44 RecordLayout_7 0 CompuMethod_492 0 65535 /end CHARACTERISTIC
/begin CHARACTERISTIC FaultManager.Park_Nuetral_Switch_Input_Low.Action_4 "Fault manager configuration.  Select up to 4 actions for each fault." VALUE 0x80000F46 RecordLayout_7 0 CompuMethod_491 0 65535 /end CHARACTERISTIC
/begin CHARACTERISTIC FaultManager.Park_Nuetral_Switch_Input_Low.Action_4_Condition "Fault manager configuration.  Select up to 4 actions for each fault." VALUE 0x80000F48 RecordLayout_7 0 CompuMethod_492 0 65535 /end CHARACTERISTIC
/begin CHARACTERISTIC FaultManager.Pedal_Position_Sensor_A_Circuit_High.Mode "Fault manager configuration.  Select up to 4 actions for each fault." VALUE 0x80000F4A RecordLayout_7 0 CompuMethod_489 0 65535 /end CHARACTERISTIC
/begin CHARACTERISTIC FaultManager.Pedal_Position_Sensor_A_Circuit_High.ID "Fault manager configuration.  Select up to 4 actions for each fault." VALUE 0x80000F4C RecordLayout_7 0 CompuMethod_1 0 65535 /end CHARACTERISTIC
/begin CHARACTERISTIC FaultManager.Pedal_Position_Sensor_A_Circuit_High.Test "Fault manager configuration.  Select up to 4 actions for each fault." VALUE 0x80000F4E RecordLayout_7 0 CompuMethod_490 0 65535 /end CHARACTERISTIC
/begin CHARACTERISTIC FaultManager.Pedal_Position_Sensor_A_Circuit_High.Faulty_Samples__X_ "Fault manager configuration.  Select up to 4 actions for each fault." VALUE 0x80000F50 RecordLayout_7 0 CompuMethod_1 0 65535 /end CHARACTERISTIC
/begin CHARACTERISTIC FaultManager.Pedal_Position_Sensor_A_Circuit_High.Total_Samples__Y_ "Fault manager configuration.  Select up to 4 actions for each fault." VALUE 0x80000F52 RecordLayout_7 0 CompuMethod_1 0 65535 /end CHARACTERISTIC
/begin CHARACTERISTIC FaultManager.Pedal_Position_Sensor_A_Circuit_High.Action_1 "Fault manager configuration.  Select up to 4 actions for each fault." VALUE 0x80000F54 RecordLayout_7 0 CompuMethod_491 0 65535 /end CHARACTERISTIC
/begin RECORD_LAYOUT RecordLayout_7 FNC_VALUES 1 UWORD ROW_DIR DIRECT /end RECORD_LAYOUT
/*~~~~~~~~~ 6.3.31 COMPU_METHODs ~~~~~~~~~*/
/begin COMPU_METHOD CompuMethod_1 "" RAT_FUNC "%3.0" "" COEFFS 0 1 0 0 0 1 /end COMPU_METHOD
/begin COMPU_METHOD CompuMethod_489 "" TAB_VERB "%3.0" "" COMPU_TAB_REF CompuVtab_475 /end COMPU_METHOD
/begin COMPU_METHOD CompuMethod_490 "" TAB_VERB "%3.0" "" COMPU_TAB_REF CompuVtab_476 /end COMPU_METHOD
/begin COMPU_METHOD CompuMethod_491 "" TAB_VERB "%3.0" "" COMPU_TAB_REF CompuVtab_477 /end COMPU_METHOD
/begin COMPU_METHOD CompuMethod_492 "" TAB_VERB "%3.0" "" COMPU_TAB_REF CompuVtab_478 /end COMPU_METHOD
/begin COMPU_VTAB CompuVtab_475 "" TAB_VERB 6 0 "Disabled" 1 "Enabled" 2 "Sticky" 3 "Enabled - Persistent" 4 "Sticky - Persistent" 5 "Save Occurred" /end COMPU_VTAB
/begin COMPU_VTAB CompuVtab_476 "" TAB_VERB 2 0 "-" 1 "Test" /end COMPU_VTAB
/begin COMPU_VTAB CompuVtab_477 "" TAB_VERB 17 0 "Batt_Light" 1 "Batt_Shutdown" 2 "Cell_Voltage_Max" 3 "Check_Engine_Light" 4 "Check_Engine_Light_Flashing" 5 "Cooling_Max" 6 "Cruise" 7 "Dyno_Shutdown" 8 "EatonChargerFault" 9 "HV_Light" 10 "Pump_On" 11 "Regen_Brakes_Disabled" 12 "Set_Crawl_Home" 13 "Temperature_Flash" 14 "Temperature_Solid" 15 "Wrench_Light" 16 "(None)" /end COMPU_VTAB
/begin COMPU_VTAB CompuVtab_478 "" TAB_VERB 8 0 "(None)" 1 "Suspected" 2 "Active" 3 "Suspected or Active" 4 "Occurred" 5 "Suspected or Occurred" 6 "Active or Occurred" 7 "Suspected or Active or Occurred" /end COMPU_VTAB
/begin FUNCTION Faults_1 ""
 /begin DEF_CHARACTERISTIC FaultManager.Cruise_Control_Brake_Switch_A_Circuit_Malfunction.Action_4_Condition FaultManager.Cruise_Control_Coast_Signal_Malfunction.Mode FaultManager.Cruise_Control_Coast_Signal_Malfunction.ID FaultManager.Cruise_Control_Coast_Signal_Malfunction.Test FaultManager.Cruise_Control_Coast_Signal_Malfunction.Faulty_Samples__X_ FaultManager.Cruise_Control_Coast_Signal_Malfunction.Total_Samples__Y_ FaultManager.Cruise_Control_Coast_Signal_Malfunction.Action_1 FaultManager.Cruise_Control_Coast_Signal_Malfunction.Action_1_Condition FaultManager.Cruise_Control_Coast_Signal_Malfunction.Action_2 FaultManager.Cruise_Control_Coast_Signal_Malfunction.Action_2_Condition FaultManager.Cruise_Control_Coast_Signal_Malfunction.Action_3 FaultManager.Cruise_Control_Coast_Signal_Malfunction.Action_3_Condition FaultManager.Cruise_Control_Coast_Signal_Malfunction.Action_4 FaultManager.Cruise_Control_Coast_Signal_Malfunction.Action_4_Condition FaultManager.Cruise_Control_Off_Signal_Malfunction.Mode FaultManager.Cruise_Control_Off_Signal_Malfunction.ID FaultManager.Cruise_Control_Off_Signal_Malfunction.Test FaultManager.Cruise_Control_Off_Signal_Malfunction.Faulty_Samples__X_ FaultManager.Cruise_Control_Off_Signal_Malfunction.Total_Samples__Y_ FaultManager.Cruise_Control_Off_Signal_Malfunction.Action_1 FaultManager.Cruise_Control_Off_Signal_Malfunction.Action_1_Condition FaultManager.Cruise_Control_Off_Signal_Malfunction.Action_2 FaultManager.Cruise_Control_Off_Signal_Malfunction.Action_2_Condition FaultManager.Cruise_Control_Off_Signal_Malfunction.Action_3 FaultManager.Cruise_Control_Off_Signal_Malfunction.Action_3_Condition FaultManager.Cruise_Control_Off_Signal_Malfunction.Action_4 FaultManager.Cruise_Control_Off_Signal_Malfunction.Action_4_Condition FaultManager.Cruise_Control_On_Signal_Malfunction.Mode FaultManager.Cruise_Control_On_Signal_Malfunction.ID FaultManager.Cruise_Control_On_Signal_Malfunction.Test FaultManager.Cruise_Control_On_Signal_Malfunction.Faulty_Samples__X_ FaultManager.Cruise_Control_On_Signal_Malfunction.Total_Samples__Y_ FaultManager.Cruise_Control_On_Signal_Malfunction.Action_1 FaultManager.Cruise_Control_On_Signal_Malfunction.Action_1_Condition FaultManager.Cruise_Control_On_Signal_Malfunction.Action_2 FaultManager.Cruise_Control_On_Signal_Malfunction.Action_2_Condition FaultManager.Cruise_Control_On_Signal_Malfunction.Action_3 FaultManager.Cruise_Control_On_Signal_Malfunction.Action_3_Condition FaultManager.Cruise_Control_On_Signal_Malfunction.Action_4 FaultManager.Cruise_Control_On_Signal_Malfunction.Action_4_Condition FaultManager.Cruise_Control_Resume_Signal_Malfunction.Mode FaultManager.Cruise_Control_Resume_Signal_Malfunction.ID FaultManager.Cruise_Control_Resume_Signal_Malfunction.Test FaultManager.Cruise_Control_Resume_Signal_Malfunction.Faulty_Samples__X_ FaultManager.Cruise_Control_Resume_Signal_Malfunction.Total_Samples__Y_ FaultManager.Cruise_Control_Resume_Signal_Malfunction.Action_1 FaultManager.Cruise_Control_Resume_Signal_Malfunction.Action_1_Condition FaultManager.Cruise_Control_Resume_Signal_Malfunction.Action_2 FaultManager.Cruise_Control_Resume_Signal_Malfunction.Action_2_Condition FaultManager.Cruise_Control_Resume_Signal_Malfunction.Action_3 FaultManager.Cruise_Control_Resume_Signal_Malfunction.Action_3_Condition FaultManager.Cruise_Control_Resume_Signal_Malfunction.Action_4 FaultManager.Cruise_Control_Resume_Signal_Malfunction.Action_4_Condition FaultManager.Cruise_Control_Set_Signal_Malfunction.Mode FaultManager.Cruise_Control_Set_Signal_Malfunction.ID FaultManager.Cruise_Control_Set_Signal_Malfunction.Test FaultManager.Cruise_Control_Set_Signal_Malfunction.Faulty_Samples__X_ FaultManager.Cruise_Control_Set_Signal_Malfunction.Total_Samples__Y_ FaultManager.Cruise_Control_Set_Signal_Malfunction.Action_1 FaultManager.Cruise_Control_Set_Signal_Malfunction.Action_1_Condition FaultManager.Cruise_Control_Set_Signal_Malfunction.Action_2 FaultManager.Cruise_Control_Set_Signal_Malfunction.Action_2_Condition FaultManager.Cruise_Control_Set_Signal_Malfunction.Action_3 FaultManager.Cruise_Control_Set_Signal_Malfunction.Action_3_Condition FaultManager.Cruise_Control_Set_Signal_Malfunction.Action_4 FaultManager.Cruise_Control_Set_Signal_Malfunction.Action_4_Condition FaultManager.DCDC_Converter_Not_Running.Mode FaultManager.DCDC_Converter_Not_Running.ID FaultManager.DCDC_Converter_Not_Running.Test FaultManager.DCDC_Converter_Not_Running.Faulty_Samples__X_ FaultManager.DCDC_Converter_Not_Running.Total_Samples__Y_ FaultManager.DCDC_Converter_Not_Running.Action_1 FaultManager.DCDC_Converter_Not_Running.Action_1_Condition FaultManager.DCDC_Converter_Not_Running.Action_2 FaultManager.DCDC_Converter_Not_Running.Action_2_Condition FaultManager.DCDC_Converter_Not_Running.Action_3 FaultManager.DCDC_Converter_Not_Running.Action_3_Condition FaultManager.DCDC_Converter_Not_Running.Action_4 FaultManager.DCDC_Converter_Not_Running.Action_4_Condition FaultManager.Drive_Switch_Input_Circuit.Mode FaultManager.Drive_Switch_Input_Circuit.ID FaultManager.Drive_Switch_Input_Circuit.Test FaultManager.Drive_Switch_Input_Circuit.Faulty_Samples__X_ FaultManager.Drive_Switch_Input_Circuit.Total_Samples__Y_ FaultManager.Drive_Switch_Input_Circuit.Action_1 FaultManager.Drive_Switch_Input_Circuit.Action_1_Condition FaultManager.Drive_Switch_Input_Circuit.Action_2 FaultManager.Drive_Switch_Input_Circuit.Action_2_Condition FaultManager.Drive_Switch_Input_Circuit.Action_3 FaultManager.Drive_Switch_Input_Circuit.Action_3_Condition FaultManager.Drive_Switch_Input_Circuit.Action_4 FaultManager.Drive_Switch_Input_Circuit.Action_4_Condition FaultManager.Drive_Switch_Input_High.Mode FaultManager.Drive_Switch_Input_High.ID FaultManager.Drive_Switch_Input_High.Test FaultManager.Drive_Switch_Input_High.Faulty_Samples__X_ FaultManager.Drive_Switch_Input_High.Total_Samples__Y_ FaultManager.Drive_Switch_Input_High.Action_1 FaultManager.Drive_Switch_Input_High.Action_1_Condition FaultManager.Drive_Switch_Input_High.Action_2 FaultManager.Drive_Switch_Input_High.Action_2_Condition FaultManager.Drive_Switch_Input_High.Action_3 FaultManager.Drive_Switch_Input_High.Action_3_Condition FaultManager.Drive_Switch_Input_High.Action_4 FaultManager.Drive_Switch_Input_High.Action_4_Condition FaultManager.Drive_Switch_Input_Low.Mode FaultManager.Drive_Switch_Input_Low.ID FaultManager.Drive_Switch_Input_Low.Test FaultManager.Drive_Switch_Input_Low.Faulty_Samples__X_ FaultManager.Drive_Switch_Input_Low.Total_Samples__Y_ FaultManager.Drive_Switch_Input_Low.Action_1 FaultManager.Drive_Switch_Input_Low.Action_1_Condition FaultManager.Drive_Switch_Input_Low.Action_2 FaultManager.Drive_Switch_Input_Low.Action_2_Condition FaultManager.Drive_Switch_Input_Low.Action_3 FaultManager.Drive_Switch_Input_Low.Action_3_Condition FaultManager.Drive_Switch_Input_Low.Action_4 FaultManager.Drive_Switch_Input_Low.Action_4_Condition FaultManager.Eaton_Charger_AgeCount.Mode FaultManager.Eaton_Charger_AgeCount.ID FaultManager.Eaton_Charger_AgeCount.Test FaultManager.Eaton_Charger_AgeCount.Faulty_Samples__X_ FaultManager.Eaton_Charger_AgeCount.Total_Samples__Y_ FaultManager.Eaton_Charger_AgeCount.Action_1 FaultManager.Eaton_Charger_AgeCount.Action_1_Condition FaultManager.Eaton_Charger_AgeCount.Action_2 FaultManager.Eaton_Charger_AgeCount.Action_2_Condition FaultManager.Eaton_Charger_AgeCount.Action_3 FaultManager.Eaton_Charger_AgeCount.Action_3_Condition FaultManager.Eaton_Charger_AgeCount.Action_4 FaultManager.Eaton_Charger_AgeCount.Action_4_Condition FaultManager.Electric_Motor_Approaching_Over_Temperature.Mode FaultManager.Electric_Motor_Approaching_Over_Temperature.ID FaultManager.Electric_Motor_Approaching_Over_Temperature.Test FaultManager.Electric_Motor_Approaching_Over_Temperature.Faulty_Samples__X_ FaultManager.Electric_Motor_Approaching_Over_Temperature.Total_Samples__Y_ FaultManager.Electric_Motor_Approaching_Over_Temperature.Action_1 FaultManager.Electric_Motor_Approaching_Over_Temperature.Action_1_Condition FaultManager.Electric_Motor_Approaching_Over_Temperature.Action_2 FaultManager.Electric_Motor_Approaching_Over_Temperature.Action_2_Condition FaultManager.Electric_Motor_Approaching_Over_Temperature.Action_3 FaultManager.Electric_Motor_Approaching_Over_Temperature.Action_3_Condition FaultManager.Electric_Motor_Approaching_Over_Temperature.Action_4 FaultManager.Electric_Motor_Approaching_Over_Temperature.Action_4_Condition FaultManager.Electric_Motor_Derated_Over_Temperature.Mode FaultManager.Electric_Motor_Derated_Over_Temperature.ID FaultManager.Electric_Motor_Derated_Over_Temperature.Test FaultManager.Electric_Motor_Derated_Over_Temperature.Faulty_Samples__X_ FaultManager.Electric_Motor_Derated_Over_Temperature.Total_Samples__Y_ FaultManager.Electric_Motor_Derated_Over_Temperature.Action_1 FaultManager.Electric_Motor_Derated_Over_Temperature.Action_1_Condition FaultManager.Electric_Motor_Derated_Over_Temperature.Action_2 FaultManager.Electric_Motor_Derated_Over_Temperature.Action_2_Condition FaultManager.Electric_Motor_Derated_Over_Temperature.Action_3 FaultManager.Electric_Motor_Derated_Over_Temperature.Action_3_Condition FaultManager.Electric_Motor_Derated_Over_Temperature.Action_4 FaultManager.Electric_Motor_Derated_Over_Temperature.Action_4_Condition FaultManager.Electric_Motor_Derated_Over_Voltage.Mode FaultManager.Electric_Motor_Derated_Over_Voltage.ID FaultManager.Electric_Motor_Derated_Over_Voltage.Test FaultManager.Electric_Motor_Derated_Over_Voltage.Faulty_Samples__X_ FaultManager.Electric_Motor_Derated_Over_Voltage.Total_Samples__Y_ FaultManager.Electric_Motor_Derated_Over_Voltage.Action_1 FaultManager.Electric_Motor_Derated_Over_Voltage.Action_1_Condition FaultManager.Electric_Motor_Derated_Over_Voltage.Action_2 FaultManager.Electric_Motor_Derated_Over_Voltage.Action_2_Condition FaultManager.Electric_Motor_Derated_Over_Voltage.Action_3 FaultManager.Electric_Motor_Derated_Over_Voltage.Action_3_Condition FaultManager.Electric_Motor_Derated_Over_Voltage.Action_4 FaultManager.Electric_Motor_Derated_Over_Voltage.Action_4_Condition FaultManager.Electric_Motor_Derated_Under_Temperature.Mode FaultManager.Electric_Motor_Derated_Under_Temperature.ID FaultManager.Electric_Motor_Derated_Under_Temperature.Test FaultManager.Electric_Motor_Derated_Under_Temperature.Faulty_Samples__X_ FaultManager.Electric_Motor_Derated_Under_Temperature.Total_Samples__Y_ FaultManager.Electric_Motor_Derated_Under_Temperature.Action_1 FaultManager.Electric_Motor_Derated_Under_Temperature.Action_1_Condition FaultManager.Electric_Motor_Derated_Under_Temperature.Action_2 FaultManager.Electric_Motor_Derated_Under_Temperature.Action_2_Condition FaultManager.Electric_Motor_Derated_Under_Temperature.Action_3 FaultManager.Electric_Motor_Derated_Under_Temperature.Action_3_Condition FaultManager.Electric_Motor_Derated_Under_Temperature.Action_4 FaultManager.Electric_Motor_Derated_Under_Temperature.Action_4_Condition FaultManager.Electric_Motor_Derated_Under_Voltage.Mode FaultManager.Electric_Motor_Derated_Under_Voltage.ID FaultManager.Electric_Motor_Derated_Under_Voltage.Test FaultManager.Electric_Motor_Derated_Under_Voltage.Faulty_Samples__X_ FaultManager.Electric_Motor_Derated_Under_Voltage.Total_Samples__Y_ FaultManager.Electric_Motor_Derated_Under_Voltage.Action_1 FaultManager.Electric_Motor_Derated_Under_Voltage.Action_1_Condition FaultManager.Electric_Motor_Derated_Under_Voltage.Action_2 FaultManager.Electric_Motor_Derated_Under_Voltage.Action_2_Condition FaultManager.Electric_Motor_Derated_Under_Voltage.Action_3 FaultManager.Electric_Motor_Derated_Under_Voltage.Action_3_Condition FaultManager.Electric_Motor_Derated_Under_Voltage.Action_4 FaultManager.Electric_Motor_Derated_Under_Voltage.Action_4_Condition FaultManager.Electric_Motor_General_Error.Mode FaultManager.Electric_Motor_General_Error.ID FaultManager.Electric_Motor_General_Error.Test FaultManager.Electric_Motor_General_Error.Faulty_Samples__X_ FaultManager.Electric_Motor_General_Error.Total_Samples__Y_ FaultManager.Electric_Motor_General_Error.Action_1 FaultManager.Electric_Motor_General_Error.Action_1_Condition FaultManager.Electric_Motor_General_Error.Action_2 FaultManager.Electric_Motor_General_Error.Action_2_Condition FaultManager.Electric_Motor_General_Error.Action_3 FaultManager.Electric_Motor_General_Error.Action_3_Condition FaultManager.Electric_Motor_General_Error.Action_4 FaultManager.Electric_Motor_General_Error.Action_4_Condition FaultManager.Electric_Motor_Over_Speed_Forward.Mode FaultManager.Electric_Motor_Over_Speed_Forward.ID FaultManager.Electric_Motor_Over_Speed_Forward.Test FaultManager.Electric_Motor_Over_Speed_Forward.Faulty_Samples__X_ FaultManager.Electric_Motor_Over_Speed_Forward.Total_Samples__Y_ FaultManager.Electric_Motor_Over_Speed_Forward.Action_1 FaultManager.Electric_Motor_Over_Speed_Forward.Action_1_Condition FaultManager.Electric_Motor_Over_Speed_Forward.Action_2 FaultManager.Electric_Motor_Over_Speed_Forward.Action_2_Condition FaultManager.Electric_Motor_Over_Speed_Forward.Action_3 FaultManager.Electric_Motor_Over_Speed_Forward.Action_3_Condition FaultManager.Electric_Motor_Over_Speed_Forward.Action_4 FaultManager.Electric_Motor_Over_Speed_Forward.Action_4_Condition FaultManager.Electric_Motor_Over_Speed_Reverse.Mode FaultManager.Electric_Motor_Over_Speed_Reverse.ID FaultManager.Electric_Motor_Over_Speed_Reverse.Test FaultManager.Electric_Motor_Over_Speed_Reverse.Faulty_Samples__X_ FaultManager.Electric_Motor_Over_Speed_Reverse.Total_Samples__Y_ FaultManager.Electric_Motor_Over_Speed_Reverse.Action_1 FaultManager.Electric_Motor_Over_Speed_Reverse.Action_1_Condition FaultManager.Electric_Motor_Over_Speed_Reverse.Action_2 FaultManager.Electric_Motor_Over_Speed_Reverse.Action_2_Condition FaultManager.Electric_Motor_Over_Speed_Reverse.Action_3 FaultManager.Electric_Motor_Over_Speed_Reverse.Action_3_Condition FaultManager.Electric_Motor_Over_Speed_Reverse.Action_4 FaultManager.Electric_Motor_Over_Speed_Reverse.Action_4_Condition FaultManager.Electric_Motor_Shutodwn_Error.Mode FaultManager.Electric_Motor_Shutodwn_Error.ID FaultManager.Electric_Motor_Shutodwn_Error.Test FaultManager.Electric_Motor_Shutodwn_Error.Faulty_Samples__X_ FaultManager.Electric_Motor_Shutodwn_Error.Total_Samples__Y_ FaultManager.Electric_Motor_Shutodwn_Error.Action_1 FaultManager.Electric_Motor_Shutodwn_Error.Action_1_Condition FaultManager.Electric_Motor_Shutodwn_Error.Action_2 FaultManager.Electric_Motor_Shutodwn_Error.Action_2_Condition FaultManager.Electric_Motor_Shutodwn_Error.Action_3 FaultManager.Electric_Motor_Shutodwn_Error.Action_3_Condition FaultManager.Electric_Motor_Shutodwn_Error.Action_4 FaultManager.Electric_Motor_Shutodwn_Error.Action_4_Condition FaultManager.Electric_Motor_Torque_Output_Fault.Mode FaultManager.Electric_Motor_Torque_Output_Fault.ID FaultManager.Electric_Motor_Torque_Output_Fault.Test FaultManager.Electric_Motor_Torque_Output_Fault.Faulty_Samples__X_ FaultManager.Electric_Motor_Torque_Output_Fault.Total_Samples__Y_ FaultManager.Electric_Motor_Torque_Output_Fault.Action_1 FaultManager.Electric_Motor_Torque_Output_Fault.Action_1_Condition FaultManager.Electric_Motor_Torque_Output_Fault.Action_2 FaultManager.Electric_Motor_Torque_Output_Fault.Action_2_Condition FaultManager.Electric_Motor_Torque_Output_Fault.Action_3 FaultManager.Electric_Motor_Torque_Output_Fault.Action_3_Condition FaultManager.Electric_Motor_Torque_Output_Fault.Action_4 FaultManager.Electric_Motor_Torque_Output_Fault.Action_4_Condition FaultManager.Gear_Shift_Communication_Circuit.Mode FaultManager.Gear_Shift_Communication_Circuit.ID FaultManager.Gear_Shift_Communication_Circuit.Test FaultManager.Gear_Shift_Communication_Circuit.Faulty_Samples__X_ FaultManager.Gear_Shift_Communication_Circuit.Total_Samples__Y_ FaultManager.Gear_Shift_Communication_Circuit.Action_1 FaultManager.Gear_Shift_Communication_Circuit.Action_1_Condition FaultManager.Gear_Shift_Communication_Circuit.Action_2 FaultManager.Gear_Shift_Communication_Circuit.Action_2_Condition FaultManager.Gear_Shift_Communication_Circuit.Action_3 FaultManager.Gear_Shift_Communication_Circuit.Action_3_Condition FaultManager.Gear_Shift_Communication_Circuit.Action_4 FaultManager.Gear_Shift_Communication_Circuit.Action_4_Condition FaultManager.HV_Battery_2G_BMS_Fault.Mode FaultManager.HV_Battery_2G_BMS_Fault.ID FaultManager.HV_Battery_2G_BMS_Fault.Test FaultManager.HV_Battery_2G_BMS_Fault.Faulty_Samples__X_ FaultManager.HV_Battery_2G_BMS_Fault.Total_Samples__Y_ FaultManager.HV_Battery_2G_BMS_Fault.Action_1 FaultManager.HV_Battery_2G_BMS_Fault.Action_1_Condition FaultManager.HV_Battery_2G_BMS_Fault.Action_2 FaultManager.HV_Battery_2G_BMS_Fault.Action_2_Condition FaultManager.HV_Battery_2G_BMS_Fault.Action_3 FaultManager.HV_Battery_2G_BMS_Fault.Action_3_Condition FaultManager.HV_Battery_2G_BMS_Fault.Action_4 FaultManager.HV_Battery_2G_BMS_Fault.Action_4_Condition FaultManager.HV_Battery_48_Controller_Communication_Fault.Mode FaultManager.HV_Battery_48_Controller_Communication_Fault.ID FaultManager.HV_Battery_48_Controller_Communication_Fault.Test FaultManager.HV_Battery_48_Controller_Communication_Fault.Faulty_Samples__X_ FaultManager.HV_Battery_48_Controller_Communication_Fault.Total_Samples__Y_ FaultManager.HV_Battery_48_Controller_Communication_Fault.Action_1 FaultManager.HV_Battery_48_Controller_Communication_Fault.Action_1_Condition FaultManager.HV_Battery_48_Controller_Communication_Fault.Action_2 FaultManager.HV_Battery_48_Controller_Communication_Fault.Action_2_Condition FaultManager.HV_Battery_48_Controller_Communication_Fault.Action_3 FaultManager.HV_Battery_48_Controller_Communication_Fault.Action_3_Condition FaultManager.HV_Battery_48_Controller_Communication_Fault.Action_4 FaultManager.HV_Battery_48_Controller_Communication_Fault.Action_4_Condition FaultManager.HV_Battery_Above_Safe_Charge_Point.Mode FaultManager.HV_Battery_Above_Safe_Charge_Point.ID FaultManager.HV_Battery_Above_Safe_Charge_Point.Test FaultManager.HV_Battery_Above_Safe_Charge_Point.Faulty_Samples__X_ FaultManager.HV_Battery_Above_Safe_Charge_Point.Total_Samples__Y_ FaultManager.HV_Battery_Above_Safe_Charge_Point.Action_1 FaultManager.HV_Battery_Above_Safe_Charge_Point.Action_1_Condition FaultManager.HV_Battery_Above_Safe_Charge_Point.Action_2 FaultManager.HV_Battery_Above_Safe_Charge_Point.Action_2_Condition FaultManager.HV_Battery_Above_Safe_Charge_Point.Action_3 FaultManager.HV_Battery_Above_Safe_Charge_Point.Action_3_Condition FaultManager.HV_Battery_Above_Safe_Charge_Point.Action_4 FaultManager.HV_Battery_Above_Safe_Charge_Point.Action_4_Condition FaultManager.HV_Battery_Cell_Balancing_Required_Fault.Mode FaultManager.HV_Battery_Cell_Balancing_Required_Fault.ID FaultManager.HV_Battery_Cell_Balancing_Required_Fault.Test FaultManager.HV_Battery_Cell_Balancing_Required_Fault.Faulty_Samples__X_ FaultManager.HV_Battery_Cell_Balancing_Required_Fault.Total_Samples__Y_ FaultManager.HV_Battery_Cell_Balancing_Required_Fault.Action_1 FaultManager.HV_Battery_Cell_Balancing_Required_Fault.Action_1_Condition FaultManager.HV_Battery_Cell_Balancing_Required_Fault.Action_2 FaultManager.HV_Battery_Cell_Balancing_Required_Fault.Action_2_Condition FaultManager.HV_Battery_Cell_Balancing_Required_Fault.Action_3 FaultManager.HV_Battery_Cell_Balancing_Required_Fault.Action_3_Condition FaultManager.HV_Battery_Cell_Balancing_Required_Fault.Action_4 FaultManager.HV_Battery_Cell_Balancing_Required_Fault.Action_4_Condition FaultManager.HV_Battery_Pack_Above_Operating_Temperature.Mode FaultManager.HV_Battery_Pack_Above_Operating_Temperature.ID FaultManager.HV_Battery_Pack_Above_Operating_Temperature.Test FaultManager.HV_Battery_Pack_Above_Operating_Temperature.Faulty_Samples__X_ FaultManager.HV_Battery_Pack_Above_Operating_Temperature.Total_Samples__Y_ FaultManager.HV_Battery_Pack_Above_Operating_Temperature.Action_1 FaultManager.HV_Battery_Pack_Above_Operating_Temperature.Action_1_Condition FaultManager.HV_Battery_Pack_Above_Operating_Temperature.Action_2 FaultManager.HV_Battery_Pack_Above_Operating_Temperature.Action_2_Condition FaultManager.HV_Battery_Pack_Above_Operating_Temperature.Action_3 FaultManager.HV_Battery_Pack_Above_Operating_Temperature.Action_3_Condition FaultManager.HV_Battery_Pack_Above_Operating_Temperature.Action_4 FaultManager.HV_Battery_Pack_Above_Operating_Temperature.Action_4_Condition FaultManager.HV_Battery_Pack_Below_Operating_Temperature.Mode FaultManager.HV_Battery_Pack_Below_Operating_Temperature.ID FaultManager.HV_Battery_Pack_Below_Operating_Temperature.Test FaultManager.HV_Battery_Pack_Below_Operating_Temperature.Faulty_Samples__X_ FaultManager.HV_Battery_Pack_Below_Operating_Temperature.Total_Samples__Y_ FaultManager.HV_Battery_Pack_Below_Operating_Temperature.Action_1 FaultManager.HV_Battery_Pack_Below_Operating_Temperature.Action_1_Condition FaultManager.HV_Battery_Pack_Below_Operating_Temperature.Action_2 FaultManager.HV_Battery_Pack_Below_Operating_Temperature.Action_2_Condition FaultManager.HV_Battery_Pack_Below_Operating_Temperature.Action_3 FaultManager.HV_Battery_Pack_Below_Operating_Temperature.Action_3_Condition FaultManager.HV_Battery_Pack_Below_Operating_Temperature.Action_4 FaultManager.HV_Battery_Pack_Below_Operating_Temperature.Action_4_Condition FaultManager.HV_Battery_Pack_High_Temperature.Mode FaultManager.HV_Battery_Pack_High_Temperature.ID FaultManager.HV_Battery_Pack_High_Temperature.Test FaultManager.HV_Battery_Pack_High_Temperature.Faulty_Samples__X_ FaultManager.HV_Battery_Pack_High_Temperature.Total_Samples__Y_ FaultManager.HV_Battery_Pack_High_Temperature.Action_1 FaultManager.HV_Battery_Pack_High_Temperature.Action_1_Condition FaultManager.HV_Battery_Pack_High_Temperature.Action_2 FaultManager.HV_Battery_Pack_High_Temperature.Action_2_Condition FaultManager.HV_Battery_Pack_High_Temperature.Action_3 FaultManager.HV_Battery_Pack_High_Temperature.Action_3_Condition FaultManager.HV_Battery_Pack_High_Temperature.Action_4 FaultManager.HV_Battery_Pack_High_Temperature.Action_4_Condition FaultManager.HV_Battery_Pack_Low_Temperature.Mode FaultManager.HV_Battery_Pack_Low_Temperature.ID FaultManager.HV_Battery_Pack_Low_Temperature.Test FaultManager.HV_Battery_Pack_Low_Temperature.Faulty_Samples__X_ FaultManager.HV_Battery_Pack_Low_Temperature.Total_Samples__Y_ FaultManager.HV_Battery_Pack_Low_Temperature.Action_1 FaultManager.HV_Battery_Pack_Low_Temperature.Action_1_Condition FaultManager.HV_Battery_Pack_Low_Temperature.Action_2 FaultManager.HV_Battery_Pack_Low_Temperature.Action_2_Condition FaultManager.HV_Battery_Pack_Low_Temperature.Action_3 FaultManager.HV_Battery_Pack_Low_Temperature.Action_3_Condition FaultManager.HV_Battery_Pack_Low_Temperature.Action_4 FaultManager.HV_Battery_Pack_Low_Temperature.Action_4_Condition FaultManager.HV_Battery_Precharge_Failure.Mode FaultManager.HV_Battery_Precharge_Failure.ID FaultManager.HV_Battery_Precharge_Failure.Test FaultManager.HV_Battery_Precharge_Failure.Faulty_Samples__X_ FaultManager.HV_Battery_Precharge_Failure.Total_Samples__Y_ FaultManager.HV_Battery_Precharge_Failure.Action_1 FaultManager.HV_Battery_Precharge_Failure.Action_1_Condition FaultManager.HV_Battery_Precharge_Failure.Action_2 FaultManager.HV_Battery_Precharge_Failure.Action_2_Condition FaultManager.HV_Battery_Precharge_Failure.Action_3 FaultManager.HV_Battery_Precharge_Failure.Action_3_Condition FaultManager.HV_Battery_Precharge_Failure.Action_4 FaultManager.HV_Battery_Precharge_Failure.Action_4_Condition FaultManager.HV_Battery_Too_Low_For_Load.Mode FaultManager.HV_Battery_Too_Low_For_Load.ID FaultManager.HV_Battery_Too_Low_For_Load.Test FaultManager.HV_Battery_Too_Low_For_Load.Faulty_Samples__X_ FaultManager.HV_Battery_Too_Low_For_Load.Total_Samples__Y_ FaultManager.HV_Battery_Too_Low_For_Load.Action_1 FaultManager.HV_Battery_Too_Low_For_Load.Action_1_Condition FaultManager.HV_Battery_Too_Low_For_Load.Action_2 FaultManager.HV_Battery_Too_Low_For_Load.Action_2_Condition FaultManager.HV_Battery_Too_Low_For_Load.Action_3 FaultManager.HV_Battery_Too_Low_For_Load.Action_3_Condition FaultManager.HV_Battery_Too_Low_For_Load.Action_4 FaultManager.HV_Battery_Too_Low_For_Load.Action_4_Condition FaultManager.HV_Battery_Try_To_Balance_Under_Load.Mode FaultManager.HV_Battery_Try_To_Balance_Under_Load.ID FaultManager.HV_Battery_Try_To_Balance_Under_Load.Test FaultManager.HV_Battery_Try_To_Balance_Under_Load.Faulty_Samples__X_ FaultManager.HV_Battery_Try_To_Balance_Under_Load.Total_Samples__Y_ FaultManager.HV_Battery_Try_To_Balance_Under_Load.Action_1 FaultManager.HV_Battery_Try_To_Balance_Under_Load.Action_1_Condition FaultManager.HV_Battery_Try_To_Balance_Under_Load.Action_2 FaultManager.HV_Battery_Try_To_Balance_Under_Load.Action_2_Condition FaultManager.HV_Battery_Try_To_Balance_Under_Load.Action_3 FaultManager.HV_Battery_Try_To_Balance_Under_Load.Action_3_Condition FaultManager.HV_Battery_Try_To_Balance_Under_Load.Action_4 FaultManager.HV_Battery_Try_To_Balance_Under_Load.Action_4_Condition FaultManager.HV_Heater_Over_Temperature.Mode FaultManager.HV_Heater_Over_Temperature.ID FaultManager.HV_Heater_Over_Temperature.Test FaultManager.HV_Heater_Over_Temperature.Faulty_Samples__X_ FaultManager.HV_Heater_Over_Temperature.Total_Samples__Y_ FaultManager.HV_Heater_Over_Temperature.Action_1 FaultManager.HV_Heater_Over_Temperature.Action_1_Condition FaultManager.HV_Heater_Over_Temperature.Action_2 FaultManager.HV_Heater_Over_Temperature.Action_2_Condition FaultManager.HV_Heater_Over_Temperature.Action_3 FaultManager.HV_Heater_Over_Temperature.Action_3_Condition FaultManager.HV_Heater_Over_Temperature.Action_4 FaultManager.HV_Heater_Over_Temperature.Action_4_Condition FaultManager.HV_Heater_Poor_Performance.Mode FaultManager.HV_Heater_Poor_Performance.ID FaultManager.HV_Heater_Poor_Performance.Test FaultManager.HV_Heater_Poor_Performance.Faulty_Samples__X_ FaultManager.HV_Heater_Poor_Performance.Total_Samples__Y_ FaultManager.HV_Heater_Poor_Performance.Action_1 FaultManager.HV_Heater_Poor_Performance.Action_1_Condition FaultManager.HV_Heater_Poor_Performance.Action_2 FaultManager.HV_Heater_Poor_Performance.Action_2_Condition FaultManager.HV_Heater_Poor_Performance.Action_3 FaultManager.HV_Heater_Poor_Performance.Action_3_Condition FaultManager.HV_Heater_Poor_Performance.Action_4 FaultManager.HV_Heater_Poor_Performance.Action_4_Condition FaultManager.HV_Heater_Temperature_Sensor_A_High_Voltage.Mode FaultManager.HV_Heater_Temperature_Sensor_A_High_Voltage.ID FaultManager.HV_Heater_Temperature_Sensor_A_High_Voltage.Test FaultManager.HV_Heater_Temperature_Sensor_A_High_Voltage.Faulty_Samples__X_ FaultManager.HV_Heater_Temperature_Sensor_A_High_Voltage.Total_Samples__Y_ FaultManager.HV_Heater_Temperature_Sensor_A_High_Voltage.Action_1 FaultManager.HV_Heater_Temperature_Sensor_A_High_Voltage.Action_1_Condition FaultManager.HV_Heater_Temperature_Sensor_A_High_Voltage.Action_2 FaultManager.HV_Heater_Temperature_Sensor_A_High_Voltage.Action_2_Condition FaultManager.HV_Heater_Temperature_Sensor_A_High_Voltage.Action_3 FaultManager.HV_Heater_Temperature_Sensor_A_High_Voltage.Action_3_Condition FaultManager.HV_Heater_Temperature_Sensor_A_High_Voltage.Action_4 FaultManager.HV_Heater_Temperature_Sensor_A_High_Voltage.Action_4_Condition FaultManager.HV_Heater_Temperature_Sensor_A_Intermittent.Mode FaultManager.HV_Heater_Temperature_Sensor_A_Intermittent.ID FaultManager.HV_Heater_Temperature_Sensor_A_Intermittent.Test FaultManager.HV_Heater_Temperature_Sensor_A_Intermittent.Faulty_Samples__X_ FaultManager.HV_Heater_Temperature_Sensor_A_Intermittent.Total_Samples__Y_ FaultManager.HV_Heater_Temperature_Sensor_A_Intermittent.Action_1 FaultManager.HV_Heater_Temperature_Sensor_A_Intermittent.Action_1_Condition FaultManager.HV_Heater_Temperature_Sensor_A_Intermittent.Action_2 FaultManager.HV_Heater_Temperature_Sensor_A_Intermittent.Action_2_Condition FaultManager.HV_Heater_Temperature_Sensor_A_Intermittent.Action_3 FaultManager.HV_Heater_Temperature_Sensor_A_Intermittent.Action_3_Condition FaultManager.HV_Heater_Temperature_Sensor_A_Intermittent.Action_4 FaultManager.HV_Heater_Temperature_Sensor_A_Intermittent.Action_4_Condition FaultManager.HV_Heater_Temperature_Sensor_A_Low_Voltage.Mode FaultManager.HV_Heater_Temperature_Sensor_A_Low_Voltage.ID FaultManager.HV_Heater_Temperature_Sensor_A_Low_Voltage.Test FaultManager.HV_Heater_Temperature_Sensor_A_Low_Voltage.Faulty_Samples__X_ FaultManager.HV_Heater_Temperature_Sensor_A_Low_Voltage.Total_Samples__Y_ FaultManager.HV_Heater_Temperature_Sensor_A_Low_Voltage.Action_1 FaultManager.HV_Heater_Temperature_Sensor_A_Low_Voltage.Action_1_Condition FaultManager.HV_Heater_Temperature_Sensor_A_Low_Voltage.Action_2 FaultManager.HV_Heater_Temperature_Sensor_A_Low_Voltage.Action_2_Condition FaultManager.HV_Heater_Temperature_Sensor_A_Low_Voltage.Action_3 FaultManager.HV_Heater_Temperature_Sensor_A_Low_Voltage.Action_3_Condition FaultManager.HV_Heater_Temperature_Sensor_A_Low_Voltage.Action_4 FaultManager.HV_Heater_Temperature_Sensor_A_Low_Voltage.Action_4_Condition FaultManager.IPT_DCDC_AgeCount.Mode FaultManager.IPT_DCDC_AgeCount.ID FaultManager.IPT_DCDC_AgeCount.Test FaultManager.IPT_DCDC_AgeCount.Faulty_Samples__X_ FaultManager.IPT_DCDC_AgeCount.Total_Samples__Y_ FaultManager.IPT_DCDC_AgeCount.Action_1 FaultManager.IPT_DCDC_AgeCount.Action_1_Condition FaultManager.IPT_DCDC_AgeCount.Action_2 FaultManager.IPT_DCDC_AgeCount.Action_2_Condition FaultManager.IPT_DCDC_AgeCount.Action_3 FaultManager.IPT_DCDC_AgeCount.Action_3_Condition FaultManager.IPT_DCDC_AgeCount.Action_4 FaultManager.IPT_DCDC_AgeCount.Action_4_Condition FaultManager.IPT_Status1_AgeCount.Mode FaultManager.IPT_Status1_AgeCount.ID FaultManager.IPT_Status1_AgeCount.Test FaultManager.IPT_Status1_AgeCount.Faulty_Samples__X_ FaultManager.IPT_Status1_AgeCount.Total_Samples__Y_ FaultManager.IPT_Status1_AgeCount.Action_1 FaultManager.IPT_Status1_AgeCount.Action_1_Condition FaultManager.IPT_Status1_AgeCount.Action_2 FaultManager.IPT_Status1_AgeCount.Action_2_Condition FaultManager.IPT_Status1_AgeCount.Action_3 FaultManager.IPT_Status1_AgeCount.Action_3_Condition FaultManager.IPT_Status1_AgeCount.Action_4 FaultManager.IPT_Status1_AgeCount.Action_4_Condition FaultManager.IPT_Status2_AgeCount.Mode FaultManager.IPT_Status2_AgeCount.ID FaultManager.IPT_Status2_AgeCount.Test FaultManager.IPT_Status2_AgeCount.Faulty_Samples__X_ FaultManager.IPT_Status2_AgeCount.Total_Samples__Y_ FaultManager.IPT_Status2_AgeCount.Action_1 FaultManager.IPT_Status2_AgeCount.Action_1_Condition FaultManager.IPT_Status2_AgeCount.Action_2 FaultManager.IPT_Status2_AgeCount.Action_2_Condition FaultManager.IPT_Status2_AgeCount.Action_3 FaultManager.IPT_Status2_AgeCount.Action_3_Condition FaultManager.IPT_Status2_AgeCount.Action_4 FaultManager.IPT_Status2_AgeCount.Action_4_Condition FaultManager.Key_Line_Voltage.Mode FaultManager.Key_Line_Voltage.ID FaultManager.Key_Line_Voltage.Test FaultManager.Key_Line_Voltage.Faulty_Samples__X_ FaultManager.Key_Line_Voltage.Total_Samples__Y_ FaultManager.Key_Line_Voltage.Action_1 FaultManager.Key_Line_Voltage.Action_1_Condition FaultManager.Key_Line_Voltage.Action_2 FaultManager.Key_Line_Voltage.Action_2_Condition FaultManager.Key_Line_Voltage.Action_3 FaultManager.Key_Line_Voltage.Action_3_Condition FaultManager.Key_Line_Voltage.Action_4 FaultManager.Key_Line_Voltage.Action_4_Condition FaultManager.Key_Off_Voltage_High.Mode FaultManager.Key_Off_Voltage_High.ID FaultManager.Key_Off_Voltage_High.Test FaultManager.Key_Off_Voltage_High.Faulty_Samples__X_ FaultManager.Key_Off_Voltage_High.Total_Samples__Y_ FaultManager.Key_Off_Voltage_High.Action_1 FaultManager.Key_Off_Voltage_High.Action_1_Condition FaultManager.Key_Off_Voltage_High.Action_2 FaultManager.Key_Off_Voltage_High.Action_2_Condition FaultManager.Key_Off_Voltage_High.Action_3 FaultManager.Key_Off_Voltage_High.Action_3_Condition FaultManager.Key_Off_Voltage_High.Action_4 FaultManager.Key_Off_Voltage_High.Action_4_Condition FaultManager.Park_Nuetral_Switch_Input_Circuit.Mode FaultManager.Park_Nuetral_Switch_Input_Circuit.ID FaultManager.Park_Nuetral_Switch_Input_Circuit.Test FaultManager.Park_Nuetral_Switch_Input_Circuit.Faulty_Samples__X_ FaultManager.Park_Nuetral_Switch_Input_Circuit.Total_Samples__Y_ FaultManager.Park_Nuetral_Switch_Input_Circuit.Action_1 FaultManager.Park_Nuetral_Switch_Input_Circuit.Action_1_Condition FaultManager.Park_Nuetral_Switch_Input_Circuit.Action_2 FaultManager.Park_Nuetral_Switch_Input_Circuit.Action_2_Condition FaultManager.Park_Nuetral_Switch_Input_Circuit.Action_3 FaultManager.Park_Nuetral_Switch_Input_Circuit.Action_3_Condition FaultManager.Park_Nuetral_Switch_Input_Circuit.Action_4 FaultManager.Park_Nuetral_Switch_Input_Circuit.Action_4_Condition FaultManager.Park_Nuetral_Switch_Input_High.Mode FaultManager.Park_Nuetral_Switch_Input_High.ID FaultManager.Park_Nuetral_Switch_Input_High.Test FaultManager.Park_Nuetral_Switch_Input_High.Faulty_Samples__X_ FaultManager.Park_Nuetral_Switch_Input_High.Total_Samples__Y_ FaultManager.Park_Nuetral_Switch_Input_High.Action_1 FaultManager.Park_Nuetral_Switch_Input_High.Action_1_Condition FaultManager.Park_Nuetral_Switch_Input_High.Action_2 FaultManager.Park_Nuetral_Switch_Input_High.Action_2_Condition FaultManager.Park_Nuetral_Switch_Input_High.Action_3 FaultManager.Park_Nuetral_Switch_Input_High.Action_3_Condition FaultManager.Park_Nuetral_Switch_Input_High.Action_4 FaultManager.Park_Nuetral_Switch_Input_High.Action_4_Condition FaultManager.Park_Nuetral_Switch_Input_Low.Mode FaultManager.Park_Nuetral_Switch_Input_Low.ID FaultManager.Park_Nuetral_Switch_Input_Low.Test FaultManager.Park_Nuetral_Switch_Input_Low.Faulty_Samples__X_ FaultManager.Park_Nuetral_Switch_Input_Low.Total_Samples__Y_ FaultManager.Park_Nuetral_Switch_Input_Low.Action_1 FaultManager.Park_Nuetral_Switch_Input_Low.Action_1_Condition FaultManager.Park_Nuetral_Switch_Input_Low.Action_2 FaultManager.Park_Nuetral_Switch_Input_Low.Action_2_Condition FaultManager.Park_Nuetral_Switch_Input_Low.Action_3 FaultManager.Park_Nuetral_Switch_Input_Low.Action_3_Condition FaultManager.Park_Nuetral_Switch_Input_Low.Action_4 FaultManager.Park_Nuetral_Switch_Input_Low.Action_4_Condition FaultManager.Pedal_Position_Sensor_A_Circuit_High.Mode FaultManager.Pedal_Position_Sensor_A_Circuit_High.ID FaultManager.Pedal_Position_Sensor_A_Circuit_High.Test FaultManager.Pedal_Position_Sensor_A_Circuit_High.Faulty_Samples__X_ FaultManager.Pedal_Position_Sensor_A_Circuit_High.Total_Samples__Y_ FaultManager.Pedal_Position_Sensor_A_Circuit_High.Action_1 /end DEF_CHARACTERISTIC
/end FUNCTION
/end MODULE
/end PROJECT
