/******************************************************************************
* ASAP2 descrition file /
* Generated by Woodward ASAP2 Generator /
* This file was auto-generated on: Friday, September 7, 2018 5:18 PM /
******************************************************************************/
ASAP2_VERSION 1 51
/begin PROJECT Project ""
/begin MODULE Mooventur_219 ""
/begin IF_DATA VISION DEVICE_SETTING "CCP=2.1_ASAP1b" DEVICE_SETTING "DefaultCRCType=5" /end IF_DATA
/begin IF_DATA ASAP1B_CCP
 /begin SOURCE "List 1" 0 0 DISPLAY_IDENTIFIER "DAQ1"
  /begin QP_BLOB 0 LENGTH 8 CAN_ID_FIXED 0x98EF3102 RASTER 0 REDUCTION_ALLOWED FIRST_PID 0 /end QP_BLOB
 /end SOURCE
 /begin SOURCE "List 2" 0 0 DISPLAY_IDENTIFIER "DAQ2"
  /begin QP_BLOB 1 LENGTH 8 CAN_ID_FIXED 0x98EF3102 RASTER 1 REDUCTION_ALLOWED FIRST_PID 8 /end QP_BLOB
 /end SOURCE
 /begin SOURCE "List 3" 0 0 DISPLAY_IDENTIFIER "DAQ3"
  /begin QP_BLOB 2 LENGTH 8 CAN_ID_FIXED 0x98EF3102 RASTER 2 REDUCTION_ALLOWED FIRST_PID 16 /end QP_BLOB
 /end SOURCE
 /begin SOURCE "List 4" 0 0 DISPLAY_IDENTIFIER "DAQ4"
  /begin QP_BLOB 3 LENGTH 8 CAN_ID_FIXED 0x98EF3102 RASTER 3 REDUCTION_ALLOWED FIRST_PID 24 /end QP_BLOB
 /end SOURCE
 /begin RASTER "FGND_RTI_PERIODIC" "FGND_RTI_PERIODIC" 0 3 5 /end RASTER
 /begin RASTER "FGND_2XRTI_PERIODIC" "FGND_2XRTI_PERIODIC" 1 3 10 /end RASTER
 /begin RASTER "FGND_10XRTI_PERIODIC" "FGND_10XRTI_PERIODIC" 2 3 50 /end RASTER
 /begin RASTER "FGND_20XRTI_PERIODIC" "FGND_20XRTI_PERIODIC" 3 3 100 /end RASTER
 /begin RASTER "BGND_BASE_PERIODIC" "BGND_BASE_PERIODIC" 4 3 50 /end RASTER
 /begin RASTER "BGND_BASEx2_PERIODIC" "BGND_BASEx2_PERIODIC" 5 3 100 /end RASTER
 /begin RASTER "BGND_BASEx10_PERIODIC" "BGND_BASEx10_PERIODIC" 6 3 500 /end RASTER
 /begin RASTER "ONE_SECOND_EVENT" "ONE_SECOND_EVENT" 7 3 1000 /end RASTER
 /* /begin SEED_KEY */ /* DLL for CAL */ /* Uncomment and supply a value "SecurityCAL.dll" */ /* DLL for DAQ */ /* Uncomment and supply a value "SecurityDAQ.dll" */ /* DLL for PGM */ /* Uncomment and supply a value "SecurityPGM.dll" */ /* /end SEED_KEY */
 /begin TP_BLOB /* CCP version */ 0x201 /* Blob version */ 0x204 /* CAN msg ID - send */ 0x98EF0231 /* CAN msg ID - recv */ 0x98EF3102 /* Station address */ 0x31 /* byte order */ 1 BAUDRATE 500000 SAMPLE_RATE 1 SAMPLE_POINT 75 BTL_CYCLES 8 SJW 2 SYNC_EDGE SINGLE DAQ_MODE BURST CONSISTENCY ODT ADDRESS_EXTENSION DAQ
  /begin CHECKSUM_PARAM /* algorithm */ 0x8009 /* limit */ 0x1000 CHECKSUM_CALCULATION ACTIVE_PAGE /end CHECKSUM_PARAM
  /begin DEFINED_PAGES /* Memory page num */ 1 /* Page Name */ "working page" /* address ext. */ 0x00 /* base address */ 0x80000000 /* page length */ 0x0000180A RAM /* memory page in RAM */ RAM_INIT_BY_ECU /* memory page is initialised by ECU start-up */ /end DEFINED_PAGES
  OPTIONAL_CMD 0x5 /* TEST */ OPTIONAL_CMD 0x8 /* START_STOP_ALL */ OPTIONAL_CMD 0xC /* SET_S_STATUS */ OPTIONAL_CMD 0xD /* GET_S_STATUS */ OPTIONAL_CMD 0xE /* BUILD_CHECKSUM */ OPTIONAL_CMD 0xF /* SHORT_UP */ OPTIONAL_CMD 0x12 /* GET_SEED */ OPTIONAL_CMD 0x13 /* UNLOCK */ OPTIONAL_CMD 0x23 /* DNLOAD_6 */ /end TP_BLOB
/end IF_DATA
/*~~~~~~~~~ 6.3.91 MOD_PAR ~~~~~~~~~*/
/begin MOD_PAR /* MOD_PAR Comment*/ "" ECU_CALIBRATION_OFFSET 0x00000000
 /begin MEMORY_SEGMENT CAL "" DATA FLASH INTERN 0x80000000 /* Size */ 0x0000180A /* Offset */ -1 -1 -1 -1 -1 /end MEMORY_SEGMENT
 /begin MEMORY_SEGMENT MeasRAM "" VARIABLES RAM INTERN 0x40000000 /* Size */ 0x00000874 /* Offset */ -1 -1 -1 -1 -1 /end MEMORY_SEGMENT
/end MOD_PAR
/begin MOD_COMMON /* MOD_COMMON Comment */ "" BYTE_ORDER MSB_FIRST ALIGNMENT_BYTE 1 ALIGNMENT_FLOAT32_IEEE 1 ALIGNMENT_FLOAT64_IEEE 1 ALIGNMENT_LONG 1 ALIGNMENT_WORD 1 /end MOD_COMMON
/*~~~~~~~~~ 6.3.86 MEASUREMENTs ~~~~~~~~~*/
/begin MEASUREMENT project_id "This is the Platform ID used by the tools." UBYTE CompuMethod_1 1 0 0 255 ECU_ADDRESS 0x40000873 /end MEASUREMENT
/begin MEASUREMENT table_0_rev "This is Table0 Revision Number" UBYTE CompuMethod_1 1 0 0 255 ECU_ADDRESS 0x40000001 /end MEASUREMENT
/begin MEASUREMENT table_1_rev "This is Table1 Revision Number" UBYTE CompuMethod_1 1 0 0 255 ECU_ADDRESS 0x40000002 /end MEASUREMENT
/begin MEASUREMENT table_2_rev "This is Table2 Revision Number" UBYTE CompuMethod_1 1 0 0 255 ECU_ADDRESS 0x40000003 /end MEASUREMENT
/begin MEASUREMENT Protocol_KeySuite_Rev "MotoTron KeySuite Protocol Version (Key/ERI)" UBYTE CompuMethod_1 1 0 0 255 ECU_ADDRESS 0x40000005 /end MEASUREMENT
/begin MEASUREMENT EriRev "This is the revision for the ERI protocol." UBYTE CompuMethod_1 1 0 0 255 ECU_ADDRESS 0x40000006 /end MEASUREMENT
/begin MEASUREMENT table_3_rev "This is Table3 Revision Number" UBYTE CompuMethod_1 1 0 0 255 ECU_ADDRESS 0x40000007 /end MEASUREMENT
/begin MEASUREMENT table_4_rev "This is Table4 Revision Number" UBYTE CompuMethod_1 1 0 0 255 ECU_ADDRESS 0x40000008 /end MEASUREMENT
/begin MEASUREMENT table_5_rev "This is Table5 Revision Number" UBYTE CompuMethod_1 1 0 0 255 ECU_ADDRESS 0x40000009 /end MEASUREMENT
/begin MEASUREMENT table_6_rev "This is Table6 Revision Number" UBYTE CompuMethod_1 1 0 0 255 ECU_ADDRESS 0x4000000A /end MEASUREMENT
/begin MEASUREMENT table_7_rev "This is Table7 Revision Number" UBYTE CompuMethod_1 1 0 0 255 ECU_ADDRESS 0x4000000B /end MEASUREMENT
/begin MEASUREMENT ProductID "Customer's ID used by the tools." ULONG CompuMethod_3 1 0 0 4294970000 ECU_ADDRESS 0x40000075 /end MEASUREMENT
/begin MEASUREMENT MotProgRev "MotoTron Programming Interface Version" UBYTE CompuMethod_1 1 0 0 255 ECU_ADDRESS 0x40000079 /end MEASUREMENT
/begin MEASUREMENT BootVerMaj "" UBYTE CompuMethod_1 1 0 0 255 ECU_ADDRESS 0x4000007A /end MEASUREMENT
/begin MEASUREMENT BootVerMin "" UBYTE CompuMethod_1 1 0 0 255 ECU_ADDRESS 0x4000007B /end MEASUREMENT
/begin MEASUREMENT EcuHwMaj "" UBYTE CompuMethod_4 1 0 0 255 ECU_ADDRESS 0x4000007C /end MEASUREMENT
/begin MEASUREMENT EcuHwMin "" UBYTE CompuMethod_1 1 0 0 255 ECU_ADDRESS 0x4000007D /end MEASUREMENT
/begin MEASUREMENT ApplicationCompatibilityArr "Software Format ID" UWORD CompuMethod_5 1 0 0 65535 ECU_ADDRESS 0x4000007E MATRIX_DIM 1 50 1 /end MEASUREMENT
/begin MEASUREMENT ABS_217_AgeCount_Prb "" ULONG CompuMethod_6 1 0 0 4294970000 ECU_ADDRESS 0x40000144 /end MEASUREMENT
/begin MEASUREMENT ABS_417_AgeCount_Prb "" ULONG CompuMethod_6 1 0 0 4294970000 ECU_ADDRESS 0x40000148 /end MEASUREMENT
/begin MEASUREMENT ABS_4B0_AgeCount_Prb "" ULONG CompuMethod_6 1 0 0 4294970000 ECU_ADDRESS 0x4000014C /end MEASUREMENT
/begin MEASUREMENT ABS_Trq_Out_Prb "" FLOAT32_IEEE CompuMethod_2 1 0 -1E+17 1E+17 ECU_ADDRESS 0x40000150 /end MEASUREMENT
/begin MEASUREMENT AC_Cmd_Prb "" FLOAT32_IEEE CompuMethod_2 1 0 -1E+17 1E+17 ECU_ADDRESS 0x40000154 /end MEASUREMENT
/begin MEASUREMENT AC_Command_Prb "" FLOAT32_IEEE CompuMethod_2 1 0 -1E+17 1E+17 ECU_ADDRESS 0x40000158 /end MEASUREMENT
/begin MEASUREMENT ACC_torq_rqstd_prb "" FLOAT32_IEEE CompuMethod_2 1 0 -1E+17 1E+17 ECU_ADDRESS 0x4000015C /end MEASUREMENT
/begin MEASUREMENT ActiveDTC "" FLOAT32_IEEE CompuMethod_2 1 0 -1E+17 1E+17 ECU_ADDRESS 0x40000160 /end MEASUREMENT
/begin MEASUREMENT Age_Count_260_Prb "" ULONG CompuMethod_6 1 0 0 4294970000 ECU_ADDRESS 0x40000164 /end MEASUREMENT
/begin MEASUREMENT Age_Count_278_Prb "" ULONG CompuMethod_6 1 0 0 4294970000 ECU_ADDRESS 0x40000168 /end MEASUREMENT
/begin MEASUREMENT Age_Count_590_Prb "" ULONG CompuMethod_6 1 0 0 4294970000 ECU_ADDRESS 0x4000016C /end MEASUREMENT
/begin MEASUREMENT Age_Count_624_Prb "" ULONG CompuMethod_6 1 0 0 4294970000 ECU_ADDRESS 0x40000170 /end MEASUREMENT
/begin MEASUREMENT Altitude_Prb "" FLOAT32_IEEE CompuMethod_2 1 0 -1E+17 1E+17 ECU_ADDRESS 0x40000174 /end MEASUREMENT
/begin MEASUREMENT ApplicationInterruptTaskCPU "Percentage of CPU spent on ApplicationInterruptTask task" UWORD CompuMethod_9 1 0 0 100 ECU_ADDRESS 0x40000178 /end MEASUREMENT
/begin MEASUREMENT ApplicationInterruptTaskStackMinBytesFree "Remaining bytes available on the ApplicationInterruptTask stack" UWORD CompuMethod_10 1 0 0 65535 ECU_ADDRESS 0x4000017A /end MEASUREMENT
/begin MEASUREMENT Batt_Boot_request_fromcontrol_Prb "" UBYTE CompuMethod_11 1 0 0 1 ECU_ADDRESS 0x4000017C /end MEASUREMENT
/begin MEASUREMENT Batt_Connect_Cmd_Probe "" SBYTE CompuMethod_1 1 0 -128 127 ECU_ADDRESS 0x4000017D /end MEASUREMENT
/begin MEASUREMENT Batt_Shutdown_Request_Prb "" UBYTE CompuMethod_11 1 0 0 1 ECU_ADDRESS 0x4000017E /end MEASUREMENT
/begin MEASUREMENT Battery_Light_Prb "" UBYTE CompuMethod_11 1 0 0 1 ECU_ADDRESS 0x4000017F /end MEASUREMENT
/begin MEASUREMENT BatteryCurrent "" FLOAT32_IEEE CompuMethod_2 1 0 -1E+17 1E+17 ECU_ADDRESS 0x40000180 /end MEASUREMENT
/begin MEASUREMENT BatteryVoltage "" FLOAT32_IEEE CompuMethod_2 1 0 -1E+17 1E+17 ECU_ADDRESS 0x40000184 /end MEASUREMENT
/begin MEASUREMENT BCU_Caution_Prb "" FLOAT32_IEEE CompuMethod_2 1 0 -1E+17 1E+17 ECU_ADDRESS 0x40000188 /end MEASUREMENT
/begin MEASUREMENT BCU_Hazard_Prb "" FLOAT32_IEEE CompuMethod_2 1 0 -1E+17 1E+17 ECU_ADDRESS 0x4000018C /end MEASUREMENT
/begin MEASUREMENT BGNDTaskCPU "Percentage of CPU spent on BGNDTask task" UWORD CompuMethod_9 1 0 0 100 ECU_ADDRESS 0x40000190 /end MEASUREMENT
/begin MEASUREMENT BGNDTaskStackMinBytesFree "Remaining bytes available on the BGNDTask stack" UWORD CompuMethod_10 1 0 0 65535 ECU_ADDRESS 0x40000192 /end MEASUREMENT
/begin MEASUREMENT Brake_Pedal_Prb_crawlMode "" FLOAT32_IEEE CompuMethod_2 1 0 -1E+17 1E+17 ECU_ADDRESS 0x40000194 /end MEASUREMENT
/begin MEASUREMENT Brake_Pedal_Prb_EcoMode "" FLOAT32_IEEE CompuMethod_2 1 0 -1E+17 1E+17 ECU_ADDRESS 0x40000198 /end MEASUREMENT
/begin MEASUREMENT Brake_Pedal_Prb_SUVMode "" FLOAT32_IEEE CompuMethod_2 1 0 -1E+17 1E+17 ECU_ADDRESS 0x4000019C /end MEASUREMENT
/begin MEASUREMENT Brake_Position_Prb "" FLOAT32_IEEE CompuMethod_2 1 0 -1E+17 1E+17 ECU_ADDRESS 0x400001A0 /end MEASUREMENT
/begin MEASUREMENT Brake_Position_PreIdx "" UWORD CompuMethod_12 1 0 0 127.998 ECU_ADDRESS 0x400001A4 /end MEASUREMENT
/begin MEASUREMENT Brake_Position_PreIn "" FLOAT32_IEEE CompuMethod_2 1 0 -1E+17 1E+17 ECU_ADDRESS 0x400001A6 /end MEASUREMENT
/begin MEASUREMENT Brake_Position_Tbl "" FLOAT32_IEEE CompuMethod_13 1 0 -1E+17 1E+17 ECU_ADDRESS 0x400001AA /end MEASUREMENT
/begin MEASUREMENT Brakes_AgeCount_Prb "" ULONG CompuMethod_6 1 0 0 4294970000 ECU_ADDRESS 0x400001AE /end MEASUREMENT
/begin MEASUREMENT BusVoltage "" FLOAT32_IEEE CompuMethod_2 1 0 -1E+17 1E+17 ECU_ADDRESS 0x400001B2 /end MEASUREMENT
/begin MEASUREMENT Button_Pressed_Prb "" FLOAT32_IEEE CompuMethod_2 1 0 -1E+17 1E+17 ECU_ADDRESS 0x400001B6 /end MEASUREMENT
/begin MEASUREMENT Calc_Active_Prb "" UWORD CompuMethod_5 1 0 0 65535 ECU_ADDRESS 0x400001BA /end MEASUREMENT
/begin MEASUREMENT Calc_Trq_Out_Prb "" FLOAT32_IEEE CompuMethod_2 1 0 -1E+17 1E+17 ECU_ADDRESS 0x400001BC /end MEASUREMENT
/begin MEASUREMENT CAN1_Bus_Passive_Prb "" UBYTE CompuMethod_11 1 0 0 1 ECU_ADDRESS 0x400001C0 /end MEASUREMENT
/begin MEASUREMENT CAN1_RX_Error_Prb "" UBYTE CompuMethod_1 1 0 0 255 ECU_ADDRESS 0x400001C1 /end MEASUREMENT
/begin MEASUREMENT CAN1_TX_Error_Prb "" UBYTE CompuMethod_1 1 0 0 255 ECU_ADDRESS 0x400001C2 /end MEASUREMENT
/begin MEASUREMENT CAN2_Bus_Passive_Prb "" UBYTE CompuMethod_11 1 0 0 1 ECU_ADDRESS 0x400001C3 /end MEASUREMENT
/begin MEASUREMENT CAN2_RX_Error_Prb "" UBYTE CompuMethod_1 1 0 0 255 ECU_ADDRESS 0x400001C4 /end MEASUREMENT
/begin MEASUREMENT CAN2_TX_Error_Prb "" UBYTE CompuMethod_1 1 0 0 255 ECU_ADDRESS 0x400001C5 /end MEASUREMENT
/begin MEASUREMENT CAN3_Bus_Passive_Prb "" UBYTE CompuMethod_11 1 0 0 1 ECU_ADDRESS 0x400001C6 /end MEASUREMENT
/begin MEASUREMENT CAN3_RX_Error_Prb "" UBYTE CompuMethod_1 1 0 0 255 ECU_ADDRESS 0x400001C7 /end MEASUREMENT
/begin MEASUREMENT CAN3_TX_Error_Prb "" UBYTE CompuMethod_1 1 0 0 255 ECU_ADDRESS 0x400001C8 /end MEASUREMENT
/begin MEASUREMENT Capability "" UBYTE CompuMethod_15 1 0 0 255 ECU_ADDRESS 0x400001C9 /end MEASUREMENT
/begin MEASUREMENT CCP_CCP1_Access.CCP_CCP1_CAL "Calibration Authentication Status for CCP Handler CCP1" UBYTE CompuMethod_16 1 0 0 1 ECU_ADDRESS 0x400001CA BIT_MASK 0x00000001 /end MEASUREMENT
/begin MEASUREMENT CCP_CCP1_Access.CCP_CCP1_DAQ "Data Acquisition Authentication Status for CCP Handler CCP1" UBYTE CompuMethod_17 1 0 0 1 ECU_ADDRESS 0x400001CA BIT_MASK 0x00000002 /end MEASUREMENT
/begin MEASUREMENT CCP_CCP1_Access.CCP_CCP1_PGM "Programming Authentication Status for CCP Handler CCP1" UBYTE CompuMethod_18 1 0 0 1 ECU_ADDRESS 0x400001CA BIT_MASK 0x00000040 /end MEASUREMENT
/begin MEASUREMENT CCP_CCP1_Access "Current Access Code for CCP Handler CCP1" UBYTE CompuMethod_2 1 0 0 255 ECU_ADDRESS 0x400001CA /end MEASUREMENT
/begin MEASUREMENT CCP_CCP1_ConnectionStatus "CCP Handler CCP1 connection status" UBYTE CompuMethod_19 1 0 0 255 ECU_ADDRESS 0x400001CB /end MEASUREMENT
/begin MEASUREMENT CellBalanceingActive "" UBYTE CompuMethod_11 1 0 0 1 ECU_ADDRESS 0x400001CC /end MEASUREMENT
/begin MEASUREMENT Charge_Complete_Probe "" UBYTE CompuMethod_11 1 0 0 1 ECU_ADDRESS 0x400001CD /end MEASUREMENT
/begin MEASUREMENT Charge_Enable_Probe "" UBYTE CompuMethod_11 1 0 0 1 ECU_ADDRESS 0x400001CE /end MEASUREMENT
/begin MEASUREMENT Charge_Falt_Probe "" UBYTE CompuMethod_11 1 0 0 1 ECU_ADDRESS 0x400001CF /end MEASUREMENT
/begin MEASUREMENT Charger_State_Prb "" FLOAT32_IEEE CompuMethod_2 1 0 -1E+17 1E+17 ECU_ADDRESS 0x400001D0 /end MEASUREMENT
/begin MEASUREMENT Check_Engine_Light_Prb "" FLOAT32_IEEE CompuMethod_2 1 0 -1E+17 1E+17 ECU_ADDRESS 0x400001D4 /end MEASUREMENT
/begin MEASUREMENT CodeCoverParent000.CodeCover000029 "Determines if this subsystem has run" ULONG CompuMethod_20 1 0 0 1 ECU_ADDRESS 0x400001D8 BIT_MASK 0x20000000 /end MEASUREMENT
/begin MEASUREMENT CodeCoverParent000.CodeCover000018 "Determines if this subsystem has run" ULONG CompuMethod_21 1 0 0 1 ECU_ADDRESS 0x400001D8 BIT_MASK 0x00040000 /end MEASUREMENT
/begin MEASUREMENT CodeCoverParent000.CodeCover000007 "Determines if this subsystem has run" ULONG CompuMethod_22 1 0 0 1 ECU_ADDRESS 0x400001D8 BIT_MASK 0x00000080 /end MEASUREMENT
/begin MEASUREMENT CodeCoverParent000.CodeCover000019 "Determines if this subsystem has run" ULONG CompuMethod_23 1 0 0 1 ECU_ADDRESS 0x400001D8 BIT_MASK 0x00080000 /end MEASUREMENT
/begin MEASUREMENT CodeCoverParent000.CodeCover000008 "Determines if this subsystem has run" ULONG CompuMethod_24 1 0 0 1 ECU_ADDRESS 0x400001D8 BIT_MASK 0x00000100 /end MEASUREMENT
/begin MEASUREMENT CodeCoverParent000.CodeCover000009 "Determines if this subsystem has run" ULONG CompuMethod_25 1 0 0 1 ECU_ADDRESS 0x400001D8 BIT_MASK 0x00000200 /end MEASUREMENT
/begin MEASUREMENT CodeCoverParent000.CodeCover000030 "Determines if this subsystem has run" ULONG CompuMethod_26 1 0 0 1 ECU_ADDRESS 0x400001D8 BIT_MASK 0x40000000 /end MEASUREMENT
/begin MEASUREMENT CodeCoverParent000.CodeCover000031 "Determines if this subsystem has run" ULONG CompuMethod_27 1 0 0 1 ECU_ADDRESS 0x400001D8 BIT_MASK 0x80000000 /end MEASUREMENT
/begin MEASUREMENT CodeCoverParent000.CodeCover000020 "Determines if this subsystem has run" ULONG CompuMethod_28 1 0 0 1 ECU_ADDRESS 0x400001D8 BIT_MASK 0x00100000 /end MEASUREMENT
/begin MEASUREMENT CodeCoverParent000.CodeCover000021 "Determines if this subsystem has run" ULONG CompuMethod_29 1 0 0 1 ECU_ADDRESS 0x400001D8 BIT_MASK 0x00200000 /end MEASUREMENT
/begin MEASUREMENT CodeCoverParent000.CodeCover000010 "Determines if this subsystem has run" ULONG CompuMethod_30 1 0 0 1 ECU_ADDRESS 0x400001D8 BIT_MASK 0x00000400 /end MEASUREMENT
/begin MEASUREMENT CodeCoverParent000.CodeCover000022 "Determines if this subsystem has run" ULONG CompuMethod_31 1 0 0 1 ECU_ADDRESS 0x400001D8 BIT_MASK 0x00400000 /end MEASUREMENT
/begin MEASUREMENT CodeCoverParent000.CodeCover000011 "Determines if this subsystem has run" ULONG CompuMethod_32 1 0 0 1 ECU_ADDRESS 0x400001D8 BIT_MASK 0x00000800 /end MEASUREMENT
/begin MEASUREMENT CodeCoverParent000.CodeCover000000 "Determines if this subsystem has run" ULONG CompuMethod_33 1 0 0 1 ECU_ADDRESS 0x400001D8 BIT_MASK 0x00000001 /end MEASUREMENT
/begin MEASUREMENT CodeCoverParent000.CodeCover000023 "Determines if this subsystem has run" ULONG CompuMethod_34 1 0 0 1 ECU_ADDRESS 0x400001D8 BIT_MASK 0x00800000 /end MEASUREMENT
/begin MEASUREMENT CodeCoverParent000.CodeCover000012 "Determines if this subsystem has run" ULONG CompuMethod_35 1 0 0 1 ECU_ADDRESS 0x400001D8 BIT_MASK 0x00001000 /end MEASUREMENT
/begin MEASUREMENT CodeCoverParent000.CodeCover000001 "Determines if this subsystem has run" ULONG CompuMethod_36 1 0 0 1 ECU_ADDRESS 0x400001D8 BIT_MASK 0x00000002 /end MEASUREMENT
/begin MEASUREMENT CodeCoverParent000.CodeCover000024 "Determines if this subsystem has run" ULONG CompuMethod_37 1 0 0 1 ECU_ADDRESS 0x400001D8 BIT_MASK 0x01000000 /end MEASUREMENT
/begin MEASUREMENT CodeCoverParent000.CodeCover000013 "Determines if this subsystem has run" ULONG CompuMethod_38 1 0 0 1 ECU_ADDRESS 0x400001D8 BIT_MASK 0x00002000 /end MEASUREMENT
/begin MEASUREMENT CodeCoverParent000.CodeCover000002 "Determines if this subsystem has run" ULONG CompuMethod_39 1 0 0 1 ECU_ADDRESS 0x400001D8 BIT_MASK 0x00000004 /end MEASUREMENT
/begin MEASUREMENT CodeCoverParent000.CodeCover000025 "Determines if this subsystem has run" ULONG CompuMethod_40 1 0 0 1 ECU_ADDRESS 0x400001D8 BIT_MASK 0x02000000 /end MEASUREMENT
/begin MEASUREMENT CodeCoverParent000.CodeCover000014 "Determines if this subsystem has run" ULONG CompuMethod_41 1 0 0 1 ECU_ADDRESS 0x400001D8 BIT_MASK 0x00004000 /end MEASUREMENT
/begin MEASUREMENT CodeCoverParent000.CodeCover000003 "Determines if this subsystem has run" ULONG CompuMethod_42 1 0 0 1 ECU_ADDRESS 0x400001D8 BIT_MASK 0x00000008 /end MEASUREMENT
/begin MEASUREMENT CodeCoverParent000.CodeCover000026 "Determines if this subsystem has run" ULONG CompuMethod_43 1 0 0 1 ECU_ADDRESS 0x400001D8 BIT_MASK 0x04000000 /end MEASUREMENT
/begin MEASUREMENT CodeCoverParent000.CodeCover000015 "Determines if this subsystem has run" ULONG CompuMethod_44 1 0 0 1 ECU_ADDRESS 0x400001D8 BIT_MASK 0x00008000 /end MEASUREMENT
/begin MEASUREMENT CodeCoverParent000.CodeCover000004 "Determines if this subsystem has run" ULONG CompuMethod_45 1 0 0 1 ECU_ADDRESS 0x400001D8 BIT_MASK 0x00000010 /end MEASUREMENT
/begin MEASUREMENT CodeCoverParent000.CodeCover000027 "Determines if this subsystem has run" ULONG CompuMethod_46 1 0 0 1 ECU_ADDRESS 0x400001D8 BIT_MASK 0x08000000 /end MEASUREMENT
/begin MEASUREMENT CodeCoverParent000.CodeCover000016 "Determines if this subsystem has run" ULONG CompuMethod_47 1 0 0 1 ECU_ADDRESS 0x400001D8 BIT_MASK 0x00010000 /end MEASUREMENT
/begin MEASUREMENT CodeCoverParent000.CodeCover000005 "Determines if this subsystem has run" ULONG CompuMethod_48 1 0 0 1 ECU_ADDRESS 0x400001D8 BIT_MASK 0x00000020 /end MEASUREMENT
/begin MEASUREMENT CodeCoverParent000.CodeCover000028 "Determines if this subsystem has run" ULONG CompuMethod_49 1 0 0 1 ECU_ADDRESS 0x400001D8 BIT_MASK 0x10000000 /end MEASUREMENT
/begin MEASUREMENT CodeCoverParent000.CodeCover000017 "Determines if this subsystem has run" ULONG CompuMethod_50 1 0 0 1 ECU_ADDRESS 0x400001D8 BIT_MASK 0x00020000 /end MEASUREMENT
/begin MEASUREMENT CodeCoverParent000.CodeCover000006 "Determines if this subsystem has run" ULONG CompuMethod_51 1 0 0 1 ECU_ADDRESS 0x400001D8 BIT_MASK 0x00000040 /end MEASUREMENT
/begin MEASUREMENT CodeCoverParent000 "Run Status of Subsystems" ULONG CompuMethod_2 1 0 0 4294967295 ECU_ADDRESS 0x400001D8 /end MEASUREMENT
/begin MEASUREMENT CodeCoverParent001.CodeCover000060 "Determines if this subsystem has run" ULONG CompuMethod_52 1 0 0 1 ECU_ADDRESS 0x400001DC BIT_MASK 0x10000000 /end MEASUREMENT
/begin MEASUREMENT CodeCoverParent001.CodeCover000061 "Determines if this subsystem has run" ULONG CompuMethod_53 1 0 0 1 ECU_ADDRESS 0x400001DC BIT_MASK 0x20000000 /end MEASUREMENT
/begin MEASUREMENT CodeCoverParent001.CodeCover000050 "Determines if this subsystem has run" ULONG CompuMethod_54 1 0 0 1 ECU_ADDRESS 0x400001DC BIT_MASK 0x00040000 /end MEASUREMENT
/begin MEASUREMENT CodeCoverParent001.CodeCover000062 "Determines if this subsystem has run" ULONG CompuMethod_55 1 0 0 1 ECU_ADDRESS 0x400001DC BIT_MASK 0x40000000 /end MEASUREMENT
/begin MEASUREMENT CodeCoverParent001.CodeCover000051 "Determines if this subsystem has run" ULONG CompuMethod_56 1 0 0 1 ECU_ADDRESS 0x400001DC BIT_MASK 0x00080000 /end MEASUREMENT
/begin MEASUREMENT CodeCoverParent001.CodeCover000040 "Determines if this subsystem has run" ULONG CompuMethod_57 1 0 0 1 ECU_ADDRESS 0x400001DC BIT_MASK 0x00000100 /end MEASUREMENT
/begin MEASUREMENT CodeCoverParent001.CodeCover000063 "Determines if this subsystem has run" ULONG CompuMethod_58 1 0 0 1 ECU_ADDRESS 0x400001DC BIT_MASK 0x80000000 /end MEASUREMENT
/begin MEASUREMENT CodeCoverParent001.CodeCover000052 "Determines if this subsystem has run" ULONG CompuMethod_59 1 0 0 1 ECU_ADDRESS 0x400001DC BIT_MASK 0x00100000 /end MEASUREMENT
/begin MEASUREMENT CodeCoverParent001.CodeCover000041 "Determines if this subsystem has run" ULONG CompuMethod_60 1 0 0 1 ECU_ADDRESS 0x400001DC BIT_MASK 0x00000200 /end MEASUREMENT
/begin MEASUREMENT CodeCoverParent001.CodeCover000053 "Determines if this subsystem has run" ULONG CompuMethod_61 1 0 0 1 ECU_ADDRESS 0x400001DC BIT_MASK 0x00200000 /end MEASUREMENT
/begin MEASUREMENT CodeCoverParent001.CodeCover000042 "Determines if this subsystem has run" ULONG CompuMethod_62 1 0 0 1 ECU_ADDRESS 0x400001DC BIT_MASK 0x00000400 /end MEASUREMENT
/begin MEASUREMENT CodeCoverParent001.CodeCover000054 "Determines if this subsystem has run" ULONG CompuMethod_63 1 0 0 1 ECU_ADDRESS 0x400001DC BIT_MASK 0x00400000 /end MEASUREMENT
/begin MEASUREMENT CodeCoverParent001.CodeCover000043 "Determines if this subsystem has run" ULONG CompuMethod_64 1 0 0 1 ECU_ADDRESS 0x400001DC BIT_MASK 0x00000800 /end MEASUREMENT
/begin MEASUREMENT CodeCoverParent001.CodeCover000032 "Determines if this subsystem has run" ULONG CompuMethod_65 1 0 0 1 ECU_ADDRESS 0x400001DC BIT_MASK 0x00000001 /end MEASUREMENT
/begin MEASUREMENT CodeCoverParent001.CodeCover000055 "Determines if this subsystem has run" ULONG CompuMethod_66 1 0 0 1 ECU_ADDRESS 0x400001DC BIT_MASK 0x00800000 /end MEASUREMENT
/begin MEASUREMENT CodeCoverParent001.CodeCover000044 "Determines if this subsystem has run" ULONG CompuMethod_67 1 0 0 1 ECU_ADDRESS 0x400001DC BIT_MASK 0x00001000 /end MEASUREMENT
/begin MEASUREMENT CodeCoverParent001.CodeCover000033 "Determines if this subsystem has run" ULONG CompuMethod_68 1 0 0 1 ECU_ADDRESS 0x400001DC BIT_MASK 0x00000002 /end MEASUREMENT
/begin MEASUREMENT CodeCoverParent001.CodeCover000056 "Determines if this subsystem has run" ULONG CompuMethod_69 1 0 0 1 ECU_ADDRESS 0x400001DC BIT_MASK 0x01000000 /end MEASUREMENT
/begin MEASUREMENT CodeCoverParent001.CodeCover000045 "Determines if this subsystem has run" ULONG CompuMethod_70 1 0 0 1 ECU_ADDRESS 0x400001DC BIT_MASK 0x00002000 /end MEASUREMENT
/begin MEASUREMENT CodeCoverParent001.CodeCover000034 "Determines if this subsystem has run" ULONG CompuMethod_71 1 0 0 1 ECU_ADDRESS 0x400001DC BIT_MASK 0x00000004 /end MEASUREMENT
/begin MEASUREMENT CodeCoverParent001.CodeCover000057 "Determines if this subsystem has run" ULONG CompuMethod_72 1 0 0 1 ECU_ADDRESS 0x400001DC BIT_MASK 0x02000000 /end MEASUREMENT
/begin MEASUREMENT CodeCoverParent001.CodeCover000046 "Determines if this subsystem has run" ULONG CompuMethod_73 1 0 0 1 ECU_ADDRESS 0x400001DC BIT_MASK 0x00004000 /end MEASUREMENT
/begin MEASUREMENT CodeCoverParent001.CodeCover000035 "Determines if this subsystem has run" ULONG CompuMethod_74 1 0 0 1 ECU_ADDRESS 0x400001DC BIT_MASK 0x00000008 /end MEASUREMENT
/begin MEASUREMENT CodeCoverParent001.CodeCover000058 "Determines if this subsystem has run" ULONG CompuMethod_75 1 0 0 1 ECU_ADDRESS 0x400001DC BIT_MASK 0x04000000 /end MEASUREMENT
/begin MEASUREMENT CodeCoverParent001.CodeCover000047 "Determines if this subsystem has run" ULONG CompuMethod_76 1 0 0 1 ECU_ADDRESS 0x400001DC BIT_MASK 0x00008000 /end MEASUREMENT
/begin MEASUREMENT CodeCoverParent001.CodeCover000036 "Determines if this subsystem has run" ULONG CompuMethod_77 1 0 0 1 ECU_ADDRESS 0x400001DC BIT_MASK 0x00000010 /end MEASUREMENT
/begin MEASUREMENT CodeCoverParent001.CodeCover000059 "Determines if this subsystem has run" ULONG CompuMethod_78 1 0 0 1 ECU_ADDRESS 0x400001DC BIT_MASK 0x08000000 /end MEASUREMENT
/begin MEASUREMENT CodeCoverParent001.CodeCover000048 "Determines if this subsystem has run" ULONG CompuMethod_79 1 0 0 1 ECU_ADDRESS 0x400001DC BIT_MASK 0x00010000 /end MEASUREMENT
/begin MEASUREMENT CodeCoverParent001.CodeCover000037 "Determines if this subsystem has run" ULONG CompuMethod_80 1 0 0 1 ECU_ADDRESS 0x400001DC BIT_MASK 0x00000020 /end MEASUREMENT
/begin MEASUREMENT CodeCoverParent001.CodeCover000049 "Determines if this subsystem has run" ULONG CompuMethod_81 1 0 0 1 ECU_ADDRESS 0x400001DC BIT_MASK 0x00020000 /end MEASUREMENT
/begin MEASUREMENT CodeCoverParent001.CodeCover000038 "Determines if this subsystem has run" ULONG CompuMethod_82 1 0 0 1 ECU_ADDRESS 0x400001DC BIT_MASK 0x00000040 /end MEASUREMENT
/begin MEASUREMENT CodeCoverParent001.CodeCover000039 "Determines if this subsystem has run" ULONG CompuMethod_83 1 0 0 1 ECU_ADDRESS 0x400001DC BIT_MASK 0x00000080 /end MEASUREMENT
/begin MEASUREMENT CodeCoverParent001 "Run Status of Subsystems" ULONG CompuMethod_2 1 0 0 4294967295 ECU_ADDRESS 0x400001DC /end MEASUREMENT
/begin MEASUREMENT CodeCoverParent002.CodeCover000090 "Determines if this subsystem has run" ULONG CompuMethod_84 1 0 0 1 ECU_ADDRESS 0x400001E0 BIT_MASK 0x04000000 /end MEASUREMENT
/begin MEASUREMENT CodeCoverParent002.CodeCover000091 "Determines if this subsystem has run" ULONG CompuMethod_85 1 0 0 1 ECU_ADDRESS 0x400001E0 BIT_MASK 0x08000000 /end MEASUREMENT
/begin MEASUREMENT CodeCoverParent002.CodeCover000080 "Determines if this subsystem has run" ULONG CompuMethod_86 1 0 0 1 ECU_ADDRESS 0x400001E0 BIT_MASK 0x00010000 /end MEASUREMENT
/begin MEASUREMENT CodeCoverParent002.CodeCover000092 "Determines if this subsystem has run" ULONG CompuMethod_87 1 0 0 1 ECU_ADDRESS 0x400001E0 BIT_MASK 0x10000000 /end MEASUREMENT
/begin MEASUREMENT CodeCoverParent002.CodeCover000081 "Determines if this subsystem has run" ULONG CompuMethod_88 1 0 0 1 ECU_ADDRESS 0x400001E0 BIT_MASK 0x00020000 /end MEASUREMENT
/begin MEASUREMENT CodeCoverParent002.CodeCover000070 "Determines if this subsystem has run" ULONG CompuMethod_89 1 0 0 1 ECU_ADDRESS 0x400001E0 BIT_MASK 0x00000040 /end MEASUREMENT
/begin MEASUREMENT CodeCoverParent002.CodeCover000093 "Determines if this subsystem has run" ULONG CompuMethod_90 1 0 0 1 ECU_ADDRESS 0x400001E0 BIT_MASK 0x20000000 /end MEASUREMENT
/begin MEASUREMENT CodeCoverParent002.CodeCover000082 "Determines if this subsystem has run" ULONG CompuMethod_91 1 0 0 1 ECU_ADDRESS 0x400001E0 BIT_MASK 0x00040000 /end MEASUREMENT
/begin MEASUREMENT CodeCoverParent002.CodeCover000071 "Determines if this subsystem has run" ULONG CompuMethod_92 1 0 0 1 ECU_ADDRESS 0x400001E0 BIT_MASK 0x00000080 /end MEASUREMENT
/begin MEASUREMENT CodeCoverParent002.CodeCover000094 "Determines if this subsystem has run" ULONG CompuMethod_93 1 0 0 1 ECU_ADDRESS 0x400001E0 BIT_MASK 0x40000000 /end MEASUREMENT
/begin MEASUREMENT CodeCoverParent002.CodeCover000083 "Determines if this subsystem has run" ULONG CompuMethod_94 1 0 0 1 ECU_ADDRESS 0x400001E0 BIT_MASK 0x00080000 /end MEASUREMENT
/begin MEASUREMENT CodeCoverParent002.CodeCover000072 "Determines if this subsystem has run" ULONG CompuMethod_95 1 0 0 1 ECU_ADDRESS 0x400001E0 BIT_MASK 0x00000100 /end MEASUREMENT
/begin MEASUREMENT CodeCoverParent002.CodeCover000095 "Determines if this subsystem has run" ULONG CompuMethod_96 1 0 0 1 ECU_ADDRESS 0x400001E0 BIT_MASK 0x80000000 /end MEASUREMENT
/begin MEASUREMENT CodeCoverParent002.CodeCover000084 "Determines if this subsystem has run" ULONG CompuMethod_97 1 0 0 1 ECU_ADDRESS 0x400001E0 BIT_MASK 0x00100000 /end MEASUREMENT
/begin MEASUREMENT CodeCoverParent002.CodeCover000073 "Determines if this subsystem has run" ULONG CompuMethod_98 1 0 0 1 ECU_ADDRESS 0x400001E0 BIT_MASK 0x00000200 /end MEASUREMENT
/begin MEASUREMENT CodeCoverParent002.CodeCover000085 "Determines if this subsystem has run" ULONG CompuMethod_99 1 0 0 1 ECU_ADDRESS 0x400001E0 BIT_MASK 0x00200000 /end MEASUREMENT
/begin MEASUREMENT CodeCoverParent002.CodeCover000074 "Determines if this subsystem has run" ULONG CompuMethod_100 1 0 0 1 ECU_ADDRESS 0x400001E0 BIT_MASK 0x00000400 /end MEASUREMENT
/begin MEASUREMENT CodeCoverParent002.CodeCover000086 "Determines if this subsystem has run" ULONG CompuMethod_101 1 0 0 1 ECU_ADDRESS 0x400001E0 BIT_MASK 0x00400000 /end MEASUREMENT
/begin MEASUREMENT CodeCoverParent002.CodeCover000075 "Determines if this subsystem has run" ULONG CompuMethod_102 1 0 0 1 ECU_ADDRESS 0x400001E0 BIT_MASK 0x00000800 /end MEASUREMENT
/begin MEASUREMENT CodeCoverParent002.CodeCover000064 "Determines if this subsystem has run" ULONG CompuMethod_103 1 0 0 1 ECU_ADDRESS 0x400001E0 BIT_MASK 0x00000001 /end MEASUREMENT
/begin MEASUREMENT CodeCoverParent002.CodeCover000087 "Determines if this subsystem has run" ULONG CompuMethod_104 1 0 0 1 ECU_ADDRESS 0x400001E0 BIT_MASK 0x00800000 /end MEASUREMENT
/begin MEASUREMENT CodeCoverParent002.CodeCover000076 "Determines if this subsystem has run" ULONG CompuMethod_105 1 0 0 1 ECU_ADDRESS 0x400001E0 BIT_MASK 0x00001000 /end MEASUREMENT
/begin MEASUREMENT CodeCoverParent002.CodeCover000065 "Determines if this subsystem has run" ULONG CompuMethod_106 1 0 0 1 ECU_ADDRESS 0x400001E0 BIT_MASK 0x00000002 /end MEASUREMENT
/begin MEASUREMENT CodeCoverParent002.CodeCover000088 "Determines if this subsystem has run" ULONG CompuMethod_107 1 0 0 1 ECU_ADDRESS 0x400001E0 BIT_MASK 0x01000000 /end MEASUREMENT
/begin MEASUREMENT CodeCoverParent002.CodeCover000077 "Determines if this subsystem has run" ULONG CompuMethod_108 1 0 0 1 ECU_ADDRESS 0x400001E0 BIT_MASK 0x00002000 /end MEASUREMENT
/begin MEASUREMENT CodeCoverParent002.CodeCover000066 "Determines if this subsystem has run" ULONG CompuMethod_109 1 0 0 1 ECU_ADDRESS 0x400001E0 BIT_MASK 0x00000004 /end MEASUREMENT
/begin MEASUREMENT CodeCoverParent002.CodeCover000089 "Determines if this subsystem has run" ULONG CompuMethod_110 1 0 0 1 ECU_ADDRESS 0x400001E0 BIT_MASK 0x02000000 /end MEASUREMENT
/begin MEASUREMENT CodeCoverParent002.CodeCover000078 "Determines if this subsystem has run" ULONG CompuMethod_111 1 0 0 1 ECU_ADDRESS 0x400001E0 BIT_MASK 0x00004000 /end MEASUREMENT
/begin MEASUREMENT CodeCoverParent002.CodeCover000067 "Determines if this subsystem has run" ULONG CompuMethod_112 1 0 0 1 ECU_ADDRESS 0x400001E0 BIT_MASK 0x00000008 /end MEASUREMENT
/begin MEASUREMENT CodeCoverParent002.CodeCover000079 "Determines if this subsystem has run" ULONG CompuMethod_113 1 0 0 1 ECU_ADDRESS 0x400001E0 BIT_MASK 0x00008000 /end MEASUREMENT
/begin MEASUREMENT CodeCoverParent002.CodeCover000068 "Determines if this subsystem has run" ULONG CompuMethod_114 1 0 0 1 ECU_ADDRESS 0x400001E0 BIT_MASK 0x00000010 /end MEASUREMENT
/begin MEASUREMENT CodeCoverParent002.CodeCover000069 "Determines if this subsystem has run" ULONG CompuMethod_115 1 0 0 1 ECU_ADDRESS 0x400001E0 BIT_MASK 0x00000020 /end MEASUREMENT
/begin MEASUREMENT CodeCoverParent002 "Run Status of Subsystems" ULONG CompuMethod_2 1 0 0 4294967295 ECU_ADDRESS 0x400001E0 /end MEASUREMENT
/begin MEASUREMENT CodeCoverParent003.CodeCover000117 "Determines if this subsystem has run" ULONG CompuMethod_116 1 0 0 1 ECU_ADDRESS 0x400001E4 BIT_MASK 0x00200000 /end MEASUREMENT
/begin MEASUREMENT CodeCoverParent003.CodeCover000106 "Determines if this subsystem has run" ULONG CompuMethod_117 1 0 0 1 ECU_ADDRESS 0x400001E4 BIT_MASK 0x00000400 /end MEASUREMENT
/begin MEASUREMENT CodeCoverParent003.CodeCover000118 "Determines if this subsystem has run" ULONG CompuMethod_118 1 0 0 1 ECU_ADDRESS 0x400001E4 BIT_MASK 0x00400000 /end MEASUREMENT
/begin MEASUREMENT CodeCoverParent003.CodeCover000107 "Determines if this subsystem has run" ULONG CompuMethod_119 1 0 0 1 ECU_ADDRESS 0x400001E4 BIT_MASK 0x00000800 /end MEASUREMENT
/begin MEASUREMENT CodeCoverParent003.CodeCover000119 "Determines if this subsystem has run" ULONG CompuMethod_120 1 0 0 1 ECU_ADDRESS 0x400001E4 BIT_MASK 0x00800000 /end MEASUREMENT
/begin MEASUREMENT CodeCoverParent003.CodeCover000108 "Determines if this subsystem has run" ULONG CompuMethod_121 1 0 0 1 ECU_ADDRESS 0x400001E4 BIT_MASK 0x00001000 /end MEASUREMENT
/begin MEASUREMENT CodeCoverParent003.CodeCover000109 "Determines if this subsystem has run" ULONG CompuMethod_122 1 0 0 1 ECU_ADDRESS 0x400001E4 BIT_MASK 0x00002000 /end MEASUREMENT
/begin MEASUREMENT CodeCoverParent003.CodeCover000096 "Determines if this subsystem has run" ULONG CompuMethod_123 1 0 0 1 ECU_ADDRESS 0x400001E4 BIT_MASK 0x00000001 /end MEASUREMENT
/begin MEASUREMENT CodeCoverParent003.CodeCover000097 "Determines if this subsystem has run" ULONG CompuMethod_124 1 0 0 1 ECU_ADDRESS 0x400001E4 BIT_MASK 0x00000002 /end MEASUREMENT
/begin MEASUREMENT CodeCoverParent003.CodeCover000120 "Determines if this subsystem has run" ULONG CompuMethod_125 1 0 0 1 ECU_ADDRESS 0x400001E4 BIT_MASK 0x01000000 /end MEASUREMENT
/begin MEASUREMENT CodeCoverParent003.CodeCover000098 "Determines if this subsystem has run" ULONG CompuMethod_126 1 0 0 1 ECU_ADDRESS 0x400001E4 BIT_MASK 0x00000004 /end MEASUREMENT
/begin MEASUREMENT CodeCoverParent003.CodeCover000121 "Determines if this subsystem has run" ULONG CompuMethod_127 1 0 0 1 ECU_ADDRESS 0x400001E4 BIT_MASK 0x02000000 /end MEASUREMENT
/begin MEASUREMENT CodeCoverParent003.CodeCover000110 "Determines if this subsystem has run" ULONG CompuMethod_128 1 0 0 1 ECU_ADDRESS 0x400001E4 BIT_MASK 0x00004000 /end MEASUREMENT
/begin MEASUREMENT CodeCoverParent003.CodeCover000099 "Determines if this subsystem has run" ULONG CompuMethod_129 1 0 0 1 ECU_ADDRESS 0x400001E4 BIT_MASK 0x00000008 /end MEASUREMENT
/begin MEASUREMENT CodeCoverParent003.CodeCover000122 "Determines if this subsystem has run" ULONG CompuMethod_130 1 0 0 1 ECU_ADDRESS 0x400001E4 BIT_MASK 0x04000000 /end MEASUREMENT
/begin MEASUREMENT CodeCoverParent003.CodeCover000111 "Determines if this subsystem has run" ULONG CompuMethod_131 1 0 0 1 ECU_ADDRESS 0x400001E4 BIT_MASK 0x00008000 /end MEASUREMENT
/begin MEASUREMENT CodeCoverParent003.CodeCover000100 "Determines if this subsystem has run" ULONG CompuMethod_132 1 0 0 1 ECU_ADDRESS 0x400001E4 BIT_MASK 0x00000010 /end MEASUREMENT
/begin MEASUREMENT CodeCoverParent003.CodeCover000123 "Determines if this subsystem has run" ULONG CompuMethod_133 1 0 0 1 ECU_ADDRESS 0x400001E4 BIT_MASK 0x08000000 /end MEASUREMENT
/begin MEASUREMENT CodeCoverParent003.CodeCover000112 "Determines if this subsystem has run" ULONG CompuMethod_134 1 0 0 1 ECU_ADDRESS 0x400001E4 BIT_MASK 0x00010000 /end MEASUREMENT
/begin MEASUREMENT CodeCoverParent003.CodeCover000101 "Determines if this subsystem has run" ULONG CompuMethod_135 1 0 0 1 ECU_ADDRESS 0x400001E4 BIT_MASK 0x00000020 /end MEASUREMENT
/begin MEASUREMENT CodeCoverParent003.CodeCover000124 "Determines if this subsystem has run" ULONG CompuMethod_136 1 0 0 1 ECU_ADDRESS 0x400001E4 BIT_MASK 0x10000000 /end MEASUREMENT
/begin MEASUREMENT CodeCoverParent003.CodeCover000113 "Determines if this subsystem has run" ULONG CompuMethod_137 1 0 0 1 ECU_ADDRESS 0x400001E4 BIT_MASK 0x00020000 /end MEASUREMENT
/begin MEASUREMENT CodeCoverParent003.CodeCover000102 "Determines if this subsystem has run" ULONG CompuMethod_138 1 0 0 1 ECU_ADDRESS 0x400001E4 BIT_MASK 0x00000040 /end MEASUREMENT
/begin MEASUREMENT CodeCoverParent003.CodeCover000125 "Determines if this subsystem has run" ULONG CompuMethod_139 1 0 0 1 ECU_ADDRESS 0x400001E4 BIT_MASK 0x20000000 /end MEASUREMENT
/begin MEASUREMENT CodeCoverParent003.CodeCover000114 "Determines if this subsystem has run" ULONG CompuMethod_140 1 0 0 1 ECU_ADDRESS 0x400001E4 BIT_MASK 0x00040000 /end MEASUREMENT
/begin MEASUREMENT CodeCoverParent003.CodeCover000103 "Determines if this subsystem has run" ULONG CompuMethod_141 1 0 0 1 ECU_ADDRESS 0x400001E4 BIT_MASK 0x00000080 /end MEASUREMENT
/begin MEASUREMENT CodeCoverParent003.CodeCover000126 "Determines if this subsystem has run" ULONG CompuMethod_142 1 0 0 1 ECU_ADDRESS 0x400001E4 BIT_MASK 0x40000000 /end MEASUREMENT
/begin MEASUREMENT CodeCoverParent003.CodeCover000115 "Determines if this subsystem has run" ULONG CompuMethod_143 1 0 0 1 ECU_ADDRESS 0x400001E4 BIT_MASK 0x00080000 /end MEASUREMENT
/begin MEASUREMENT CodeCoverParent003.CodeCover000104 "Determines if this subsystem has run" ULONG CompuMethod_144 1 0 0 1 ECU_ADDRESS 0x400001E4 BIT_MASK 0x00000100 /end MEASUREMENT
/begin MEASUREMENT CodeCoverParent003.CodeCover000127 "Determines if this subsystem has run" ULONG CompuMethod_145 1 0 0 1 ECU_ADDRESS 0x400001E4 BIT_MASK 0x80000000 /end MEASUREMENT
/begin MEASUREMENT CodeCoverParent003.CodeCover000116 "Determines if this subsystem has run" ULONG CompuMethod_146 1 0 0 1 ECU_ADDRESS 0x400001E4 BIT_MASK 0x00100000 /end MEASUREMENT
/begin MEASUREMENT CodeCoverParent003.CodeCover000105 "Determines if this subsystem has run" ULONG CompuMethod_147 1 0 0 1 ECU_ADDRESS 0x400001E4 BIT_MASK 0x00000200 /end MEASUREMENT
/begin MEASUREMENT CodeCoverParent003 "Run Status of Subsystems" ULONG CompuMethod_2 1 0 0 4294967295 ECU_ADDRESS 0x400001E4 /end MEASUREMENT
/begin MEASUREMENT CodeCoverParent004.CodeCover000139 "Determines if this subsystem has run" ULONG CompuMethod_148 1 0 0 1 ECU_ADDRESS 0x400001E8 BIT_MASK 0x00000800 /end MEASUREMENT
/begin MEASUREMENT CodeCoverParent004.CodeCover000128 "Determines if this subsystem has run" ULONG CompuMethod_149 1 0 0 1 ECU_ADDRESS 0x400001E8 BIT_MASK 0x00000001 /end MEASUREMENT
/begin MEASUREMENT CodeCoverParent004.CodeCover000129 "Determines if this subsystem has run" ULONG CompuMethod_150 1 0 0 1 ECU_ADDRESS 0x400001E8 BIT_MASK 0x00000002 /end MEASUREMENT
/begin MEASUREMENT CodeCoverParent004.CodeCover000150 "Determines if this subsystem has run" ULONG CompuMethod_151 1 0 0 1 ECU_ADDRESS 0x400001E8 BIT_MASK 0x00400000 /end MEASUREMENT
/begin MEASUREMENT CodeCoverParent004.CodeCover000151 "Determines if this subsystem has run" ULONG CompuMethod_152 1 0 0 1 ECU_ADDRESS 0x400001E8 BIT_MASK 0x00800000 /end MEASUREMENT
/begin MEASUREMENT CodeCoverParent004.CodeCover000140 "Determines if this subsystem has run" ULONG CompuMethod_153 1 0 0 1 ECU_ADDRESS 0x400001E8 BIT_MASK 0x00001000 /end MEASUREMENT
/begin MEASUREMENT CodeCoverParent004.CodeCover000152 "Determines if this subsystem has run" ULONG CompuMethod_154 1 0 0 1 ECU_ADDRESS 0x400001E8 BIT_MASK 0x01000000 /end MEASUREMENT
/begin MEASUREMENT CodeCoverParent004.CodeCover000141 "Determines if this subsystem has run" ULONG CompuMethod_155 1 0 0 1 ECU_ADDRESS 0x400001E8 BIT_MASK 0x00002000 /end MEASUREMENT
/begin MEASUREMENT CodeCoverParent004.CodeCover000130 "Determines if this subsystem has run" ULONG CompuMethod_156 1 0 0 1 ECU_ADDRESS 0x400001E8 BIT_MASK 0x00000004 /end MEASUREMENT
/begin MEASUREMENT CodeCoverParent004.CodeCover000153 "Determines if this subsystem has run" ULONG CompuMethod_157 1 0 0 1 ECU_ADDRESS 0x400001E8 BIT_MASK 0x02000000 /end MEASUREMENT
/begin MEASUREMENT CodeCoverParent004.CodeCover000142 "Determines if this subsystem has run" ULONG CompuMethod_158 1 0 0 1 ECU_ADDRESS 0x400001E8 BIT_MASK 0x00004000 /end MEASUREMENT
/begin MEASUREMENT CodeCoverParent004.CodeCover000131 "Determines if this subsystem has run" ULONG CompuMethod_159 1 0 0 1 ECU_ADDRESS 0x400001E8 BIT_MASK 0x00000008 /end MEASUREMENT
/begin MEASUREMENT CodeCoverParent004.CodeCover000154 "Determines if this subsystem has run" ULONG CompuMethod_160 1 0 0 1 ECU_ADDRESS 0x400001E8 BIT_MASK 0x04000000 /end MEASUREMENT
/begin MEASUREMENT CodeCoverParent004.CodeCover000143 "Determines if this subsystem has run" ULONG CompuMethod_161 1 0 0 1 ECU_ADDRESS 0x400001E8 BIT_MASK 0x00008000 /end MEASUREMENT
/begin MEASUREMENT CodeCoverParent004.CodeCover000132 "Determines if this subsystem has run" ULONG CompuMethod_162 1 0 0 1 ECU_ADDRESS 0x400001E8 BIT_MASK 0x00000010 /end MEASUREMENT
/begin MEASUREMENT CodeCoverParent004.CodeCover000155 "Determines if this subsystem has run" ULONG CompuMethod_163 1 0 0 1 ECU_ADDRESS 0x400001E8 BIT_MASK 0x08000000 /end MEASUREMENT
/begin MEASUREMENT CodeCoverParent004.CodeCover000144 "Determines if this subsystem has run" ULONG CompuMethod_164 1 0 0 1 ECU_ADDRESS 0x400001E8 BIT_MASK 0x00010000 /end MEASUREMENT
/begin MEASUREMENT CodeCoverParent004.CodeCover000133 "Determines if this subsystem has run" ULONG CompuMethod_165 1 0 0 1 ECU_ADDRESS 0x400001E8 BIT_MASK 0x00000020 /end MEASUREMENT
/begin MEASUREMENT CodeCoverParent004.CodeCover000156 "Determines if this subsystem has run" ULONG CompuMethod_166 1 0 0 1 ECU_ADDRESS 0x400001E8 BIT_MASK 0x10000000 /end MEASUREMENT
/begin MEASUREMENT CodeCoverParent004.CodeCover000145 "Determines if this subsystem has run" ULONG CompuMethod_167 1 0 0 1 ECU_ADDRESS 0x400001E8 BIT_MASK 0x00020000 /end MEASUREMENT
/begin MEASUREMENT CodeCoverParent004.CodeCover000134 "Determines if this subsystem has run" ULONG CompuMethod_168 1 0 0 1 ECU_ADDRESS 0x400001E8 BIT_MASK 0x00000040 /end MEASUREMENT
/begin MEASUREMENT CodeCoverParent004.CodeCover000157 "Determines if this subsystem has run" ULONG CompuMethod_169 1 0 0 1 ECU_ADDRESS 0x400001E8 BIT_MASK 0x20000000 /end MEASUREMENT
/begin MEASUREMENT CodeCoverParent004.CodeCover000146 "Determines if this subsystem has run" ULONG CompuMethod_170 1 0 0 1 ECU_ADDRESS 0x400001E8 BIT_MASK 0x00040000 /end MEASUREMENT
/begin MEASUREMENT CodeCoverParent004.CodeCover000135 "Determines if this subsystem has run" ULONG CompuMethod_171 1 0 0 1 ECU_ADDRESS 0x400001E8 BIT_MASK 0x00000080 /end MEASUREMENT
/begin MEASUREMENT CodeCoverParent004.CodeCover000158 "Determines if this subsystem has run" ULONG CompuMethod_172 1 0 0 1 ECU_ADDRESS 0x400001E8 BIT_MASK 0x40000000 /end MEASUREMENT
/begin MEASUREMENT CodeCoverParent004.CodeCover000147 "Determines if this subsystem has run" ULONG CompuMethod_173 1 0 0 1 ECU_ADDRESS 0x400001E8 BIT_MASK 0x00080000 /end MEASUREMENT
/begin MEASUREMENT CodeCoverParent004.CodeCover000136 "Determines if this subsystem has run" ULONG CompuMethod_174 1 0 0 1 ECU_ADDRESS 0x400001E8 BIT_MASK 0x00000100 /end MEASUREMENT
/begin MEASUREMENT CodeCoverParent004.CodeCover000159 "Determines if this subsystem has run" ULONG CompuMethod_175 1 0 0 1 ECU_ADDRESS 0x400001E8 BIT_MASK 0x80000000 /end MEASUREMENT
/begin MEASUREMENT CodeCoverParent004.CodeCover000148 "Determines if this subsystem has run" ULONG CompuMethod_176 1 0 0 1 ECU_ADDRESS 0x400001E8 BIT_MASK 0x00100000 /end MEASUREMENT
/begin MEASUREMENT CodeCoverParent004 "Run Status of Subsystems" ULONG CompuMethod_2 1 0 0 4294967295 ECU_ADDRESS 0x400001E8 /end MEASUREMENT
/begin MEASUREMENT Commanded_gen_torq_Prb "" FLOAT32_IEEE CompuMethod_2 1 0 -1E+17 1E+17 ECU_ADDRESS 0x4000021F /end MEASUREMENT
/begin MEASUREMENT Commanded_motor_torq_Prb "" FLOAT32_IEEE CompuMethod_2 1 0 -1E+17 1E+17 ECU_ADDRESS 0x40000223 /end MEASUREMENT
/begin MEASUREMENT Component_Keyed_Prb "" UBYTE CompuMethod_11 1 0 0 1 ECU_ADDRESS 0x40000277 /end MEASUREMENT
/begin MEASUREMENT CoolantTemperature "" FLOAT32_IEEE CompuMethod_2 1 0 -1E+17 1E+17 ECU_ADDRESS 0x40000278 /end MEASUREMENT
/begin MEASUREMENT Cooling_Pump_Heater_Core_Probe "" FLOAT32_IEEE CompuMethod_2 1 0 -1E+17 1E+17 ECU_ADDRESS 0x4000027C /end MEASUREMENT
/begin MEASUREMENT Cooling_Pump_Radiator_Probe "" FLOAT32_IEEE CompuMethod_2 1 0 -1E+17 1E+17 ECU_ADDRESS 0x40000280 /end MEASUREMENT
/begin MEASUREMENT CPUIdlePcnt "Percentage of CPU spent executing idle activity" UWORD CompuMethod_9 1 0 0 100 ECU_ADDRESS 0x40000284 /end MEASUREMENT
/begin MEASUREMENT crawlMode_Accel_Map "" FLOAT32_IEEE CompuMethod_13 1 0 -1E+17 1E+17 ECU_ADDRESS 0x40000286 /end MEASUREMENT
/begin MEASUREMENT crawlMode_AccelIdx "" UWORD CompuMethod_12 1 0 0 127.998 ECU_ADDRESS 0x4000028A /end MEASUREMENT
/begin MEASUREMENT crawlMode_AccelIn "" FLOAT32_IEEE CompuMethod_2 1 0 -1E+17 1E+17 ECU_ADDRESS 0x4000028C /end MEASUREMENT
/begin MEASUREMENT crawlMode_Brake_Map "" FLOAT32_IEEE CompuMethod_13 1 0 -1E+17 1E+17 ECU_ADDRESS 0x40000290 /end MEASUREMENT
/begin MEASUREMENT crawlMode_BrakeIdx "" UWORD CompuMethod_12 1 0 0 127.998 ECU_ADDRESS 0x40000294 /end MEASUREMENT
/begin MEASUREMENT crawlMode_BrakeIn "" FLOAT32_IEEE CompuMethod_2 1 0 -1E+17 1E+17 ECU_ADDRESS 0x40000296 /end MEASUREMENT
/begin MEASUREMENT Cruise_Ctrl_Light_Prb "" UBYTE CompuMethod_11 1 0 0 1 ECU_ADDRESS 0x400002B6 /end MEASUREMENT
/begin MEASUREMENT Current_Limit_Probe "" FLOAT32_IEEE CompuMethod_2 1 0 -1E+17 1E+17 ECU_ADDRESS 0x400002D0 /end MEASUREMENT
/begin MEASUREMENT Current_Prb "" FLOAT32_IEEE CompuMethod_2 1 0 -1E+17 1E+17 ECU_ADDRESS 0x400002D4 /end MEASUREMENT
/begin MEASUREMENT DateTime_Prb "" FLOAT32_IEEE CompuMethod_2 1 0 -1E+17 1E+17 ECU_ADDRESS 0x400002E8 /end MEASUREMENT
/begin MEASUREMENT Defrost_Mode_Prb "" FLOAT32_IEEE CompuMethod_2 1 0 -1E+17 1E+17 ECU_ADDRESS 0x400002EE /end MEASUREMENT
/begin MEASUREMENT Defrost_Prb "" FLOAT32_IEEE CompuMethod_2 1 0 -1E+17 1E+17 ECU_ADDRESS 0x400002F2 /end MEASUREMENT
/begin MEASUREMENT DPI_RollingCounter "" FLOAT32_IEEE CompuMethod_2 1 0 -1E+17 1E+17 ECU_ADDRESS 0x400002F6 /end MEASUREMENT
/begin MEASUREMENT Driver_1_Prb "" FLOAT32_IEEE CompuMethod_2 1 0 -1E+17 1E+17 ECU_ADDRESS 0x400002FA /end MEASUREMENT
/begin MEASUREMENT Driver_10_Prb "" FLOAT32_IEEE CompuMethod_2 1 0 -1E+17 1E+17 ECU_ADDRESS 0x400002FE /end MEASUREMENT
/begin MEASUREMENT Driver_Temp_Prb "" FLOAT32_IEEE CompuMethod_2 1 0 -1E+17 1E+17 ECU_ADDRESS 0x40000302 /end MEASUREMENT
/begin MEASUREMENT driveTorque_Prb_crawlMode "" FLOAT32_IEEE CompuMethod_2 1 0 -1E+17 1E+17 ECU_ADDRESS 0x40000306 /end MEASUREMENT
/begin MEASUREMENT driveTorque_Prb_ecoMode "" FLOAT32_IEEE CompuMethod_2 1 0 -1E+17 1E+17 ECU_ADDRESS 0x4000030A /end MEASUREMENT
/begin MEASUREMENT driveTorque_Prb_SUVMode "" FLOAT32_IEEE CompuMethod_2 1 0 -1E+17 1E+17 ECU_ADDRESS 0x4000030E /end MEASUREMENT
/begin MEASUREMENT Dyno_Shutdown_Prb "" UBYTE CompuMethod_11 1 0 0 1 ECU_ADDRESS 0x40000312 /end MEASUREMENT
/begin MEASUREMENT Eaton_Charger_AgeCount_Prb "" ULONG CompuMethod_6 1 0 0 4294970000 ECU_ADDRESS 0x40000313 /end MEASUREMENT
/begin MEASUREMENT Eaton_Charger_Message_Checksum_Prb "" FLOAT32_IEEE CompuMethod_2 1 0 -1E+17 1E+17 ECU_ADDRESS 0x40000317 /end MEASUREMENT
/begin MEASUREMENT Eaton_Charger_Message_Counter_Prb "" FLOAT32_IEEE CompuMethod_2 1 0 -1E+17 1E+17 ECU_ADDRESS 0x4000031B /end MEASUREMENT
/begin MEASUREMENT Eaton_HV_Charger_Temperature_Prb "" FLOAT32_IEEE CompuMethod_2 1 0 -1E+17 1E+17 ECU_ADDRESS 0x4000031F /end MEASUREMENT
/begin MEASUREMENT EcoMode_Accel_Map "" FLOAT32_IEEE CompuMethod_13 1 0 -1E+17 1E+17 ECU_ADDRESS 0x40000323 /end MEASUREMENT
/begin MEASUREMENT EcoMode_AccelIdx "" UWORD CompuMethod_12 1 0 0 127.998 ECU_ADDRESS 0x40000327 /end MEASUREMENT
/begin MEASUREMENT EcoMode_AccelIn "" FLOAT32_IEEE CompuMethod_2 1 0 -1E+17 1E+17 ECU_ADDRESS 0x40000329 /end MEASUREMENT
/begin MEASUREMENT EcoMode_Brake_Map "" FLOAT32_IEEE CompuMethod_13 1 0 -1E+17 1E+17 ECU_ADDRESS 0x4000032D /end MEASUREMENT
/begin MEASUREMENT EcoMode_BrakeIdx "" UWORD CompuMethod_12 1 0 0 127.998 ECU_ADDRESS 0x40000331 /end MEASUREMENT
/begin MEASUREMENT EcoMode_BrakeIn "" FLOAT32_IEEE CompuMethod_2 1 0 -1E+17 1E+17 ECU_ADDRESS 0x40000333 /end MEASUREMENT
/begin MEASUREMENT ecoMode_Prb "" FLOAT32_IEEE CompuMethod_2 1 0 -1E+17 1E+17 ECU_ADDRESS 0x40000337 /end MEASUREMENT
/begin MEASUREMENT Eng_Cool_Temp_Prb "" FLOAT32_IEEE CompuMethod_2 1 0 -1E+17 1E+17 ECU_ADDRESS 0x4000033B /end MEASUREMENT
/begin MEASUREMENT Engine_On_ABS_Prb "" FLOAT32_IEEE CompuMethod_2 1 0 -1E+17 1E+17 ECU_ADDRESS 0x40000343 /end MEASUREMENT
/begin MEASUREMENT Engine_Speed_Prb "" FLOAT32_IEEE CompuMethod_2 1 0 -1E+17 1E+17 ECU_ADDRESS 0x4000034B /end MEASUREMENT
/begin MEASUREMENT ESTOP2_Prb "" UBYTE CompuMethod_11 1 0 0 1 ECU_ADDRESS 0x4000034F /end MEASUREMENT
/begin MEASUREMENT Fault_Severity_Indiciator_Prb "" UBYTE CompuMethod_11 1 0 0 1 ECU_ADDRESS 0x40000360 /end MEASUREMENT
/begin MEASUREMENT FGNDTaskCPU "Percentage of CPU spent on FGNDTask task" UWORD CompuMethod_9 1 0 0 100 ECU_ADDRESS 0x40000374 /end MEASUREMENT
/begin MEASUREMENT FGNDTaskStackMinBytesFree "Remaining bytes available on the FGNDTask stack" UWORD CompuMethod_10 1 0 0 65535 ECU_ADDRESS 0x40000376 /end MEASUREMENT
/begin MEASUREMENT Front_left_whl_speed_Prb "" FLOAT32_IEEE CompuMethod_2 1 0 -1E+17 1E+17 ECU_ADDRESS 0x40000378 /end MEASUREMENT
/begin MEASUREMENT Front_right_whl_speed_Prb "" FLOAT32_IEEE CompuMethod_2 1 0 -1E+17 1E+17 ECU_ADDRESS 0x4000037C /end MEASUREMENT
/begin MEASUREMENT Gas_Pedal_Prb_crawlMode "" FLOAT32_IEEE CompuMethod_2 1 0 -1E+17 1E+17 ECU_ADDRESS 0x40000380 /end MEASUREMENT
/begin MEASUREMENT Gas_Pedal_Prb_EcoMode "" FLOAT32_IEEE CompuMethod_2 1 0 -1E+17 1E+17 ECU_ADDRESS 0x40000384 /end MEASUREMENT
/begin MEASUREMENT Gas_Pedal_Prb_SUVMode "" FLOAT32_IEEE CompuMethod_2 1 0 -1E+17 1E+17 ECU_ADDRESS 0x40000388 /end MEASUREMENT
/begin MEASUREMENT GPSQuality_Prb "" FLOAT32_IEEE CompuMethod_2 1 0 -1E+17 1E+17 ECU_ADDRESS 0x400003A1 /end MEASUREMENT
/begin MEASUREMENT Heading_Prb "" FLOAT32_IEEE CompuMethod_2 1 0 -1E+17 1E+17 ECU_ADDRESS 0x400003A5 /end MEASUREMENT
/begin MEASUREMENT Heat_1_Prb "" FLOAT32_IEEE CompuMethod_2 1 0 -1E+17 1E+17 ECU_ADDRESS 0x400003A9 /end MEASUREMENT
/begin MEASUREMENT Heat_2_Prb "" FLOAT32_IEEE CompuMethod_2 1 0 -1E+17 1E+17 ECU_ADDRESS 0x400003AD /end MEASUREMENT
/begin MEASUREMENT Heat_3_Prb "" FLOAT32_IEEE CompuMethod_2 1 0 -1E+17 1E+17 ECU_ADDRESS 0x400003B1 /end MEASUREMENT
/begin MEASUREMENT Heat_4_Prb "" FLOAT32_IEEE CompuMethod_2 1 0 -1E+17 1E+17 ECU_ADDRESS 0x400003B5 /end MEASUREMENT
/begin MEASUREMENT Heater_Core_Blend_Prb "" FLOAT32_IEEE CompuMethod_2 1 0 -1E+17 1E+17 ECU_ADDRESS 0x400003BD /end MEASUREMENT
/begin MEASUREMENT HV_Elec_Sys_Wrn_Prb "" UBYTE CompuMethod_11 1 0 0 1 ECU_ADDRESS 0x400003DC /end MEASUREMENT
/begin MEASUREMENT HVIL_Status "" FLOAT32_IEEE CompuMethod_2 1 0 -1E+17 1E+17 ECU_ADDRESS 0x400003DD /end MEASUREMENT
/begin MEASUREMENT HybridStateProbe "" FLOAT32_IEEE CompuMethod_2 1 0 -1E+17 1E+17 ECU_ADDRESS 0x400003E1 /end MEASUREMENT
/begin MEASUREMENT IdleStackMinBytesFree "Remaining bytes available on the Idle stack" UWORD CompuMethod_497 1 0 0 65535 ECU_ADDRESS 0x400003E5 /end MEASUREMENT
/begin MEASUREMENT Ignition_Status_Prb "" UBYTE CompuMethod_11 1 0 0 1 ECU_ADDRESS 0x400003E7 /end MEASUREMENT
/begin MEASUREMENT Input_Current_Limit_Max_Prb "" FLOAT32_IEEE CompuMethod_2 1 0 -1E+17 1E+17 ECU_ADDRESS 0x400003E8 /end MEASUREMENT
/begin MEASUREMENT Input_Current_Prb "" FLOAT32_IEEE CompuMethod_2 1 0 -1E+17 1E+17 ECU_ADDRESS 0x400003EC /end MEASUREMENT
/begin MEASUREMENT Input_Voltage_Prb "" FLOAT32_IEEE CompuMethod_2 1 0 -1E+17 1E+17 ECU_ADDRESS 0x400003F0 /end MEASUREMENT
/begin MEASUREMENT InterruptStackMinBytesFree "Remaining bytes available on the interrupt stack" UWORD CompuMethod_497 1 0 0 65535 ECU_ADDRESS 0x400003F8 /end MEASUREMENT
/begin MEASUREMENT IPT_Antishudder_Prb "" FLOAT32_IEEE CompuMethod_2 1 0 -1E+17 1E+17 ECU_ADDRESS 0x400003FE /end MEASUREMENT
/begin MEASUREMENT IPT_Current_Limit_Prb "" FLOAT32_IEEE CompuMethod_2 1 0 -1E+17 1E+17 ECU_ADDRESS 0x40000402 /end MEASUREMENT
/begin MEASUREMENT IPT_Current_Request_Prb "" FLOAT32_IEEE CompuMethod_2 1 0 -1E+17 1E+17 ECU_ADDRESS 0x40000406 /end MEASUREMENT
/begin MEASUREMENT IPT_Current_Used_Prb "" FLOAT32_IEEE CompuMethod_2 1 0 -1E+17 1E+17 ECU_ADDRESS 0x4000040A /end MEASUREMENT
/begin MEASUREMENT IPT_DC_Error_Category_Prb "" FLOAT32_IEEE CompuMethod_2 1 0 -1E+17 1E+17 ECU_ADDRESS 0x4000040E /end MEASUREMENT
/begin MEASUREMENT IPT_DCHV_Bus_Current_Prb "" FLOAT32_IEEE CompuMethod_2 1 0 -1E+17 1E+17 ECU_ADDRESS 0x40000412 /end MEASUREMENT
/begin MEASUREMENT IPT_DCLV_Bus_Current_Prb "" FLOAT32_IEEE CompuMethod_2 1 0 -1E+17 1E+17 ECU_ADDRESS 0x40000416 /end MEASUREMENT
/begin MEASUREMENT IPT_DCLV_Bus_Voltage_Prb "" FLOAT32_IEEE CompuMethod_2 1 0 -1E+17 1E+17 ECU_ADDRESS 0x4000041A /end MEASUREMENT
/begin MEASUREMENT IPT_DCLV_General_Error_Prb "" FLOAT32_IEEE CompuMethod_2 1 0 -1E+17 1E+17 ECU_ADDRESS 0x4000041E /end MEASUREMENT
/begin MEASUREMENT IPT_DCLV_Max_Power_Prb "" FLOAT32_IEEE CompuMethod_2 1 0 -1E+17 1E+17 ECU_ADDRESS 0x40000422 /end MEASUREMENT
/begin MEASUREMENT IPT_DCLV_On_Prb "" FLOAT32_IEEE CompuMethod_2 1 0 -1E+17 1E+17 ECU_ADDRESS 0x40000426 /end MEASUREMENT
/begin MEASUREMENT IPT_Error_Category_Prb "" FLOAT32_IEEE CompuMethod_2 1 0 -1E+17 1E+17 ECU_ADDRESS 0x40000432 /end MEASUREMENT
/begin MEASUREMENT IPT_HVDC_Voltage_Prb "" FLOAT32_IEEE CompuMethod_2 1 0 -1E+17 1E+17 ECU_ADDRESS 0x4000043A /end MEASUREMENT
/begin MEASUREMENT IPT_Inverter_Temperature_Prb "" FLOAT32_IEEE CompuMethod_2 1 0 -1E+17 1E+17 ECU_ADDRESS 0x4000043E /end MEASUREMENT
/begin MEASUREMENT IPT_IPTAwake_Prb "" FLOAT32_IEEE CompuMethod_2 1 0 -1E+17 1E+17 ECU_ADDRESS 0x40000442 /end MEASUREMENT
/begin MEASUREMENT IPT_IPTReady_Prb "" FLOAT32_IEEE CompuMethod_2 1 0 -1E+17 1E+17 ECU_ADDRESS 0x40000446 /end MEASUREMENT
/begin MEASUREMENT IPT_Max_Torque_Avail_Gen_Prb "" FLOAT32_IEEE CompuMethod_2 1 0 -1E+17 1E+17 ECU_ADDRESS 0x4000044A /end MEASUREMENT
/begin MEASUREMENT IPT_Max_Torque_Avail_Motor_Prb "" FLOAT32_IEEE CompuMethod_2 1 0 -1E+17 1E+17 ECU_ADDRESS 0x4000044E /end MEASUREMENT
/begin MEASUREMENT IPT_Max_Waste_Available_Prb "" FLOAT32_IEEE CompuMethod_2 1 0 -1E+17 1E+17 ECU_ADDRESS 0x40000452 /end MEASUREMENT
/begin MEASUREMENT IPT_Motor_Ready_Prb "" UBYTE CompuMethod_11 1 0 0 1 ECU_ADDRESS 0x40000456 /end MEASUREMENT
/begin MEASUREMENT IPT_Motor_Speed_Prb "" FLOAT32_IEEE CompuMethod_2 1 0 -1E+17 1E+17 ECU_ADDRESS 0x40000457 /end MEASUREMENT
/begin MEASUREMENT IPT_Motor_Temperature_Prb "" FLOAT32_IEEE CompuMethod_2 1 0 -1E+17 1E+17 ECU_ADDRESS 0x4000045B /end MEASUREMENT
/begin MEASUREMENT IPT_Wheel_Torque_Delivered_Prb "" FLOAT32_IEEE CompuMethod_2 1 0 -1E+17 1E+17 ECU_ADDRESS 0x4000045F /end MEASUREMENT
/begin MEASUREMENT Isolation_Measure_Enable_Probe "" UBYTE CompuMethod_11 1 0 0 1 ECU_ADDRESS 0x40000463 /end MEASUREMENT
/begin MEASUREMENT IsolationLevel "" FLOAT32_IEEE CompuMethod_2 1 0 -1E+17 1E+17 ECU_ADDRESS 0x40000464 /end MEASUREMENT
/begin MEASUREMENT IsolationStatus "" FLOAT32_IEEE CompuMethod_2 1 0 -1E+17 1E+17 ECU_ADDRESS 0x40000468 /end MEASUREMENT
/begin MEASUREMENT JCS_PackIdentifier "" FLOAT32_IEEE CompuMethod_2 1 0 -1E+17 1E+17 ECU_ADDRESS 0x4000047A /end MEASUREMENT
/begin MEASUREMENT KernelStackMinBytesFree "Remaining bytes available on the Kernel stack" UWORD CompuMethod_497 1 0 0 65535 ECU_ADDRESS 0x4000047E /end MEASUREMENT
/begin MEASUREMENT LF_Wheel_Rolling_Count_Prb "" FLOAT32_IEEE CompuMethod_2 1 0 -1E+17 1E+17 ECU_ADDRESS 0x40000480 /end MEASUREMENT
/begin MEASUREMENT LifeTimeAmpHoursOut "" FLOAT32_IEEE CompuMethod_2 1 0 -1E+17 1E+17 ECU_ADDRESS 0x40000484 /end MEASUREMENT
/begin MEASUREMENT LTAHI_RollingCounter "" FLOAT32_IEEE CompuMethod_2 1 0 -1E+17 1E+17 ECU_ADDRESS 0x40000494 /end MEASUREMENT
/begin MEASUREMENT MaxCellTemperature "" FLOAT32_IEEE CompuMethod_2 1 0 -1E+17 1E+17 ECU_ADDRESS 0x400004E8 /end MEASUREMENT
/begin MEASUREMENT MaxCellVoltage "" FLOAT32_IEEE CompuMethod_2 1 0 -1E+17 1E+17 ECU_ADDRESS 0x400004EC /end MEASUREMENT
/begin MEASUREMENT MaximumDischargePower_10s "" FLOAT32_IEEE CompuMethod_2 1 0 -1E+17 1E+17 ECU_ADDRESS 0x400004F0 /end MEASUREMENT
/begin MEASUREMENT MaximumDischargePower_Continuous "" FLOAT32_IEEE CompuMethod_2 1 0 -1E+17 1E+17 ECU_ADDRESS 0x400004F4 /end MEASUREMENT
/begin MEASUREMENT MaximumRegenPower_10s "" FLOAT32_IEEE CompuMethod_2 1 0 -1E+17 1E+17 ECU_ADDRESS 0x400004F8 /end MEASUREMENT
/begin MEASUREMENT MaximumRegenPower_Continuous "" FLOAT32_IEEE CompuMethod_2 1 0 -1E+17 1E+17 ECU_ADDRESS 0x400004FC /end MEASUREMENT
/begin MEASUREMENT Me_Cool_Temp_Prb "" FLOAT32_IEEE CompuMethod_2 1 0 -1E+17 1E+17 ECU_ADDRESS 0x40000500 /end MEASUREMENT
/begin MEASUREMENT MILState "" FLOAT32_IEEE CompuMethod_2 1 0 -1E+17 1E+17 ECU_ADDRESS 0x40000504 /end MEASUREMENT
/begin MEASUREMENT MinCellTemperature "" FLOAT32_IEEE CompuMethod_2 1 0 -1E+17 1E+17 ECU_ADDRESS 0x40000508 /end MEASUREMENT
/begin MEASUREMENT MinCellVoltage "" FLOAT32_IEEE CompuMethod_2 1 0 -1E+17 1E+17 ECU_ADDRESS 0x4000050C /end MEASUREMENT
/begin MEASUREMENT MotoHawkModelSecondsInUse "Total runtime of this MotoHawk software model" ULONG CompuMethod_499 1 0 0 4294970000 ECU_ADDRESS 0x4000062D /end MEASUREMENT
/begin MEASUREMENT ODO_Count_Prb "" FLOAT32_IEEE CompuMethod_2 1 0 -1E+17 1E+17 ECU_ADDRESS 0x400006BD /end MEASUREMENT
/begin MEASUREMENT Output_Current_Prb "" FLOAT32_IEEE CompuMethod_2 1 0 -1E+17 1E+17 ECU_ADDRESS 0x400006C5 /end MEASUREMENT
/begin MEASUREMENT Output_Voltage_Prb "" FLOAT32_IEEE CompuMethod_2 1 0 -1E+17 1E+17 ECU_ADDRESS 0x400006C9 /end MEASUREMENT
/begin MEASUREMENT PackState "" FLOAT32_IEEE CompuMethod_2 1 0 -1E+17 1E+17 ECU_ADDRESS 0x400006D5 /end MEASUREMENT
/begin MEASUREMENT Passenger_1_Prb "" FLOAT32_IEEE CompuMethod_2 1 0 -1E+17 1E+17 ECU_ADDRESS 0x40000701 /end MEASUREMENT
/begin MEASUREMENT Passenger_10_Prb "" FLOAT32_IEEE CompuMethod_2 1 0 -1E+17 1E+17 ECU_ADDRESS 0x40000705 /end MEASUREMENT
/begin MEASUREMENT Passenger_Temp_Prb "" FLOAT32_IEEE CompuMethod_2 1 0 -1E+17 1E+17 ECU_ADDRESS 0x40000709 /end MEASUREMENT
/begin MEASUREMENT Pct_whl_trq_cmd_prb "" FLOAT32_IEEE CompuMethod_2 1 0 -1E+17 1E+17 ECU_ADDRESS 0x4000070D /end MEASUREMENT
/begin MEASUREMENT PeakHeapBytesUsed "Maximum number of bytes used on the heap since startup" ULONG CompuMethod_507 1 0 0 4294970000 ECU_ADDRESS 0x40000711 /end MEASUREMENT
/begin MEASUREMENT Power_train_torq_actual_prb "" FLOAT32_IEEE CompuMethod_2 1 0 -1E+17 1E+17 ECU_ADDRESS 0x40000715 /end MEASUREMENT
/begin MEASUREMENT PPL10s_RollingCounter "" FLOAT32_IEEE CompuMethod_2 1 0 -1E+17 1E+17 ECU_ADDRESS 0x4000071A /end MEASUREMENT
/begin MEASUREMENT PPLCont_RollingCounter "" FLOAT32_IEEE CompuMethod_2 1 0 -1E+17 1E+17 ECU_ADDRESS 0x4000071E /end MEASUREMENT
/begin MEASUREMENT PrechargeState "" FLOAT32_IEEE CompuMethod_2 1 0 -1E+17 1E+17 ECU_ADDRESS 0x40000726 /end MEASUREMENT
/begin MEASUREMENT prndl_dir_prb "" FLOAT32_IEEE CompuMethod_2 1 0 -1E+17 1E+17 ECU_ADDRESS 0x4000072A /end MEASUREMENT
/begin MEASUREMENT PS_RollingCounter "" FLOAT32_IEEE CompuMethod_2 1 0 -1E+17 1E+17 ECU_ADDRESS 0x4000072E /end MEASUREMENT
/begin MEASUREMENT PVC_RollingCounter "" FLOAT32_IEEE CompuMethod_2 1 0 -1E+17 1E+17 ECU_ADDRESS 0x40000736 /end MEASUREMENT
/begin MEASUREMENT Radiator_Blend_Prb "" FLOAT32_IEEE CompuMethod_2 1 0 -1E+17 1E+17 ECU_ADDRESS 0x4000073A /end MEASUREMENT
/begin MEASUREMENT Radiator_Fan_Prb "" FLOAT32_IEEE CompuMethod_2 1 0 -1E+17 1E+17 ECU_ADDRESS 0x40000740 /end MEASUREMENT
/begin MEASUREMENT Ready_Light_Prb "" UBYTE CompuMethod_11 1 0 0 1 ECU_ADDRESS 0x4000074B /end MEASUREMENT
/begin MEASUREMENT Rear_left_whl_speed_Prb "" FLOAT32_IEEE CompuMethod_2 1 0 -1E+17 1E+17 ECU_ADDRESS 0x4000074C /end MEASUREMENT
/begin MEASUREMENT Rear_right_whl_speed_Prb "" FLOAT32_IEEE CompuMethod_2 1 0 -1E+17 1E+17 ECU_ADDRESS 0x40000750 /end MEASUREMENT
/begin MEASUREMENT Regen_Brakes_Disabled_Prb "" UBYTE CompuMethod_11 1 0 0 1 ECU_ADDRESS 0x40000754 /end MEASUREMENT
/begin MEASUREMENT regen_torq_limit_prb "" FLOAT32_IEEE CompuMethod_2 1 0 -1E+17 1E+17 ECU_ADDRESS 0x40000755 /end MEASUREMENT
/begin MEASUREMENT regenTorque_Prb_crawlMode "" FLOAT32_IEEE CompuMethod_2 1 0 -1E+17 1E+17 ECU_ADDRESS 0x40000759 /end MEASUREMENT
/begin MEASUREMENT regenTorque_Prb_ecoMode "" FLOAT32_IEEE CompuMethod_2 1 0 -1E+17 1E+17 ECU_ADDRESS 0x4000075D /end MEASUREMENT
/begin MEASUREMENT regenTorque_Prb_SUVMode "" FLOAT32_IEEE CompuMethod_2 1 0 -1E+17 1E+17 ECU_ADDRESS 0x40000761 /end MEASUREMENT
/begin MEASUREMENT Repair_Wrench_Prb "" UBYTE CompuMethod_11 1 0 0 1 ECU_ADDRESS 0x40000769 /end MEASUREMENT
/begin MEASUREMENT RT_Wheel_Rolling_Count_Prb "" FLOAT32_IEEE CompuMethod_2 1 0 -1E+17 1E+17 ECU_ADDRESS 0x4000076E /end MEASUREMENT
/begin MEASUREMENT Shift_Position_Raw_Prb "" FLOAT32_IEEE CompuMethod_2 1 0 -1E+17 1E+17 ECU_ADDRESS 0x40000772 /end MEASUREMENT
/begin MEASUREMENT SHUTDOWNTaskCPU "Percentage of CPU spent on SHUTDOWNTask task" UWORD CompuMethod_9 1 0 0 100 ECU_ADDRESS 0x40000776 /end MEASUREMENT
/begin MEASUREMENT SHUTDOWNTaskStackMinBytesFree "Remaining bytes available on the SHUTDOWNTask stack" UWORD CompuMethod_10 1 0 0 65535 ECU_ADDRESS 0x40000778 /end MEASUREMENT
/begin MEASUREMENT SleepInhibited "" FLOAT32_IEEE CompuMethod_2 1 0 -1E+17 1E+17 ECU_ADDRESS 0x4000077A /end MEASUREMENT
/begin MEASUREMENT Speed_Diff_Prb "" FLOAT32_IEEE CompuMethod_2 1 0 -1E+17 1E+17 ECU_ADDRESS 0x4000077E /end MEASUREMENT
/begin MEASUREMENT Speed_Prb "" FLOAT32_IEEE CompuMethod_2 1 0 -1E+17 1E+17 ECU_ADDRESS 0x40000782 /end MEASUREMENT
/begin MEASUREMENT StateOfCharge "" FLOAT32_IEEE CompuMethod_2 1 0 -1E+17 1E+17 ECU_ADDRESS 0x40000786 /end MEASUREMENT
/begin MEASUREMENT StateOfChargeMax "" FLOAT32_IEEE CompuMethod_2 1 0 -1E+17 1E+17 ECU_ADDRESS 0x4000078A /end MEASUREMENT
/begin MEASUREMENT StateOfChargeMin "" FLOAT32_IEEE CompuMethod_2 1 0 -1E+17 1E+17 ECU_ADDRESS 0x4000078E /end MEASUREMENT
/begin MEASUREMENT SUVMode_Accel_Map "" FLOAT32_IEEE CompuMethod_13 1 0 -1E+17 1E+17 ECU_ADDRESS 0x4000079A /end MEASUREMENT
/begin MEASUREMENT SUVMode_AccelIdx "" UWORD CompuMethod_12 1 0 0 127.998 ECU_ADDRESS 0x4000079E /end MEASUREMENT
/begin MEASUREMENT SUVMode_AccelIn "" FLOAT32_IEEE CompuMethod_2 1 0 -1E+17 1E+17 ECU_ADDRESS 0x400007A0 /end MEASUREMENT
/begin MEASUREMENT SUVMode_Brake_Map "" FLOAT32_IEEE CompuMethod_13 1 0 -1E+17 1E+17 ECU_ADDRESS 0x400007A4 /end MEASUREMENT
/begin MEASUREMENT SUVMode_BrakeIdx "" UWORD CompuMethod_12 1 0 0 127.998 ECU_ADDRESS 0x400007A8 /end MEASUREMENT
/begin MEASUREMENT SUVMode_BrakeIn "" FLOAT32_IEEE CompuMethod_2 1 0 -1E+17 1E+17 ECU_ADDRESS 0x400007AA /end MEASUREMENT
/begin MEASUREMENT TAH_RollingCounter "" FLOAT32_IEEE CompuMethod_2 1 0 -1E+17 1E+17 ECU_ADDRESS 0x400007AE /end MEASUREMENT
/begin MEASUREMENT TCS_ENG_EVNT_IN_PROGRESS_Prb "" FLOAT32_IEEE CompuMethod_2 1 0 -1E+17 1E+17 ECU_ADDRESS 0x400007B2 /end MEASUREMENT
/begin MEASUREMENT Throttle_Position_PreIdx "" UWORD CompuMethod_12 1 0 0 127.998 ECU_ADDRESS 0x400007BC /end MEASUREMENT
/begin MEASUREMENT Throttle_Position_PreIn "" FLOAT32_IEEE CompuMethod_2 1 0 -1E+17 1E+17 ECU_ADDRESS 0x400007BE /end MEASUREMENT
/begin MEASUREMENT Throttle_Position_Raw_Prb "" FLOAT32_IEEE CompuMethod_2 1 0 -1E+17 1E+17 ECU_ADDRESS 0x400007C2 /end MEASUREMENT
/begin MEASUREMENT Throttle_Position_Tbl "" FLOAT32_IEEE CompuMethod_13 1 0 -1E+17 1E+17 ECU_ADDRESS 0x400007C6 /end MEASUREMENT
/begin MEASUREMENT Traction_Control_Trq_Out_Prb "" FLOAT32_IEEE CompuMethod_2 1 0 -1E+17 1E+17 ECU_ADDRESS 0x400007D2 /end MEASUREMENT
/begin MEASUREMENT Transmission_AgeCount_Prb "" ULONG CompuMethod_6 1 0 0 4294970000 ECU_ADDRESS 0x400007D6 /end MEASUREMENT
/begin MEASUREMENT TripAmpHoursIn "" FLOAT32_IEEE CompuMethod_2 1 0 -1E+17 1E+17 ECU_ADDRESS 0x400007DA /end MEASUREMENT
/begin MEASUREMENT TripAmpHoursOut "" FLOAT32_IEEE CompuMethod_2 1 0 -1E+17 1E+17 ECU_ADDRESS 0x400007DE /end MEASUREMENT
/begin MEASUREMENT Vehicle_Speed_Prb "" FLOAT32_IEEE CompuMethod_2 1 0 -1E+17 1E+17 ECU_ADDRESS 0x400007E6 /end MEASUREMENT
/begin MEASUREMENT Voltage_Limit_Probe "" FLOAT32_IEEE CompuMethod_2 1 0 -1E+17 1E+17 ECU_ADDRESS 0x40000832 /end MEASUREMENT
/begin MEASUREMENT WakeSignal "" FLOAT32_IEEE CompuMethod_2 1 0 -1E+17 1E+17 ECU_ADDRESS 0x40000866 /end MEASUREMENT
/begin MEASUREMENT Wheel_Rolling_Timestamp_Prb "" FLOAT32_IEEE CompuMethod_2 1 0 -1E+17 1E+17 ECU_ADDRESS 0x4000086A /end MEASUREMENT
/*~~~~~~~~~ 6.3.27 CHARACTERISTICs ~~~~~~~~~*/
/begin CHARACTERISTIC SwIdTxt "Software Format ID" ASCII 0x4000000C RecordLayout_1 0 CompuMethod_2 0 255 NUMBER 13 MATRIX_DIM 13 1 1 READ_ONLY /end CHARACTERISTIC
/begin CHARACTERISTIC CalIdTxt "Calibration ID" ASCII 0x80000000 RecordLayout_1 0 CompuMethod_2 0 255 NUMBER 33 MATRIX_DIM 33 1 1 /end CHARACTERISTIC
/begin CHARACTERISTIC SwRevisionTxt "Software Revision ID" ASCII 0x40000019 RecordLayout_1 0 CompuMethod_2 0 255 NUMBER 50 MATRIX_DIM 50 1 1 READ_ONLY /end CHARACTERISTIC
/begin CHARACTERISTIC FriendlyName "The device's friendly name." ASCII 0x40000054 RecordLayout_1 0 CompuMethod_2 0 255 NUMBER 33 MATRIX_DIM 33 1 1 READ_ONLY /end CHARACTERISTIC
/begin CHARACTERISTIC SerialNumber "Module Serial Number" ASCII 0x400000E2 RecordLayout_1 0 CompuMethod_2 0 255 NUMBER 49 MATRIX_DIM 49 1 1 READ_ONLY /end CHARACTERISTIC
/begin CHARACTERISTIC ModelNumber "Module Model Number" ASCII 0x40000113 RecordLayout_1 0 CompuMethod_2 0 255 NUMBER 49 MATRIX_DIM 49 1 1 READ_ONLY /end CHARACTERISTIC
/begin CHARACTERISTIC ABS_217_AgeCount_Ovr_new "" VALUE 0x80000021 RecordLayout_2 0 CompuMethod_6 0 4294970000 /end CHARACTERISTIC
/begin CHARACTERISTIC ABS_217_AgeCount_Ovr_ovr "" VALUE 0x80000025 RecordLayout_3 0 CompuMethod_7 0 1 /end CHARACTERISTIC
/begin CHARACTERISTIC ABS_417_AgeCount_Ovr_new "" VALUE 0x80000026 RecordLayout_2 0 CompuMethod_6 0 4294970000 /end CHARACTERISTIC
/begin CHARACTERISTIC ABS_417_AgeCount_Ovr_ovr "" VALUE 0x8000002A RecordLayout_3 0 CompuMethod_7 0 1 /end CHARACTERISTIC
/begin CHARACTERISTIC ABS_4B0_AgeCount_Ovr_new "" VALUE 0x8000002B RecordLayout_2 0 CompuMethod_6 0 4294970000 /end CHARACTERISTIC
/begin CHARACTERISTIC ABS_4B0_AgeCount_Ovr_ovr "" VALUE 0x8000002F RecordLayout_3 0 CompuMethod_7 0 1 /end CHARACTERISTIC
/begin CHARACTERISTIC ABS_ToneRing_AgeCount_Fault "" VALUE 0x80000030 RecordLayout_4 0 CompuMethod_2 -1E+17 1E+17 /end CHARACTERISTIC
/begin CHARACTERISTIC ABS_Traction_Control_AgeCount_Fault "" VALUE 0x80000034 RecordLayout_4 0 CompuMethod_2 -1E+17 1E+17 /end CHARACTERISTIC
/begin CHARACTERISTIC ABS_WheelSpeed_AgeCount_Fault "" VALUE 0x80000038 RecordLayout_4 0 CompuMethod_2 -1E+17 1E+17 /end CHARACTERISTIC
/begin CHARACTERISTIC AC_Cmd_Ovr_new "" VALUE 0x8000003C RecordLayout_4 0 CompuMethod_2 -1E+17 1E+17 /end CHARACTERISTIC
/begin CHARACTERISTIC AC_Cmd_Ovr_ovr "" VALUE 0x80000040 RecordLayout_3 0 CompuMethod_7 0 1 /end CHARACTERISTIC
/begin CHARACTERISTIC AC_Command_Ovr_new "" VALUE 0x80000041 RecordLayout_4 0 CompuMethod_2 -1E+17 1E+17 /end CHARACTERISTIC
/begin CHARACTERISTIC AC_Command_Ovr_ovr "" VALUE 0x80000045 RecordLayout_3 0 CompuMethod_7 0 1 /end CHARACTERISTIC
/begin CHARACTERISTIC ACC_torq_rqstd_ovr_new "" VALUE 0x80000046 RecordLayout_4 0 CompuMethod_2 0 4 /end CHARACTERISTIC
/begin CHARACTERISTIC ACC_torq_rqstd_ovr_ovr "" VALUE 0x8000004A RecordLayout_3 0 CompuMethod_7 0 1 /end CHARACTERISTIC
/begin CHARACTERISTIC accelEnd_Pedal_crawlMode "" VALUE 0x8000004B RecordLayout_4 0 CompuMethod_2 -1E+17 1E+17 /end CHARACTERISTIC
/begin CHARACTERISTIC accelEnd_Pedal_ecoMode "" VALUE 0x8000004F RecordLayout_4 0 CompuMethod_2 -1E+17 1E+17 /end CHARACTERISTIC
/begin CHARACTERISTIC accelEnd_Pedal_SUVMode "" VALUE 0x80000053 RecordLayout_4 0 CompuMethod_2 -1E+17 1E+17 /end CHARACTERISTIC
/begin CHARACTERISTIC accelStart_Pedal_crawlMode "" VALUE 0x80000057 RecordLayout_4 0 CompuMethod_2 -1E+17 1E+17 /end CHARACTERISTIC
/begin CHARACTERISTIC accelStart_Pedal_ecoMode "" VALUE 0x8000005B RecordLayout_4 0 CompuMethod_2 -1E+17 1E+17 /end CHARACTERISTIC
/begin CHARACTERISTIC accelStart_Pedal_SUVMode "" VALUE 0x8000005F RecordLayout_4 0 CompuMethod_8 -1E+17 1E+17 /end CHARACTERISTIC
/begin CHARACTERISTIC Age_Count_260_Ovr_new "" VALUE 0x80000063 RecordLayout_2 0 CompuMethod_6 0 4294970000 /end CHARACTERISTIC
/begin CHARACTERISTIC Age_Count_260_Ovr_ovr "" VALUE 0x80000067 RecordLayout_3 0 CompuMethod_7 0 1 /end CHARACTERISTIC
/begin CHARACTERISTIC Age_Count_278_Ovr_new "" VALUE 0x80000068 RecordLayout_2 0 CompuMethod_6 0 4294970000 /end CHARACTERISTIC
/begin CHARACTERISTIC Age_Count_278_Ovr_ovr "" VALUE 0x8000006C RecordLayout_3 0 CompuMethod_7 0 1 /end CHARACTERISTIC
/begin CHARACTERISTIC Age_Count_590_Ovr_new "" VALUE 0x8000006D RecordLayout_2 0 CompuMethod_6 0 4294970000 /end CHARACTERISTIC
/begin CHARACTERISTIC Age_Count_590_Ovr_ovr "" VALUE 0x80000071 RecordLayout_3 0 CompuMethod_7 0 1 /end CHARACTERISTIC
/begin CHARACTERISTIC Age_Count_624_Ovr_new "" VALUE 0x80000072 RecordLayout_2 0 CompuMethod_6 0 4294970000 /end CHARACTERISTIC
/begin CHARACTERISTIC Age_Count_624_Ovr_ovr "" VALUE 0x80000076 RecordLayout_3 0 CompuMethod_7 0 1 /end CHARACTERISTIC
/begin CHARACTERISTIC Altitude_Ovr_new "" VALUE 0x80000077 RecordLayout_4 0 CompuMethod_2 -1E+17 1E+17 /end CHARACTERISTIC
/begin CHARACTERISTIC Altitude_Ovr_ovr "" VALUE 0x8000007B RecordLayout_3 0 CompuMethod_7 0 1 /end CHARACTERISTIC
/begin CHARACTERISTIC Auto_Battery_Startup "" VALUE 0x8000007C RecordLayout_4 0 CompuMethod_2 -1E+17 1E+17 /end CHARACTERISTIC
/begin CHARACTERISTIC Automatic_Battery_Bootup "" VALUE 0x80000080 RecordLayout_3 0 CompuMethod_11 0 1 /end CHARACTERISTIC
/begin CHARACTERISTIC Batt_Age_Count_ovr_new "" VALUE 0x80000081 RecordLayout_2 0 CompuMethod_6 0 4294970000 /end CHARACTERISTIC
/begin CHARACTERISTIC Batt_Age_Count_ovr_ovr "" VALUE 0x80000085 RecordLayout_3 0 CompuMethod_7 0 1 /end CHARACTERISTIC
/begin CHARACTERISTIC Batt_Connect_Cmd_ovr_new "" VALUE 0x80000086 RecordLayout_5 0 CompuMethod_1 0 4 /end CHARACTERISTIC
/begin CHARACTERISTIC Batt_Connect_Cmd_ovr_ovr "" VALUE 0x80000087 RecordLayout_3 0 CompuMethod_7 0 1 /end CHARACTERISTIC
/begin CHARACTERISTIC Batt_Contactor_Status "" VALUE 0x80000088 RecordLayout_3 0 CompuMethod_11 0 1 /end CHARACTERISTIC
/begin CHARACTERISTIC Batt_Coolant_Temp_ovr_new "" VALUE 0x80000089 RecordLayout_4 0 CompuMethod_2 -1E+17 1E+17 /end CHARACTERISTIC
/begin CHARACTERISTIC Batt_Coolant_Temp_ovr_ovr "" VALUE 0x8000008D RecordLayout_3 0 CompuMethod_7 0 1 /end CHARACTERISTIC
/begin CHARACTERISTIC Batt_Current_ovr_new "" VALUE 0x8000008E RecordLayout_4 0 CompuMethod_2 -1E+17 1E+17 /end CHARACTERISTIC
/begin CHARACTERISTIC Batt_Current_ovr_ovr "" VALUE 0x80000092 RecordLayout_3 0 CompuMethod_7 0 1 /end CHARACTERISTIC
/begin CHARACTERISTIC Batt_Ign_Cal "" VALUE 0x80000093 RecordLayout_4 0 CompuMethod_2 -1E+17 1E+17 /end CHARACTERISTIC
/begin CHARACTERISTIC Batt_Isolation_det_Cal "" VALUE 0x80000097 RecordLayout_4 0 CompuMethod_2 -1E+17 1E+17 /end CHARACTERISTIC
/begin CHARACTERISTIC Batt_Load_Enable "" VALUE 0x8000009B RecordLayout_3 0 CompuMethod_11 0 1 /end CHARACTERISTIC
/begin CHARACTERISTIC Battery_AgeCount_Fault "" VALUE 0x8000009C RecordLayout_4 0 CompuMethod_2 -1E+17 1E+17 /end CHARACTERISTIC
/begin CHARACTERISTIC Battery_Light_Ovr_new "" VALUE 0x800000A0 RecordLayout_3 0 CompuMethod_11 0 1 /end CHARACTERISTIC
/begin CHARACTERISTIC Battery_Light_Ovr_ovr "" VALUE 0x800000A1 RecordLayout_3 0 CompuMethod_7 0 1 /end CHARACTERISTIC
/begin CHARACTERISTIC Battery_Voltage_ovr_new "" VALUE 0x800000A2 RecordLayout_4 0 CompuMethod_2 0 65535 /end CHARACTERISTIC
/begin CHARACTERISTIC Battery_Voltage_ovr_ovr "" VALUE 0x800000A6 RecordLayout_3 0 CompuMethod_7 0 1 /end CHARACTERISTIC
/begin CHARACTERISTIC Battery_Voltage_Too_High_Fault "" VALUE 0x800000A7 RecordLayout_4 0 CompuMethod_2 -1E+17 1E+17 /end CHARACTERISTIC
/begin CHARACTERISTIC Battery_Voltage_Too_Low_Fault "" VALUE 0x800000AB RecordLayout_4 0 CompuMethod_2 -1E+17 1E+17 /end CHARACTERISTIC
/begin CHARACTERISTIC BCU_Caution "" VALUE 0x800000AF RecordLayout_4 0 CompuMethod_2 -1E+17 1E+17 /end CHARACTERISTIC
/begin CHARACTERISTIC BCU_Caution_Ovr_new "" VALUE 0x800000B3 RecordLayout_4 0 CompuMethod_2 -1E+17 1E+17 /end CHARACTERISTIC
/begin CHARACTERISTIC BCU_Caution_Ovr_ovr "" VALUE 0x800000B7 RecordLayout_3 0 CompuMethod_7 0 1 /end CHARACTERISTIC
/begin CHARACTERISTIC BCU_Hazard "" VALUE 0x800000B8 RecordLayout_4 0 CompuMethod_2 -1E+17 1E+17 /end CHARACTERISTIC
/begin CHARACTERISTIC BCU_Hazard_Ovr_new "" VALUE 0x800000BC RecordLayout_4 0 CompuMethod_2 -1E+17 1E+17 /end CHARACTERISTIC
/begin CHARACTERISTIC BCU_Hazard_Ovr_ovr "" VALUE 0x800000C0 RecordLayout_3 0 CompuMethod_7 0 1 /end CHARACTERISTIC
/begin CHARACTERISTIC Blend_Pump_On_Threshold "" VALUE 0x800000C1 RecordLayout_4 0 CompuMethod_2 -1E+17 1E+17 /end CHARACTERISTIC
/begin CHARACTERISTIC Blend_Valve_A_No_Response_Fault "" VALUE 0x800000C5 RecordLayout_4 0 CompuMethod_2 -1E+17 1E+17 /end CHARACTERISTIC
/begin CHARACTERISTIC Blend_Valve_B_No_Response_Fault "" VALUE 0x800000C9 RecordLayout_4 0 CompuMethod_2 -1E+17 1E+17 /end CHARACTERISTIC
/begin CHARACTERISTIC Blend_Valve_Sensor_A_High_Voltage_Fault "" VALUE 0x800000CD RecordLayout_4 0 CompuMethod_2 -1E+17 1E+17 /end CHARACTERISTIC
/begin CHARACTERISTIC Blend_Valve_Sensor_A_Intermittent_Fault "" VALUE 0x800000D1 RecordLayout_4 0 CompuMethod_2 -1E+17 1E+17 /end CHARACTERISTIC
/begin CHARACTERISTIC Blend_Valve_Sensor_A_Low_Voltage_Fault "" VALUE 0x800000D5 RecordLayout_4 0 CompuMethod_2 -1E+17 1E+17 /end CHARACTERISTIC
/begin CHARACTERISTIC Blend_Valve_Sensor_B_High_Voltage_Fault "" VALUE 0x800000D9 RecordLayout_4 0 CompuMethod_2 -1E+17 1E+17 /end CHARACTERISTIC
/begin CHARACTERISTIC Blend_Valve_Sensor_B_Intermittent_Fault "" VALUE 0x800000DD RecordLayout_4 0 CompuMethod_2 -1E+17 1E+17 /end CHARACTERISTIC
/begin CHARACTERISTIC Blend_Valve_Sensor_B_Low_Voltage_Fault "" VALUE 0x800000E1 RecordLayout_4 0 CompuMethod_2 -1E+17 1E+17 /end CHARACTERISTIC
/begin CHARACTERISTIC Brake_Pedal_Position_Communication_Loss_Fault "" VALUE 0x800000E5 RecordLayout_4 0 CompuMethod_2 -1E+17 1E+17 /end CHARACTERISTIC
/begin CHARACTERISTIC Brake_Pedal_Position_High_Fault "" VALUE 0x800000E9 RecordLayout_4 0 CompuMethod_2 -1E+17 1E+17 /end CHARACTERISTIC
/begin CHARACTERISTIC Brake_Pedal_Position_Intermiitent_Fault "" VALUE 0x800000ED RecordLayout_4 0 CompuMethod_2 -1E+17 1E+17 /end CHARACTERISTIC
/begin CHARACTERISTIC Brake_Pedal_Position_Low_Fault "" VALUE 0x800000F1 RecordLayout_4 0 CompuMethod_2 -1E+17 1E+17 /end CHARACTERISTIC
/begin CHARACTERISTIC Brake_Position_Ovr_new "" VALUE 0x800000F5 RecordLayout_4 0 CompuMethod_2 -1E+17 1E+17 /end CHARACTERISTIC
/begin CHARACTERISTIC Brake_Position_Ovr_ovr "" VALUE 0x800000F9 RecordLayout_3 0 CompuMethod_7 0 1 /end CHARACTERISTIC
/begin CHARACTERISTIC Brake_Position_TblTbl "" CURVE 0x8000014E RecordLayout_4 0 CompuMethod_13 0 1
 /begin AXIS_DESCR COM_AXIS Brake_Position_PreIn CompuMethod_2 21 -1E+17 1E+17 AXIS_PTS_REF Brake_Position_PreIdxArr /end AXIS_DESCR
/end CHARACTERISTIC
/begin CHARACTERISTIC brakeEnd_Pedal_crawlMode "" VALUE 0x800001A2 RecordLayout_4 0 CompuMethod_2 -1E+17 1E+17 /end CHARACTERISTIC
/begin CHARACTERISTIC brakeEnd_Pedal_ecoMode "" VALUE 0x800001A6 RecordLayout_4 0 CompuMethod_2 -1E+17 1E+17 /end CHARACTERISTIC
/begin CHARACTERISTIC brakeEnd_Pedal_SUVMode "" VALUE 0x800001AA RecordLayout_4 0 CompuMethod_2 -1E+17 1E+17 /end CHARACTERISTIC
/begin CHARACTERISTIC Brakes_AgeCount_Fault "" VALUE 0x800001AE RecordLayout_4 0 CompuMethod_2 -1E+17 1E+17 /end CHARACTERISTIC
/begin CHARACTERISTIC Brakes_AgeCount_Ovr_new "" VALUE 0x800001B2 RecordLayout_2 0 CompuMethod_6 0 4294970000 /end CHARACTERISTIC
/begin CHARACTERISTIC Brakes_AgeCount_Ovr_ovr "" VALUE 0x800001B6 RecordLayout_3 0 CompuMethod_7 0 1 /end CHARACTERISTIC
/begin CHARACTERISTIC brakeStart_Pedal_crawlMode "" VALUE 0x800001B7 RecordLayout_4 0 CompuMethod_2 -1E+17 1E+17 /end CHARACTERISTIC
/begin CHARACTERISTIC brakeStart_Pedal_ecoMode "" VALUE 0x800001BB RecordLayout_4 0 CompuMethod_2 -1E+17 1E+17 /end CHARACTERISTIC
/begin CHARACTERISTIC brakeStart_Pedal_SUVMode "" VALUE 0x800001BF RecordLayout_4 0 CompuMethod_2 -1E+17 1E+17 /end CHARACTERISTIC
/begin CHARACTERISTIC Button_Pressed_Ovr_new "" VALUE 0x800001C3 RecordLayout_4 0 CompuMethod_2 -1E+17 1E+17 /end CHARACTERISTIC
/begin CHARACTERISTIC Button_Pressed_Ovr_ovr "" VALUE 0x800001C7 RecordLayout_3 0 CompuMethod_7 0 1 /end CHARACTERISTIC
/begin CHARACTERISTIC CAN_1_TransmitOverrun "Debug value for CAN_1_TransmitOverrun" VALUE 0x800001C8 RecordLayout_7 0 CompuMethod_14 0 65535 /end CHARACTERISTIC
/begin CHARACTERISTIC CAN_2_TransmitOverrun "Debug value for CAN_2_TransmitOverrun" VALUE 0x800001CA RecordLayout_7 0 CompuMethod_14 0 65535 /end CHARACTERISTIC
/begin CHARACTERISTIC CAN_3_TransmitOverrun "Debug value for CAN_3_TransmitOverrun" VALUE 0x800001CC RecordLayout_7 0 CompuMethod_14 0 65535 /end CHARACTERISTIC
/begin CHARACTERISTIC CCP1_StationAddr "Station ID for CCP handler: CCP1" VALUE 0x800001CE RecordLayout_7 0 CompuMethod_5 0 65535 /end CHARACTERISTIC
/begin CHARACTERISTIC CCP1RxID "Receive CAN ID for CCP handler: CCP1" VALUE 0x800001D0 RecordLayout_2 0 CompuMethod_6 0 4294970000 /end CHARACTERISTIC
/begin CHARACTERISTIC CCP1RxIDMask "Receive CAN ID Mask for CCP handler: CCP1" VALUE 0x800001D4 RecordLayout_2 0 CompuMethod_6 0 4294970000 /end CHARACTERISTIC
/begin CHARACTERISTIC CCP1TxID "Transmit CAN ID for CCP handler: CCP1" VALUE 0x800001D8 RecordLayout_2 0 CompuMethod_6 0 4294970000 /end CHARACTERISTIC
/begin CHARACTERISTIC Charge_Complete_Override_new "" VALUE 0x800001DC RecordLayout_3 0 CompuMethod_11 0 1 /end CHARACTERISTIC
/begin CHARACTERISTIC Charge_Complete_Override_ovr "" VALUE 0x800001DD RecordLayout_3 0 CompuMethod_7 0 1 /end CHARACTERISTIC
/begin CHARACTERISTIC Charge_Enable_Override_new "" VALUE 0x800001DE RecordLayout_3 0 CompuMethod_11 0 1 /end CHARACTERISTIC
/begin CHARACTERISTIC Charge_Enable_Override_ovr "" VALUE 0x800001DF RecordLayout_3 0 CompuMethod_7 0 1 /end CHARACTERISTIC
/begin CHARACTERISTIC Charge_Falt_Override_new "This tells the charger that there is a problem with the vehcile where the charger can not charge the vehicle." VALUE 0x800001E0 RecordLayout_3 0 CompuMethod_11 0 1 /end CHARACTERISTIC
/begin CHARACTERISTIC Charge_Falt_Override_ovr "" VALUE 0x800001E1 RecordLayout_3 0 CompuMethod_7 0 1 /end CHARACTERISTIC
/begin CHARACTERISTIC Charger_Auto_Start "" VALUE 0x800001E2 RecordLayout_4 0 CompuMethod_2 -1E+17 1E+17 /end CHARACTERISTIC
/begin CHARACTERISTIC Charger_Derated_Over_Temperature_Fault "" VALUE 0x800001E6 RecordLayout_4 0 CompuMethod_2 -1E+17 1E+17 /end CHARACTERISTIC
/begin CHARACTERISTIC Charger_Derated_Under_Temperature_Fault "" VALUE 0x800001EA RecordLayout_4 0 CompuMethod_2 -1E+17 1E+17 /end CHARACTERISTIC
/begin CHARACTERISTIC Charger_Line_Voltage_Too_Low_Fault "" VALUE 0x800001EE RecordLayout_4 0 CompuMethod_2 -1E+17 1E+17 /end CHARACTERISTIC
/begin CHARACTERISTIC Charger_Line_Votlage_Too_High_Fault "" VALUE 0x800001F2 RecordLayout_4 0 CompuMethod_2 -1E+17 1E+17 /end CHARACTERISTIC
/begin CHARACTERISTIC Charger_Requested_But_No_High_Voltage_Fault "" VALUE 0x800001F6 RecordLayout_4 0 CompuMethod_2 -1E+17 1E+17 /end CHARACTERISTIC
/begin CHARACTERISTIC Charger_Requested_Current_Too_High_Fault "" VALUE 0x800001FA RecordLayout_4 0 CompuMethod_2 -1E+17 1E+17 /end CHARACTERISTIC
/begin CHARACTERISTIC Charger_Requested_Voltage_Out_of_Bounds_Fault_Lower "" VALUE 0x800001FE RecordLayout_4 0 CompuMethod_2 -1E+17 1E+17 /end CHARACTERISTIC
/begin CHARACTERISTIC Charger_Requested_Voltage_Out_of_Bounds_Fault_Upper "" VALUE 0x80000202 RecordLayout_4 0 CompuMethod_2 -1E+17 1E+17 /end CHARACTERISTIC
/begin CHARACTERISTIC Charger_State_Ovr_new "" VALUE 0x80000206 RecordLayout_4 0 CompuMethod_2 -1E+17 1E+17 /end CHARACTERISTIC
/begin CHARACTERISTIC Charger_State_Ovr_ovr "" VALUE 0x8000020A RecordLayout_3 0 CompuMethod_7 0 1 /end CHARACTERISTIC
/begin CHARACTERISTIC Check_Engine_Light_Ovr_new "" VALUE 0x8000020B RecordLayout_4 0 CompuMethod_2 -1E+17 1E+17 /end CHARACTERISTIC
/begin CHARACTERISTIC Check_Engine_Light_Ovr_ovr "" VALUE 0x8000020F RecordLayout_3 0 CompuMethod_7 0 1 /end CHARACTERISTIC
/begin CHARACTERISTIC CityID_CAN_1 "City ID for CAN bus CAN_1" VALUE 0x80000210 RecordLayout_3 0 CompuMethod_1 0 255 /end CHARACTERISTIC
/begin CHARACTERISTIC CityID_CAN_2 "City ID for CAN bus CAN_2" VALUE 0x80000211 RecordLayout_3 0 CompuMethod_1 0 255 /end CHARACTERISTIC
/begin CHARACTERISTIC CityID_CAN_3 "City ID for CAN bus CAN_3" VALUE 0x80000212 RecordLayout_3 0 CompuMethod_1 0 255 /end CHARACTERISTIC
/begin CHARACTERISTIC Commanded_gen_trq "" VALUE 0x80000228 RecordLayout_4 0 CompuMethod_2 -1E+17 1E+17 /end CHARACTERISTIC
/begin CHARACTERISTIC Commanded_motor_trq_div "" VALUE 0x80000231 RecordLayout_4 0 CompuMethod_2 -1E+17 1E+17 /end CHARACTERISTIC
/begin CHARACTERISTIC CompilerVersion "Compiler toolchain version used for the MotoHawk build" ASCII 0x40000227 RecordLayout_1 0 CompuMethod_2 0 255 NUMBER 80 MATRIX_DIM 80 1 1 READ_ONLY /end CHARACTERISTIC
/begin CHARACTERISTIC crawlMode_Accel_MapTbl "" CURVE 0x80000257 RecordLayout_4 0 CompuMethod_13 0 1
 /begin AXIS_DESCR COM_AXIS crawlMode_AccelIn CompuMethod_2 11 -1E+17 1E+17 AXIS_PTS_REF crawlMode_AccelIdxArr /end AXIS_DESCR
/end CHARACTERISTIC
/begin CHARACTERISTIC crawlMode_Brake_MapTbl "" CURVE 0x800002AF RecordLayout_4 0 CompuMethod_13 0 1
 /begin AXIS_DESCR COM_AXIS crawlMode_BrakeIn CompuMethod_2 11 -1E+17 1E+17 AXIS_PTS_REF crawlMode_BrakeIdxArr /end AXIS_DESCR
/end CHARACTERISTIC
/begin CHARACTERISTIC Dist_Trv "" VALUE 0x800005EA RecordLayout_4 0 CompuMethod_485 -1E+17 1E+17 /end CHARACTERISTIC
/begin CHARACTERISTIC dragTorque_crawlMode "" VALUE 0x800005EE RecordLayout_4 0 CompuMethod_2 -1E+17 1E+17 /end CHARACTERISTIC
/begin CHARACTERISTIC dragTorque_ecoMode "" VALUE 0x800005F2 RecordLayout_4 0 CompuMethod_2 -1E+17 1E+17 /end CHARACTERISTIC
/begin CHARACTERISTIC dragTorque_SUVMode "" VALUE 0x800005F6 RecordLayout_4 0 CompuMethod_2 -1E+17 1E+17 /end CHARACTERISTIC
/begin CHARACTERISTIC driveMaxTorque_crawlMode "" VALUE 0x80000602 RecordLayout_4 0 CompuMethod_2 -1E+17 1E+17 /end CHARACTERISTIC
/begin CHARACTERISTIC driveMaxTorque_ecoMode "" VALUE 0x80000606 RecordLayout_4 0 CompuMethod_2 -1E+17 1E+17 /end CHARACTERISTIC
/begin CHARACTERISTIC driveMaxTorque_SUVMode "" VALUE 0x8000060A RecordLayout_4 0 CompuMethod_2 -1E+17 1E+17 /end CHARACTERISTIC
/begin CHARACTERISTIC Eaton_Charger_AgeCount_Fault "" VALUE 0x8000061D RecordLayout_4 0 CompuMethod_2 -1E+17 1E+17 /end CHARACTERISTIC
/begin CHARACTERISTIC Eaton_Charging "" VALUE 0x80000630 RecordLayout_3 0 CompuMethod_11 0 1 /end CHARACTERISTIC
/begin CHARACTERISTIC Eaton_Plugged_In "" VALUE 0x80000636 RecordLayout_3 0 CompuMethod_11 0 1 /end CHARACTERISTIC
/begin CHARACTERISTIC EcoMode_Accel_MapTbl "" CURVE 0x80000637 RecordLayout_4 0 CompuMethod_13 0 1
 /begin AXIS_DESCR COM_AXIS EcoMode_AccelIn CompuMethod_2 11 -1E+17 1E+17 AXIS_PTS_REF EcoMode_AccelIdxArr /end AXIS_DESCR
/end CHARACTERISTIC
/begin CHARACTERISTIC EcoMode_Brake_MapTbl "" CURVE 0x8000068F RecordLayout_4 0 CompuMethod_13 0 1
 /begin AXIS_DESCR COM_AXIS EcoMode_BrakeIn CompuMethod_2 11 -1E+17 1E+17 AXIS_PTS_REF EcoMode_BrakeIdxArr /end AXIS_DESCR
/end CHARACTERISTIC
/begin CHARACTERISTIC Engine_Fan_Offset "" VALUE 0x8000072C RecordLayout_4 0 CompuMethod_2 -1E+17 1E+17 /end CHARACTERISTIC
/begin CHARACTERISTIC Engine_On "" VALUE 0x80000730 RecordLayout_4 0 CompuMethod_2 -1E+17 1E+17 /end CHARACTERISTIC
/begin CHARACTERISTIC Flash_Timer "" VALUE 0x80001122 RecordLayout_4 0 CompuMethod_2 -1E+17 1E+17 /end CHARACTERISTIC
/begin CHARACTERISTIC Heat_On_Driver_Threshold "" VALUE 0x8000119D RecordLayout_4 0 CompuMethod_2 -1E+17 1E+17 /end CHARACTERISTIC
/begin CHARACTERISTIC Heat1_Threshold "" VALUE 0x800011A3 RecordLayout_4 0 CompuMethod_2 -1E+17 1E+17 /end CHARACTERISTIC
/begin CHARACTERISTIC Heat2_Threshold "" VALUE 0x800011A9 RecordLayout_4 0 CompuMethod_2 -1E+17 1E+17 /end CHARACTERISTIC
/begin CHARACTERISTIC Heat3_Threshold "" VALUE 0x800011AF RecordLayout_4 0 CompuMethod_2 -1E+17 1E+17 /end CHARACTERISTIC
/begin CHARACTERISTIC Heat4_Threshold "" VALUE 0x800011B5 RecordLayout_4 0 CompuMethod_2 -1E+17 1E+17 /end CHARACTERISTIC
/begin CHARACTERISTIC Heater_Core_Threshold "" VALUE 0x800011CE RecordLayout_4 0 CompuMethod_2 -1E+17 1E+17 /end CHARACTERISTIC
/begin CHARACTERISTIC High_Threshold "" VALUE 0x800011D9 RecordLayout_4 0 CompuMethod_2 -1E+17 1E+17 /end CHARACTERISTIC
/begin CHARACTERISTIC Hybrid_State "" VALUE 0x80001283 RecordLayout_8 0 CompuMethod_6 -2147480000 2147480000 /end CHARACTERISTIC
/begin CHARACTERISTIC IPT_DCDC_AgeCount_Fault "" VALUE 0x800012C8 RecordLayout_4 0 CompuMethod_2 -1E+17 1E+17 /end CHARACTERISTIC
/begin CHARACTERISTIC IPT_Status1_AgeCount_Fault "" VALUE 0x80001330 RecordLayout_4 0 CompuMethod_2 -1E+17 1E+17 /end CHARACTERISTIC
/begin CHARACTERISTIC IPT_Status2_AgeCount_Fault "" VALUE 0x80001334 RecordLayout_4 0 CompuMethod_2 -1E+17 1E+17 /end CHARACTERISTIC
/begin CHARACTERISTIC Low_Threshold "" VALUE 0x80001365 RecordLayout_4 0 CompuMethod_2 -1E+17 1E+17 /end CHARACTERISTIC
/begin CHARACTERISTIC MatlabVersionTxt "MATLAB version used to build the application." ASCII 0x40000498 RecordLayout_1 0 CompuMethod_2 0 255 NUMBER 80 MATRIX_DIM 80 1 1 READ_ONLY /end CHARACTERISTIC
/begin CHARACTERISTIC Max_Cell_Voltage_Limit "" VALUE 0x8000136D RecordLayout_4 0 CompuMethod_2 -1E+17 1E+17 /end CHARACTERISTIC
/begin CHARACTERISTIC Max_Dist_Travel_In_Sec "" VALUE 0x80001371 RecordLayout_4 0 CompuMethod_2 -1E+17 1E+17 /end CHARACTERISTIC
/begin CHARACTERISTIC Max_Motor_Torque "" VALUE 0x80001375 RecordLayout_4 0 CompuMethod_2 -1E+17 1E+17 /end CHARACTERISTIC
/begin CHARACTERISTIC Max_Regen_Torque "" VALUE 0x80001379 RecordLayout_4 0 CompuMethod_2 -1E+17 1E+17 /end CHARACTERISTIC
/begin CHARACTERISTIC Medium_Threshold "" VALUE 0x8000138E RecordLayout_4 0 CompuMethod_2 -1E+17 1E+17 /end CHARACTERISTIC
/begin CHARACTERISTIC MessageChecksum "" VALUE 0x80001396 RecordLayout_4 0 CompuMethod_2 -1E+17 1E+17 /end CHARACTERISTIC
/begin CHARACTERISTIC MessageCounterOutput "" VALUE 0x8000139A RecordLayout_4 0 CompuMethod_2 -1E+17 1E+17 /end CHARACTERISTIC
/begin CHARACTERISTIC Min_Torque_ABS "" VALUE 0x8000139E RecordLayout_4 0 CompuMethod_2 -1E+17 1E+17 /end CHARACTERISTIC
/begin CHARACTERISTIC Min_Torque_CALC "" VALUE 0x800013A2 RecordLayout_4 0 CompuMethod_2 -1E+17 1E+17 /end CHARACTERISTIC
/begin CHARACTERISTIC MotoCoderVersionTxt "MotoCoder version used to build the application." ASCII 0x40000536 RecordLayout_1 0 CompuMethod_2 0 255 NUMBER 7 MATRIX_DIM 7 1 1 READ_ONLY /end CHARACTERISTIC
/begin CHARACTERISTIC MotoHawkBuildGUID "GUID identifying the MotoHawk build session" ASCII 0x4000053D RecordLayout_1 0 CompuMethod_2 0 255 NUMBER 80 MATRIX_DIM 80 1 1 READ_ONLY /end CHARACTERISTIC
/begin CHARACTERISTIC MotoHawkModelGUID "GUID identifying the MotoHawk model" ASCII 0x4000058D RecordLayout_1 0 CompuMethod_2 0 255 NUMBER 80 MATRIX_DIM 80 1 1 READ_ONLY /end CHARACTERISTIC
/begin CHARACTERISTIC MotoHawkModelName "Simulink model name used for the MotoHawk build" ASCII 0x400005DD RecordLayout_1 0 CompuMethod_2 0 255 NUMBER 80 MATRIX_DIM 80 1 1 READ_ONLY /end CHARACTERISTIC
/begin CHARACTERISTIC MotoHawkTokenGUID "GUID identifying the token inserted during the build.  May be empty if no token was available" ASCII 0x40000631 RecordLayout_1 0 CompuMethod_2 0 255 NUMBER 80 MATRIX_DIM 80 1 1 READ_ONLY /end CHARACTERISTIC
/begin CHARACTERISTIC MotoHawkVersionTxt "MotoHawk version used to build the application." ASCII 0x40000681 RecordLayout_1 0 CompuMethod_2 0 255 NUMBER 50 MATRIX_DIM 50 1 1 READ_ONLY /end CHARACTERISTIC
/begin CHARACTERISTIC MPH_to_KMH "" VALUE 0x80001416 RecordLayout_4 0 CompuMethod_2 -1E+17 1E+17 /end CHARACTERISTIC
/begin CHARACTERISTIC ODO_INCRE "" VALUE 0x80001424 RecordLayout_4 0 CompuMethod_506 -1E+17 1E+17 /end CHARACTERISTIC
/begin CHARACTERISTIC PartNumber "Module Part Number" ASCII 0x400006D9 RecordLayout_1 0 CompuMethod_2 0 255 NUMBER 40 MATRIX_DIM 40 1 1 READ_ONLY /end CHARACTERISTIC
/begin CHARACTERISTIC Pump_Off_Temp "" VALUE 0x80001480 RecordLayout_4 0 CompuMethod_2 -1E+17 1E+17 /end CHARACTERISTIC
/begin CHARACTERISTIC Pump_On_Temp "" VALUE 0x80001484 RecordLayout_4 0 CompuMethod_2 -1E+17 1E+17 /end CHARACTERISTIC
/begin CHARACTERISTIC Ramp_In_Rate_ABS "" VALUE 0x800014A4 RecordLayout_4 0 CompuMethod_510 -1E+17 1E+17 /end CHARACTERISTIC
/begin CHARACTERISTIC Ramp_In_Rate_CALC "" VALUE 0x800014A8 RecordLayout_4 0 CompuMethod_510 -1E+17 1E+17 /end CHARACTERISTIC
/begin CHARACTERISTIC Ramp_Out_Rate_ABS "" VALUE 0x800014AC RecordLayout_4 0 CompuMethod_510 -1E+17 1E+17 /end CHARACTERISTIC
/begin CHARACTERISTIC Ramp_Out_Rate_CALC "" VALUE 0x800014B0 RecordLayout_4 0 CompuMethod_510 -1E+17 1E+17 /end CHARACTERISTIC
/begin CHARACTERISTIC regenEnd_Speed_crawlMode "" VALUE 0x800014C7 RecordLayout_4 0 CompuMethod_2 -1E+17 1E+17 /end CHARACTERISTIC
/begin CHARACTERISTIC regenEnd_Speed_ecoMode "" VALUE 0x800014CB RecordLayout_4 0 CompuMethod_2 -1E+17 1E+17 /end CHARACTERISTIC
/begin CHARACTERISTIC regenEnd_Speed_SUVMode "" VALUE 0x800014CF RecordLayout_4 0 CompuMethod_2 -1E+17 1E+17 /end CHARACTERISTIC
/begin CHARACTERISTIC regenMaxTorque_crawlMode "" VALUE 0x800014D3 RecordLayout_4 0 CompuMethod_2 -1E+17 1E+17 /end CHARACTERISTIC
/begin CHARACTERISTIC regenMaxTorque_ecoMode "" VALUE 0x800014D7 RecordLayout_4 0 CompuMethod_2 -1E+17 1E+17 /end CHARACTERISTIC
/begin CHARACTERISTIC regenMaxTorque_SUVMode "" VALUE 0x800014DB RecordLayout_4 0 CompuMethod_2 -1E+17 1E+17 /end CHARACTERISTIC
/begin CHARACTERISTIC regenStart_Speed_crawlMode "" VALUE 0x800014DF RecordLayout_4 0 CompuMethod_2 -1E+17 1E+17 /end CHARACTERISTIC
/begin CHARACTERISTIC regenStart_Speed_ecoMode "" VALUE 0x800014E3 RecordLayout_4 0 CompuMethod_2 -1E+17 1E+17 /end CHARACTERISTIC
/begin CHARACTERISTIC regenStart_Speed_SUVMode "" VALUE 0x800014E7 RecordLayout_4 0 CompuMethod_2 -1E+17 1E+17 /end CHARACTERISTIC
/begin CHARACTERISTIC RPM_to_Wheel_Speed_Multiplier "" VALUE 0x800014F8 RecordLayout_4 0 CompuMethod_2 -1E+17 1E+17 /end CHARACTERISTIC
/begin CHARACTERISTIC RPM_to_Wheel_Speed_Multiplier_crawlMode "" VALUE 0x800014FC RecordLayout_4 0 CompuMethod_2 -1E+17 1E+17 /end CHARACTERISTIC
/begin CHARACTERISTIC RPM_to_Wheel_Speed_Multiplier_ecoMode "" VALUE 0x80001500 RecordLayout_4 0 CompuMethod_2 -1E+17 1E+17 /end CHARACTERISTIC
/begin CHARACTERISTIC RPM_to_Wheel_Speed_Multiplier_SUVMode "" VALUE 0x80001504 RecordLayout_4 0 CompuMethod_2 -1E+17 1E+17 /end CHARACTERISTIC
/begin CHARACTERISTIC SOC_Multiplier "" VALUE 0x80001547 RecordLayout_4 0 CompuMethod_2 -1E+17 1E+17 /end CHARACTERISTIC
/begin CHARACTERISTIC SOC_Subtract "" VALUE 0x8000154B RecordLayout_4 0 CompuMethod_2 -1E+17 1E+17 /end CHARACTERISTIC
/begin CHARACTERISTIC Steering_Wheel_AgeCount_Fault "" VALUE 0x80001560 RecordLayout_4 0 CompuMethod_2 -1E+17 1E+17 /end CHARACTERISTIC
/begin CHARACTERISTIC SUVMode_Accel_MapTbl "" CURVE 0x8000156F RecordLayout_4 0 CompuMethod_13 0 1
 /begin AXIS_DESCR COM_AXIS SUVMode_AccelIn CompuMethod_2 11 -1E+17 1E+17 AXIS_PTS_REF SUVMode_AccelIdxArr /end AXIS_DESCR
/end CHARACTERISTIC
/begin CHARACTERISTIC SUVMode_Brake_MapTbl "" CURVE 0x800015C7 RecordLayout_4 0 CompuMethod_13 0 1
 /begin AXIS_DESCR COM_AXIS SUVMode_BrakeIn CompuMethod_2 11 -1E+17 1E+17 AXIS_PTS_REF SUVMode_BrakeIdxArr /end AXIS_DESCR
/end CHARACTERISTIC
/begin CHARACTERISTIC TC_Event_Time "" VALUE 0x8000161F RecordLayout_4 0 CompuMethod_2 -1E+17 1E+17 /end CHARACTERISTIC
/begin CHARACTERISTIC TC_Wheel_Speed_Diff "" VALUE 0x80001623 RecordLayout_4 0 CompuMethod_2 -1E+17 1E+17 /end CHARACTERISTIC
/begin CHARACTERISTIC Throttle_Position_TblTbl "" CURVE 0x80001669 RecordLayout_4 0 CompuMethod_13 0 1
 /begin AXIS_DESCR COM_AXIS Throttle_Position_PreIn CompuMethod_2 11 -1E+17 1E+17 AXIS_PTS_REF Throttle_Position_PreIdxArr /end AXIS_DESCR
/end CHARACTERISTIC
/begin CHARACTERISTIC Too_Cold_Temp "" VALUE 0x80001695 RecordLayout_4 0 CompuMethod_2 -1E+17 1E+17 /end CHARACTERISTIC
/begin CHARACTERISTIC Torque_Enable "" VALUE 0x80001699 RecordLayout_3 0 CompuMethod_11 0 1 /end CHARACTERISTIC
/begin CHARACTERISTIC Traction_Control_Model "" VALUE 0x800016BD RecordLayout_5 0 CompuMethod_514 -128 127 /end CHARACTERISTIC
/begin CHARACTERISTIC Transmission_AgeCount_Fault "" VALUE 0x800016C6 RecordLayout_4 0 CompuMethod_2 -1E+17 1E+17 /end CHARACTERISTIC
/begin CHARACTERISTIC Vehicle_Enable "" VALUE 0x800016E4 RecordLayout_3 0 CompuMethod_11 0 1 /end CHARACTERISTIC
/begin CHARACTERISTIC Vehicle_Ready "" VALUE 0x800016E5 RecordLayout_3 0 CompuMethod_11 0 1 /end CHARACTERISTIC
/begin CHARACTERISTIC Warmed_Up_Temp "" VALUE 0x80001801 RecordLayout_4 0 CompuMethod_2 -1E+17 1E+17 /end CHARACTERISTIC
/*~~~~~~~~~ 6.3.17 AXIS_PTS ~~~~~~~~~*/
/begin AXIS_PTS Brake_Position_PreIdxArr "" 0x800000FA Brake_Position_PreIn RecordLayout_6 0 CompuMethod_2 21 -1E+17 1E+17 DEPOSIT ABSOLUTE /end AXIS_PTS
/begin AXIS_PTS crawlMode_AccelIdxArr "" 0x80000283 crawlMode_AccelIn RecordLayout_6 0 CompuMethod_2 11 -1E+17 1E+17 DEPOSIT ABSOLUTE /end AXIS_PTS
/begin AXIS_PTS crawlMode_BrakeIdxArr "" 0x800002DB crawlMode_BrakeIn RecordLayout_6 0 CompuMethod_2 11 -1E+17 1E+17 DEPOSIT ABSOLUTE /end AXIS_PTS
/begin AXIS_PTS EcoMode_AccelIdxArr "" 0x80000663 EcoMode_AccelIn RecordLayout_6 0 CompuMethod_2 11 -1E+17 1E+17 DEPOSIT ABSOLUTE /end AXIS_PTS
/begin AXIS_PTS EcoMode_BrakeIdxArr "" 0x800006BB EcoMode_BrakeIn RecordLayout_6 0 CompuMethod_2 11 -1E+17 1E+17 DEPOSIT ABSOLUTE /end AXIS_PTS
/begin AXIS_PTS SUVMode_AccelIdxArr "" 0x8000159B SUVMode_AccelIn RecordLayout_6 0 CompuMethod_2 11 -1E+17 1E+17 DEPOSIT ABSOLUTE /end AXIS_PTS
/begin AXIS_PTS SUVMode_BrakeIdxArr "" 0x800015F3 SUVMode_BrakeIn RecordLayout_6 0 CompuMethod_2 11 -1E+17 1E+17 DEPOSIT ABSOLUTE /end AXIS_PTS
/begin AXIS_PTS Throttle_Position_PreIdxArr "" 0x80001638 Throttle_Position_PreIn RecordLayout_6 0 CompuMethod_2 11 -1E+17 1E+17 DEPOSIT ABSOLUTE /end AXIS_PTS
/*~~~~~~~~~ 6.3.106 RECORD_LAYOUTs ~~~~~~~~~*/
/begin RECORD_LAYOUT RecordLayout_1 FNC_VALUES 1 UBYTE ROW_DIR DIRECT /end RECORD_LAYOUT
/begin RECORD_LAYOUT RecordLayout_2 FNC_VALUES 1 ULONG ROW_DIR DIRECT /end RECORD_LAYOUT
/begin RECORD_LAYOUT RecordLayout_3 FNC_VALUES 1 UBYTE ROW_DIR DIRECT /end RECORD_LAYOUT
/begin RECORD_LAYOUT RecordLayout_4 FNC_VALUES 1 FLOAT32_IEEE ROW_DIR DIRECT /end RECORD_LAYOUT
/begin RECORD_LAYOUT RecordLayout_5 FNC_VALUES 1 SBYTE ROW_DIR DIRECT /end RECORD_LAYOUT
/begin RECORD_LAYOUT RecordLayout_6 AXIS_PTS_X 1 FLOAT32_IEEE /* IndexIncr */ INDEX_INCR /* Addressing */ DIRECT /end RECORD_LAYOUT
/begin RECORD_LAYOUT RecordLayout_7 FNC_VALUES 1 UWORD ROW_DIR DIRECT /end RECORD_LAYOUT
/begin RECORD_LAYOUT RecordLayout_8 FNC_VALUES 1 SLONG ROW_DIR DIRECT /end RECORD_LAYOUT
/*~~~~~~~~~ 6.3.31 COMPU_METHODs ~~~~~~~~~*/
/begin COMPU_METHOD CompuMethod_1 "" RAT_FUNC "%3.0" "" COEFFS 0 1 0 0 0 1 /end COMPU_METHOD
/begin COMPU_METHOD CompuMethod_2 "" RAT_FUNC "%6.2" "" COEFFS 0 1 0 0 0 1 /end COMPU_METHOD
/begin COMPU_METHOD CompuMethod_3 "" RAT_FUNC "%10.0" "ID" COEFFS 0 1 0 0 0 1 /end COMPU_METHOD
/begin COMPU_METHOD CompuMethod_4 "" TAB_VERB "%3.0" "" COMPU_TAB_REF CompuVtab_1 /end COMPU_METHOD
/begin COMPU_METHOD CompuMethod_5 "" RAT_FUNC "%5.0" "" COEFFS 0 1 0 0 0 1 /end COMPU_METHOD
/begin COMPU_METHOD CompuMethod_6 "" RAT_FUNC "%8.0" "" COEFFS 0 1 0 0 0 1 /end COMPU_METHOD
/begin COMPU_METHOD CompuMethod_7 "" TAB_VERB "%1.0" "" COMPU_TAB_REF CompuVtab_2 /end COMPU_METHOD
/begin COMPU_METHOD CompuMethod_8 "" RAT_FUNC "%6.2" "%" COEFFS 0 1 0 0 0 1 /end COMPU_METHOD
/begin COMPU_METHOD CompuMethod_9 "" RAT_FUNC "%6.2" "%" COEFFS 0 1 0 0 0 0.0015259 /end COMPU_METHOD
/begin COMPU_METHOD CompuMethod_10 "" RAT_FUNC "%8.0" "bytes" COEFFS 0 1 0 0 0 1 /end COMPU_METHOD
/begin COMPU_METHOD CompuMethod_11 "" RAT_FUNC "%1.0" "" COEFFS 0 1 0 0 0 1 /end COMPU_METHOD
/begin COMPU_METHOD CompuMethod_12 "" RAT_FUNC "%6.2" "idx.frac" COEFFS 0 1 0 0 0 0.00195313 /end COMPU_METHOD
/begin COMPU_METHOD CompuMethod_13 "" RAT_FUNC "%3.2" "" COEFFS 0 1 0 0 0 1 /end COMPU_METHOD
/begin COMPU_METHOD CompuMethod_14 "" TAB_VERB "%5.0" "" COMPU_TAB_REF CompuVtab_3 /end COMPU_METHOD
/begin COMPU_METHOD CompuMethod_15 "" TAB_VERB "%4.0" "" COMPU_TAB_REF CompuVtab_4 /end COMPU_METHOD
/begin COMPU_METHOD CompuMethod_16 "" TAB_VERB "%1.0" "" COMPU_TAB_REF CompuVtab_5 /end COMPU_METHOD
/begin COMPU_METHOD CompuMethod_17 "" TAB_VERB "%1.0" "" COMPU_TAB_REF CompuVtab_6 /end COMPU_METHOD
/begin COMPU_METHOD CompuMethod_18 "" TAB_VERB "%1.0" "" COMPU_TAB_REF CompuVtab_7 /end COMPU_METHOD
/begin COMPU_METHOD CompuMethod_19 "" TAB_VERB "%1.0" "" COMPU_TAB_REF CompuVtab_8 /end COMPU_METHOD
/begin COMPU_METHOD CompuMethod_20 "" TAB_VERB "%1.0" "" COMPU_TAB_REF CompuVtab_9 /end COMPU_METHOD
/begin COMPU_METHOD CompuMethod_21 "" TAB_VERB "%1.0" "" COMPU_TAB_REF CompuVtab_10 /end COMPU_METHOD
/begin COMPU_METHOD CompuMethod_22 "" TAB_VERB "%1.0" "" COMPU_TAB_REF CompuVtab_11 /end COMPU_METHOD
/begin COMPU_METHOD CompuMethod_23 "" TAB_VERB "%1.0" "" COMPU_TAB_REF CompuVtab_12 /end COMPU_METHOD
/begin COMPU_METHOD CompuMethod_24 "" TAB_VERB "%1.0" "" COMPU_TAB_REF CompuVtab_13 /end COMPU_METHOD
/begin COMPU_METHOD CompuMethod_25 "" TAB_VERB "%1.0" "" COMPU_TAB_REF CompuVtab_14 /end COMPU_METHOD
/begin COMPU_METHOD CompuMethod_26 "" TAB_VERB "%1.0" "" COMPU_TAB_REF CompuVtab_15 /end COMPU_METHOD
/begin COMPU_METHOD CompuMethod_27 "" TAB_VERB "%1.0" "" COMPU_TAB_REF CompuVtab_16 /end COMPU_METHOD
/begin COMPU_METHOD CompuMethod_28 "" TAB_VERB "%1.0" "" COMPU_TAB_REF CompuVtab_17 /end COMPU_METHOD
/begin COMPU_METHOD CompuMethod_29 "" TAB_VERB "%1.0" "" COMPU_TAB_REF CompuVtab_18 /end COMPU_METHOD
/begin COMPU_METHOD CompuMethod_30 "" TAB_VERB "%1.0" "" COMPU_TAB_REF CompuVtab_19 /end COMPU_METHOD
/begin COMPU_METHOD CompuMethod_31 "" TAB_VERB "%1.0" "" COMPU_TAB_REF CompuVtab_20 /end COMPU_METHOD
/begin COMPU_METHOD CompuMethod_32 "" TAB_VERB "%1.0" "" COMPU_TAB_REF CompuVtab_21 /end COMPU_METHOD
/begin COMPU_METHOD CompuMethod_33 "" TAB_VERB "%1.0" "" COMPU_TAB_REF CompuVtab_22 /end COMPU_METHOD
/begin COMPU_METHOD CompuMethod_34 "" TAB_VERB "%1.0" "" COMPU_TAB_REF CompuVtab_23 /end COMPU_METHOD
/begin COMPU_METHOD CompuMethod_35 "" TAB_VERB "%1.0" "" COMPU_TAB_REF CompuVtab_24 /end COMPU_METHOD
/begin COMPU_METHOD CompuMethod_36 "" TAB_VERB "%1.0" "" COMPU_TAB_REF CompuVtab_25 /end COMPU_METHOD
/begin COMPU_METHOD CompuMethod_37 "" TAB_VERB "%1.0" "" COMPU_TAB_REF CompuVtab_26 /end COMPU_METHOD
/begin COMPU_METHOD CompuMethod_38 "" TAB_VERB "%1.0" "" COMPU_TAB_REF CompuVtab_27 /end COMPU_METHOD
/begin COMPU_METHOD CompuMethod_39 "" TAB_VERB "%1.0" "" COMPU_TAB_REF CompuVtab_28 /end COMPU_METHOD
/begin COMPU_METHOD CompuMethod_40 "" TAB_VERB "%1.0" "" COMPU_TAB_REF CompuVtab_29 /end COMPU_METHOD
/begin COMPU_METHOD CompuMethod_41 "" TAB_VERB "%1.0" "" COMPU_TAB_REF CompuVtab_30 /end COMPU_METHOD
/begin COMPU_METHOD CompuMethod_42 "" TAB_VERB "%1.0" "" COMPU_TAB_REF CompuVtab_31 /end COMPU_METHOD
/begin COMPU_METHOD CompuMethod_43 "" TAB_VERB "%1.0" "" COMPU_TAB_REF CompuVtab_32 /end COMPU_METHOD
/begin COMPU_METHOD CompuMethod_44 "" TAB_VERB "%1.0" "" COMPU_TAB_REF CompuVtab_33 /end COMPU_METHOD
/begin COMPU_METHOD CompuMethod_45 "" TAB_VERB "%1.0" "" COMPU_TAB_REF CompuVtab_34 /end COMPU_METHOD
/begin COMPU_METHOD CompuMethod_46 "" TAB_VERB "%1.0" "" COMPU_TAB_REF CompuVtab_35 /end COMPU_METHOD
/begin COMPU_METHOD CompuMethod_47 "" TAB_VERB "%1.0" "" COMPU_TAB_REF CompuVtab_36 /end COMPU_METHOD
/begin COMPU_METHOD CompuMethod_48 "" TAB_VERB "%1.0" "" COMPU_TAB_REF CompuVtab_37 /end COMPU_METHOD
/begin COMPU_METHOD CompuMethod_49 "" TAB_VERB "%1.0" "" COMPU_TAB_REF CompuVtab_38 /end COMPU_METHOD
/begin COMPU_METHOD CompuMethod_50 "" TAB_VERB "%1.0" "" COMPU_TAB_REF CompuVtab_39 /end COMPU_METHOD
/begin COMPU_METHOD CompuMethod_51 "" TAB_VERB "%1.0" "" COMPU_TAB_REF CompuVtab_40 /end COMPU_METHOD
/begin COMPU_METHOD CompuMethod_52 "" TAB_VERB "%1.0" "" COMPU_TAB_REF CompuVtab_41 /end COMPU_METHOD
/begin COMPU_METHOD CompuMethod_53 "" TAB_VERB "%1.0" "" COMPU_TAB_REF CompuVtab_42 /end COMPU_METHOD
/begin COMPU_METHOD CompuMethod_54 "" TAB_VERB "%1.0" "" COMPU_TAB_REF CompuVtab_43 /end COMPU_METHOD
/begin COMPU_METHOD CompuMethod_55 "" TAB_VERB "%1.0" "" COMPU_TAB_REF CompuVtab_44 /end COMPU_METHOD
/begin COMPU_METHOD CompuMethod_56 "" TAB_VERB "%1.0" "" COMPU_TAB_REF CompuVtab_45 /end COMPU_METHOD
/begin COMPU_METHOD CompuMethod_57 "" TAB_VERB "%1.0" "" COMPU_TAB_REF CompuVtab_46 /end COMPU_METHOD
/begin COMPU_METHOD CompuMethod_58 "" TAB_VERB "%1.0" "" COMPU_TAB_REF CompuVtab_47 /end COMPU_METHOD
/begin COMPU_METHOD CompuMethod_59 "" TAB_VERB "%1.0" "" COMPU_TAB_REF CompuVtab_48 /end COMPU_METHOD
/begin COMPU_METHOD CompuMethod_60 "" TAB_VERB "%1.0" "" COMPU_TAB_REF CompuVtab_49 /end COMPU_METHOD
/begin COMPU_METHOD CompuMethod_61 "" TAB_VERB "%1.0" "" COMPU_TAB_REF CompuVtab_50 /end COMPU_METHOD
/begin COMPU_METHOD CompuMethod_62 "" TAB_VERB "%1.0" "" COMPU_TAB_REF CompuVtab_51 /end COMPU_METHOD
/begin COMPU_METHOD CompuMethod_63 "" TAB_VERB "%1.0" "" COMPU_TAB_REF CompuVtab_52 /end COMPU_METHOD
/begin COMPU_METHOD CompuMethod_64 "" TAB_VERB "%1.0" "" COMPU_TAB_REF CompuVtab_53 /end COMPU_METHOD
/begin COMPU_METHOD CompuMethod_65 "" TAB_VERB "%1.0" "" COMPU_TAB_REF CompuVtab_54 /end COMPU_METHOD
/begin COMPU_METHOD CompuMethod_66 "" TAB_VERB "%1.0" "" COMPU_TAB_REF CompuVtab_55 /end COMPU_METHOD
/begin COMPU_METHOD CompuMethod_67 "" TAB_VERB "%1.0" "" COMPU_TAB_REF CompuVtab_56 /end COMPU_METHOD
/begin COMPU_METHOD CompuMethod_68 "" TAB_VERB "%1.0" "" COMPU_TAB_REF CompuVtab_57 /end COMPU_METHOD
/begin COMPU_METHOD CompuMethod_69 "" TAB_VERB "%1.0" "" COMPU_TAB_REF CompuVtab_58 /end COMPU_METHOD
/begin COMPU_METHOD CompuMethod_70 "" TAB_VERB "%1.0" "" COMPU_TAB_REF CompuVtab_59 /end COMPU_METHOD
/begin COMPU_METHOD CompuMethod_71 "" TAB_VERB "%1.0" "" COMPU_TAB_REF CompuVtab_60 /end COMPU_METHOD
/begin COMPU_METHOD CompuMethod_72 "" TAB_VERB "%1.0" "" COMPU_TAB_REF CompuVtab_61 /end COMPU_METHOD
/begin COMPU_METHOD CompuMethod_73 "" TAB_VERB "%1.0" "" COMPU_TAB_REF CompuVtab_62 /end COMPU_METHOD
/begin COMPU_METHOD CompuMethod_74 "" TAB_VERB "%1.0" "" COMPU_TAB_REF CompuVtab_63 /end COMPU_METHOD
/begin COMPU_METHOD CompuMethod_75 "" TAB_VERB "%1.0" "" COMPU_TAB_REF CompuVtab_64 /end COMPU_METHOD
/begin COMPU_METHOD CompuMethod_76 "" TAB_VERB "%1.0" "" COMPU_TAB_REF CompuVtab_65 /end COMPU_METHOD
/begin COMPU_METHOD CompuMethod_77 "" TAB_VERB "%1.0" "" COMPU_TAB_REF CompuVtab_66 /end COMPU_METHOD
/begin COMPU_METHOD CompuMethod_78 "" TAB_VERB "%1.0" "" COMPU_TAB_REF CompuVtab_67 /end COMPU_METHOD
/begin COMPU_METHOD CompuMethod_79 "" TAB_VERB "%1.0" "" COMPU_TAB_REF CompuVtab_68 /end COMPU_METHOD
/begin COMPU_METHOD CompuMethod_80 "" TAB_VERB "%1.0" "" COMPU_TAB_REF CompuVtab_69 /end COMPU_METHOD
/begin COMPU_METHOD CompuMethod_81 "" TAB_VERB "%1.0" "" COMPU_TAB_REF CompuVtab_70 /end COMPU_METHOD
/begin COMPU_METHOD CompuMethod_82 "" TAB_VERB "%1.0" "" COMPU_TAB_REF CompuVtab_71 /end COMPU_METHOD
/begin COMPU_METHOD CompuMethod_83 "" TAB_VERB "%1.0" "" COMPU_TAB_REF CompuVtab_72 /end COMPU_METHOD
/begin COMPU_METHOD CompuMethod_84 "" TAB_VERB "%1.0" "" COMPU_TAB_REF CompuVtab_73 /end COMPU_METHOD
/begin COMPU_METHOD CompuMethod_85 "" TAB_VERB "%1.0" "" COMPU_TAB_REF CompuVtab_74 /end COMPU_METHOD
/begin COMPU_METHOD CompuMethod_86 "" TAB_VERB "%1.0" "" COMPU_TAB_REF CompuVtab_75 /end COMPU_METHOD
/begin COMPU_METHOD CompuMethod_87 "" TAB_VERB "%1.0" "" COMPU_TAB_REF CompuVtab_76 /end COMPU_METHOD
/begin COMPU_METHOD CompuMethod_88 "" TAB_VERB "%1.0" "" COMPU_TAB_REF CompuVtab_77 /end COMPU_METHOD
/begin COMPU_METHOD CompuMethod_89 "" TAB_VERB "%1.0" "" COMPU_TAB_REF CompuVtab_78 /end COMPU_METHOD
/begin COMPU_METHOD CompuMethod_90 "" TAB_VERB "%1.0" "" COMPU_TAB_REF CompuVtab_79 /end COMPU_METHOD
/begin COMPU_METHOD CompuMethod_91 "" TAB_VERB "%1.0" "" COMPU_TAB_REF CompuVtab_80 /end COMPU_METHOD
/begin COMPU_METHOD CompuMethod_92 "" TAB_VERB "%1.0" "" COMPU_TAB_REF CompuVtab_81 /end COMPU_METHOD
/begin COMPU_METHOD CompuMethod_93 "" TAB_VERB "%1.0" "" COMPU_TAB_REF CompuVtab_82 /end COMPU_METHOD
/begin COMPU_METHOD CompuMethod_94 "" TAB_VERB "%1.0" "" COMPU_TAB_REF CompuVtab_83 /end COMPU_METHOD
/begin COMPU_METHOD CompuMethod_95 "" TAB_VERB "%1.0" "" COMPU_TAB_REF CompuVtab_84 /end COMPU_METHOD
/begin COMPU_METHOD CompuMethod_96 "" TAB_VERB "%1.0" "" COMPU_TAB_REF CompuVtab_85 /end COMPU_METHOD
/begin COMPU_METHOD CompuMethod_97 "" TAB_VERB "%1.0" "" COMPU_TAB_REF CompuVtab_86 /end COMPU_METHOD
/begin COMPU_METHOD CompuMethod_98 "" TAB_VERB "%1.0" "" COMPU_TAB_REF CompuVtab_87 /end COMPU_METHOD
/begin COMPU_METHOD CompuMethod_99 "" TAB_VERB "%1.0" "" COMPU_TAB_REF CompuVtab_88 /end COMPU_METHOD
/begin COMPU_METHOD CompuMethod_100 "" TAB_VERB "%1.0" "" COMPU_TAB_REF CompuVtab_89 /end COMPU_METHOD
/begin COMPU_METHOD CompuMethod_101 "" TAB_VERB "%1.0" "" COMPU_TAB_REF CompuVtab_90 /end COMPU_METHOD
/begin COMPU_METHOD CompuMethod_102 "" TAB_VERB "%1.0" "" COMPU_TAB_REF CompuVtab_91 /end COMPU_METHOD
/begin COMPU_METHOD CompuMethod_103 "" TAB_VERB "%1.0" "" COMPU_TAB_REF CompuVtab_92 /end COMPU_METHOD
/begin COMPU_METHOD CompuMethod_104 "" TAB_VERB "%1.0" "" COMPU_TAB_REF CompuVtab_93 /end COMPU_METHOD
/begin COMPU_METHOD CompuMethod_105 "" TAB_VERB "%1.0" "" COMPU_TAB_REF CompuVtab_94 /end COMPU_METHOD
/begin COMPU_METHOD CompuMethod_106 "" TAB_VERB "%1.0" "" COMPU_TAB_REF CompuVtab_95 /end COMPU_METHOD
/begin COMPU_METHOD CompuMethod_107 "" TAB_VERB "%1.0" "" COMPU_TAB_REF CompuVtab_96 /end COMPU_METHOD
/begin COMPU_METHOD CompuMethod_108 "" TAB_VERB "%1.0" "" COMPU_TAB_REF CompuVtab_97 /end COMPU_METHOD
/begin COMPU_METHOD CompuMethod_109 "" TAB_VERB "%1.0" "" COMPU_TAB_REF CompuVtab_98 /end COMPU_METHOD
/begin COMPU_METHOD CompuMethod_110 "" TAB_VERB "%1.0" "" COMPU_TAB_REF CompuVtab_99 /end COMPU_METHOD
/begin COMPU_METHOD CompuMethod_111 "" TAB_VERB "%1.0" "" COMPU_TAB_REF CompuVtab_100 /end COMPU_METHOD
/begin COMPU_METHOD CompuMethod_112 "" TAB_VERB "%1.0" "" COMPU_TAB_REF CompuVtab_101 /end COMPU_METHOD
/begin COMPU_METHOD CompuMethod_113 "" TAB_VERB "%1.0" "" COMPU_TAB_REF CompuVtab_102 /end COMPU_METHOD
/begin COMPU_METHOD CompuMethod_114 "" TAB_VERB "%1.0" "" COMPU_TAB_REF CompuVtab_103 /end COMPU_METHOD
/begin COMPU_METHOD CompuMethod_115 "" TAB_VERB "%1.0" "" COMPU_TAB_REF CompuVtab_104 /end COMPU_METHOD
/begin COMPU_METHOD CompuMethod_116 "" TAB_VERB "%1.0" "" COMPU_TAB_REF CompuVtab_105 /end COMPU_METHOD
/begin COMPU_METHOD CompuMethod_117 "" TAB_VERB "%1.0" "" COMPU_TAB_REF CompuVtab_106 /end COMPU_METHOD
/begin COMPU_METHOD CompuMethod_118 "" TAB_VERB "%1.0" "" COMPU_TAB_REF CompuVtab_107 /end COMPU_METHOD
/begin COMPU_METHOD CompuMethod_119 "" TAB_VERB "%1.0" "" COMPU_TAB_REF CompuVtab_108 /end COMPU_METHOD
/begin COMPU_METHOD CompuMethod_120 "" TAB_VERB "%1.0" "" COMPU_TAB_REF CompuVtab_109 /end COMPU_METHOD
/begin COMPU_METHOD CompuMethod_121 "" TAB_VERB "%1.0" "" COMPU_TAB_REF CompuVtab_110 /end COMPU_METHOD
/begin COMPU_METHOD CompuMethod_122 "" TAB_VERB "%1.0" "" COMPU_TAB_REF CompuVtab_111 /end COMPU_METHOD
/begin COMPU_METHOD CompuMethod_123 "" TAB_VERB "%1.0" "" COMPU_TAB_REF CompuVtab_112 /end COMPU_METHOD
/begin COMPU_METHOD CompuMethod_124 "" TAB_VERB "%1.0" "" COMPU_TAB_REF CompuVtab_113 /end COMPU_METHOD
/begin COMPU_METHOD CompuMethod_125 "" TAB_VERB "%1.0" "" COMPU_TAB_REF CompuVtab_114 /end COMPU_METHOD
/begin COMPU_METHOD CompuMethod_126 "" TAB_VERB "%1.0" "" COMPU_TAB_REF CompuVtab_115 /end COMPU_METHOD
/begin COMPU_METHOD CompuMethod_127 "" TAB_VERB "%1.0" "" COMPU_TAB_REF CompuVtab_116 /end COMPU_METHOD
/begin COMPU_METHOD CompuMethod_128 "" TAB_VERB "%1.0" "" COMPU_TAB_REF CompuVtab_117 /end COMPU_METHOD
/begin COMPU_METHOD CompuMethod_129 "" TAB_VERB "%1.0" "" COMPU_TAB_REF CompuVtab_118 /end COMPU_METHOD
/begin COMPU_METHOD CompuMethod_130 "" TAB_VERB "%1.0" "" COMPU_TAB_REF CompuVtab_119 /end COMPU_METHOD
/begin COMPU_METHOD CompuMethod_131 "" TAB_VERB "%1.0" "" COMPU_TAB_REF CompuVtab_120 /end COMPU_METHOD
/begin COMPU_METHOD CompuMethod_132 "" TAB_VERB "%1.0" "" COMPU_TAB_REF CompuVtab_121 /end COMPU_METHOD
/begin COMPU_METHOD CompuMethod_133 "" TAB_VERB "%1.0" "" COMPU_TAB_REF CompuVtab_122 /end COMPU_METHOD
/begin COMPU_METHOD CompuMethod_134 "" TAB_VERB "%1.0" "" COMPU_TAB_REF CompuVtab_123 /end COMPU_METHOD
/begin COMPU_METHOD CompuMethod_135 "" TAB_VERB "%1.0" "" COMPU_TAB_REF CompuVtab_124 /end COMPU_METHOD
/begin COMPU_METHOD CompuMethod_136 "" TAB_VERB "%1.0" "" COMPU_TAB_REF CompuVtab_125 /end COMPU_METHOD
/begin COMPU_METHOD CompuMethod_137 "" TAB_VERB "%1.0" "" COMPU_TAB_REF CompuVtab_126 /end COMPU_METHOD
/begin COMPU_METHOD CompuMethod_138 "" TAB_VERB "%1.0" "" COMPU_TAB_REF CompuVtab_127 /end COMPU_METHOD
/begin COMPU_METHOD CompuMethod_139 "" TAB_VERB "%1.0" "" COMPU_TAB_REF CompuVtab_128 /end COMPU_METHOD
/begin COMPU_METHOD CompuMethod_140 "" TAB_VERB "%1.0" "" COMPU_TAB_REF CompuVtab_129 /end COMPU_METHOD
/begin COMPU_METHOD CompuMethod_141 "" TAB_VERB "%1.0" "" COMPU_TAB_REF CompuVtab_130 /end COMPU_METHOD
/begin COMPU_METHOD CompuMethod_142 "" TAB_VERB "%1.0" "" COMPU_TAB_REF CompuVtab_131 /end COMPU_METHOD
/begin COMPU_METHOD CompuMethod_143 "" TAB_VERB "%1.0" "" COMPU_TAB_REF CompuVtab_132 /end COMPU_METHOD
/begin COMPU_METHOD CompuMethod_144 "" TAB_VERB "%1.0" "" COMPU_TAB_REF CompuVtab_133 /end COMPU_METHOD
/begin COMPU_METHOD CompuMethod_145 "" TAB_VERB "%1.0" "" COMPU_TAB_REF CompuVtab_134 /end COMPU_METHOD
/begin COMPU_METHOD CompuMethod_146 "" TAB_VERB "%1.0" "" COMPU_TAB_REF CompuVtab_135 /end COMPU_METHOD
/begin COMPU_METHOD CompuMethod_147 "" TAB_VERB "%1.0" "" COMPU_TAB_REF CompuVtab_136 /end COMPU_METHOD
/begin COMPU_METHOD CompuMethod_148 "" TAB_VERB "%1.0" "" COMPU_TAB_REF CompuVtab_137 /end COMPU_METHOD
/begin COMPU_METHOD CompuMethod_149 "" TAB_VERB "%1.0" "" COMPU_TAB_REF CompuVtab_138 /end COMPU_METHOD
/begin COMPU_METHOD CompuMethod_150 "" TAB_VERB "%1.0" "" COMPU_TAB_REF CompuVtab_139 /end COMPU_METHOD
/begin COMPU_METHOD CompuMethod_151 "" TAB_VERB "%1.0" "" COMPU_TAB_REF CompuVtab_140 /end COMPU_METHOD
/begin COMPU_METHOD CompuMethod_152 "" TAB_VERB "%1.0" "" COMPU_TAB_REF CompuVtab_141 /end COMPU_METHOD
/begin COMPU_METHOD CompuMethod_153 "" TAB_VERB "%1.0" "" COMPU_TAB_REF CompuVtab_142 /end COMPU_METHOD
/begin COMPU_METHOD CompuMethod_154 "" TAB_VERB "%1.0" "" COMPU_TAB_REF CompuVtab_143 /end COMPU_METHOD
/begin COMPU_METHOD CompuMethod_155 "" TAB_VERB "%1.0" "" COMPU_TAB_REF CompuVtab_144 /end COMPU_METHOD
/begin COMPU_METHOD CompuMethod_156 "" TAB_VERB "%1.0" "" COMPU_TAB_REF CompuVtab_145 /end COMPU_METHOD
/begin COMPU_METHOD CompuMethod_157 "" TAB_VERB "%1.0" "" COMPU_TAB_REF CompuVtab_146 /end COMPU_METHOD
/begin COMPU_METHOD CompuMethod_158 "" TAB_VERB "%1.0" "" COMPU_TAB_REF CompuVtab_147 /end COMPU_METHOD
/begin COMPU_METHOD CompuMethod_159 "" TAB_VERB "%1.0" "" COMPU_TAB_REF CompuVtab_148 /end COMPU_METHOD
/begin COMPU_METHOD CompuMethod_160 "" TAB_VERB "%1.0" "" COMPU_TAB_REF CompuVtab_149 /end COMPU_METHOD
/begin COMPU_METHOD CompuMethod_161 "" TAB_VERB "%1.0" "" COMPU_TAB_REF CompuVtab_150 /end COMPU_METHOD
/begin COMPU_METHOD CompuMethod_162 "" TAB_VERB "%1.0" "" COMPU_TAB_REF CompuVtab_151 /end COMPU_METHOD
/begin COMPU_METHOD CompuMethod_163 "" TAB_VERB "%1.0" "" COMPU_TAB_REF CompuVtab_152 /end COMPU_METHOD
/begin COMPU_METHOD CompuMethod_164 "" TAB_VERB "%1.0" "" COMPU_TAB_REF CompuVtab_153 /end COMPU_METHOD
/begin COMPU_METHOD CompuMethod_165 "" TAB_VERB "%1.0" "" COMPU_TAB_REF CompuVtab_154 /end COMPU_METHOD
/begin COMPU_METHOD CompuMethod_166 "" TAB_VERB "%1.0" "" COMPU_TAB_REF CompuVtab_155 /end COMPU_METHOD
/begin COMPU_METHOD CompuMethod_167 "" TAB_VERB "%1.0" "" COMPU_TAB_REF CompuVtab_156 /end COMPU_METHOD
/begin COMPU_METHOD CompuMethod_168 "" TAB_VERB "%1.0" "" COMPU_TAB_REF CompuVtab_157 /end COMPU_METHOD
/begin COMPU_METHOD CompuMethod_169 "" TAB_VERB "%1.0" "" COMPU_TAB_REF CompuVtab_158 /end COMPU_METHOD
/begin COMPU_METHOD CompuMethod_170 "" TAB_VERB "%1.0" "" COMPU_TAB_REF CompuVtab_159 /end COMPU_METHOD
/begin COMPU_METHOD CompuMethod_171 "" TAB_VERB "%1.0" "" COMPU_TAB_REF CompuVtab_160 /end COMPU_METHOD
/begin COMPU_METHOD CompuMethod_172 "" TAB_VERB "%1.0" "" COMPU_TAB_REF CompuVtab_161 /end COMPU_METHOD
/begin COMPU_METHOD CompuMethod_173 "" TAB_VERB "%1.0" "" COMPU_TAB_REF CompuVtab_162 /end COMPU_METHOD
/begin COMPU_METHOD CompuMethod_174 "" TAB_VERB "%1.0" "" COMPU_TAB_REF CompuVtab_163 /end COMPU_METHOD
/begin COMPU_METHOD CompuMethod_175 "" TAB_VERB "%1.0" "" COMPU_TAB_REF CompuVtab_164 /end COMPU_METHOD
/begin COMPU_METHOD CompuMethod_176 "" TAB_VERB "%1.0" "" COMPU_TAB_REF CompuVtab_165 /end COMPU_METHOD
/begin COMPU_METHOD CompuMethod_485 "" RAT_FUNC "%6.5" "miles" COEFFS 0 1 0 0 0 1 /end COMPU_METHOD
/begin COMPU_METHOD CompuMethod_497 "" RAT_FUNC "%5.0" "bytes" COEFFS 0 1 0 0 0 1 /end COMPU_METHOD
/begin COMPU_METHOD CompuMethod_499 "" RAT_FUNC "%8.0" "seconds" COEFFS 0 1 0 0 0 1 /end COMPU_METHOD
/begin COMPU_METHOD CompuMethod_506 "" RAT_FUNC "%6.5" "" COEFFS 0 1 0 0 0 1 /end COMPU_METHOD
/begin COMPU_METHOD CompuMethod_507 "" RAT_FUNC "%9.0" "bytes" COEFFS 0 1 0 0 0 1 /end COMPU_METHOD
/begin COMPU_METHOD CompuMethod_510 "" RAT_FUNC "%6.2" "NM/5ms" COEFFS 0 1 0 0 0 1 /end COMPU_METHOD
/begin COMPU_METHOD CompuMethod_514 "" TAB_VERB "%3.0" "" COMPU_TAB_REF CompuVtab_490 /end COMPU_METHOD
/*~~~~~~~~~ 6.3.34 COMPU_VTABs ~~~~~~~~~*/
/begin COMPU_VTAB CompuVtab_1 "" TAB_VERB 41 8 "PCM" 9 "ECM" 10 "PCM80" 11 "VCM" 13 "PCM128" 14 "ISDL 555" 15 "ISDL" 15 "DLM565-24" 17 "SECM" 18 "uCHI" 19 "ECM48" 20 "AIM" 21 "FIRE48" 22 "TVM48" 23 "Axiom Eval" 24 "Indy 05" 25 "MPC5554 112 Pin module" 26 "PCM0901" 27 "Lowrance LMF-200" 28 "Peiker" 29 "M3A" 30 "Kohler Doolittle" 31 "PIM" 32 "Win32 Host" 33 "Bedrock" 34 "SECM" 35 "uCHI" 36 "Tenneco AT" 37 "Woodward DPF" 38 "M460" 39 "DE-ECU" 40 "Axiom MPC5566EVB" 41 "Large Engine Platform Core" 42 "Large Engine Platform Knock Processor" 43 "ECM OH with MPC5566" 44 "ECM OH with MPC5554" 45 "Axiom MPC5553EVB" 46 "ECM OH Quizzer micro" 47 "GCM-5566-068-047" 48 "ECM-5644-112-048" 49 "ECM-5642-112-049" /end COMPU_VTAB
/begin COMPU_VTAB CompuVtab_2 "" TAB_VERB 2 0 "Pass-Through" 1 "Override" /end COMPU_VTAB
/begin COMPU_VTAB CompuVtab_3 "" TAB_VERB 41 0 "Normal Operation" 1 "Task Kernel API Usage" 2 "Bad Attribute Data" 3 "Operation timed out" 4 "Operation aborted" 5 "Access from an ISR" 6 "Illegal Handle" 7 "Out of free store memory" 8 "The supplied task information is not valid." 9 "Missing Attribute" 10 "Insufficient FW resource" 11 "TPU Mask incompatible with the eTPU" 12 "Resource Busy" 13 "Data Unavailable" 14 "Function Not Supported" 15 "Flash is not blank" 16 "Flash Prog Voltage Unavailable" 17 "Memory verify" 18 "Uncreated Resource access" 19 "Illegal address" 20 "Hardware overrun" 21 "Alignment" 22 "Hardware timeout" 23 "TPU Function not in mask" 24 "TPU coprocessor not succesfully opened" 25 "Required dependants were not located" 26 "SPI Bus Integrity check failed." 27 "Insufficient param ram for TPU primitive" 28 "Dependent ASIC not created" 29 "Resource Not Capable." 30 "Software overrun" 31 "A Write attempted failed but OK to continue" 32 "Heap free-list distroyed; found while allocating" 33 "Heap freeing already freed or distroyed block" 34 "Heap freeing block outside of pool" 35 "Heap free list crashed; found while reallocating" 36 "An operation to the host operating system failed" 37 "Data Alignment" 38 "Attempt to create resource that is already created" 39 "Attempt to attach an ISR handler that is in use" 40 "Attempt to attach an ISR IRQ that is out of range" /end COMPU_VTAB
/begin COMPU_VTAB CompuVtab_4 "" TAB_VERB 7 0 "Calibratable Development Module" 1 "Non-Calibratable Production Module" 2 "Software Dev Module (with RAM overlay only)" 3 "Software Dev Module (with Trace Pod & RAM)" 4 "Calibratable Development Module with Censorship disabled" 5 "Non-Calibratable Production Module with Censorship disabled" 6 "Module with a daughter board whose purpose is to aid in calibration" /end COMPU_VTAB
/begin COMPU_VTAB CompuVtab_5 "" TAB_VERB 2 0 "Calibration Locked" 1 "Calibration Unlocked" /end COMPU_VTAB
/begin COMPU_VTAB CompuVtab_6 "" TAB_VERB 2 0 "Data Acquisition Locked" 1 "Data Acquisition Unlocked" /end COMPU_VTAB
/begin COMPU_VTAB CompuVtab_7 "" TAB_VERB 2 0 "Programming Locked" 1 "Programming Unlocked" /end COMPU_VTAB
/begin COMPU_VTAB CompuVtab_8 "" TAB_VERB 2 0 "Not Connected" 1 "Connected" /end COMPU_VTAB
/begin COMPU_VTAB CompuVtab_9 "" TAB_VERB 2 0 "Mooventure2016_Rev5/Foreground/Control/Engine Control/motohawk_override_abs2/OldValue" 1 "-" /end COMPU_VTAB
/begin COMPU_VTAB CompuVtab_10 "" TAB_VERB 2 0 "Mooventure2016_Rev5/Foreground/Control/Coolant Control/motohawk_override_abs5/NewValue" 1 "-" /end COMPU_VTAB
/begin COMPU_VTAB CompuVtab_11 "" TAB_VERB 2 0 "Mooventure2016_Rev5/Foreground/Control/Battery/motohawk_override_abs4/OldValue" 1 "-" /end COMPU_VTAB
/begin COMPU_VTAB CompuVtab_12 "" TAB_VERB 2 0 "Mooventure2016_Rev5/Foreground/Control/Coolant Control/motohawk_override_abs5/OldValue" 1 "-" /end COMPU_VTAB
/begin COMPU_VTAB CompuVtab_13 "" TAB_VERB 2 0 "Mooventure2016_Rev5/Foreground/Control/Coolant Control/motohawk_override_abs1/NewValue" 1 "-" /end COMPU_VTAB
/begin COMPU_VTAB CompuVtab_14 "" TAB_VERB 2 0 "Mooventure2016_Rev5/Foreground/Control/Coolant Control/motohawk_override_abs1/OldValue" 1 "-" /end COMPU_VTAB
/begin COMPU_VTAB CompuVtab_15 "" TAB_VERB 2 0 "Mooventure2016_Rev5/Foreground/Control/Engine Control/motohawk_override_abs3/NewValue" 1 "-" /end COMPU_VTAB
/begin COMPU_VTAB CompuVtab_16 "" TAB_VERB 2 0 "Mooventure2016_Rev5/Foreground/Control/Engine Control/motohawk_override_abs3/OldValue" 1 "-" /end COMPU_VTAB
/begin COMPU_VTAB CompuVtab_17 "" TAB_VERB 2 0 "Mooventure2016_Rev5/Foreground/Control/Coolant Control/motohawk_override_abs6/NewValue" 1 "-" /end COMPU_VTAB
/begin COMPU_VTAB CompuVtab_18 "" TAB_VERB 2 0 "Mooventure2016_Rev5/Foreground/Control/Coolant Control/motohawk_override_abs6/OldValue" 1 "-" /end COMPU_VTAB
/begin COMPU_VTAB CompuVtab_19 "" TAB_VERB 2 0 "Mooventure2016_Rev5/Foreground/Control/Coolant Control/motohawk_override_abs11/NewValue" 1 "-" /end COMPU_VTAB
/begin COMPU_VTAB CompuVtab_20 "" TAB_VERB 2 0 "Mooventure2016_Rev5/Foreground/Control/Coolant Control/motohawk_override_abs7/NewValue" 1 "-" /end COMPU_VTAB
/begin COMPU_VTAB CompuVtab_21 "" TAB_VERB 2 0 "Mooventure2016_Rev5/Foreground/Control/Coolant Control/motohawk_override_abs11/OldValue" 1 "-" /end COMPU_VTAB
/begin COMPU_VTAB CompuVtab_22 "" TAB_VERB 2 0 "Mooventure2016_Rev5/CCP CAN Protocol/CCP CAN Protocol External Trig1/CCP Command Driver" 1 "-" /end COMPU_VTAB
/begin COMPU_VTAB CompuVtab_23 "" TAB_VERB 2 0 "Mooventure2016_Rev5/Foreground/Control/Coolant Control/motohawk_override_abs7/OldValue" 1 "-" /end COMPU_VTAB
/begin COMPU_VTAB CompuVtab_24 "" TAB_VERB 2 0 "Mooventure2016_Rev5/Foreground/Control/Coolant Control/motohawk_override_abs2/NewValue" 1 "-" /end COMPU_VTAB
/begin COMPU_VTAB CompuVtab_25 "" TAB_VERB 2 0 "Mooventure2016_Rev5/CCP CAN Protocol/CCP CAN Protocol External Trig1/CCP Command Driver/While new CCP Command" 1 "-" /end COMPU_VTAB
/begin COMPU_VTAB CompuVtab_26 "" TAB_VERB 2 0 "Mooventure2016_Rev5/Foreground/Control/Coolant Control/motohawk_override_abs8/NewValue" 1 "-" /end COMPU_VTAB
/begin COMPU_VTAB CompuVtab_27 "" TAB_VERB 2 0 "Mooventure2016_Rev5/Foreground/Control/Coolant Control/motohawk_override_abs2/OldValue" 1 "-" /end COMPU_VTAB
/begin COMPU_VTAB CompuVtab_28 "" TAB_VERB 2 0 "Mooventure2016_Rev5/CCP CAN Protocol/CCP CAN Protocol External Trig1/CCP Command Driver/While new CCP Command/Adjust ID" 1 "-" /end COMPU_VTAB
/begin COMPU_VTAB CompuVtab_29 "" TAB_VERB 2 0 "Mooventure2016_Rev5/Foreground/Control/Coolant Control/motohawk_override_abs8/OldValue" 1 "-" /end COMPU_VTAB
/begin COMPU_VTAB CompuVtab_30 "" TAB_VERB 2 0 "Mooventure2016_Rev5/Foreground/Control/Coolant Control/motohawk_override_abs3/NewValue" 1 "-" /end COMPU_VTAB
/begin COMPU_VTAB CompuVtab_31 "" TAB_VERB 2 0 "Mooventure2016_Rev5/CCP CAN Protocol/CCP CAN Protocol External Trig1/CCP Daq Processing" 1 "-" /end COMPU_VTAB
/begin COMPU_VTAB CompuVtab_32 "" TAB_VERB 2 0 "Mooventure2016_Rev5/Foreground/Control/Engine Control/motohawk_override_abs1/NewValue" 1 "-" /end COMPU_VTAB
/begin COMPU_VTAB CompuVtab_33 "" TAB_VERB 2 0 "Mooventure2016_Rev5/Foreground/Control/Coolant Control/motohawk_override_abs3/OldValue" 1 "-" /end COMPU_VTAB
/begin COMPU_VTAB CompuVtab_34 "" TAB_VERB 2 0 "Mooventure2016_Rev5/CCP CAN Protocol/CCP CAN Protocol External Trig1/CCP IDLE Processing" 1 "-" /end COMPU_VTAB
/begin COMPU_VTAB CompuVtab_35 "" TAB_VERB 2 0 "Mooventure2016_Rev5/Foreground/Control/Engine Control/motohawk_override_abs1/OldValue" 1 "-" /end COMPU_VTAB
/begin COMPU_VTAB CompuVtab_36 "" TAB_VERB 2 0 "Mooventure2016_Rev5/Foreground/Control/Coolant Control/motohawk_override_abs4/NewValue" 1 "-" /end COMPU_VTAB
/begin COMPU_VTAB CompuVtab_37 "" TAB_VERB 2 0 "Mooventure2016_Rev5/Foreground" 1 "-" /end COMPU_VTAB
/begin COMPU_VTAB CompuVtab_38 "" TAB_VERB 2 0 "Mooventure2016_Rev5/Foreground/Control/Engine Control/motohawk_override_abs2/NewValue" 1 "-" /end COMPU_VTAB
/begin COMPU_VTAB CompuVtab_39 "" TAB_VERB 2 0 "Mooventure2016_Rev5/Foreground/Control/Coolant Control/motohawk_override_abs4/OldValue" 1 "-" /end COMPU_VTAB
/begin COMPU_VTAB CompuVtab_40 "" TAB_VERB 2 0 "Mooventure2016_Rev5/Foreground/Control/Battery/motohawk_override_abs4/NewValue" 1 "-" /end COMPU_VTAB
/begin COMPU_VTAB CompuVtab_41 "" TAB_VERB 2 0 "Mooventure2016_Rev5/Foreground/Inputs/ABS/motohawk_override_abs8/NewValue" 1 "-" /end COMPU_VTAB
/begin COMPU_VTAB CompuVtab_42 "" TAB_VERB 2 0 "Mooventure2016_Rev5/Foreground/Inputs/ABS/motohawk_override_abs8/OldValue" 1 "-" /end COMPU_VTAB
/begin COMPU_VTAB CompuVtab_43 "" TAB_VERB 2 0 "Mooventure2016_Rev5/Foreground/Inputs/ABS/motohawk_override_abs3/NewValue" 1 "-" /end COMPU_VTAB
/begin COMPU_VTAB CompuVtab_44 "" TAB_VERB 2 0 "Mooventure2016_Rev5/Foreground/Inputs/ABS/motohawk_override_abs9/NewValue" 1 "-" /end COMPU_VTAB
/begin COMPU_VTAB CompuVtab_45 "" TAB_VERB 2 0 "Mooventure2016_Rev5/Foreground/Inputs/ABS/motohawk_override_abs3/OldValue" 1 "-" /end COMPU_VTAB
/begin COMPU_VTAB CompuVtab_46 "" TAB_VERB 2 0 "Mooventure2016_Rev5/Foreground/Control/Hybrid Control Code/motohawk_override_abs/NewValue" 1 "-" /end COMPU_VTAB
/begin COMPU_VTAB CompuVtab_47 "" TAB_VERB 2 0 "Mooventure2016_Rev5/Foreground/Inputs/ABS/motohawk_override_abs9/OldValue" 1 "-" /end COMPU_VTAB
/begin COMPU_VTAB CompuVtab_48 "" TAB_VERB 2 0 "Mooventure2016_Rev5/Foreground/Inputs/ABS/motohawk_override_abs4/NewValue" 1 "-" /end COMPU_VTAB
/begin COMPU_VTAB CompuVtab_49 "" TAB_VERB 2 0 "Mooventure2016_Rev5/Foreground/Control/Hybrid Control Code/motohawk_override_abs/OldValue" 1 "-" /end COMPU_VTAB
/begin COMPU_VTAB CompuVtab_50 "" TAB_VERB 2 0 "Mooventure2016_Rev5/Foreground/Inputs/ABS/motohawk_override_abs4/OldValue" 1 "-" /end COMPU_VTAB
/begin COMPU_VTAB CompuVtab_51 "" TAB_VERB 2 0 "Mooventure2016_Rev5/Foreground/Inputs/ABS/motohawk_override_abs1/NewValue" 1 "-" /end COMPU_VTAB
/begin COMPU_VTAB CompuVtab_52 "" TAB_VERB 2 0 "Mooventure2016_Rev5/Foreground/Inputs/ABS/motohawk_override_abs5/NewValue" 1 "-" /end COMPU_VTAB
/begin COMPU_VTAB CompuVtab_53 "" TAB_VERB 2 0 "Mooventure2016_Rev5/Foreground/Inputs/ABS/motohawk_override_abs1/OldValue" 1 "-" /end COMPU_VTAB
/begin COMPU_VTAB CompuVtab_54 "" TAB_VERB 2 0 "Mooventure2016_Rev5/Foreground/Control/Engine Control/motohawk_override_abs4/NewValue" 1 "-" /end COMPU_VTAB
/begin COMPU_VTAB CompuVtab_55 "" TAB_VERB 2 0 "Mooventure2016_Rev5/Foreground/Inputs/ABS/motohawk_override_abs5/OldValue" 1 "-" /end COMPU_VTAB
/begin COMPU_VTAB CompuVtab_56 "" TAB_VERB 2 0 "Mooventure2016_Rev5/Foreground/Inputs/ABS/motohawk_override_abs10/NewValue" 1 "-" /end COMPU_VTAB
/begin COMPU_VTAB CompuVtab_57 "" TAB_VERB 2 0 "Mooventure2016_Rev5/Foreground/Control/Engine Control/motohawk_override_abs4/OldValue" 1 "-" /end COMPU_VTAB
/begin COMPU_VTAB CompuVtab_58 "" TAB_VERB 2 0 "Mooventure2016_Rev5/Foreground/Inputs/ABS/motohawk_override_abs6/NewValue" 1 "-" /end COMPU_VTAB
/begin COMPU_VTAB CompuVtab_59 "" TAB_VERB 2 0 "Mooventure2016_Rev5/Foreground/Inputs/ABS/motohawk_override_abs10/OldValue" 1 "-" /end COMPU_VTAB
/begin COMPU_VTAB CompuVtab_60 "" TAB_VERB 2 0 "Mooventure2016_Rev5/Foreground/Control/Hybrid Control Code/IPT/Drive/motohawk_override_abs4/NewValue" 1 "-" /end COMPU_VTAB
/begin COMPU_VTAB CompuVtab_61 "" TAB_VERB 2 0 "Mooventure2016_Rev5/Foreground/Inputs/ABS/motohawk_override_abs6/OldValue" 1 "-" /end COMPU_VTAB
/begin COMPU_VTAB CompuVtab_62 "" TAB_VERB 2 0 "Mooventure2016_Rev5/Foreground/Inputs/ABS/motohawk_override_abs11/NewValue" 1 "-" /end COMPU_VTAB
/begin COMPU_VTAB CompuVtab_63 "" TAB_VERB 2 0 "Mooventure2016_Rev5/Foreground/Control/Hybrid Control Code/IPT/Drive/motohawk_override_abs4/OldValue" 1 "-" /end COMPU_VTAB
/begin COMPU_VTAB CompuVtab_64 "" TAB_VERB 2 0 "Mooventure2016_Rev5/Foreground/Inputs/ABS/motohawk_override_abs7/NewValue" 1 "-" /end COMPU_VTAB
/begin COMPU_VTAB CompuVtab_65 "" TAB_VERB 2 0 "Mooventure2016_Rev5/Foreground/Inputs/ABS/motohawk_override_abs11/OldValue" 1 "-" /end COMPU_VTAB
/begin COMPU_VTAB CompuVtab_66 "" TAB_VERB 2 0 "Mooventure2016_Rev5/Foreground/Control/Hybrid Control Code/IPT/Reverse/motohawk_override_abs4/NewValue" 1 "-" /end COMPU_VTAB
/begin COMPU_VTAB CompuVtab_67 "" TAB_VERB 2 0 "Mooventure2016_Rev5/Foreground/Inputs/ABS/motohawk_override_abs7/OldValue" 1 "-" /end COMPU_VTAB
/begin COMPU_VTAB CompuVtab_68 "" TAB_VERB 2 0 "Mooventure2016_Rev5/Foreground/Inputs/ABS/motohawk_override_abs2/NewValue" 1 "-" /end COMPU_VTAB
/begin COMPU_VTAB CompuVtab_69 "" TAB_VERB 2 0 "Mooventure2016_Rev5/Foreground/Control/Hybrid Control Code/IPT/Reverse/motohawk_override_abs4/OldValue" 1 "-" /end COMPU_VTAB
/begin COMPU_VTAB CompuVtab_70 "" TAB_VERB 2 0 "Mooventure2016_Rev5/Foreground/Inputs/ABS/motohawk_override_abs2/OldValue" 1 "-" /end COMPU_VTAB
/begin COMPU_VTAB CompuVtab_71 "" TAB_VERB 2 0 "Mooventure2016_Rev5/Foreground/Control/Hybrid Control Code/IPT/motohawk_override_abs/NewValue" 1 "-" /end COMPU_VTAB
/begin COMPU_VTAB CompuVtab_72 "" TAB_VERB 2 0 "Mooventure2016_Rev5/Foreground/Control/Hybrid Control Code/IPT/motohawk_override_abs/OldValue" 1 "-" /end COMPU_VTAB
/begin COMPU_VTAB CompuVtab_73 "" TAB_VERB 2 0 "Mooventure2016_Rev5/Foreground/Inputs/Cruise Control/motohawk_override_abs1/NewValue" 1 "-" /end COMPU_VTAB
/begin COMPU_VTAB CompuVtab_74 "" TAB_VERB 2 0 "Mooventure2016_Rev5/Foreground/Inputs/Cruise Control/motohawk_override_abs1/OldValue" 1 "-" /end COMPU_VTAB
/begin COMPU_VTAB CompuVtab_75 "" TAB_VERB 2 0 "Mooventure2016_Rev5/Foreground/Inputs/Battery_Inputs/motohawk_override_abs3/NewValue" 1 "-" /end COMPU_VTAB
/begin COMPU_VTAB CompuVtab_76 "" TAB_VERB 2 0 "Mooventure2016_Rev5/Foreground/Inputs/Cruise Control/motohawk_override_abs12/NewValue" 1 "-" /end COMPU_VTAB
/begin COMPU_VTAB CompuVtab_77 "" TAB_VERB 2 0 "Mooventure2016_Rev5/Foreground/Inputs/Battery_Inputs/motohawk_override_abs3/OldValue" 1 "-" /end COMPU_VTAB
/begin COMPU_VTAB CompuVtab_78 "" TAB_VERB 2 0 "Mooventure2016_Rev5/Foreground/Inputs/Analog Inputs/Cruise Control In/motohawk_override_abs12/NewValue" 1 "-" /end COMPU_VTAB
/begin COMPU_VTAB CompuVtab_79 "" TAB_VERB 2 0 "Mooventure2016_Rev5/Foreground/Inputs/Cruise Control/motohawk_override_abs12/OldValue" 1 "-" /end COMPU_VTAB
/begin COMPU_VTAB CompuVtab_80 "" TAB_VERB 2 0 "Mooventure2016_Rev5/Foreground/Inputs/Battery_Inputs/motohawk_override_abs4/NewValue" 1 "-" /end COMPU_VTAB
/begin COMPU_VTAB CompuVtab_81 "" TAB_VERB 2 0 "Mooventure2016_Rev5/Foreground/Inputs/Analog Inputs/Cruise Control In/motohawk_override_abs12/OldValue" 1 "-" /end COMPU_VTAB
/begin COMPU_VTAB CompuVtab_82 "" TAB_VERB 2 0 "Mooventure2016_Rev5/Foreground/Inputs/Cruise Control/motohawk_override_abs2/NewValue" 1 "-" /end COMPU_VTAB
/begin COMPU_VTAB CompuVtab_83 "" TAB_VERB 2 0 "Mooventure2016_Rev5/Foreground/Inputs/Battery_Inputs/motohawk_override_abs4/OldValue" 1 "-" /end COMPU_VTAB
/begin COMPU_VTAB CompuVtab_84 "" TAB_VERB 2 0 "Mooventure2016_Rev5/Foreground/Inputs/Analog Inputs/DCDC Converter/motohawk_override_abs12/NewValue" 1 "-" /end COMPU_VTAB
/begin COMPU_VTAB CompuVtab_85 "" TAB_VERB 2 0 "Mooventure2016_Rev5/Foreground/Inputs/Cruise Control/motohawk_override_abs2/OldValue" 1 "-" /end COMPU_VTAB
/begin COMPU_VTAB CompuVtab_86 "" TAB_VERB 2 0 "Mooventure2016_Rev5/Foreground/Inputs/Battery_Inputs/motohawk_override_abs5/NewValue" 1 "-" /end COMPU_VTAB
/begin COMPU_VTAB CompuVtab_87 "" TAB_VERB 2 0 "Mooventure2016_Rev5/Foreground/Inputs/Analog Inputs/DCDC Converter/motohawk_override_abs12/OldValue" 1 "-" /end COMPU_VTAB
/begin COMPU_VTAB CompuVtab_88 "" TAB_VERB 2 0 "Mooventure2016_Rev5/Foreground/Inputs/Battery_Inputs/motohawk_override_abs5/OldValue" 1 "-" /end COMPU_VTAB
/begin COMPU_VTAB CompuVtab_89 "" TAB_VERB 2 0 "Mooventure2016_Rev5/Foreground/Inputs/Analog Inputs/Throttle Position/motohawk_override_abs12/NewValue" 1 "-" /end COMPU_VTAB
/begin COMPU_VTAB CompuVtab_90 "" TAB_VERB 2 0 "Mooventure2016_Rev5/Foreground/Inputs/CAN Gateway In/motohawk_override_abs1/NewValue" 1 "-" /end COMPU_VTAB
/begin COMPU_VTAB CompuVtab_91 "" TAB_VERB 2 0 "Mooventure2016_Rev5/Foreground/Inputs/Analog Inputs/Throttle Position/motohawk_override_abs12/OldValue" 1 "-" /end COMPU_VTAB
/begin COMPU_VTAB CompuVtab_92 "" TAB_VERB 2 0 "Mooventure2016_Rev5/Foreground/Inputs/Analog Inputs/Coolant/motohawk_override_abs1/NewValue" 1 "-" /end COMPU_VTAB
/begin COMPU_VTAB CompuVtab_93 "" TAB_VERB 2 0 "Mooventure2016_Rev5/Foreground/Inputs/CAN Gateway In/motohawk_override_abs1/OldValue" 1 "-" /end COMPU_VTAB
/begin COMPU_VTAB CompuVtab_94 "" TAB_VERB 2 0 "Mooventure2016_Rev5/Foreground/Inputs/Battery_Inputs/motohawk_override_abs/NewValue" 1 "-" /end COMPU_VTAB
/begin COMPU_VTAB CompuVtab_95 "" TAB_VERB 2 0 "Mooventure2016_Rev5/Foreground/Inputs/Analog Inputs/Coolant/motohawk_override_abs1/OldValue" 1 "-" /end COMPU_VTAB
/begin COMPU_VTAB CompuVtab_96 "" TAB_VERB 2 0 "Mooventure2016_Rev5/Foreground/Inputs/CAN Gateway In/motohawk_override_abs2/NewValue" 1 "-" /end COMPU_VTAB
/begin COMPU_VTAB CompuVtab_97 "" TAB_VERB 2 0 "Mooventure2016_Rev5/Foreground/Inputs/Battery_Inputs/motohawk_override_abs/OldValue" 1 "-" /end COMPU_VTAB
/begin COMPU_VTAB CompuVtab_98 "" TAB_VERB 2 0 "Mooventure2016_Rev5/Foreground/Inputs/Analog Inputs/Coolant/motohawk_override_abs12/NewValue" 1 "-" /end COMPU_VTAB
/begin COMPU_VTAB CompuVtab_99 "" TAB_VERB 2 0 "Mooventure2016_Rev5/Foreground/Inputs/CAN Gateway In/motohawk_override_abs2/OldValue" 1 "-" /end COMPU_VTAB
/begin COMPU_VTAB CompuVtab_100 "" TAB_VERB 2 0 "Mooventure2016_Rev5/Foreground/Inputs/Battery_Inputs/motohawk_override_abs2/NewValue" 1 "-" /end COMPU_VTAB
/begin COMPU_VTAB CompuVtab_101 "" TAB_VERB 2 0 "Mooventure2016_Rev5/Foreground/Inputs/Analog Inputs/Coolant/motohawk_override_abs12/OldValue" 1 "-" /end COMPU_VTAB
/begin COMPU_VTAB CompuVtab_102 "" TAB_VERB 2 0 "Mooventure2016_Rev5/Foreground/Inputs/Battery_Inputs/motohawk_override_abs2/OldValue" 1 "-" /end COMPU_VTAB
/begin COMPU_VTAB CompuVtab_103 "" TAB_VERB 2 0 "Mooventure2016_Rev5/Foreground/Inputs/Analog Inputs/Coolant/motohawk_override_abs2/NewValue" 1 "-" /end COMPU_VTAB
/begin COMPU_VTAB CompuVtab_104 "" TAB_VERB 2 0 "Mooventure2016_Rev5/Foreground/Inputs/Analog Inputs/Coolant/motohawk_override_abs2/OldValue" 1 "-" /end COMPU_VTAB
/begin COMPU_VTAB CompuVtab_105 "" TAB_VERB 2 0 "Mooventure2016_Rev5/Foreground/Inputs/Driver Inputs/motohawk_override_abs3/OldValue" 1 "-" /end COMPU_VTAB
/begin COMPU_VTAB CompuVtab_106 "" TAB_VERB 2 0 "Mooventure2016_Rev5/Foreground/Inputs/Driver Inputs/motohawk_override_abs11/NewValue" 1 "-" /end COMPU_VTAB
/begin COMPU_VTAB CompuVtab_107 "" TAB_VERB 2 0 "Mooventure2016_Rev5/Foreground/Inputs/Driver Inputs/motohawk_override_abs5/NewValue" 1 "-" /end COMPU_VTAB
/begin COMPU_VTAB CompuVtab_108 "" TAB_VERB 2 0 "Mooventure2016_Rev5/Foreground/Inputs/Driver Inputs/motohawk_override_abs11/OldValue" 1 "-" /end COMPU_VTAB
/begin COMPU_VTAB CompuVtab_109 "" TAB_VERB 2 0 "Mooventure2016_Rev5/Foreground/Inputs/Driver Inputs/motohawk_override_abs5/OldValue" 1 "-" /end COMPU_VTAB
/begin COMPU_VTAB CompuVtab_110 "" TAB_VERB 2 0 "Mooventure2016_Rev5/Foreground/Inputs/Driver Inputs/motohawk_override_abs12/NewValue" 1 "-" /end COMPU_VTAB
/begin COMPU_VTAB CompuVtab_111 "" TAB_VERB 2 0 "Mooventure2016_Rev5/Foreground/Inputs/Driver Inputs/motohawk_override_abs12/OldValue" 1 "-" /end COMPU_VTAB
/begin COMPU_VTAB CompuVtab_112 "" TAB_VERB 2 0 "Mooventure2016_Rev5/Foreground/Inputs/Cruise Control/motohawk_override_abs3/NewValue" 1 "-" /end COMPU_VTAB
/begin COMPU_VTAB CompuVtab_113 "" TAB_VERB 2 0 "Mooventure2016_Rev5/Foreground/Inputs/Cruise Control/motohawk_override_abs3/OldValue" 1 "-" /end COMPU_VTAB
/begin COMPU_VTAB CompuVtab_114 "" TAB_VERB 2 0 "Mooventure2016_Rev5/Foreground/Inputs/Driver Inputs/motohawk_override_abs6/NewValue" 1 "-" /end COMPU_VTAB
/begin COMPU_VTAB CompuVtab_115 "" TAB_VERB 2 0 "Mooventure2016_Rev5/Foreground/Inputs/Cruise Control/motohawk_override_abs4/NewValue" 1 "-" /end COMPU_VTAB
/begin COMPU_VTAB CompuVtab_116 "" TAB_VERB 2 0 "Mooventure2016_Rev5/Foreground/Inputs/Driver Inputs/motohawk_override_abs6/OldValue" 1 "-" /end COMPU_VTAB
/begin COMPU_VTAB CompuVtab_117 "" TAB_VERB 2 0 "Mooventure2016_Rev5/Foreground/Inputs/Driver Inputs/motohawk_override_abs13/NewValue" 1 "-" /end COMPU_VTAB
/begin COMPU_VTAB CompuVtab_118 "" TAB_VERB 2 0 "Mooventure2016_Rev5/Foreground/Inputs/Cruise Control/motohawk_override_abs4/OldValue" 1 "-" /end COMPU_VTAB
/begin COMPU_VTAB CompuVtab_119 "" TAB_VERB 2 0 "Mooventure2016_Rev5/Foreground/Inputs/Driver Inputs/motohawk_override_abs7/NewValue" 1 "-" /end COMPU_VTAB
/begin COMPU_VTAB CompuVtab_120 "" TAB_VERB 2 0 "Mooventure2016_Rev5/Foreground/Inputs/Driver Inputs/motohawk_override_abs13/OldValue" 1 "-" /end COMPU_VTAB
/begin COMPU_VTAB CompuVtab_121 "" TAB_VERB 2 0 "Mooventure2016_Rev5/Foreground/Inputs/Cruise Control/motohawk_override_abs5/NewValue" 1 "-" /end COMPU_VTAB
/begin COMPU_VTAB CompuVtab_122 "" TAB_VERB 2 0 "Mooventure2016_Rev5/Foreground/Inputs/Driver Inputs/motohawk_override_abs7/OldValue" 1 "-" /end COMPU_VTAB
/begin COMPU_VTAB CompuVtab_123 "" TAB_VERB 2 0 "Mooventure2016_Rev5/Foreground/Inputs/Driver Inputs/motohawk_override_abs14/NewValue" 1 "-" /end COMPU_VTAB
/begin COMPU_VTAB CompuVtab_124 "" TAB_VERB 2 0 "Mooventure2016_Rev5/Foreground/Inputs/Cruise Control/motohawk_override_abs5/OldValue" 1 "-" /end COMPU_VTAB
/begin COMPU_VTAB CompuVtab_125 "" TAB_VERB 2 0 "Mooventure2016_Rev5/Foreground/Inputs/Driver Inputs/motohawk_override_abs8/NewValue" 1 "-" /end COMPU_VTAB
/begin COMPU_VTAB CompuVtab_126 "" TAB_VERB 2 0 "Mooventure2016_Rev5/Foreground/Inputs/Driver Inputs/motohawk_override_abs14/OldValue" 1 "-" /end COMPU_VTAB
/begin COMPU_VTAB CompuVtab_127 "" TAB_VERB 2 0 "Mooventure2016_Rev5/Foreground/Inputs/Driver Inputs/motohawk_override_abs1/NewValue" 1 "-" /end COMPU_VTAB
/begin COMPU_VTAB CompuVtab_128 "" TAB_VERB 2 0 "Mooventure2016_Rev5/Foreground/Inputs/Driver Inputs/motohawk_override_abs8/OldValue" 1 "-" /end COMPU_VTAB
/begin COMPU_VTAB CompuVtab_129 "" TAB_VERB 2 0 "Mooventure2016_Rev5/Foreground/Inputs/Driver Inputs/motohawk_override_abs2/NewValue" 1 "-" /end COMPU_VTAB
/begin COMPU_VTAB CompuVtab_130 "" TAB_VERB 2 0 "Mooventure2016_Rev5/Foreground/Inputs/Driver Inputs/motohawk_override_abs1/OldValue" 1 "-" /end COMPU_VTAB
/begin COMPU_VTAB CompuVtab_131 "" TAB_VERB 2 0 "Mooventure2016_Rev5/Foreground/Inputs/Driver Inputs/motohawk_override_abs9/NewValue" 1 "-" /end COMPU_VTAB
/begin COMPU_VTAB CompuVtab_132 "" TAB_VERB 2 0 "Mooventure2016_Rev5/Foreground/Inputs/Driver Inputs/motohawk_override_abs2/OldValue" 1 "-" /end COMPU_VTAB
/begin COMPU_VTAB CompuVtab_133 "" TAB_VERB 2 0 "Mooventure2016_Rev5/Foreground/Inputs/Driver Inputs/motohawk_override_abs10/NewValue" 1 "-" /end COMPU_VTAB
/begin COMPU_VTAB CompuVtab_134 "" TAB_VERB 2 0 "Mooventure2016_Rev5/Foreground/Inputs/Driver Inputs/motohawk_override_abs9/OldValue" 1 "-" /end COMPU_VTAB
/begin COMPU_VTAB CompuVtab_135 "" TAB_VERB 2 0 "Mooventure2016_Rev5/Foreground/Inputs/Driver Inputs/motohawk_override_abs3/NewValue" 1 "-" /end COMPU_VTAB
/begin COMPU_VTAB CompuVtab_136 "" TAB_VERB 2 0 "Mooventure2016_Rev5/Foreground/Inputs/Driver Inputs/motohawk_override_abs10/OldValue" 1 "-" /end COMPU_VTAB
/begin COMPU_VTAB CompuVtab_137 "" TAB_VERB 2 0 "Mooventure2016_Rev5/Foreground/Inputs/Eaton Charger/motohawk_override_abs3/OldValue" 1 "-" /end COMPU_VTAB
/begin COMPU_VTAB CompuVtab_138 "" TAB_VERB 2 0 "Mooventure2016_Rev5/Foreground/Inputs/Eaton Charger/motohawk_override_abs1/NewValue" 1 "-" /end COMPU_VTAB
/begin COMPU_VTAB CompuVtab_139 "" TAB_VERB 2 0 "Mooventure2016_Rev5/Foreground/Inputs/Eaton Charger/motohawk_override_abs1/OldValue" 1 "-" /end COMPU_VTAB
/begin COMPU_VTAB CompuVtab_140 "" TAB_VERB 2 0 "Mooventure2016_Rev5/Foreground/Inputs/Eaton Charger/motohawk_override_abs9/NewValue" 1 "-" /end COMPU_VTAB
/begin COMPU_VTAB CompuVtab_141 "" TAB_VERB 2 0 "Mooventure2016_Rev5/Foreground/Inputs/Eaton Charger/motohawk_override_abs9/OldValue" 1 "-" /end COMPU_VTAB
/begin COMPU_VTAB CompuVtab_142 "" TAB_VERB 2 0 "Mooventure2016_Rev5/Foreground/Inputs/Eaton Charger/motohawk_override_abs4/NewValue" 1 "-" /end COMPU_VTAB
/begin COMPU_VTAB CompuVtab_143 "" TAB_VERB 2 0 "Mooventure2016_Rev5/Foreground/Inputs/Engine Inputs/motohawk_override_abs1/NewValue" 1 "-" /end COMPU_VTAB
/begin COMPU_VTAB CompuVtab_144 "" TAB_VERB 2 0 "Mooventure2016_Rev5/Foreground/Inputs/Eaton Charger/motohawk_override_abs4/OldValue" 1 "-" /end COMPU_VTAB
/begin COMPU_VTAB CompuVtab_145 "" TAB_VERB 2 0 "Mooventure2016_Rev5/Foreground/Inputs/Eaton Charger/motohawk_override_abs10/NewValue" 1 "-" /end COMPU_VTAB
/begin COMPU_VTAB CompuVtab_146 "" TAB_VERB 2 0 "Mooventure2016_Rev5/Foreground/Inputs/Engine Inputs/motohawk_override_abs1/OldValue" 1 "-" /end COMPU_VTAB
/begin COMPU_VTAB CompuVtab_147 "" TAB_VERB 2 0 "Mooventure2016_Rev5/Foreground/Inputs/Eaton Charger/motohawk_override_abs5/NewValue" 1 "-" /end COMPU_VTAB
/begin COMPU_VTAB CompuVtab_148 "" TAB_VERB 2 0 "Mooventure2016_Rev5/Foreground/Inputs/Eaton Charger/motohawk_override_abs10/OldValue" 1 "-" /end COMPU_VTAB
/begin COMPU_VTAB CompuVtab_149 "" TAB_VERB 2 0 "Mooventure2016_Rev5/Foreground/Inputs/Engine Inputs/motohawk_override_abs2/NewValue" 1 "-" /end COMPU_VTAB
/begin COMPU_VTAB CompuVtab_150 "" TAB_VERB 2 0 "Mooventure2016_Rev5/Foreground/Inputs/Eaton Charger/motohawk_override_abs5/OldValue" 1 "-" /end COMPU_VTAB
/begin COMPU_VTAB CompuVtab_151 "" TAB_VERB 2 0 "Mooventure2016_Rev5/Foreground/Inputs/Eaton Charger/motohawk_override_abs11/NewValue" 1 "-" /end COMPU_VTAB
/begin COMPU_VTAB CompuVtab_152 "" TAB_VERB 2 0 "Mooventure2016_Rev5/Foreground/Inputs/Engine Inputs/motohawk_override_abs2/OldValue" 1 "-" /end COMPU_VTAB
/begin COMPU_VTAB CompuVtab_153 "" TAB_VERB 2 0 "Mooventure2016_Rev5/Foreground/Inputs/Eaton Charger/motohawk_override_abs6/NewValue" 1 "-" /end COMPU_VTAB
/begin COMPU_VTAB CompuVtab_154 "" TAB_VERB 2 0 "Mooventure2016_Rev5/Foreground/Inputs/Eaton Charger/motohawk_override_abs11/OldValue" 1 "-" /end COMPU_VTAB
/begin COMPU_VTAB CompuVtab_155 "" TAB_VERB 2 0 "Mooventure2016_Rev5/Foreground/Inputs/Engine Inputs/motohawk_override_abs3/NewValue" 1 "-" /end COMPU_VTAB
/begin COMPU_VTAB CompuVtab_156 "" TAB_VERB 2 0 "Mooventure2016_Rev5/Foreground/Inputs/Eaton Charger/motohawk_override_abs6/OldValue" 1 "-" /end COMPU_VTAB
/begin COMPU_VTAB CompuVtab_157 "" TAB_VERB 2 0 "Mooventure2016_Rev5/Foreground/Inputs/Eaton Charger/motohawk_override_abs12/NewValue" 1 "-" /end COMPU_VTAB
/begin COMPU_VTAB CompuVtab_158 "" TAB_VERB 2 0 "Mooventure2016_Rev5/Foreground/Inputs/Engine Inputs/motohawk_override_abs3/OldValue" 1 "-" /end COMPU_VTAB
/begin COMPU_VTAB CompuVtab_159 "" TAB_VERB 2 0 "Mooventure2016_Rev5/Foreground/Inputs/Eaton Charger/motohawk_override_abs7/NewValue" 1 "-" /end COMPU_VTAB
/begin COMPU_VTAB CompuVtab_160 "" TAB_VERB 2 0 "Mooventure2016_Rev5/Foreground/Inputs/Eaton Charger/motohawk_override_abs12/OldValue" 1 "-" /end COMPU_VTAB
/begin COMPU_VTAB CompuVtab_161 "" TAB_VERB 2 0 "Mooventure2016_Rev5/Foreground/Inputs/Engine Inputs/motohawk_override_abs4/NewValue" 1 "-" /end COMPU_VTAB
/begin COMPU_VTAB CompuVtab_162 "" TAB_VERB 2 0 "Mooventure2016_Rev5/Foreground/Inputs/Eaton Charger/motohawk_override_abs7/OldValue" 1 "-" /end COMPU_VTAB
/begin COMPU_VTAB CompuVtab_163 "" TAB_VERB 2 0 "Mooventure2016_Rev5/Foreground/Inputs/Eaton Charger/motohawk_override_abs2/NewValue" 1 "-" /end COMPU_VTAB
/begin COMPU_VTAB CompuVtab_164 "" TAB_VERB 2 0 "Mooventure2016_Rev5/Foreground/Inputs/Engine Inputs/motohawk_override_abs4/OldValue" 1 "-" /end COMPU_VTAB
/begin COMPU_VTAB CompuVtab_165 "" TAB_VERB 2 0 "Mooventure2016_Rev5/Foreground/Inputs/Eaton Charger/motohawk_override_abs8/NewValue" 1 "-" /end COMPU_VTAB
/begin COMPU_VTAB CompuVtab_490 "" TAB_VERB 3 0 "Calculated" 1 "ABS" 2 "None" /end COMPU_VTAB
/*~~~~~~~~~ 6.3.65 FUNCTIONs ~~~~~~~~~*/
/begin FUNCTION Version ""
 /begin DEF_CHARACTERISTIC SwIdTxt CalIdTxt SwRevisionTxt FriendlyName CompilerVersion MatlabVersionTxt MotoCoderVersionTxt MotoHawkBuildGUID MotoHawkModelGUID MotoHawkModelName MotoHawkTokenGUID MotoHawkVersionTxt /end DEF_CHARACTERISTIC
 /begin OUT_MEASUREMENT project_id ProductID MotoHawkModelSecondsInUse /end OUT_MEASUREMENT
/end FUNCTION
/begin FUNCTION System ""
 /begin SUB_FUNCTION Version Tool_Interface Module Performance Memory Debug CCP System_Config Code_Coverage Main_Power_Relay NonVolatile_Storage Status /end SUB_FUNCTION
/end FUNCTION
/begin FUNCTION Tool_Interface ""
 /begin OUT_MEASUREMENT table_0_rev table_1_rev table_2_rev Protocol_KeySuite_Rev EriRev table_3_rev table_4_rev table_5_rev table_6_rev table_7_rev MotProgRev /end OUT_MEASUREMENT
/end FUNCTION
/begin FUNCTION Module "" /begin DEF_CHARACTERISTIC SerialNumber ModelNumber PartNumber /end DEF_CHARACTERISTIC
 /begin OUT_MEASUREMENT BootVerMaj BootVerMin EcuHwMaj EcuHwMin ApplicationCompatibilityArr Capability /end OUT_MEASUREMENT
/end FUNCTION
/begin FUNCTION ABS_217_AgeCount_Ovr_Override "" /begin DEF_CHARACTERISTIC ABS_217_AgeCount_Ovr_new ABS_217_AgeCount_Ovr_ovr /end DEF_CHARACTERISTIC /end FUNCTION
/begin FUNCTION ABS ""
 /begin OUT_MEASUREMENT ABS_217_AgeCount_Prb ABS_417_AgeCount_Prb ABS_4B0_AgeCount_Prb Front_left_whl_speed_Prb Front_right_whl_speed_Prb LF_Wheel_Rolling_Count_Prb Rear_left_whl_speed_Prb Rear_right_whl_speed_Prb RT_Wheel_Rolling_Count_Prb TCS_ENG_EVNT_IN_PROGRESS_Prb Wheel_Rolling_Timestamp_Prb /end OUT_MEASUREMENT
 /begin SUB_FUNCTION ABS_217_AgeCount_Ovr_Override ABS_417_AgeCount_Ovr_Override ABS_4B0_AgeCount_Ovr_Override Front_left_whl_speed_Ovr_Override Front_right_whl_speed_Ovr_Override LF_Wheel_Rolling_Count_Ovr_Override Rear_left_whl_speed_Ovr_Override Rear_right_whl_speed_Ovr_Override RT_Wheel_Rolling_Count_Ovr_Override TCS_ENG_EVNT_IN_PROGRESS_Ovr_Override Wheel_Rolling_Timestamp_Ovr_Override /end SUB_FUNCTION
/end FUNCTION
/begin FUNCTION Inputs ""
 /begin SUB_FUNCTION ABS CAN_Gateway_In Battery_Inputs IPT_CAN_Inputs Driver_Inputs Eaton_Charger Cruise_Control_1 Analog_Inputs Engine_Inputs Charger_Param Steering_Wheel /end SUB_FUNCTION
/end FUNCTION
/begin FUNCTION Foreground "" /begin DEF_CHARACTERISTIC Torque_Enable Vehicle_Enable Vehicle_Ready /end DEF_CHARACTERISTIC /begin SUB_FUNCTION Inputs Control Outputs /end SUB_FUNCTION /end FUNCTION
/begin FUNCTION Mooventure2016_Rev5 "" /begin SUB_FUNCTION Foreground Main_Power_Relay1 /end SUB_FUNCTION /end FUNCTION
/begin FUNCTION ABS_417_AgeCount_Ovr_Override "" /begin DEF_CHARACTERISTIC ABS_417_AgeCount_Ovr_new ABS_417_AgeCount_Ovr_ovr /end DEF_CHARACTERISTIC /end FUNCTION
/begin FUNCTION ABS_4B0_AgeCount_Ovr_Override "" /begin DEF_CHARACTERISTIC ABS_4B0_AgeCount_Ovr_new ABS_4B0_AgeCount_Ovr_ovr /end DEF_CHARACTERISTIC /end FUNCTION
/begin FUNCTION CAN ""
 /begin DEF_CHARACTERISTIC ABS_ToneRing_AgeCount_Fault ABS_Traction_Control_AgeCount_Fault ABS_WheelSpeed_AgeCount_Fault Battery_AgeCount_Fault Brakes_AgeCount_Fault Eaton_Charger_AgeCount_Fault IPT_DCDC_AgeCount_Fault IPT_Status1_AgeCount_Fault IPT_Status2_AgeCount_Fault Steering_Wheel_AgeCount_Fault Transmission_AgeCount_Fault /end DEF_CHARACTERISTIC
 /begin OUT_MEASUREMENT CAN1_Bus_Passive_Prb CAN1_RX_Error_Prb CAN1_TX_Error_Prb CAN2_Bus_Passive_Prb CAN2_RX_Error_Prb CAN2_TX_Error_Prb CAN3_Bus_Passive_Prb CAN3_RX_Error_Prb CAN3_TX_Error_Prb /end OUT_MEASUREMENT
/end FUNCTION
/begin FUNCTION Faults "" /begin SUB_FUNCTION CAN Accesories Power_Train Freeze_Frame Battery_1 /end SUB_FUNCTION /end FUNCTION
/begin FUNCTION Control ""
 /begin SUB_FUNCTION Faults Hybrid_Control_Code Vehicle_Run_Stop_Determination Battery Coolant_Control Engine_Control /end SUB_FUNCTION
/end FUNCTION
/begin FUNCTION ABS_Ramp_Control "" /begin DEF_CHARACTERISTIC Min_Torque_ABS Ramp_In_Rate_ABS Ramp_Out_Rate_ABS /end DEF_CHARACTERISTIC /begin OUT_MEASUREMENT ABS_Trq_Out_Prb /end OUT_MEASUREMENT /end FUNCTION
/begin FUNCTION Traction_Control "" /begin DEF_CHARACTERISTIC Traction_Control_Model /end DEF_CHARACTERISTIC /begin OUT_MEASUREMENT Traction_Control_Trq_Out_Prb /end OUT_MEASUREMENT
 /begin SUB_FUNCTION ABS_Ramp_Control Traction_Control_Event_Needed CALC_Ramp_Control /end SUB_FUNCTION
/end FUNCTION
/begin FUNCTION Hybrid_Control_Code "" /begin DEF_CHARACTERISTIC Hybrid_State /end DEF_CHARACTERISTIC /begin OUT_MEASUREMENT HybridStateProbe /end OUT_MEASUREMENT
 /begin SUB_FUNCTION Traction_Control CrawlHomeMode EcoMode SUVMode Hybrid_state_limits1 Cruise_Control IPT HybridStateOverride_Override /end SUB_FUNCTION
/end FUNCTION
/begin FUNCTION AC_Cmd_Ovr_Override "" /begin DEF_CHARACTERISTIC AC_Cmd_Ovr_new AC_Cmd_Ovr_ovr /end DEF_CHARACTERISTIC /end FUNCTION
/begin FUNCTION CAN_Gateway_In "" /begin OUT_MEASUREMENT AC_Cmd_Prb Defrost_Mode_Prb /end OUT_MEASUREMENT /begin SUB_FUNCTION AC_Cmd_Ovr_Override Defrost_Mode_Ovr_Override /end SUB_FUNCTION /end FUNCTION
/begin FUNCTION AC_Command_Ovr_Override "" /begin DEF_CHARACTERISTIC AC_Command_Ovr_new AC_Command_Ovr_ovr /end DEF_CHARACTERISTIC /end FUNCTION
/begin FUNCTION CAN_Gateway_Out "" /begin OUT_MEASUREMENT AC_Command_Prb Defrost_Prb /end OUT_MEASUREMENT /begin SUB_FUNCTION AC_Command_Ovr_Override Defrost_Ovr_Override /end SUB_FUNCTION /end FUNCTION
/begin FUNCTION Outputs ""
 /begin SUB_FUNCTION CAN_Gateway_Out ABS_Outputs Battery_Outputs Driver_Ouputs EatonCharger DistributionBox Coolant_Outputs Engine_Outputs IPT_Outputs /end SUB_FUNCTION
/end FUNCTION
/begin FUNCTION ACC_torq_rqstd_ovr_Override "" /begin DEF_CHARACTERISTIC ACC_torq_rqstd_ovr_new ACC_torq_rqstd_ovr_ovr /end DEF_CHARACTERISTIC /end FUNCTION
/begin FUNCTION ABS_Outputs ""
 /begin DEF_CHARACTERISTIC Commanded_gen_trq Commanded_motor_trq_div Engine_On Max_Motor_Torque Max_Regen_Torque /end DEF_CHARACTERISTIC
 /begin OUT_MEASUREMENT ACC_torq_rqstd_prb Commanded_gen_torq_Prb Commanded_motor_torq_Prb Engine_On_ABS_Prb Pct_whl_trq_cmd_prb Power_train_torq_actual_prb prndl_dir_prb regen_torq_limit_prb /end OUT_MEASUREMENT
 /begin SUB_FUNCTION ACC_torq_rqstd_ovr_Override Commanded_gen_torq_Ovr_Override Commanded_motor_torq_Ovr_Override Engine_On_ABS_Ovr_Override Pct_whl_trq_desired_ovr_Override Power_train_torq_actual_ovr_Override prndl_dir_ovr_Override regen_torq_limit_ovr_Override /end SUB_FUNCTION
/end FUNCTION
/begin FUNCTION CrawlHomeMode ""
 /begin DEF_CHARACTERISTIC accelEnd_Pedal_crawlMode accelStart_Pedal_crawlMode brakeEnd_Pedal_crawlMode brakeStart_Pedal_crawlMode crawlMode_Accel_MapTbl crawlMode_Brake_MapTbl dragTorque_crawlMode driveMaxTorque_crawlMode regenEnd_Speed_crawlMode regenMaxTorque_crawlMode regenStart_Speed_crawlMode RPM_to_Wheel_Speed_Multiplier_crawlMode /end DEF_CHARACTERISTIC
 /begin OUT_MEASUREMENT Brake_Pedal_Prb_crawlMode crawlMode_Accel_Map crawlMode_AccelIdx crawlMode_AccelIn crawlMode_Brake_Map crawlMode_BrakeIdx crawlMode_BrakeIn driveTorque_Prb_crawlMode Gas_Pedal_Prb_crawlMode regenTorque_Prb_crawlMode /end OUT_MEASUREMENT
/end FUNCTION
/begin FUNCTION EcoMode ""
 /begin DEF_CHARACTERISTIC accelEnd_Pedal_ecoMode accelStart_Pedal_ecoMode brakeEnd_Pedal_ecoMode brakeStart_Pedal_ecoMode dragTorque_ecoMode driveMaxTorque_ecoMode EcoMode_Accel_MapTbl EcoMode_Brake_MapTbl regenEnd_Speed_ecoMode regenMaxTorque_ecoMode regenStart_Speed_ecoMode RPM_to_Wheel_Speed_Multiplier_ecoMode /end DEF_CHARACTERISTIC
 /begin OUT_MEASUREMENT Brake_Pedal_Prb_EcoMode driveTorque_Prb_ecoMode EcoMode_Accel_Map EcoMode_AccelIdx EcoMode_AccelIn EcoMode_Brake_Map EcoMode_BrakeIdx EcoMode_BrakeIn Gas_Pedal_Prb_EcoMode regenTorque_Prb_ecoMode /end OUT_MEASUREMENT
/end FUNCTION
/begin FUNCTION SUVMode ""
 /begin DEF_CHARACTERISTIC accelEnd_Pedal_SUVMode accelStart_Pedal_SUVMode brakeEnd_Pedal_SUVMode brakeStart_Pedal_SUVMode dragTorque_SUVMode driveMaxTorque_SUVMode regenEnd_Speed_SUVMode regenMaxTorque_SUVMode regenStart_Speed_SUVMode RPM_to_Wheel_Speed_Multiplier_SUVMode SUVMode_Accel_MapTbl SUVMode_Brake_MapTbl /end DEF_CHARACTERISTIC
 /begin OUT_MEASUREMENT Brake_Pedal_Prb_SUVMode driveTorque_Prb_SUVMode Gas_Pedal_Prb_SUVMode regenTorque_Prb_SUVMode SUVMode_Accel_Map SUVMode_AccelIdx SUVMode_AccelIn SUVMode_Brake_Map SUVMode_BrakeIdx SUVMode_BrakeIn /end OUT_MEASUREMENT
/end FUNCTION
/begin FUNCTION Battery_Inputs ""
 /begin OUT_MEASUREMENT ActiveDTC BatteryCurrent BatteryVoltage BusVoltage CellBalanceingActive CoolantTemperature DPI_RollingCounter HVIL_Status IsolationLevel IsolationStatus JCS_PackIdentifier LifeTimeAmpHoursOut LTAHI_RollingCounter MaxCellTemperature MaxCellVoltage MaximumDischargePower_10s MaximumDischargePower_Continuous MaximumRegenPower_10s MaximumRegenPower_Continuous MILState MinCellTemperature MinCellVoltage PackState PPL10s_RollingCounter PPLCont_RollingCounter PrechargeState PS_RollingCounter PVC_RollingCounter SleepInhibited StateOfCharge StateOfChargeMax StateOfChargeMin TAH_RollingCounter TripAmpHoursIn TripAmpHoursOut WakeSignal /end OUT_MEASUREMENT
 /begin SUB_FUNCTION Batt_Age_Count_ovr_Override Batt_Coolant_Temp_ovr_Override Batt_Current_ovr_Override Battery_Voltage_ovr_Override Pack_State_ovr_Override SOC_Filter Voltage_Filter /end SUB_FUNCTION
/end FUNCTION
/begin FUNCTION Age_Count_260_Ovr_Override "" /begin DEF_CHARACTERISTIC Age_Count_260_Ovr_new Age_Count_260_Ovr_ovr /end DEF_CHARACTERISTIC /end FUNCTION
/begin FUNCTION IPT_CAN_Inputs ""
 /begin OUT_MEASUREMENT Age_Count_260_Prb Age_Count_278_Prb Age_Count_590_Prb Age_Count_624_Prb Altitude_Prb DateTime_Prb GPSQuality_Prb Heading_Prb IPT_Antishudder_Prb IPT_Current_Limit_Prb IPT_Current_Request_Prb IPT_Current_Used_Prb IPT_DC_Error_Category_Prb IPT_DCHV_Bus_Current_Prb IPT_DCLV_Bus_Current_Prb IPT_DCLV_Bus_Voltage_Prb IPT_DCLV_General_Error_Prb IPT_DCLV_Max_Power_Prb IPT_DCLV_On_Prb IPT_Error_Category_Prb IPT_HVDC_Voltage_Prb IPT_Inverter_Temperature_Prb IPT_IPTAwake_Prb IPT_IPTReady_Prb IPT_Max_Torque_Avail_Gen_Prb IPT_Max_Torque_Avail_Motor_Prb IPT_Max_Waste_Available_Prb IPT_Motor_Ready_Prb IPT_Motor_Speed_Prb IPT_Motor_Temperature_Prb IPT_Wheel_Torque_Delivered_Prb Speed_Prb /end OUT_MEASUREMENT
 /begin SUB_FUNCTION Age_Count_260_Ovr_Override Age_Count_278_Ovr_Override Age_Count_590_Ovr_Override Age_Count_624_Ovr_Override Altitude_Ovr_Override DateTime_Ovr_Override GPSQuality_Ovr_Override Heading_Ovr_Override IPT_Antishudder_Ovr_Override IPT_Current_Limit_Ovr_Override IPT_Current_Request_Ovr_Override IPT_Current_Used_Ovr_Override IPT_DC_Error_Category_Ovr_Override IPT_DCHV_Bus_Current_Ovr_Override IPT_DCLV_Bus_Current_Ovr_Override IPT_DCLV_Bus_Voltage_Ovr_Override IPT_DCLV_General_Error_Ovr_Override IPT_DCLV_Max_Power_Ovr_Override IPT_DCLV_On_Ovr_Override IPT_Error_Category_Ovr_Override IPT_HVDC_Voltage_Ovr_Override IPT_Inverter_Temperature_Ovr_Override IPT_IPTAwake_Ovr_Override IPT_IPTReady_Ovr_Override IPT_Max_Torque_Avail_Gen_Ovr_Override IPT_Max_Torque_Avail_Motor_Ovr_Override IPT_Max_Waste_Available_Ovr_Override IPT_Motor_Ready_Ovr_Override IPT_Motor_Speed_Ovr_Override IPT_Motor_Temperature_Ovr_Override IPT_Wheel_Torque_Delivered_Ovr_Override Speed_Ovr_Override /end SUB_FUNCTION
/end FUNCTION
/begin FUNCTION Age_Count_278_Ovr_Override "" /begin DEF_CHARACTERISTIC Age_Count_278_Ovr_new Age_Count_278_Ovr_ovr /end DEF_CHARACTERISTIC /end FUNCTION
/begin FUNCTION Age_Count_590_Ovr_Override "" /begin DEF_CHARACTERISTIC Age_Count_590_Ovr_new Age_Count_590_Ovr_ovr /end DEF_CHARACTERISTIC /end FUNCTION
/begin FUNCTION Age_Count_624_Ovr_Override "" /begin DEF_CHARACTERISTIC Age_Count_624_Ovr_new Age_Count_624_Ovr_ovr /end DEF_CHARACTERISTIC /end FUNCTION
/begin FUNCTION Altitude_Ovr_Override "" /begin DEF_CHARACTERISTIC Altitude_Ovr_new Altitude_Ovr_ovr /end DEF_CHARACTERISTIC /end FUNCTION
/begin FUNCTION Performance ""
 /begin OUT_MEASUREMENT ApplicationInterruptTaskCPU BGNDTaskCPU CPUIdlePcnt FGNDTaskCPU SHUTDOWNTaskCPU /end OUT_MEASUREMENT
 /begin SUB_FUNCTION ISR /end SUB_FUNCTION
/end FUNCTION
/begin FUNCTION Memory ""
 /begin OUT_MEASUREMENT ApplicationInterruptTaskStackMinBytesFree BGNDTaskStackMinBytesFree FGNDTaskStackMinBytesFree IdleStackMinBytesFree InterruptStackMinBytesFree KernelStackMinBytesFree PeakHeapBytesUsed SHUTDOWNTaskStackMinBytesFree /end OUT_MEASUREMENT
/end FUNCTION
/begin FUNCTION Vehicle_Run_Stop_Determination "" /begin DEF_CHARACTERISTIC Auto_Battery_Startup /end DEF_CHARACTERISTIC /begin OUT_MEASUREMENT Component_Keyed_Prb Dyno_Shutdown_Prb ESTOP2_Prb /end OUT_MEASUREMENT /end FUNCTION
/begin FUNCTION Battery ""
 /begin DEF_CHARACTERISTIC Automatic_Battery_Bootup Batt_Contactor_Status Batt_Load_Enable /end DEF_CHARACTERISTIC
 /begin OUT_MEASUREMENT Batt_Boot_request_fromcontrol_Prb Batt_Shutdown_Request_Prb /end OUT_MEASUREMENT
 /begin SUB_FUNCTION Safe_Shutdown_Sequence Shutdown_ovr_Override /end SUB_FUNCTION
/end FUNCTION
/begin FUNCTION Batt_Age_Count_ovr_Override "" /begin DEF_CHARACTERISTIC Batt_Age_Count_ovr_new Batt_Age_Count_ovr_ovr /end DEF_CHARACTERISTIC /end FUNCTION
/begin FUNCTION Batt_Connect_Cmd_ovr_Override "" /begin DEF_CHARACTERISTIC Batt_Connect_Cmd_ovr_new Batt_Connect_Cmd_ovr_ovr /end DEF_CHARACTERISTIC /end FUNCTION
/begin FUNCTION Battery_Outputs "" /begin DEF_CHARACTERISTIC Batt_Ign_Cal Batt_Isolation_det_Cal /end DEF_CHARACTERISTIC /begin OUT_MEASUREMENT Batt_Connect_Cmd_Probe Isolation_Measure_Enable_Probe /end OUT_MEASUREMENT
 /begin SUB_FUNCTION Batt_Connect_Cmd_ovr_Override Isolation_Measure_Enable_ovr_Override /end SUB_FUNCTION
/end FUNCTION
/begin FUNCTION Batt_Coolant_Temp_ovr_Override "" /begin DEF_CHARACTERISTIC Batt_Coolant_Temp_ovr_new Batt_Coolant_Temp_ovr_ovr /end DEF_CHARACTERISTIC /end FUNCTION
/begin FUNCTION Batt_Current_ovr_Override "" /begin DEF_CHARACTERISTIC Batt_Current_ovr_new Batt_Current_ovr_ovr /end DEF_CHARACTERISTIC /end FUNCTION
/begin FUNCTION Battery_Light_Ovr_Override "" /begin DEF_CHARACTERISTIC Battery_Light_Ovr_new Battery_Light_Ovr_ovr /end DEF_CHARACTERISTIC /end FUNCTION
/begin FUNCTION Driver_Ouputs ""
 /begin DEF_CHARACTERISTIC BCU_Caution BCU_Hazard Dist_Trv Flash_Timer Max_Dist_Travel_In_Sec MPH_to_KMH ODO_INCRE RPM_to_Wheel_Speed_Multiplier SOC_Multiplier SOC_Subtract /end DEF_CHARACTERISTIC
 /begin OUT_MEASUREMENT Battery_Light_Prb BCU_Caution_Prb BCU_Hazard_Prb Check_Engine_Light_Prb Cruise_Ctrl_Light_Prb Current_Prb Eng_Cool_Temp_Prb Engine_Speed_Prb HV_Elec_Sys_Wrn_Prb Me_Cool_Temp_Prb ODO_Count_Prb Ready_Light_Prb Regen_Brakes_Disabled_Prb Repair_Wrench_Prb Vehicle_Speed_Prb /end OUT_MEASUREMENT
 /begin SUB_FUNCTION Battery_Light_Ovr_Override BCU_Caution_Ovr_Override BCU_Hazard_Ovr_Override Check_Engine_Light_Ovr_Override Cruise_Ctrl_Light_Ovr_Override Current_Ovr_Override VIN_Output_and_Button_Probing Eng_Cool_Temp_Ovr_Override Engine_Speed_Ovr_Override HV_Elec_Sys_Wrn_Ovr_Override Me_Cool_Temp_Ovr_Override ODO_Count_Ovr_Override Ready_Light_Ovr_Override Regen_Brakes_Disabled_Ovr_Override Repair_Wrench_Ovr_Override Vehicle_Speed_Ovr_Override /end SUB_FUNCTION
/end FUNCTION
/begin FUNCTION Battery_Voltage_ovr_Override "" /begin DEF_CHARACTERISTIC Battery_Voltage_ovr_new Battery_Voltage_ovr_ovr /end DEF_CHARACTERISTIC /end FUNCTION
/begin FUNCTION Charger ""
 /begin DEF_CHARACTERISTIC Battery_Voltage_Too_High_Fault Battery_Voltage_Too_Low_Fault Charger_Derated_Over_Temperature_Fault Charger_Derated_Under_Temperature_Fault Charger_Line_Voltage_Too_Low_Fault Charger_Line_Votlage_Too_High_Fault Charger_Requested_But_No_High_Voltage_Fault Charger_Requested_Current_Too_High_Fault Charger_Requested_Voltage_Out_of_Bounds_Fault_Lower Charger_Requested_Voltage_Out_of_Bounds_Fault_Upper /end DEF_CHARACTERISTIC
/end FUNCTION
/begin FUNCTION Accesories "" /begin SUB_FUNCTION Charger Blend_Valves DC_DC_Converter HV_Heater_System /end SUB_FUNCTION /end FUNCTION
/begin FUNCTION BCU_Caution_Ovr_Override "" /begin DEF_CHARACTERISTIC BCU_Caution_Ovr_new BCU_Caution_Ovr_ovr /end DEF_CHARACTERISTIC /end FUNCTION
/begin FUNCTION BCU_Hazard_Ovr_Override "" /begin DEF_CHARACTERISTIC BCU_Hazard_Ovr_new BCU_Hazard_Ovr_ovr /end DEF_CHARACTERISTIC /end FUNCTION
/begin FUNCTION Coolant_Control ""
 /begin DEF_CHARACTERISTIC Blend_Pump_On_Threshold Engine_Fan_Offset Heat_On_Driver_Threshold Heat1_Threshold Heat2_Threshold Heat3_Threshold Heat4_Threshold Heater_Core_Threshold High_Threshold Low_Threshold Medium_Threshold Pump_Off_Temp Pump_On_Temp Too_Cold_Temp Warmed_Up_Temp /end DEF_CHARACTERISTIC
 /begin OUT_MEASUREMENT Cooling_Pump_Heater_Core_Probe Cooling_Pump_Radiator_Probe Heat_1_Prb Heat_2_Prb Heat_3_Prb Heat_4_Prb Heater_Core_Blend_Prb Radiator_Blend_Prb Radiator_Fan_Prb /end OUT_MEASUREMENT
 /begin SUB_FUNCTION Cooling_Pump_Heater_Core_Ovr_Override Cooling_Pump_Radiator_Ovr_Override Heat_1_Ovr_Override Heat_2_Ovr_Override Heat_3_Ovr_Override Heat_4_Ovr_Override Heater_Core_Blend_Ovr_Override Radiator_Blend_Ovr_Override Radiator_Fan_Ovr_Override /end SUB_FUNCTION
/end FUNCTION
/begin FUNCTION Blend_Valves ""
 /begin DEF_CHARACTERISTIC Blend_Valve_A_No_Response_Fault Blend_Valve_B_No_Response_Fault Blend_Valve_Sensor_A_High_Voltage_Fault Blend_Valve_Sensor_A_Intermittent_Fault Blend_Valve_Sensor_A_Low_Voltage_Fault Blend_Valve_Sensor_B_High_Voltage_Fault Blend_Valve_Sensor_B_Intermittent_Fault Blend_Valve_Sensor_B_Low_Voltage_Fault /end DEF_CHARACTERISTIC
/end FUNCTION
/begin FUNCTION Brake_Pedal ""
 /begin DEF_CHARACTERISTIC Brake_Pedal_Position_Communication_Loss_Fault Brake_Pedal_Position_High_Fault Brake_Pedal_Position_Intermiitent_Fault Brake_Pedal_Position_Low_Fault /end DEF_CHARACTERISTIC
/end FUNCTION
/begin FUNCTION Power_Train ""
 /begin SUB_FUNCTION Brake_Pedal Cruise_Control_2 Gear_Selector Electric_Motor Ignition_Key Vehicle_Speed_Sensor Gas_Pedal Traction_Control_1 _12V_Battery /end SUB_FUNCTION
/end FUNCTION
/begin FUNCTION Brake_Position_Ovr_Override "" /begin DEF_CHARACTERISTIC Brake_Position_Ovr_new Brake_Position_Ovr_ovr /end DEF_CHARACTERISTIC /end FUNCTION
/begin FUNCTION Driver_Inputs "" /begin DEF_CHARACTERISTIC Brake_Position_TblTbl Throttle_Position_TblTbl /end DEF_CHARACTERISTIC
 /begin OUT_MEASUREMENT Brake_Position_Prb Brake_Position_PreIdx Brake_Position_PreIn Brake_Position_Tbl Brakes_AgeCount_Prb Button_Pressed_Prb Driver_1_Prb Driver_10_Prb Driver_Temp_Prb ecoMode_Prb Passenger_1_Prb Passenger_10_Prb Passenger_Temp_Prb Shift_Position_Raw_Prb Throttle_Position_PreIdx Throttle_Position_PreIn Throttle_Position_Raw_Prb Throttle_Position_Tbl Transmission_AgeCount_Prb /end OUT_MEASUREMENT
 /begin SUB_FUNCTION Brake_Position_Ovr_Override Brakes_AgeCount_Ovr_Override Button_Pressed_Ovr_Override Driver_1_Ovr_Override Driver_10_Ovr_Override Driver_Temp_Ovr_Override ecoMode_Ovr_Override Passenger_1_Ovr_Override Passenger_10_Ovr_Override Passenger_Temp_Ovr_Override Shift_Position_Raw_Ovr_Override Throttle_Position_Raw_Ovr_Override Transmission_AgeCount_Ovr_Override /end SUB_FUNCTION
/end FUNCTION
/begin FUNCTION Brakes_AgeCount_Ovr_Override "" /begin DEF_CHARACTERISTIC Brakes_AgeCount_Ovr_new Brakes_AgeCount_Ovr_ovr /end DEF_CHARACTERISTIC /end FUNCTION
/begin FUNCTION Button_Pressed_Ovr_Override "" /begin DEF_CHARACTERISTIC Button_Pressed_Ovr_new Button_Pressed_Ovr_ovr /end DEF_CHARACTERISTIC /end FUNCTION
/begin FUNCTION Traction_Control_Event_Needed "" /begin DEF_CHARACTERISTIC TC_Event_Time TC_Wheel_Speed_Diff /end DEF_CHARACTERISTIC /begin OUT_MEASUREMENT Calc_Active_Prb Speed_Diff_Prb /end OUT_MEASUREMENT /end FUNCTION
/begin FUNCTION CALC_Ramp_Control "" /begin DEF_CHARACTERISTIC Min_Torque_CALC Ramp_In_Rate_CALC Ramp_Out_Rate_CALC /end DEF_CHARACTERISTIC /begin OUT_MEASUREMENT Calc_Trq_Out_Prb /end OUT_MEASUREMENT /end FUNCTION
/begin FUNCTION CAN_1 ""
 /begin DEF_CHARACTERISTIC CAN_1_TransmitOverrun CAN_2_TransmitOverrun CAN_3_TransmitOverrun /end DEF_CHARACTERISTIC
/end FUNCTION
/begin FUNCTION Debug "" /begin SUB_FUNCTION CAN_1 Memory_1 /end SUB_FUNCTION /end FUNCTION
/begin FUNCTION CCP1 "" /begin DEF_CHARACTERISTIC CCP1_StationAddr CCP1RxID CCP1RxIDMask CCP1TxID /end DEF_CHARACTERISTIC
 /begin OUT_MEASUREMENT CCP_CCP1_Access CCP_CCP1_Access.CCP_CCP1_CAL CCP_CCP1_Access.CCP_CCP1_DAQ CCP_CCP1_Access.CCP_CCP1_PGM CCP_CCP1_ConnectionStatus /end OUT_MEASUREMENT
/end FUNCTION
/begin FUNCTION CCP "" /begin SUB_FUNCTION CCP1 /end SUB_FUNCTION /end FUNCTION
/begin FUNCTION Charge_Complete_Override_Override "" /begin DEF_CHARACTERISTIC Charge_Complete_Override_new Charge_Complete_Override_ovr /end DEF_CHARACTERISTIC /end FUNCTION
/begin FUNCTION EatonCharger ""
 /begin DEF_CHARACTERISTIC Charger_Auto_Start Max_Cell_Voltage_Limit MessageChecksum MessageCounterOutput /end DEF_CHARACTERISTIC
 /begin OUT_MEASUREMENT Charge_Complete_Probe Charge_Enable_Probe Charge_Falt_Probe Current_Limit_Probe Voltage_Limit_Probe /end OUT_MEASUREMENT
 /begin SUB_FUNCTION Charge_Complete_Override_Override Charge_Enable_Override_Override Charge_Falt_Override_Override Current_Limit_Override_Override Voltage_Limit_Override_Override /end SUB_FUNCTION
/end FUNCTION
/begin FUNCTION Charge_Enable_Override_Override "" /begin DEF_CHARACTERISTIC Charge_Enable_Override_new Charge_Enable_Override_ovr /end DEF_CHARACTERISTIC /end FUNCTION
/begin FUNCTION Charge_Falt_Override_Override "" /begin DEF_CHARACTERISTIC Charge_Falt_Override_new Charge_Falt_Override_ovr /end DEF_CHARACTERISTIC /end FUNCTION
/begin FUNCTION Charger_State_Ovr_Override "" /begin DEF_CHARACTERISTIC Charger_State_Ovr_new Charger_State_Ovr_ovr /end DEF_CHARACTERISTIC /end FUNCTION
/begin FUNCTION Eaton_Charger "" /begin DEF_CHARACTERISTIC Eaton_Charging Eaton_Plugged_In /end DEF_CHARACTERISTIC
 /begin OUT_MEASUREMENT Charger_State_Prb Eaton_Charger_AgeCount_Prb Eaton_Charger_Message_Checksum_Prb Eaton_Charger_Message_Counter_Prb Eaton_HV_Charger_Temperature_Prb Fault_Severity_Indiciator_Prb Ignition_Status_Prb Input_Current_Limit_Max_Prb Input_Current_Prb Input_Voltage_Prb Output_Current_Prb Output_Voltage_Prb /end OUT_MEASUREMENT
 /begin SUB_FUNCTION Charger_State_Ovr_Override Eaton_Charger_AgeCount_Ovr_Override Eaton_Charger_Message_Checksum_Ovr_Override Eaton_Charger_Message_Counter_Ovr_Override Eaton_HV_Charger_Temperature_Ovr_Override Fault_Severity_Indicator_Ovr_Override Ignition_Status_Ovr_Override Input_Current_Limit_Max_Ovr_Override Input_Current_Ovr_Override Input_Voltage_Ovr_Override Output_Current_Ovr_Override Output_Voltage_Ovr_Override /end SUB_FUNCTION
/end FUNCTION
/begin FUNCTION Check_Engine_Light_Ovr_Override "" /begin DEF_CHARACTERISTIC Check_Engine_Light_Ovr_new Check_Engine_Light_Ovr_ovr /end DEF_CHARACTERISTIC /end FUNCTION
/begin FUNCTION Communication_Config "" /begin DEF_CHARACTERISTIC CityID_CAN_1 CityID_CAN_2 CityID_CAN_3 /end DEF_CHARACTERISTIC /end FUNCTION
/begin FUNCTION System_Config "" /begin SUB_FUNCTION Communication_Config /end SUB_FUNCTION /end FUNCTION
/begin FUNCTION Code_Coverage ""
 /begin OUT_MEASUREMENT CodeCoverParent000 CodeCoverParent000.CodeCover000029 CodeCoverParent000.CodeCover000018 CodeCoverParent000.CodeCover000007 CodeCoverParent000.CodeCover000019 CodeCoverParent000.CodeCover000008 CodeCoverParent000.CodeCover000009 CodeCoverParent000.CodeCover000030 CodeCoverParent000.CodeCover000031 CodeCoverParent000.CodeCover000020 CodeCoverParent000.CodeCover000021 CodeCoverParent000.CodeCover000010 CodeCoverParent000.CodeCover000022 CodeCoverParent000.CodeCover000011 CodeCoverParent000.CodeCover000000 CodeCoverParent000.CodeCover000023 CodeCoverParent000.CodeCover000012 CodeCoverParent000.CodeCover000001 CodeCoverParent000.CodeCover000024 CodeCoverParent000.CodeCover000013 CodeCoverParent000.CodeCover000002 CodeCoverParent000.CodeCover000025 CodeCoverParent000.CodeCover000014 CodeCoverParent000.CodeCover000003 CodeCoverParent000.CodeCover000026 CodeCoverParent000.CodeCover000015 CodeCoverParent000.CodeCover000004 CodeCoverParent000.CodeCover000027 CodeCoverParent000.CodeCover000016 CodeCoverParent000.CodeCover000005 CodeCoverParent000.CodeCover000028 CodeCoverParent000.CodeCover000017 CodeCoverParent000.CodeCover000006 CodeCoverParent001 CodeCoverParent001.CodeCover000060 CodeCoverParent001.CodeCover000061 CodeCoverParent001.CodeCover000050 CodeCoverParent001.CodeCover000062 CodeCoverParent001.CodeCover000051 CodeCoverParent001.CodeCover000040 CodeCoverParent001.CodeCover000063 CodeCoverParent001.CodeCover000052 CodeCoverParent001.CodeCover000041 CodeCoverParent001.CodeCover000053 CodeCoverParent001.CodeCover000042 CodeCoverParent001.CodeCover000054 CodeCoverParent001.CodeCover000043 CodeCoverParent001.CodeCover000032 CodeCoverParent001.CodeCover000055 CodeCoverParent001.CodeCover000044 CodeCoverParent001.CodeCover000033 CodeCoverParent001.CodeCover000056 CodeCoverParent001.CodeCover000045 CodeCoverParent001.CodeCover000034 CodeCoverParent001.CodeCover000057 CodeCoverParent001.CodeCover000046 CodeCoverParent001.CodeCover000035 CodeCoverParent001.CodeCover000058 CodeCoverParent001.CodeCover000047 CodeCoverParent001.CodeCover000036 CodeCoverParent001.CodeCover000059 CodeCoverParent001.CodeCover000048 CodeCoverParent001.CodeCover000037 CodeCoverParent001.CodeCover000049 CodeCoverParent001.CodeCover000038 CodeCoverParent001.CodeCover000039 CodeCoverParent002 CodeCoverParent002.CodeCover000090 CodeCoverParent002.CodeCover000091 CodeCoverParent002.CodeCover000080 CodeCoverParent002.CodeCover000092 CodeCoverParent002.CodeCover000081 CodeCoverParent002.CodeCover000070 CodeCoverParent002.CodeCover000093 CodeCoverParent002.CodeCover000082 CodeCoverParent002.CodeCover000071 CodeCoverParent002.CodeCover000094 CodeCoverParent002.CodeCover000083 CodeCoverParent002.CodeCover000072 CodeCoverParent002.CodeCover000095 CodeCoverParent002.CodeCover000084 CodeCoverParent002.CodeCover000073 CodeCoverParent002.CodeCover000085 CodeCoverParent002.CodeCover000074 CodeCoverParent002.CodeCover000086 CodeCoverParent002.CodeCover000075 CodeCoverParent002.CodeCover000064 CodeCoverParent002.CodeCover000087 CodeCoverParent002.CodeCover000076 CodeCoverParent002.CodeCover000065 CodeCoverParent002.CodeCover000088 CodeCoverParent002.CodeCover000077 CodeCoverParent002.CodeCover000066 CodeCoverParent002.CodeCover000089 CodeCoverParent002.CodeCover000078 CodeCoverParent002.CodeCover000067 CodeCoverParent002.CodeCover000079 CodeCoverParent002.CodeCover000068 CodeCoverParent002.CodeCover000069 CodeCoverParent003 CodeCoverParent003.CodeCover000117 CodeCoverParent003.CodeCover000106 CodeCoverParent003.CodeCover000118 CodeCoverParent003.CodeCover000107 CodeCoverParent003.CodeCover000119 CodeCoverParent003.CodeCover000108 CodeCoverParent003.CodeCover000109 CodeCoverParent003.CodeCover000096 CodeCoverParent003.CodeCover000097 CodeCoverParent003.CodeCover000120 CodeCoverParent003.CodeCover000098 CodeCoverParent003.CodeCover000121 CodeCoverParent003.CodeCover000110 CodeCoverParent003.CodeCover000099 CodeCoverParent003.CodeCover000122 CodeCoverParent003.CodeCover000111 CodeCoverParent003.CodeCover000100 CodeCoverParent003.CodeCover000123 CodeCoverParent003.CodeCover000112 CodeCoverParent003.CodeCover000101 CodeCoverParent003.CodeCover000124 CodeCoverParent003.CodeCover000113 CodeCoverParent003.CodeCover000102 CodeCoverParent003.CodeCover000125 CodeCoverParent003.CodeCover000114 CodeCoverParent003.CodeCover000103 CodeCoverParent003.CodeCover000126 CodeCoverParent003.CodeCover000115 CodeCoverParent003.CodeCover000104 CodeCoverParent003.CodeCover000127 CodeCoverParent003.CodeCover000116 CodeCoverParent003.CodeCover000105 CodeCoverParent004 CodeCoverParent004.CodeCover000139 CodeCoverParent004.CodeCover000128 CodeCoverParent004.CodeCover000129 CodeCoverParent004.CodeCover000150 CodeCoverParent004.CodeCover000151 CodeCoverParent004.CodeCover000140 CodeCoverParent004.CodeCover000152 CodeCoverParent004.CodeCover000141 CodeCoverParent004.CodeCover000130 CodeCoverParent004.CodeCover000153 CodeCoverParent004.CodeCover000142 CodeCoverParent004.CodeCover000131 CodeCoverParent004.CodeCover000154 CodeCoverParent004.CodeCover000143 CodeCoverParent004.CodeCover000132 CodeCoverParent004.CodeCover000155 CodeCoverParent004.CodeCover000144 CodeCoverParent004.CodeCover000133 CodeCoverParent004.CodeCover000156 CodeCoverParent004.CodeCover000145 CodeCoverParent004.CodeCover000134 CodeCoverParent004.CodeCover000157 CodeCoverParent004.CodeCover000146 CodeCoverParent004.CodeCover000135 CodeCoverParent004.CodeCover000158 CodeCoverParent004.CodeCover000147 CodeCoverParent004.CodeCover000136 CodeCoverParent004.CodeCover000159 CodeCoverParent004.CodeCover000148 /end OUT_MEASUREMENT
/end FUNCTION
/end MODULE
/end PROJECT
