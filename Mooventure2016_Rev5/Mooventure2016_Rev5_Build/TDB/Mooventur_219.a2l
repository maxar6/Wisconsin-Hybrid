ASAP2_VERSION 1 51
/begin PROJECT Project ""
/begin MODULE Mooventur_219 ""
/begin MOD_COMMON /* MOD_COMMON Comment */ "" BYTE_ORDER MSB_FIRST ALIGNMENT_BYTE 1 ALIGNMENT_FLOAT32_IEEE 1 ALIGNMENT_FLOAT64_IEEE 1 ALIGNMENT_LONG 1 ALIGNMENT_WORD 1 /end MOD_COMMON
/begin MEASUREMENT Cruise_Control_PID_PreIdx "" UWORD CompuMethod_12 1 0 0 127.998 ECU_ADDRESS 0x4000029C /end MEASUREMENT
/begin MEASUREMENT Cruise_Control_PID_PreIn "" FLOAT32_IEEE CompuMethod_2 1 0 -1E+17 1E+17 ECU_ADDRESS 0x4000029E /end MEASUREMENT
/begin MEASUREMENT Cruise_Control_Tq_Table "" FLOAT32_IEEE CompuMethod_2 1 0 -1E+17 1E+17 ECU_ADDRESS 0x400002AC /end MEASUREMENT
/begin MEASUREMENT Cruise_Control_VSpeed_PreIdx "" UWORD CompuMethod_12 1 0 0 127.998 ECU_ADDRESS 0x400002B0 /end MEASUREMENT
/begin MEASUREMENT Cruise_Control_VSpeed_PreIn "" FLOAT32_IEEE CompuMethod_2 1 0 -1E+17 1E+17 ECU_ADDRESS 0x400002B2 /end MEASUREMENT
/begin MEASUREMENT CRUISE_DampTerm "PID Damper Term" FLOAT32_IEEE CompuMethod_2 1 0 -1E+17 1E+17 ECU_ADDRESS 0x400002B7 /end MEASUREMENT
/begin MEASUREMENT CRUISE_DTerm "PID Derivative Term" FLOAT32_IEEE CompuMethod_2 1 0 -1E+17 1E+17 ECU_ADDRESS 0x400002BB /end MEASUREMENT
/begin MEASUREMENT CRUISE_Error "PID Error Term" FLOAT32_IEEE CompuMethod_2 1 0 -1E+17 1E+17 ECU_ADDRESS 0x400002BF /end MEASUREMENT
/begin MEASUREMENT CRUISE_ITerm "PID Integrator Term" FLOAT32_IEEE CompuMethod_2 1 0 -1E+17 1E+17 ECU_ADDRESS 0x400002C3 /end MEASUREMENT
/begin MEASUREMENT CRUISE_Out "PID Final Output" FLOAT32_IEEE CompuMethod_2 1 0 -1E+17 1E+17 ECU_ADDRESS 0x400002C7 /end MEASUREMENT
/begin MEASUREMENT CRUISE_PTerm "PID Proportional Term" FLOAT32_IEEE CompuMethod_2 1 0 -1E+17 1E+17 ECU_ADDRESS 0x400002CB /end MEASUREMENT
/begin MEASUREMENT DATA_MODE_1_Prb "" FLOAT32_IEEE CompuMethod_2 1 0 -1E+17 1E+17 ECU_ADDRESS 0x400002D8 /end MEASUREMENT
/begin MEASUREMENT DATA_MODE_2_Prb "" FLOAT32_IEEE CompuMethod_2 1 0 -1E+17 1E+17 ECU_ADDRESS 0x400002DC /end MEASUREMENT
/begin MEASUREMENT DATA_MODE_3_Prb "" FLOAT32_IEEE CompuMethod_2 1 0 -1E+17 1E+17 ECU_ADDRESS 0x400002E0 /end MEASUREMENT
/begin MEASUREMENT DATA_MODE_4_Ovr "" FLOAT32_IEEE CompuMethod_2 1 0 -1E+17 1E+17 ECU_ADDRESS 0x400002E4 /end MEASUREMENT
/begin MEASUREMENT DCDC_Status_Prb "" UWORD CompuMethod_5 1 0 0 65535 ECU_ADDRESS 0x400002EC /end MEASUREMENT
/begin MEASUREMENT Engine_Crank_Prb "" FLOAT32_IEEE CompuMethod_2 1 0 -1E+17 1E+17 ECU_ADDRESS 0x4000033F /end MEASUREMENT
/begin MEASUREMENT Engine_On_Prb "" FLOAT32_IEEE CompuMethod_2 1 0 -1E+17 1E+17 ECU_ADDRESS 0x40000347 /end MEASUREMENT
/begin MEASUREMENT Fault_Prb "" FLOAT32_IEEE CompuMethod_2 1 0 -1E+17 1E+17 ECU_ADDRESS 0x4000035C /end MEASUREMENT
/begin MEASUREMENT FaultActionReason._.Batt_Light "Displays a rolling marquee of the reasons for fault action: FaultActionReason." UBYTE CompuMethod_487 1 0 0 255 ECU_ADDRESS 0x40000361 /end MEASUREMENT
/begin MEASUREMENT FaultActionReason._.Batt_Shutdown "Displays a rolling marquee of the reasons for fault action: FaultActionReason." UBYTE CompuMethod_487 1 0 0 255 ECU_ADDRESS 0x40000362 /end MEASUREMENT
/begin MEASUREMENT FaultActionReason._.Cell_Voltage_Max "Displays a rolling marquee of the reasons for fault action: FaultActionReason." UBYTE CompuMethod_487 1 0 0 255 ECU_ADDRESS 0x40000363 /end MEASUREMENT
/begin MEASUREMENT FaultActionReason._.Check_Engine_Light "Displays a rolling marquee of the reasons for fault action: FaultActionReason." UBYTE CompuMethod_487 1 0 0 255 ECU_ADDRESS 0x40000364 /end MEASUREMENT
/begin MEASUREMENT FaultActionReason._.Check_Engine_Light_Flashing "Displays a rolling marquee of the reasons for fault action: FaultActionReason." UBYTE CompuMethod_487 1 0 0 255 ECU_ADDRESS 0x40000365 /end MEASUREMENT
/begin MEASUREMENT FaultActionReason._.Cooling_Max "Displays a rolling marquee of the reasons for fault action: FaultActionReason." UBYTE CompuMethod_487 1 0 0 255 ECU_ADDRESS 0x40000366 /end MEASUREMENT
/begin MEASUREMENT FaultActionReason._.Cruise "Displays a rolling marquee of the reasons for fault action: FaultActionReason." UBYTE CompuMethod_487 1 0 0 255 ECU_ADDRESS 0x40000367 /end MEASUREMENT
/begin MEASUREMENT FaultActionReason._.Dyno_Shutdown "Displays a rolling marquee of the reasons for fault action: FaultActionReason." UBYTE CompuMethod_487 1 0 0 255 ECU_ADDRESS 0x40000368 /end MEASUREMENT
/begin MEASUREMENT FaultActionReason._.EatonChargerFault "Displays a rolling marquee of the reasons for fault action: FaultActionReason." UBYTE CompuMethod_487 1 0 0 255 ECU_ADDRESS 0x40000369 /end MEASUREMENT
/begin MEASUREMENT FaultActionReason._.HV_Light "Displays a rolling marquee of the reasons for fault action: FaultActionReason." UBYTE CompuMethod_487 1 0 0 255 ECU_ADDRESS 0x4000036A /end MEASUREMENT
/begin MEASUREMENT FaultActionReason._.Pump_On "Displays a rolling marquee of the reasons for fault action: FaultActionReason." UBYTE CompuMethod_487 1 0 0 255 ECU_ADDRESS 0x4000036B /end MEASUREMENT
/begin MEASUREMENT FaultActionReason._.Regen_Brakes_Disabled "Displays a rolling marquee of the reasons for fault action: FaultActionReason." UBYTE CompuMethod_487 1 0 0 255 ECU_ADDRESS 0x4000036C /end MEASUREMENT
/begin MEASUREMENT FaultActionReason._.Set_Crawl_Home "Displays a rolling marquee of the reasons for fault action: FaultActionReason." UBYTE CompuMethod_487 1 0 0 255 ECU_ADDRESS 0x4000036D /end MEASUREMENT
/begin MEASUREMENT FaultActionReason._.Temperature_Flash "Displays a rolling marquee of the reasons for fault action: FaultActionReason." UBYTE CompuMethod_487 1 0 0 255 ECU_ADDRESS 0x4000036E /end MEASUREMENT
/begin MEASUREMENT FaultActionReason._.Temperature_Solid "Displays a rolling marquee of the reasons for fault action: FaultActionReason." UBYTE CompuMethod_487 1 0 0 255 ECU_ADDRESS 0x4000036F /end MEASUREMENT
/begin MEASUREMENT FaultActionReason._.Wrench_Light "Displays a rolling marquee of the reasons for fault action: FaultActionReason." UBYTE CompuMethod_487 1 0 0 255 ECU_ADDRESS 0x40000370 /end MEASUREMENT
/begin MEASUREMENT FaultMarquees.FaultMarquees.Current_Suspected "Displays a rolling marquee for suspected, active and occurred faults." UBYTE CompuMethod_487 1 0 0 255 ECU_ADDRESS 0x40000371 /end MEASUREMENT
/begin MEASUREMENT FaultMarquees.FaultMarquees.Current_Active "Displays a rolling marquee for suspected, active and occurred faults." UBYTE CompuMethod_487 1 0 0 255 ECU_ADDRESS 0x40000372 /end MEASUREMENT
/begin MEASUREMENT FaultMarquees.FaultMarquees.Current_Occurred "Displays a rolling marquee for suspected, active and occurred faults." UBYTE CompuMethod_487 1 0 0 255 ECU_ADDRESS 0x40000373 /end MEASUREMENT
/begin MEASUREMENT Inv_Temp_Prb "" FLOAT32_IEEE CompuMethod_2 1 0 -1E+17 1E+17 ECU_ADDRESS 0x400003FA /end MEASUREMENT
/begin MEASUREMENT IPT_Direction_Prb "" FLOAT32_IEEE CompuMethod_2 1 0 -1E+17 1E+17 ECU_ADDRESS 0x4000042A /end MEASUREMENT
/begin MEASUREMENT Load_On_Prb "" FLOAT32_IEEE CompuMethod_2 1 0 -1E+17 1E+17 ECU_ADDRESS 0x40000488 /end MEASUREMENT
/begin MEASUREMENT Mode_1_1_Prb "" FLOAT32_IEEE CompuMethod_2 1 0 -1E+17 1E+17 ECU_ADDRESS 0x40000510 /end MEASUREMENT
/begin MEASUREMENT Mode_1_2_Prb "" FLOAT32_IEEE CompuMethod_2 1 0 -1E+17 1E+17 ECU_ADDRESS 0x40000514 /end MEASUREMENT
/begin MEASUREMENT Mode_2_1_Prb "" FLOAT32_IEEE CompuMethod_2 1 0 -1E+17 1E+17 ECU_ADDRESS 0x40000518 /end MEASUREMENT
/begin MEASUREMENT Mode_2_2_Prb "" FLOAT32_IEEE CompuMethod_2 1 0 -1E+17 1E+17 ECU_ADDRESS 0x4000051C /end MEASUREMENT
/begin MEASUREMENT Mode_3_2_Prb "" FLOAT32_IEEE CompuMethod_2 1 0 -1E+17 1E+17 ECU_ADDRESS 0x40000520 /end MEASUREMENT
/begin MEASUREMENT Mode_3_3_Prb "" FLOAT32_IEEE CompuMethod_2 1 0 -1E+17 1E+17 ECU_ADDRESS 0x40000524 /end MEASUREMENT
/begin MEASUREMENT Mode_4_2_Prb "" FLOAT32_IEEE CompuMethod_2 1 0 -1E+17 1E+17 ECU_ADDRESS 0x40000528 /end MEASUREMENT
/begin MEASUREMENT Mode_4_4_Prb "" FLOAT32_IEEE CompuMethod_2 1 0 -1E+17 1E+17 ECU_ADDRESS 0x4000052C /end MEASUREMENT
/begin MEASUREMENT MPRD "Indicates whether the main power relay is active" UBYTE CompuMethod_500 1 0 0 1 ECU_ADDRESS 0x400006B3 /end MEASUREMENT
/begin MEASUREMENT Oil_Pressure_Prb "" FLOAT32_IEEE CompuMethod_2 1 0 -1E+17 1E+17 ECU_ADDRESS 0x400006C1 /end MEASUREMENT
/begin MEASUREMENT pre_Filter_Torque_Request "" FLOAT32_IEEE CompuMethod_2 1 0 -1E+17 1E+17 ECU_ADDRESS 0x40000722 /end MEASUREMENT
/begin MEASUREMENT RPM_Prb "" FLOAT32_IEEE CompuMethod_2 1 0 -1E+17 1E+17 ECU_ADDRESS 0x4000076A /end MEASUREMENT
/begin MEASUREMENT Temp_Guage_Ovr "" FLOAT32_IEEE CompuMethod_2 1 0 -1E+17 1E+17 ECU_ADDRESS 0x400007B6 /end MEASUREMENT
/begin MEASUREMENT Torque_Request_Probe "" FLOAT32_IEEE CompuMethod_2 1 0 -1E+17 1E+17 ECU_ADDRESS 0x400007CA /end MEASUREMENT
/begin MEASUREMENT VEH_ID_Prb "" FLOAT32_IEEE CompuMethod_2 1 0 -1E+17 1E+17 ECU_ADDRESS 0x400007E2 /end MEASUREMENT
/begin MEASUREMENT VIN_DATA_BYTE_1_Prb "" FLOAT32_IEEE CompuMethod_2 1 0 -1E+17 1E+17 ECU_ADDRESS 0x400007EE /end MEASUREMENT
/begin MEASUREMENT VIN_DATA_BYTE_10_Prb "" FLOAT32_IEEE CompuMethod_2 1 0 -1E+17 1E+17 ECU_ADDRESS 0x400007F2 /end MEASUREMENT
/begin MEASUREMENT VIN_DATA_BYTE_11_Prb "" FLOAT32_IEEE CompuMethod_2 1 0 -1E+17 1E+17 ECU_ADDRESS 0x400007F6 /end MEASUREMENT
/begin MEASUREMENT VIN_DATA_BYTE_12_Prb "" FLOAT32_IEEE CompuMethod_2 1 0 -1E+17 1E+17 ECU_ADDRESS 0x400007FA /end MEASUREMENT
/begin MEASUREMENT VIN_DATA_BYTE_13_Prb "" FLOAT32_IEEE CompuMethod_2 1 0 -1E+17 1E+17 ECU_ADDRESS 0x400007FE /end MEASUREMENT
/begin MEASUREMENT VIN_DATA_BYTE_14_Prb "" FLOAT32_IEEE CompuMethod_2 1 0 -1E+17 1E+17 ECU_ADDRESS 0x40000802 /end MEASUREMENT
/begin MEASUREMENT VIN_DATA_BYTE_15_Prb "" FLOAT32_IEEE CompuMethod_2 1 0 -1E+17 1E+17 ECU_ADDRESS 0x40000806 /end MEASUREMENT
/begin MEASUREMENT VIN_DATA_BYte_16_Prb "" FLOAT32_IEEE CompuMethod_2 1 0 -1E+17 1E+17 ECU_ADDRESS 0x4000080A /end MEASUREMENT
/begin MEASUREMENT VIN_DATA_BYTE_17_Prb "" FLOAT32_IEEE CompuMethod_2 1 0 -1E+17 1E+17 ECU_ADDRESS 0x4000080E /end MEASUREMENT
/begin MEASUREMENT VIN_DATA_BYTE_2_Prb "" FLOAT32_IEEE CompuMethod_2 1 0 -1E+17 1E+17 ECU_ADDRESS 0x40000812 /end MEASUREMENT
/begin MEASUREMENT VIN_DATA_BYTE_3_Prb "" FLOAT32_IEEE CompuMethod_2 1 0 -1E+17 1E+17 ECU_ADDRESS 0x40000816 /end MEASUREMENT
/begin MEASUREMENT VIN_DATA_BYTE_4_Prb "" FLOAT32_IEEE CompuMethod_2 1 0 -1E+17 1E+17 ECU_ADDRESS 0x4000081A /end MEASUREMENT
/begin MEASUREMENT VIN_DATA_BYTE_5_Prb "" FLOAT32_IEEE CompuMethod_2 1 0 -1E+17 1E+17 ECU_ADDRESS 0x4000081E /end MEASUREMENT
/begin MEASUREMENT VIN_DATA_BYTE_6_Prb "" FLOAT32_IEEE CompuMethod_2 1 0 -1E+17 1E+17 ECU_ADDRESS 0x40000822 /end MEASUREMENT
/begin MEASUREMENT VIN_DATA_BYTE_7_Prb "" FLOAT32_IEEE CompuMethod_2 1 0 -1E+17 1E+17 ECU_ADDRESS 0x40000826 /end MEASUREMENT
/begin MEASUREMENT VIN_DATA_BYTE_8_Prb "" FLOAT32_IEEE CompuMethod_2 1 0 -1E+17 1E+17 ECU_ADDRESS 0x4000082A /end MEASUREMENT
/begin MEASUREMENT VIN_DATA_BYTE_9_Prb "" FLOAT32_IEEE CompuMethod_2 1 0 -1E+17 1E+17 ECU_ADDRESS 0x4000082E /end MEASUREMENT
/begin CHARACTERISTIC Cruise_Control_Raw_Ovr_new "" VALUE 0x8000033E RecordLayout_7 0 CompuMethod_5 0 65535 /end CHARACTERISTIC
/begin CHARACTERISTIC Cruise_Control_Raw_Ovr_ovr "" VALUE 0x80000340 RecordLayout_3 0 CompuMethod_7 0 1 /end CHARACTERISTIC
/begin CHARACTERISTIC Cruise_Control_RSM_Ovr_new "" VALUE 0x80000341 RecordLayout_3 0 CompuMethod_11 0 1 /end CHARACTERISTIC
/begin CHARACTERISTIC Cruise_Control_RSM_Ovr_ovr "" VALUE 0x80000342 RecordLayout_3 0 CompuMethod_7 0 1 /end CHARACTERISTIC
/begin CHARACTERISTIC Cruise_Control_SetM_Ovr_new "" VALUE 0x80000343 RecordLayout_3 0 CompuMethod_11 0 1 /end CHARACTERISTIC
/begin CHARACTERISTIC Cruise_Control_SetM_Ovr_ovr "" VALUE 0x80000344 RecordLayout_3 0 CompuMethod_7 0 1 /end CHARACTERISTIC
/begin CHARACTERISTIC Cruise_Control_SetP_Ovr_new "" VALUE 0x80000345 RecordLayout_3 0 CompuMethod_11 0 1 /end CHARACTERISTIC
/begin CHARACTERISTIC Cruise_Control_SetP_Ovr_ovr "" VALUE 0x80000346 RecordLayout_3 0 CompuMethod_7 0 1 /end CHARACTERISTIC
/begin CHARACTERISTIC Cruise_Control_Tq_TableMap "" MAP 0x80000347 RecordLayout_4 0 CompuMethod_2 -1E+17 1E+17
 /begin AXIS_DESCR COM_AXIS Cruise_Control_VSpeed_PreIn CompuMethod_2 11 -1E+17 1E+17 AXIS_PTS_REF Cruise_Control_VSpeed_PreIdxArr /end AXIS_DESCR
 /begin AXIS_DESCR COM_AXIS Cruise_Control_PID_PreIn CompuMethod_2 11 -1E+17 1E+17 AXIS_PTS_REF Cruise_Control_PID_PreIdxArr /end AXIS_DESCR
/end CHARACTERISTIC
/begin CHARACTERISTIC Cruise_Ctrl_Light_Ovr_new "" VALUE 0x80000557 RecordLayout_3 0 CompuMethod_11 0 1 /end CHARACTERISTIC
/begin CHARACTERISTIC Cruise_Ctrl_Light_Ovr_ovr "" VALUE 0x80000558 RecordLayout_3 0 CompuMethod_7 0 1 /end CHARACTERISTIC
/begin CHARACTERISTIC CRUISE_DampGainDown "PID Damper Gain - Down Direction" VALUE 0x80000559 RecordLayout_4 0 CompuMethod_484 -1E+17 1E+17 /end CHARACTERISTIC
/begin CHARACTERISTIC CRUISE_DampGainUp "PID Damper Gain - Up Direction" VALUE 0x8000055D RecordLayout_4 0 CompuMethod_484 -1E+17 1E+17 /end CHARACTERISTIC
/begin CHARACTERISTIC CRUISE_DCOffset "PID Output DC Offset" VALUE 0x80000561 RecordLayout_4 0 CompuMethod_2 -1E+17 1E+17 /end CHARACTERISTIC
/begin CHARACTERISTIC CRUISE_DGain "PID Derivative Gain" VALUE 0x80000565 RecordLayout_4 0 CompuMethod_484 -1E+17 1E+17 /end CHARACTERISTIC
/begin CHARACTERISTIC Cruise_Disable_Brake_Fault1 "" VALUE 0x8000056D RecordLayout_4 0 CompuMethod_2 -1E+17 1E+17 /end CHARACTERISTIC
/begin CHARACTERISTIC Cruise_Disable_Brake_Fault2 "" VALUE 0x80000571 RecordLayout_4 0 CompuMethod_2 -1E+17 1E+17 /end CHARACTERISTIC
/begin CHARACTERISTIC CRUISE_ErrorGain "PID Error Gain" VALUE 0x80000575 RecordLayout_4 0 CompuMethod_484 -1E+17 1E+17 /end CHARACTERISTIC
/begin CHARACTERISTIC CRUISE_IGain "PID Integral Gain" VALUE 0x80000579 RecordLayout_4 0 CompuMethod_484 -1E+17 1E+17 /end CHARACTERISTIC
/begin CHARACTERISTIC CRUISE_IMax "PID Integrator Upper Limit" VALUE 0x8000057D RecordLayout_4 0 CompuMethod_2 -1E+17 1E+17 /end CHARACTERISTIC
/begin CHARACTERISTIC CRUISE_IMin "PID Integrator Lower Limit" VALUE 0x80000581 RecordLayout_4 0 CompuMethod_2 -1E+17 1E+17 /end CHARACTERISTIC
/begin CHARACTERISTIC CRUISE_LwrLim "Lower Limit Value" VALUE 0x80000585 RecordLayout_4 0 CompuMethod_2 -1E+17 1E+17 /end CHARACTERISTIC
/begin CHARACTERISTIC CRUISE_PGain "PID Proportional Gain" VALUE 0x8000058D RecordLayout_4 0 CompuMethod_484 -1E+17 1E+17 /end CHARACTERISTIC
/begin CHARACTERISTIC CRUISE_UprLim "Upper Limit Value" VALUE 0x80000591 RecordLayout_4 0 CompuMethod_2 -1E+17 1E+17 /end CHARACTERISTIC
/begin CHARACTERISTIC Current_Limit_Override_new "" VALUE 0x8000059A RecordLayout_4 0 CompuMethod_2 -1E+17 1E+17 /end CHARACTERISTIC
/begin CHARACTERISTIC Current_Limit_Override_ovr "" VALUE 0x8000059E RecordLayout_3 0 CompuMethod_7 0 1 /end CHARACTERISTIC
/begin CHARACTERISTIC Current_Ovr_new "" VALUE 0x8000059F RecordLayout_4 0 CompuMethod_2 -1E+17 1E+17 /end CHARACTERISTIC
/begin CHARACTERISTIC Current_Ovr_ovr "" VALUE 0x800005A3 RecordLayout_3 0 CompuMethod_7 0 1 /end CHARACTERISTIC
/begin CHARACTERISTIC CurrentLimitingEnabled "" VALUE 0x800005A4 RecordLayout_4 0 CompuMethod_2 -1E+17 1E+17 /end CHARACTERISTIC
/begin CHARACTERISTIC Data_Mode_1 "" VALUE 0x800005A8 RecordLayout_4 0 CompuMethod_2 -1E+17 1E+17 /end CHARACTERISTIC
/begin CHARACTERISTIC DATA_MODE_1_Ovr_new "" VALUE 0x800005AC RecordLayout_4 0 CompuMethod_2 -1E+17 1E+17 /end CHARACTERISTIC
/begin CHARACTERISTIC DATA_MODE_1_Ovr_ovr "" VALUE 0x800005B0 RecordLayout_3 0 CompuMethod_7 0 1 /end CHARACTERISTIC
/begin CHARACTERISTIC DATA_MODE_2 "" VALUE 0x800005B1 RecordLayout_4 0 CompuMethod_2 -1E+17 1E+17 /end CHARACTERISTIC
/begin CHARACTERISTIC DATA_MODE_2_Ovr_new "" VALUE 0x800005B5 RecordLayout_4 0 CompuMethod_2 -1E+17 1E+17 /end CHARACTERISTIC
/begin CHARACTERISTIC DATA_MODE_2_Ovr_ovr "" VALUE 0x800005B9 RecordLayout_3 0 CompuMethod_7 0 1 /end CHARACTERISTIC
/begin CHARACTERISTIC DATA_MODE_3 "" VALUE 0x800005BA RecordLayout_4 0 CompuMethod_2 -1E+17 1E+17 /end CHARACTERISTIC
/begin CHARACTERISTIC DATA_MODE_3_Ovr_new "" VALUE 0x800005BE RecordLayout_4 0 CompuMethod_2 -1E+17 1E+17 /end CHARACTERISTIC
/begin CHARACTERISTIC DATA_MODE_3_Ovr_ovr "" VALUE 0x800005C2 RecordLayout_3 0 CompuMethod_7 0 1 /end CHARACTERISTIC
/begin CHARACTERISTIC DATA_MODE_4 "" VALUE 0x800005C3 RecordLayout_4 0 CompuMethod_2 -1E+17 1E+17 /end CHARACTERISTIC
/begin CHARACTERISTIC DATA_MODE_4_Ovr_new "" VALUE 0x800005C7 RecordLayout_4 0 CompuMethod_2 -1E+17 1E+17 /end CHARACTERISTIC
/begin CHARACTERISTIC DATA_MODE_4_Ovr_ovr "" VALUE 0x800005CB RecordLayout_3 0 CompuMethod_7 0 1 /end CHARACTERISTIC
/begin CHARACTERISTIC DateTime_Ovr_new "" VALUE 0x800005CC RecordLayout_4 0 CompuMethod_2 -1E+17 1E+17 /end CHARACTERISTIC
/begin CHARACTERISTIC DateTime_Ovr_ovr "" VALUE 0x800005D0 RecordLayout_3 0 CompuMethod_7 0 1 /end CHARACTERISTIC
/begin CHARACTERISTIC DCDC_Converter_Not_Running_Fault "" VALUE 0x800005D1 RecordLayout_4 0 CompuMethod_2 -1E+17 1E+17 /end CHARACTERISTIC
/begin CHARACTERISTIC DCDC_Status_Ovr_new "" VALUE 0x800005D5 RecordLayout_7 0 CompuMethod_5 0 65535 /end CHARACTERISTIC
/begin CHARACTERISTIC DCDC_Status_Ovr_ovr "" VALUE 0x800005D7 RecordLayout_3 0 CompuMethod_7 0 1 /end CHARACTERISTIC
/begin CHARACTERISTIC Defrost_Mode_Ovr_new "" VALUE 0x800005DC RecordLayout_4 0 CompuMethod_2 -1E+17 1E+17 /end CHARACTERISTIC
/begin CHARACTERISTIC Defrost_Mode_Ovr_ovr "" VALUE 0x800005E0 RecordLayout_3 0 CompuMethod_7 0 1 /end CHARACTERISTIC
/begin CHARACTERISTIC Defrost_Ovr_new "" VALUE 0x800005E1 RecordLayout_4 0 CompuMethod_2 -1E+17 1E+17 /end CHARACTERISTIC
/begin CHARACTERISTIC Defrost_Ovr_ovr "" VALUE 0x800005E5 RecordLayout_3 0 CompuMethod_7 0 1 /end CHARACTERISTIC
/begin CHARACTERISTIC Drive_Switch_Input_High_Fault "" VALUE 0x800005FA RecordLayout_4 0 CompuMethod_2 -1E+17 1E+17 /end CHARACTERISTIC
/begin CHARACTERISTIC Drive_Switch_Input_Low_Fault "" VALUE 0x800005FE RecordLayout_4 0 CompuMethod_2 -1E+17 1E+17 /end CHARACTERISTIC
/begin CHARACTERISTIC Driver_1_Ovr_new "" VALUE 0x8000060E RecordLayout_4 0 CompuMethod_2 -1E+17 1E+17 /end CHARACTERISTIC
/begin CHARACTERISTIC Driver_1_Ovr_ovr "" VALUE 0x80000612 RecordLayout_3 0 CompuMethod_7 0 1 /end CHARACTERISTIC
/begin CHARACTERISTIC Driver_10_Ovr_new "" VALUE 0x80000613 RecordLayout_4 0 CompuMethod_2 -1E+17 1E+17 /end CHARACTERISTIC
/begin CHARACTERISTIC Driver_10_Ovr_ovr "" VALUE 0x80000617 RecordLayout_3 0 CompuMethod_7 0 1 /end CHARACTERISTIC
/begin CHARACTERISTIC Driver_Temp_Ovr_new "" VALUE 0x80000618 RecordLayout_4 0 CompuMethod_2 -1E+17 1E+17 /end CHARACTERISTIC
/begin CHARACTERISTIC Driver_Temp_Ovr_ovr "" VALUE 0x8000061C RecordLayout_3 0 CompuMethod_7 0 1 /end CHARACTERISTIC
/begin CHARACTERISTIC Eaton_Charger_AgeCount_Ovr_new "" VALUE 0x80000621 RecordLayout_2 0 CompuMethod_6 0 4294970000 /end CHARACTERISTIC
/begin CHARACTERISTIC Eaton_Charger_AgeCount_Ovr_ovr "" VALUE 0x80000625 RecordLayout_3 0 CompuMethod_7 0 1 /end CHARACTERISTIC
/begin CHARACTERISTIC Eaton_Charger_Message_Checksum_Ovr_new "" VALUE 0x80000626 RecordLayout_4 0 CompuMethod_2 -1E+17 1E+17 /end CHARACTERISTIC
/begin CHARACTERISTIC Eaton_Charger_Message_Checksum_Ovr_ovr "" VALUE 0x8000062A RecordLayout_3 0 CompuMethod_7 0 1 /end CHARACTERISTIC
/begin CHARACTERISTIC Eaton_Charger_Message_Counter_Ovr_new "" VALUE 0x8000062B RecordLayout_4 0 CompuMethod_2 -1E+17 1E+17 /end CHARACTERISTIC
/begin CHARACTERISTIC Eaton_Charger_Message_Counter_Ovr_ovr "" VALUE 0x8000062F RecordLayout_3 0 CompuMethod_7 0 1 /end CHARACTERISTIC
/begin CHARACTERISTIC Eaton_HV_Charger_Temperature_Ovr_new "" VALUE 0x80000631 RecordLayout_4 0 CompuMethod_2 -1E+17 1E+17 /end CHARACTERISTIC
/begin CHARACTERISTIC Eaton_HV_Charger_Temperature_Ovr_ovr "" VALUE 0x80000635 RecordLayout_3 0 CompuMethod_7 0 1 /end CHARACTERISTIC
/begin CHARACTERISTIC ecoMode_Ovr_new "" VALUE 0x800006E7 RecordLayout_4 0 CompuMethod_2 -1E+17 1E+17 /end CHARACTERISTIC
/begin CHARACTERISTIC ecoMode_Ovr_ovr "" VALUE 0x800006EB RecordLayout_3 0 CompuMethod_7 0 1 /end CHARACTERISTIC
/begin CHARACTERISTIC ECUP "" VALUE 0x800006EC RecordLayout_4 0 CompuMethod_2 -1E+17 1E+17 /end CHARACTERISTIC
/begin CHARACTERISTIC ECUP_Threshold "ADC voltage threshold above which ECU is considered powered" VALUE 0x800006F0 RecordLayout_7 0 CompuMethod_486 0 1023 /end CHARACTERISTIC
/begin CHARACTERISTIC Electric_Motor_Derated_Approaching_Over_Temperature_Fault_Over "" VALUE 0x800006F2 RecordLayout_4 0 CompuMethod_2 -1E+17 1E+17 /end CHARACTERISTIC
/begin CHARACTERISTIC Electric_Motor_Derated_Approaching_Over_Temperature_Fault_Under "" VALUE 0x800006F6 RecordLayout_4 0 CompuMethod_2 -1E+17 1E+17 /end CHARACTERISTIC
/begin CHARACTERISTIC Electric_Motor_Derated_Over_Temperature_Fault "" VALUE 0x800006FA RecordLayout_4 0 CompuMethod_2 -1E+17 1E+17 /end CHARACTERISTIC
/begin CHARACTERISTIC Electric_Motor_Derated_Over_Voltage_Fault "" VALUE 0x800006FE RecordLayout_4 0 CompuMethod_2 -1E+17 1E+17 /end CHARACTERISTIC
/begin CHARACTERISTIC Electric_Motor_Derated_Under_Temperature_Fault "" VALUE 0x80000702 RecordLayout_4 0 CompuMethod_2 -1E+17 1E+17 /end CHARACTERISTIC
/begin CHARACTERISTIC Electric_Motor_Derated_Under_Voltage_Fault "" VALUE 0x80000706 RecordLayout_4 0 CompuMethod_2 -1E+17 1E+17 /end CHARACTERISTIC
/begin CHARACTERISTIC Electric_Motor_General_Error_Fault_Over "" VALUE 0x8000070A RecordLayout_4 0 CompuMethod_2 -1E+17 1E+17 /end CHARACTERISTIC
/begin CHARACTERISTIC Electric_Motor_General_Error_Fault_Under "" VALUE 0x8000070E RecordLayout_4 0 CompuMethod_2 -1E+17 1E+17 /end CHARACTERISTIC
/begin CHARACTERISTIC Electric_Motor_Over_Speed_Forward_Fault "" VALUE 0x80000712 RecordLayout_4 0 CompuMethod_2 -1E+17 1E+17 /end CHARACTERISTIC
/begin CHARACTERISTIC Electric_Motor_Over_Speed_Reverse_Fault "" VALUE 0x80000716 RecordLayout_4 0 CompuMethod_2 -1E+17 1E+17 /end CHARACTERISTIC
/begin CHARACTERISTIC Electric_Motor_Shutdown_Error_Fault "" VALUE 0x8000071A RecordLayout_4 0 CompuMethod_2 -1E+17 1E+17 /end CHARACTERISTIC
/begin CHARACTERISTIC Electric_Motor_Torque_Output_Fault "" VALUE 0x8000071E RecordLayout_4 0 CompuMethod_2 -1E+17 1E+17 /end CHARACTERISTIC
/begin CHARACTERISTIC Eng_Cool_Temp_Ovr_new "" VALUE 0x80000722 RecordLayout_4 0 CompuMethod_2 -1E+17 1E+17 /end CHARACTERISTIC
/begin CHARACTERISTIC Eng_Cool_Temp_Ovr_ovr "" VALUE 0x80000726 RecordLayout_3 0 CompuMethod_7 0 1 /end CHARACTERISTIC
/begin CHARACTERISTIC Engine_Crank_Ovr_new "" VALUE 0x80000727 RecordLayout_4 0 CompuMethod_2 -1E+17 1E+17 /end CHARACTERISTIC
/begin CHARACTERISTIC Engine_Crank_Ovr_ovr "" VALUE 0x8000072B RecordLayout_3 0 CompuMethod_7 0 1 /end CHARACTERISTIC
/begin CHARACTERISTIC Engine_On_ABS_Ovr_new "" VALUE 0x80000734 RecordLayout_4 0 CompuMethod_2 0 4 /end CHARACTERISTIC
/begin CHARACTERISTIC Engine_On_ABS_Ovr_ovr "" VALUE 0x80000738 RecordLayout_3 0 CompuMethod_7 0 1 /end CHARACTERISTIC
/begin CHARACTERISTIC Engine_On_Ovr_new "" VALUE 0x80000739 RecordLayout_4 0 CompuMethod_2 -1E+17 1E+17 /end CHARACTERISTIC
/begin CHARACTERISTIC Engine_On_Ovr_ovr "" VALUE 0x8000073D RecordLayout_3 0 CompuMethod_7 0 1 /end CHARACTERISTIC
/begin CHARACTERISTIC Engine_On_Time_Threshold "" VALUE 0x8000073E RecordLayout_4 0 CompuMethod_2 -1E+17 1E+17 /end CHARACTERISTIC
/begin CHARACTERISTIC Engine_Speed_Ovr_new "" VALUE 0x80000742 RecordLayout_4 0 CompuMethod_2 -1E+17 1E+17 /end CHARACTERISTIC
/begin CHARACTERISTIC Engine_Speed_Ovr_ovr "" VALUE 0x80000746 RecordLayout_3 0 CompuMethod_7 0 1 /end CHARACTERISTIC
/begin CHARACTERISTIC Fan1_Ovr_new "" VALUE 0x80000747 RecordLayout_4 0 CompuMethod_2 -1E+17 1E+17 /end CHARACTERISTIC
/begin CHARACTERISTIC Fan1_Ovr_ovr "" VALUE 0x8000074B RecordLayout_3 0 CompuMethod_7 0 1 /end CHARACTERISTIC
/begin CHARACTERISTIC Fan2_Ovr_new "" VALUE 0x8000074C RecordLayout_4 0 CompuMethod_2 -1E+17 1E+17 /end CHARACTERISTIC
/begin CHARACTERISTIC Fan2_Ovr_ovr "" VALUE 0x80000750 RecordLayout_3 0 CompuMethod_7 0 1 /end CHARACTERISTIC
/begin CHARACTERISTIC Fan3_Ovr_new "" VALUE 0x80000751 RecordLayout_4 0 CompuMethod_2 -1E+17 1E+17 /end CHARACTERISTIC
/begin CHARACTERISTIC Fan3_Ovr_ovr "" VALUE 0x80000755 RecordLayout_3 0 CompuMethod_7 0 1 /end CHARACTERISTIC
/begin CHARACTERISTIC Fault_Ovr_new "" VALUE 0x80000756 RecordLayout_4 0 CompuMethod_2 -1E+17 1E+17 /end CHARACTERISTIC
/begin CHARACTERISTIC Fault_Ovr_ovr "" VALUE 0x8000075A RecordLayout_3 0 CompuMethod_7 0 1 /end CHARACTERISTIC
/begin CHARACTERISTIC Fault_Severity_Indicator_Ovr_new "" VALUE 0x8000075B RecordLayout_3 0 CompuMethod_11 0 1 /end CHARACTERISTIC
/begin CHARACTERISTIC Fault_Severity_Indicator_Ovr_ovr "" VALUE 0x8000075C RecordLayout_3 0 CompuMethod_7 0 1 /end CHARACTERISTIC
/begin CHARACTERISTIC FaultCommand "Select a command to control the fault manager." VALUE 0x8000075D RecordLayout_3 0 CompuMethod_488 0 255 /end CHARACTERISTIC
/begin CHARACTERISTIC FaultManager.ABS_ToneRing_AgeCount.Mode "Fault manager configuration.  Select up to 4 actions for each fault." VALUE 0x8000075E RecordLayout_7 0 CompuMethod_489 0 65535 /end CHARACTERISTIC
/begin CHARACTERISTIC FaultManager.ABS_ToneRing_AgeCount.ID "Fault manager configuration.  Select up to 4 actions for each fault." VALUE 0x80000760 RecordLayout_7 0 CompuMethod_1 0 65535 /end CHARACTERISTIC
/begin CHARACTERISTIC FaultManager.ABS_ToneRing_AgeCount.Test "Fault manager configuration.  Select up to 4 actions for each fault." VALUE 0x80000762 RecordLayout_7 0 CompuMethod_490 0 65535 /end CHARACTERISTIC
/begin CHARACTERISTIC FaultManager.ABS_ToneRing_AgeCount.Faulty_Samples__X_ "Fault manager configuration.  Select up to 4 actions for each fault." VALUE 0x80000764 RecordLayout_7 0 CompuMethod_1 0 65535 /end CHARACTERISTIC
/begin CHARACTERISTIC FaultManager.ABS_ToneRing_AgeCount.Total_Samples__Y_ "Fault manager configuration.  Select up to 4 actions for each fault." VALUE 0x80000766 RecordLayout_7 0 CompuMethod_1 0 65535 /end CHARACTERISTIC
/begin CHARACTERISTIC FaultManager.ABS_ToneRing_AgeCount.Action_1 "Fault manager configuration.  Select up to 4 actions for each fault." VALUE 0x80000768 RecordLayout_7 0 CompuMethod_491 0 65535 /end CHARACTERISTIC
/begin CHARACTERISTIC FaultManager.ABS_ToneRing_AgeCount.Action_1_Condition "Fault manager configuration.  Select up to 4 actions for each fault." VALUE 0x8000076A RecordLayout_7 0 CompuMethod_492 0 65535 /end CHARACTERISTIC
/begin CHARACTERISTIC FaultManager.ABS_ToneRing_AgeCount.Action_2 "Fault manager configuration.  Select up to 4 actions for each fault." VALUE 0x8000076C RecordLayout_7 0 CompuMethod_491 0 65535 /end CHARACTERISTIC
/begin CHARACTERISTIC FaultManager.ABS_ToneRing_AgeCount.Action_2_Condition "Fault manager configuration.  Select up to 4 actions for each fault." VALUE 0x8000076E RecordLayout_7 0 CompuMethod_492 0 65535 /end CHARACTERISTIC
/begin CHARACTERISTIC FaultManager.ABS_ToneRing_AgeCount.Action_3 "Fault manager configuration.  Select up to 4 actions for each fault." VALUE 0x80000770 RecordLayout_7 0 CompuMethod_491 0 65535 /end CHARACTERISTIC
/begin CHARACTERISTIC FaultManager.ABS_ToneRing_AgeCount.Action_3_Condition "Fault manager configuration.  Select up to 4 actions for each fault." VALUE 0x80000772 RecordLayout_7 0 CompuMethod_492 0 65535 /end CHARACTERISTIC
/begin CHARACTERISTIC FaultManager.ABS_ToneRing_AgeCount.Action_4 "Fault manager configuration.  Select up to 4 actions for each fault." VALUE 0x80000774 RecordLayout_7 0 CompuMethod_491 0 65535 /end CHARACTERISTIC
/begin CHARACTERISTIC FaultManager.ABS_ToneRing_AgeCount.Action_4_Condition "Fault manager configuration.  Select up to 4 actions for each fault." VALUE 0x80000776 RecordLayout_7 0 CompuMethod_492 0 65535 /end CHARACTERISTIC
/begin CHARACTERISTIC FaultManager.ABS_Traction_Control_AgeCount.Mode "Fault manager configuration.  Select up to 4 actions for each fault." VALUE 0x80000778 RecordLayout_7 0 CompuMethod_489 0 65535 /end CHARACTERISTIC
/begin CHARACTERISTIC FaultManager.ABS_Traction_Control_AgeCount.ID "Fault manager configuration.  Select up to 4 actions for each fault." VALUE 0x8000077A RecordLayout_7 0 CompuMethod_1 0 65535 /end CHARACTERISTIC
/begin CHARACTERISTIC FaultManager.ABS_Traction_Control_AgeCount.Test "Fault manager configuration.  Select up to 4 actions for each fault." VALUE 0x8000077C RecordLayout_7 0 CompuMethod_490 0 65535 /end CHARACTERISTIC
/begin CHARACTERISTIC FaultManager.ABS_Traction_Control_AgeCount.Faulty_Samples__X_ "Fault manager configuration.  Select up to 4 actions for each fault." VALUE 0x8000077E RecordLayout_7 0 CompuMethod_1 0 65535 /end CHARACTERISTIC
/begin CHARACTERISTIC FaultManager.ABS_Traction_Control_AgeCount.Total_Samples__Y_ "Fault manager configuration.  Select up to 4 actions for each fault." VALUE 0x80000780 RecordLayout_7 0 CompuMethod_1 0 65535 /end CHARACTERISTIC
/begin CHARACTERISTIC FaultManager.ABS_Traction_Control_AgeCount.Action_1 "Fault manager configuration.  Select up to 4 actions for each fault." VALUE 0x80000782 RecordLayout_7 0 CompuMethod_491 0 65535 /end CHARACTERISTIC
/begin CHARACTERISTIC FaultManager.ABS_Traction_Control_AgeCount.Action_1_Condition "Fault manager configuration.  Select up to 4 actions for each fault." VALUE 0x80000784 RecordLayout_7 0 CompuMethod_492 0 65535 /end CHARACTERISTIC
/begin CHARACTERISTIC FaultManager.ABS_Traction_Control_AgeCount.Action_2 "Fault manager configuration.  Select up to 4 actions for each fault." VALUE 0x80000786 RecordLayout_7 0 CompuMethod_491 0 65535 /end CHARACTERISTIC
/begin CHARACTERISTIC FaultManager.ABS_Traction_Control_AgeCount.Action_2_Condition "Fault manager configuration.  Select up to 4 actions for each fault." VALUE 0x80000788 RecordLayout_7 0 CompuMethod_492 0 65535 /end CHARACTERISTIC
/begin CHARACTERISTIC FaultManager.ABS_Traction_Control_AgeCount.Action_3 "Fault manager configuration.  Select up to 4 actions for each fault." VALUE 0x8000078A RecordLayout_7 0 CompuMethod_491 0 65535 /end CHARACTERISTIC
/begin CHARACTERISTIC FaultManager.ABS_Traction_Control_AgeCount.Action_3_Condition "Fault manager configuration.  Select up to 4 actions for each fault." VALUE 0x8000078C RecordLayout_7 0 CompuMethod_492 0 65535 /end CHARACTERISTIC
/begin CHARACTERISTIC FaultManager.ABS_Traction_Control_AgeCount.Action_4 "Fault manager configuration.  Select up to 4 actions for each fault." VALUE 0x8000078E RecordLayout_7 0 CompuMethod_491 0 65535 /end CHARACTERISTIC
/begin CHARACTERISTIC FaultManager.ABS_Traction_Control_AgeCount.Action_4_Condition "Fault manager configuration.  Select up to 4 actions for each fault." VALUE 0x80000790 RecordLayout_7 0 CompuMethod_492 0 65535 /end CHARACTERISTIC
/begin CHARACTERISTIC FaultManager.ABS_WheelSpeed_AgeCount.Mode "Fault manager configuration.  Select up to 4 actions for each fault." VALUE 0x80000792 RecordLayout_7 0 CompuMethod_489 0 65535 /end CHARACTERISTIC
/begin CHARACTERISTIC FaultManager.ABS_WheelSpeed_AgeCount.ID "Fault manager configuration.  Select up to 4 actions for each fault." VALUE 0x80000794 RecordLayout_7 0 CompuMethod_1 0 65535 /end CHARACTERISTIC
/begin CHARACTERISTIC FaultManager.ABS_WheelSpeed_AgeCount.Test "Fault manager configuration.  Select up to 4 actions for each fault." VALUE 0x80000796 RecordLayout_7 0 CompuMethod_490 0 65535 /end CHARACTERISTIC
/begin CHARACTERISTIC FaultManager.ABS_WheelSpeed_AgeCount.Faulty_Samples__X_ "Fault manager configuration.  Select up to 4 actions for each fault." VALUE 0x80000798 RecordLayout_7 0 CompuMethod_1 0 65535 /end CHARACTERISTIC
/begin CHARACTERISTIC FaultManager.ABS_WheelSpeed_AgeCount.Total_Samples__Y_ "Fault manager configuration.  Select up to 4 actions for each fault." VALUE 0x8000079A RecordLayout_7 0 CompuMethod_1 0 65535 /end CHARACTERISTIC
/begin CHARACTERISTIC FaultManager.ABS_WheelSpeed_AgeCount.Action_1 "Fault manager configuration.  Select up to 4 actions for each fault." VALUE 0x8000079C RecordLayout_7 0 CompuMethod_491 0 65535 /end CHARACTERISTIC
/begin CHARACTERISTIC FaultManager.ABS_WheelSpeed_AgeCount.Action_1_Condition "Fault manager configuration.  Select up to 4 actions for each fault." VALUE 0x8000079E RecordLayout_7 0 CompuMethod_492 0 65535 /end CHARACTERISTIC
/begin CHARACTERISTIC FaultManager.ABS_WheelSpeed_AgeCount.Action_2 "Fault manager configuration.  Select up to 4 actions for each fault." VALUE 0x800007A0 RecordLayout_7 0 CompuMethod_491 0 65535 /end CHARACTERISTIC
/begin CHARACTERISTIC FaultManager.ABS_WheelSpeed_AgeCount.Action_2_Condition "Fault manager configuration.  Select up to 4 actions for each fault." VALUE 0x800007A2 RecordLayout_7 0 CompuMethod_492 0 65535 /end CHARACTERISTIC
/begin CHARACTERISTIC FaultManager.ABS_WheelSpeed_AgeCount.Action_3 "Fault manager configuration.  Select up to 4 actions for each fault." VALUE 0x800007A4 RecordLayout_7 0 CompuMethod_491 0 65535 /end CHARACTERISTIC
/begin CHARACTERISTIC FaultManager.ABS_WheelSpeed_AgeCount.Action_3_Condition "Fault manager configuration.  Select up to 4 actions for each fault." VALUE 0x800007A6 RecordLayout_7 0 CompuMethod_492 0 65535 /end CHARACTERISTIC
/begin CHARACTERISTIC FaultManager.ABS_WheelSpeed_AgeCount.Action_4 "Fault manager configuration.  Select up to 4 actions for each fault." VALUE 0x800007A8 RecordLayout_7 0 CompuMethod_491 0 65535 /end CHARACTERISTIC
/begin CHARACTERISTIC FaultManager.ABS_WheelSpeed_AgeCount.Action_4_Condition "Fault manager configuration.  Select up to 4 actions for each fault." VALUE 0x800007AA RecordLayout_7 0 CompuMethod_492 0 65535 /end CHARACTERISTIC
/begin CHARACTERISTIC FaultManager.Battery_AgeCount.Mode "Fault manager configuration.  Select up to 4 actions for each fault." VALUE 0x800007AC RecordLayout_7 0 CompuMethod_489 0 65535 /end CHARACTERISTIC
/begin CHARACTERISTIC FaultManager.Battery_AgeCount.ID "Fault manager configuration.  Select up to 4 actions for each fault." VALUE 0x800007AE RecordLayout_7 0 CompuMethod_1 0 65535 /end CHARACTERISTIC
/begin CHARACTERISTIC FaultManager.Battery_AgeCount.Test "Fault manager configuration.  Select up to 4 actions for each fault." VALUE 0x800007B0 RecordLayout_7 0 CompuMethod_490 0 65535 /end CHARACTERISTIC
/begin CHARACTERISTIC FaultManager.Battery_AgeCount.Faulty_Samples__X_ "Fault manager configuration.  Select up to 4 actions for each fault." VALUE 0x800007B2 RecordLayout_7 0 CompuMethod_1 0 65535 /end CHARACTERISTIC
/begin CHARACTERISTIC FaultManager.Battery_AgeCount.Total_Samples__Y_ "Fault manager configuration.  Select up to 4 actions for each fault." VALUE 0x800007B4 RecordLayout_7 0 CompuMethod_1 0 65535 /end CHARACTERISTIC
/begin CHARACTERISTIC FaultManager.Battery_AgeCount.Action_1 "Fault manager configuration.  Select up to 4 actions for each fault." VALUE 0x800007B6 RecordLayout_7 0 CompuMethod_491 0 65535 /end CHARACTERISTIC
/begin CHARACTERISTIC FaultManager.Battery_AgeCount.Action_1_Condition "Fault manager configuration.  Select up to 4 actions for each fault." VALUE 0x800007B8 RecordLayout_7 0 CompuMethod_492 0 65535 /end CHARACTERISTIC
/begin CHARACTERISTIC FaultManager.Battery_AgeCount.Action_2 "Fault manager configuration.  Select up to 4 actions for each fault." VALUE 0x800007BA RecordLayout_7 0 CompuMethod_491 0 65535 /end CHARACTERISTIC
/begin CHARACTERISTIC FaultManager.Battery_AgeCount.Action_2_Condition "Fault manager configuration.  Select up to 4 actions for each fault." VALUE 0x800007BC RecordLayout_7 0 CompuMethod_492 0 65535 /end CHARACTERISTIC
/begin CHARACTERISTIC FaultManager.Battery_AgeCount.Action_3 "Fault manager configuration.  Select up to 4 actions for each fault." VALUE 0x800007BE RecordLayout_7 0 CompuMethod_491 0 65535 /end CHARACTERISTIC
/begin CHARACTERISTIC FaultManager.Battery_AgeCount.Action_3_Condition "Fault manager configuration.  Select up to 4 actions for each fault." VALUE 0x800007C0 RecordLayout_7 0 CompuMethod_492 0 65535 /end CHARACTERISTIC
/begin CHARACTERISTIC FaultManager.Battery_AgeCount.Action_4 "Fault manager configuration.  Select up to 4 actions for each fault." VALUE 0x800007C2 RecordLayout_7 0 CompuMethod_491 0 65535 /end CHARACTERISTIC
/begin CHARACTERISTIC FaultManager.Battery_AgeCount.Action_4_Condition "Fault manager configuration.  Select up to 4 actions for each fault." VALUE 0x800007C4 RecordLayout_7 0 CompuMethod_492 0 65535 /end CHARACTERISTIC
/begin CHARACTERISTIC FaultManager.Battery_Voltage_Too_High.Mode "Fault manager configuration.  Select up to 4 actions for each fault." VALUE 0x800007C6 RecordLayout_7 0 CompuMethod_489 0 65535 /end CHARACTERISTIC
/begin CHARACTERISTIC FaultManager.Battery_Voltage_Too_High.ID "Fault manager configuration.  Select up to 4 actions for each fault." VALUE 0x800007C8 RecordLayout_7 0 CompuMethod_1 0 65535 /end CHARACTERISTIC
/begin CHARACTERISTIC FaultManager.Battery_Voltage_Too_High.Test "Fault manager configuration.  Select up to 4 actions for each fault." VALUE 0x800007CA RecordLayout_7 0 CompuMethod_490 0 65535 /end CHARACTERISTIC
/begin CHARACTERISTIC FaultManager.Battery_Voltage_Too_High.Faulty_Samples__X_ "Fault manager configuration.  Select up to 4 actions for each fault." VALUE 0x800007CC RecordLayout_7 0 CompuMethod_1 0 65535 /end CHARACTERISTIC
/begin CHARACTERISTIC FaultManager.Battery_Voltage_Too_High.Total_Samples__Y_ "Fault manager configuration.  Select up to 4 actions for each fault." VALUE 0x800007CE RecordLayout_7 0 CompuMethod_1 0 65535 /end CHARACTERISTIC
/begin CHARACTERISTIC FaultManager.Battery_Voltage_Too_High.Action_1 "Fault manager configuration.  Select up to 4 actions for each fault." VALUE 0x800007D0 RecordLayout_7 0 CompuMethod_491 0 65535 /end CHARACTERISTIC
/begin CHARACTERISTIC FaultManager.Battery_Voltage_Too_High.Action_1_Condition "Fault manager configuration.  Select up to 4 actions for each fault." VALUE 0x800007D2 RecordLayout_7 0 CompuMethod_492 0 65535 /end CHARACTERISTIC
/begin CHARACTERISTIC FaultManager.Battery_Voltage_Too_High.Action_2 "Fault manager configuration.  Select up to 4 actions for each fault." VALUE 0x800007D4 RecordLayout_7 0 CompuMethod_491 0 65535 /end CHARACTERISTIC
/begin CHARACTERISTIC FaultManager.Battery_Voltage_Too_High.Action_2_Condition "Fault manager configuration.  Select up to 4 actions for each fault." VALUE 0x800007D6 RecordLayout_7 0 CompuMethod_492 0 65535 /end CHARACTERISTIC
/begin CHARACTERISTIC FaultManager.Battery_Voltage_Too_High.Action_3 "Fault manager configuration.  Select up to 4 actions for each fault." VALUE 0x800007D8 RecordLayout_7 0 CompuMethod_491 0 65535 /end CHARACTERISTIC
/begin CHARACTERISTIC FaultManager.Battery_Voltage_Too_High.Action_3_Condition "Fault manager configuration.  Select up to 4 actions for each fault." VALUE 0x800007DA RecordLayout_7 0 CompuMethod_492 0 65535 /end CHARACTERISTIC
/begin CHARACTERISTIC FaultManager.Battery_Voltage_Too_High.Action_4 "Fault manager configuration.  Select up to 4 actions for each fault." VALUE 0x800007DC RecordLayout_7 0 CompuMethod_491 0 65535 /end CHARACTERISTIC
/begin CHARACTERISTIC FaultManager.Battery_Voltage_Too_High.Action_4_Condition "Fault manager configuration.  Select up to 4 actions for each fault." VALUE 0x800007DE RecordLayout_7 0 CompuMethod_492 0 65535 /end CHARACTERISTIC
/begin CHARACTERISTIC FaultManager.Battery_Voltage_Too_Low.Mode "Fault manager configuration.  Select up to 4 actions for each fault." VALUE 0x800007E0 RecordLayout_7 0 CompuMethod_489 0 65535 /end CHARACTERISTIC
/begin CHARACTERISTIC FaultManager.Battery_Voltage_Too_Low.ID "Fault manager configuration.  Select up to 4 actions for each fault." VALUE 0x800007E2 RecordLayout_7 0 CompuMethod_1 0 65535 /end CHARACTERISTIC
/begin CHARACTERISTIC FaultManager.Battery_Voltage_Too_Low.Test "Fault manager configuration.  Select up to 4 actions for each fault." VALUE 0x800007E4 RecordLayout_7 0 CompuMethod_490 0 65535 /end CHARACTERISTIC
/begin CHARACTERISTIC FaultManager.Battery_Voltage_Too_Low.Faulty_Samples__X_ "Fault manager configuration.  Select up to 4 actions for each fault." VALUE 0x800007E6 RecordLayout_7 0 CompuMethod_1 0 65535 /end CHARACTERISTIC
/begin CHARACTERISTIC FaultManager.Battery_Voltage_Too_Low.Total_Samples__Y_ "Fault manager configuration.  Select up to 4 actions for each fault." VALUE 0x800007E8 RecordLayout_7 0 CompuMethod_1 0 65535 /end CHARACTERISTIC
/begin CHARACTERISTIC FaultManager.Battery_Voltage_Too_Low.Action_1 "Fault manager configuration.  Select up to 4 actions for each fault." VALUE 0x800007EA RecordLayout_7 0 CompuMethod_491 0 65535 /end CHARACTERISTIC
/begin CHARACTERISTIC FaultManager.Battery_Voltage_Too_Low.Action_1_Condition "Fault manager configuration.  Select up to 4 actions for each fault." VALUE 0x800007EC RecordLayout_7 0 CompuMethod_492 0 65535 /end CHARACTERISTIC
/begin CHARACTERISTIC FaultManager.Battery_Voltage_Too_Low.Action_2 "Fault manager configuration.  Select up to 4 actions for each fault." VALUE 0x800007EE RecordLayout_7 0 CompuMethod_491 0 65535 /end CHARACTERISTIC
/begin CHARACTERISTIC FaultManager.Battery_Voltage_Too_Low.Action_2_Condition "Fault manager configuration.  Select up to 4 actions for each fault." VALUE 0x800007F0 RecordLayout_7 0 CompuMethod_492 0 65535 /end CHARACTERISTIC
/begin CHARACTERISTIC FaultManager.Battery_Voltage_Too_Low.Action_3 "Fault manager configuration.  Select up to 4 actions for each fault." VALUE 0x800007F2 RecordLayout_7 0 CompuMethod_491 0 65535 /end CHARACTERISTIC
/begin CHARACTERISTIC FaultManager.Battery_Voltage_Too_Low.Action_3_Condition "Fault manager configuration.  Select up to 4 actions for each fault." VALUE 0x800007F4 RecordLayout_7 0 CompuMethod_492 0 65535 /end CHARACTERISTIC
/begin CHARACTERISTIC FaultManager.Battery_Voltage_Too_Low.Action_4 "Fault manager configuration.  Select up to 4 actions for each fault." VALUE 0x800007F6 RecordLayout_7 0 CompuMethod_491 0 65535 /end CHARACTERISTIC
/begin CHARACTERISTIC FaultManager.Battery_Voltage_Too_Low.Action_4_Condition "Fault manager configuration.  Select up to 4 actions for each fault." VALUE 0x800007F8 RecordLayout_7 0 CompuMethod_492 0 65535 /end CHARACTERISTIC
/begin CHARACTERISTIC FaultManager.Blend_Valve_A_No_Response.Mode "Fault manager configuration.  Select up to 4 actions for each fault." VALUE 0x800007FA RecordLayout_7 0 CompuMethod_489 0 65535 /end CHARACTERISTIC
/begin CHARACTERISTIC FaultManager.Blend_Valve_A_No_Response.ID "Fault manager configuration.  Select up to 4 actions for each fault." VALUE 0x800007FC RecordLayout_7 0 CompuMethod_1 0 65535 /end CHARACTERISTIC
/begin CHARACTERISTIC FaultManager.Blend_Valve_A_No_Response.Test "Fault manager configuration.  Select up to 4 actions for each fault." VALUE 0x800007FE RecordLayout_7 0 CompuMethod_490 0 65535 /end CHARACTERISTIC
/begin CHARACTERISTIC FaultManager.Blend_Valve_A_No_Response.Faulty_Samples__X_ "Fault manager configuration.  Select up to 4 actions for each fault." VALUE 0x80000800 RecordLayout_7 0 CompuMethod_1 0 65535 /end CHARACTERISTIC
/begin CHARACTERISTIC FaultManager.Blend_Valve_A_No_Response.Total_Samples__Y_ "Fault manager configuration.  Select up to 4 actions for each fault." VALUE 0x80000802 RecordLayout_7 0 CompuMethod_1 0 65535 /end CHARACTERISTIC
/begin CHARACTERISTIC FaultManager.Blend_Valve_A_No_Response.Action_1 "Fault manager configuration.  Select up to 4 actions for each fault." VALUE 0x80000804 RecordLayout_7 0 CompuMethod_491 0 65535 /end CHARACTERISTIC
/begin CHARACTERISTIC FaultManager.Blend_Valve_A_No_Response.Action_1_Condition "Fault manager configuration.  Select up to 4 actions for each fault." VALUE 0x80000806 RecordLayout_7 0 CompuMethod_492 0 65535 /end CHARACTERISTIC
/begin CHARACTERISTIC FaultManager.Blend_Valve_A_No_Response.Action_2 "Fault manager configuration.  Select up to 4 actions for each fault." VALUE 0x80000808 RecordLayout_7 0 CompuMethod_491 0 65535 /end CHARACTERISTIC
/begin CHARACTERISTIC FaultManager.Blend_Valve_A_No_Response.Action_2_Condition "Fault manager configuration.  Select up to 4 actions for each fault." VALUE 0x8000080A RecordLayout_7 0 CompuMethod_492 0 65535 /end CHARACTERISTIC
/begin CHARACTERISTIC FaultManager.Blend_Valve_A_No_Response.Action_3 "Fault manager configuration.  Select up to 4 actions for each fault." VALUE 0x8000080C RecordLayout_7 0 CompuMethod_491 0 65535 /end CHARACTERISTIC
/begin CHARACTERISTIC FaultManager.Blend_Valve_A_No_Response.Action_3_Condition "Fault manager configuration.  Select up to 4 actions for each fault." VALUE 0x8000080E RecordLayout_7 0 CompuMethod_492 0 65535 /end CHARACTERISTIC
/begin CHARACTERISTIC FaultManager.Blend_Valve_A_No_Response.Action_4 "Fault manager configuration.  Select up to 4 actions for each fault." VALUE 0x80000810 RecordLayout_7 0 CompuMethod_491 0 65535 /end CHARACTERISTIC
/begin CHARACTERISTIC FaultManager.Blend_Valve_A_No_Response.Action_4_Condition "Fault manager configuration.  Select up to 4 actions for each fault." VALUE 0x80000812 RecordLayout_7 0 CompuMethod_492 0 65535 /end CHARACTERISTIC
/begin CHARACTERISTIC FaultManager.Blend_Valve_B_No_Response.Mode "Fault manager configuration.  Select up to 4 actions for each fault." VALUE 0x80000814 RecordLayout_7 0 CompuMethod_489 0 65535 /end CHARACTERISTIC
/begin CHARACTERISTIC FaultManager.Blend_Valve_B_No_Response.ID "Fault manager configuration.  Select up to 4 actions for each fault." VALUE 0x80000816 RecordLayout_7 0 CompuMethod_1 0 65535 /end CHARACTERISTIC
/begin CHARACTERISTIC FaultManager.Blend_Valve_B_No_Response.Test "Fault manager configuration.  Select up to 4 actions for each fault." VALUE 0x80000818 RecordLayout_7 0 CompuMethod_490 0 65535 /end CHARACTERISTIC
/begin CHARACTERISTIC FaultManager.Blend_Valve_B_No_Response.Faulty_Samples__X_ "Fault manager configuration.  Select up to 4 actions for each fault." VALUE 0x8000081A RecordLayout_7 0 CompuMethod_1 0 65535 /end CHARACTERISTIC
/begin CHARACTERISTIC FaultManager.Blend_Valve_B_No_Response.Total_Samples__Y_ "Fault manager configuration.  Select up to 4 actions for each fault." VALUE 0x8000081C RecordLayout_7 0 CompuMethod_1 0 65535 /end CHARACTERISTIC
/begin CHARACTERISTIC FaultManager.Blend_Valve_B_No_Response.Action_1 "Fault manager configuration.  Select up to 4 actions for each fault." VALUE 0x8000081E RecordLayout_7 0 CompuMethod_491 0 65535 /end CHARACTERISTIC
/begin CHARACTERISTIC FaultManager.Blend_Valve_B_No_Response.Action_1_Condition "Fault manager configuration.  Select up to 4 actions for each fault." VALUE 0x80000820 RecordLayout_7 0 CompuMethod_492 0 65535 /end CHARACTERISTIC
/begin CHARACTERISTIC FaultManager.Blend_Valve_B_No_Response.Action_2 "Fault manager configuration.  Select up to 4 actions for each fault." VALUE 0x80000822 RecordLayout_7 0 CompuMethod_491 0 65535 /end CHARACTERISTIC
/begin CHARACTERISTIC FaultManager.Blend_Valve_B_No_Response.Action_2_Condition "Fault manager configuration.  Select up to 4 actions for each fault." VALUE 0x80000824 RecordLayout_7 0 CompuMethod_492 0 65535 /end CHARACTERISTIC
/begin CHARACTERISTIC FaultManager.Blend_Valve_B_No_Response.Action_3 "Fault manager configuration.  Select up to 4 actions for each fault." VALUE 0x80000826 RecordLayout_7 0 CompuMethod_491 0 65535 /end CHARACTERISTIC
/begin CHARACTERISTIC FaultManager.Blend_Valve_B_No_Response.Action_3_Condition "Fault manager configuration.  Select up to 4 actions for each fault." VALUE 0x80000828 RecordLayout_7 0 CompuMethod_492 0 65535 /end CHARACTERISTIC
/begin CHARACTERISTIC FaultManager.Blend_Valve_B_No_Response.Action_4 "Fault manager configuration.  Select up to 4 actions for each fault." VALUE 0x8000082A RecordLayout_7 0 CompuMethod_491 0 65535 /end CHARACTERISTIC
/begin CHARACTERISTIC FaultManager.Blend_Valve_B_No_Response.Action_4_Condition "Fault manager configuration.  Select up to 4 actions for each fault." VALUE 0x8000082C RecordLayout_7 0 CompuMethod_492 0 65535 /end CHARACTERISTIC
/begin CHARACTERISTIC FaultManager.Blend_Valve_Sensor_A_High_Voltage.Mode "Fault manager configuration.  Select up to 4 actions for each fault." VALUE 0x8000082E RecordLayout_7 0 CompuMethod_489 0 65535 /end CHARACTERISTIC
/begin CHARACTERISTIC FaultManager.Blend_Valve_Sensor_A_High_Voltage.ID "Fault manager configuration.  Select up to 4 actions for each fault." VALUE 0x80000830 RecordLayout_7 0 CompuMethod_1 0 65535 /end CHARACTERISTIC
/begin CHARACTERISTIC FaultManager.Blend_Valve_Sensor_A_High_Voltage.Test "Fault manager configuration.  Select up to 4 actions for each fault." VALUE 0x80000832 RecordLayout_7 0 CompuMethod_490 0 65535 /end CHARACTERISTIC
/begin CHARACTERISTIC FaultManager.Blend_Valve_Sensor_A_High_Voltage.Faulty_Samples__X_ "Fault manager configuration.  Select up to 4 actions for each fault." VALUE 0x80000834 RecordLayout_7 0 CompuMethod_1 0 65535 /end CHARACTERISTIC
/begin CHARACTERISTIC FaultManager.Blend_Valve_Sensor_A_High_Voltage.Total_Samples__Y_ "Fault manager configuration.  Select up to 4 actions for each fault." VALUE 0x80000836 RecordLayout_7 0 CompuMethod_1 0 65535 /end CHARACTERISTIC
/begin CHARACTERISTIC FaultManager.Blend_Valve_Sensor_A_High_Voltage.Action_1 "Fault manager configuration.  Select up to 4 actions for each fault." VALUE 0x80000838 RecordLayout_7 0 CompuMethod_491 0 65535 /end CHARACTERISTIC
/begin CHARACTERISTIC FaultManager.Blend_Valve_Sensor_A_High_Voltage.Action_1_Condition "Fault manager configuration.  Select up to 4 actions for each fault." VALUE 0x8000083A RecordLayout_7 0 CompuMethod_492 0 65535 /end CHARACTERISTIC
/begin CHARACTERISTIC FaultManager.Blend_Valve_Sensor_A_High_Voltage.Action_2 "Fault manager configuration.  Select up to 4 actions for each fault." VALUE 0x8000083C RecordLayout_7 0 CompuMethod_491 0 65535 /end CHARACTERISTIC
/begin CHARACTERISTIC FaultManager.Blend_Valve_Sensor_A_High_Voltage.Action_2_Condition "Fault manager configuration.  Select up to 4 actions for each fault." VALUE 0x8000083E RecordLayout_7 0 CompuMethod_492 0 65535 /end CHARACTERISTIC
/begin CHARACTERISTIC FaultManager.Blend_Valve_Sensor_A_High_Voltage.Action_3 "Fault manager configuration.  Select up to 4 actions for each fault." VALUE 0x80000840 RecordLayout_7 0 CompuMethod_491 0 65535 /end CHARACTERISTIC
/begin CHARACTERISTIC FaultManager.Blend_Valve_Sensor_A_High_Voltage.Action_3_Condition "Fault manager configuration.  Select up to 4 actions for each fault." VALUE 0x80000842 RecordLayout_7 0 CompuMethod_492 0 65535 /end CHARACTERISTIC
/begin CHARACTERISTIC FaultManager.Blend_Valve_Sensor_A_High_Voltage.Action_4 "Fault manager configuration.  Select up to 4 actions for each fault." VALUE 0x80000844 RecordLayout_7 0 CompuMethod_491 0 65535 /end CHARACTERISTIC
/begin CHARACTERISTIC FaultManager.Blend_Valve_Sensor_A_High_Voltage.Action_4_Condition "Fault manager configuration.  Select up to 4 actions for each fault." VALUE 0x80000846 RecordLayout_7 0 CompuMethod_492 0 65535 /end CHARACTERISTIC
/begin CHARACTERISTIC FaultManager.Blend_Valve_Sensor_A_Intermittent.Mode "Fault manager configuration.  Select up to 4 actions for each fault." VALUE 0x80000848 RecordLayout_7 0 CompuMethod_489 0 65535 /end CHARACTERISTIC
/begin CHARACTERISTIC FaultManager.Blend_Valve_Sensor_A_Intermittent.ID "Fault manager configuration.  Select up to 4 actions for each fault." VALUE 0x8000084A RecordLayout_7 0 CompuMethod_1 0 65535 /end CHARACTERISTIC
/begin CHARACTERISTIC FaultManager.Blend_Valve_Sensor_A_Intermittent.Test "Fault manager configuration.  Select up to 4 actions for each fault." VALUE 0x8000084C RecordLayout_7 0 CompuMethod_490 0 65535 /end CHARACTERISTIC
/begin CHARACTERISTIC FaultManager.Blend_Valve_Sensor_A_Intermittent.Faulty_Samples__X_ "Fault manager configuration.  Select up to 4 actions for each fault." VALUE 0x8000084E RecordLayout_7 0 CompuMethod_1 0 65535 /end CHARACTERISTIC
/begin CHARACTERISTIC FaultManager.Blend_Valve_Sensor_A_Intermittent.Total_Samples__Y_ "Fault manager configuration.  Select up to 4 actions for each fault." VALUE 0x80000850 RecordLayout_7 0 CompuMethod_1 0 65535 /end CHARACTERISTIC
/begin CHARACTERISTIC FaultManager.Blend_Valve_Sensor_A_Intermittent.Action_1 "Fault manager configuration.  Select up to 4 actions for each fault." VALUE 0x80000852 RecordLayout_7 0 CompuMethod_491 0 65535 /end CHARACTERISTIC
/begin CHARACTERISTIC FaultManager.Blend_Valve_Sensor_A_Intermittent.Action_1_Condition "Fault manager configuration.  Select up to 4 actions for each fault." VALUE 0x80000854 RecordLayout_7 0 CompuMethod_492 0 65535 /end CHARACTERISTIC
/begin CHARACTERISTIC FaultManager.Blend_Valve_Sensor_A_Intermittent.Action_2 "Fault manager configuration.  Select up to 4 actions for each fault." VALUE 0x80000856 RecordLayout_7 0 CompuMethod_491 0 65535 /end CHARACTERISTIC
/begin CHARACTERISTIC FaultManager.Blend_Valve_Sensor_A_Intermittent.Action_2_Condition "Fault manager configuration.  Select up to 4 actions for each fault." VALUE 0x80000858 RecordLayout_7 0 CompuMethod_492 0 65535 /end CHARACTERISTIC
/begin CHARACTERISTIC FaultManager.Blend_Valve_Sensor_A_Intermittent.Action_3 "Fault manager configuration.  Select up to 4 actions for each fault." VALUE 0x8000085A RecordLayout_7 0 CompuMethod_491 0 65535 /end CHARACTERISTIC
/begin CHARACTERISTIC FaultManager.Blend_Valve_Sensor_A_Intermittent.Action_3_Condition "Fault manager configuration.  Select up to 4 actions for each fault." VALUE 0x8000085C RecordLayout_7 0 CompuMethod_492 0 65535 /end CHARACTERISTIC
/begin CHARACTERISTIC FaultManager.Blend_Valve_Sensor_A_Intermittent.Action_4 "Fault manager configuration.  Select up to 4 actions for each fault." VALUE 0x8000085E RecordLayout_7 0 CompuMethod_491 0 65535 /end CHARACTERISTIC
/begin CHARACTERISTIC FaultManager.Blend_Valve_Sensor_A_Intermittent.Action_4_Condition "Fault manager configuration.  Select up to 4 actions for each fault." VALUE 0x80000860 RecordLayout_7 0 CompuMethod_492 0 65535 /end CHARACTERISTIC
/begin CHARACTERISTIC FaultManager.Blend_Valve_Sensor_A_Low_Voltage.Mode "Fault manager configuration.  Select up to 4 actions for each fault." VALUE 0x80000862 RecordLayout_7 0 CompuMethod_489 0 65535 /end CHARACTERISTIC
/begin CHARACTERISTIC FaultManager.Blend_Valve_Sensor_A_Low_Voltage.ID "Fault manager configuration.  Select up to 4 actions for each fault." VALUE 0x80000864 RecordLayout_7 0 CompuMethod_1 0 65535 /end CHARACTERISTIC
/begin CHARACTERISTIC FaultManager.Blend_Valve_Sensor_A_Low_Voltage.Test "Fault manager configuration.  Select up to 4 actions for each fault." VALUE 0x80000866 RecordLayout_7 0 CompuMethod_490 0 65535 /end CHARACTERISTIC
/begin CHARACTERISTIC FaultManager.Blend_Valve_Sensor_A_Low_Voltage.Faulty_Samples__X_ "Fault manager configuration.  Select up to 4 actions for each fault." VALUE 0x80000868 RecordLayout_7 0 CompuMethod_1 0 65535 /end CHARACTERISTIC
/begin CHARACTERISTIC FaultManager.Blend_Valve_Sensor_A_Low_Voltage.Total_Samples__Y_ "Fault manager configuration.  Select up to 4 actions for each fault." VALUE 0x8000086A RecordLayout_7 0 CompuMethod_1 0 65535 /end CHARACTERISTIC
/begin CHARACTERISTIC FaultManager.Blend_Valve_Sensor_A_Low_Voltage.Action_1 "Fault manager configuration.  Select up to 4 actions for each fault." VALUE 0x8000086C RecordLayout_7 0 CompuMethod_491 0 65535 /end CHARACTERISTIC
/begin CHARACTERISTIC FaultManager.Blend_Valve_Sensor_A_Low_Voltage.Action_1_Condition "Fault manager configuration.  Select up to 4 actions for each fault." VALUE 0x8000086E RecordLayout_7 0 CompuMethod_492 0 65535 /end CHARACTERISTIC
/begin CHARACTERISTIC FaultManager.Blend_Valve_Sensor_A_Low_Voltage.Action_2 "Fault manager configuration.  Select up to 4 actions for each fault." VALUE 0x80000870 RecordLayout_7 0 CompuMethod_491 0 65535 /end CHARACTERISTIC
/begin CHARACTERISTIC FaultManager.Blend_Valve_Sensor_A_Low_Voltage.Action_2_Condition "Fault manager configuration.  Select up to 4 actions for each fault." VALUE 0x80000872 RecordLayout_7 0 CompuMethod_492 0 65535 /end CHARACTERISTIC
/begin CHARACTERISTIC FaultManager.Blend_Valve_Sensor_A_Low_Voltage.Action_3 "Fault manager configuration.  Select up to 4 actions for each fault." VALUE 0x80000874 RecordLayout_7 0 CompuMethod_491 0 65535 /end CHARACTERISTIC
/begin CHARACTERISTIC FaultManager.Blend_Valve_Sensor_A_Low_Voltage.Action_3_Condition "Fault manager configuration.  Select up to 4 actions for each fault." VALUE 0x80000876 RecordLayout_7 0 CompuMethod_492 0 65535 /end CHARACTERISTIC
/begin CHARACTERISTIC FaultManager.Blend_Valve_Sensor_A_Low_Voltage.Action_4 "Fault manager configuration.  Select up to 4 actions for each fault." VALUE 0x80000878 RecordLayout_7 0 CompuMethod_491 0 65535 /end CHARACTERISTIC
/begin CHARACTERISTIC FaultManager.Blend_Valve_Sensor_A_Low_Voltage.Action_4_Condition "Fault manager configuration.  Select up to 4 actions for each fault." VALUE 0x8000087A RecordLayout_7 0 CompuMethod_492 0 65535 /end CHARACTERISTIC
/begin CHARACTERISTIC FaultManager.Blend_Valve_Sensor_B_High_Voltage.Mode "Fault manager configuration.  Select up to 4 actions for each fault." VALUE 0x8000087C RecordLayout_7 0 CompuMethod_489 0 65535 /end CHARACTERISTIC
/begin CHARACTERISTIC FaultManager.Blend_Valve_Sensor_B_High_Voltage.ID "Fault manager configuration.  Select up to 4 actions for each fault." VALUE 0x8000087E RecordLayout_7 0 CompuMethod_1 0 65535 /end CHARACTERISTIC
/begin CHARACTERISTIC FaultManager.Blend_Valve_Sensor_B_High_Voltage.Test "Fault manager configuration.  Select up to 4 actions for each fault." VALUE 0x80000880 RecordLayout_7 0 CompuMethod_490 0 65535 /end CHARACTERISTIC
/begin CHARACTERISTIC FaultManager.Blend_Valve_Sensor_B_High_Voltage.Faulty_Samples__X_ "Fault manager configuration.  Select up to 4 actions for each fault." VALUE 0x80000882 RecordLayout_7 0 CompuMethod_1 0 65535 /end CHARACTERISTIC
/begin CHARACTERISTIC FaultManager.Blend_Valve_Sensor_B_High_Voltage.Total_Samples__Y_ "Fault manager configuration.  Select up to 4 actions for each fault." VALUE 0x80000884 RecordLayout_7 0 CompuMethod_1 0 65535 /end CHARACTERISTIC
/begin CHARACTERISTIC FaultManager.Blend_Valve_Sensor_B_High_Voltage.Action_1 "Fault manager configuration.  Select up to 4 actions for each fault." VALUE 0x80000886 RecordLayout_7 0 CompuMethod_491 0 65535 /end CHARACTERISTIC
/begin CHARACTERISTIC FaultManager.Blend_Valve_Sensor_B_High_Voltage.Action_1_Condition "Fault manager configuration.  Select up to 4 actions for each fault." VALUE 0x80000888 RecordLayout_7 0 CompuMethod_492 0 65535 /end CHARACTERISTIC
/begin CHARACTERISTIC FaultManager.Blend_Valve_Sensor_B_High_Voltage.Action_2 "Fault manager configuration.  Select up to 4 actions for each fault." VALUE 0x8000088A RecordLayout_7 0 CompuMethod_491 0 65535 /end CHARACTERISTIC
/begin CHARACTERISTIC FaultManager.Blend_Valve_Sensor_B_High_Voltage.Action_2_Condition "Fault manager configuration.  Select up to 4 actions for each fault." VALUE 0x8000088C RecordLayout_7 0 CompuMethod_492 0 65535 /end CHARACTERISTIC
/begin CHARACTERISTIC FaultManager.Blend_Valve_Sensor_B_High_Voltage.Action_3 "Fault manager configuration.  Select up to 4 actions for each fault." VALUE 0x8000088E RecordLayout_7 0 CompuMethod_491 0 65535 /end CHARACTERISTIC
/begin CHARACTERISTIC FaultManager.Blend_Valve_Sensor_B_High_Voltage.Action_3_Condition "Fault manager configuration.  Select up to 4 actions for each fault." VALUE 0x80000890 RecordLayout_7 0 CompuMethod_492 0 65535 /end CHARACTERISTIC
/begin CHARACTERISTIC FaultManager.Blend_Valve_Sensor_B_High_Voltage.Action_4 "Fault manager configuration.  Select up to 4 actions for each fault." VALUE 0x80000892 RecordLayout_7 0 CompuMethod_491 0 65535 /end CHARACTERISTIC
/begin CHARACTERISTIC FaultManager.Blend_Valve_Sensor_B_High_Voltage.Action_4_Condition "Fault manager configuration.  Select up to 4 actions for each fault." VALUE 0x80000894 RecordLayout_7 0 CompuMethod_492 0 65535 /end CHARACTERISTIC
/begin CHARACTERISTIC FaultManager.Blend_Valve_Sensor_B_Intermittent.Mode "Fault manager configuration.  Select up to 4 actions for each fault." VALUE 0x80000896 RecordLayout_7 0 CompuMethod_489 0 65535 /end CHARACTERISTIC
/begin CHARACTERISTIC FaultManager.Blend_Valve_Sensor_B_Intermittent.ID "Fault manager configuration.  Select up to 4 actions for each fault." VALUE 0x80000898 RecordLayout_7 0 CompuMethod_1 0 65535 /end CHARACTERISTIC
/begin CHARACTERISTIC FaultManager.Blend_Valve_Sensor_B_Intermittent.Test "Fault manager configuration.  Select up to 4 actions for each fault." VALUE 0x8000089A RecordLayout_7 0 CompuMethod_490 0 65535 /end CHARACTERISTIC
/begin CHARACTERISTIC FaultManager.Blend_Valve_Sensor_B_Intermittent.Faulty_Samples__X_ "Fault manager configuration.  Select up to 4 actions for each fault." VALUE 0x8000089C RecordLayout_7 0 CompuMethod_1 0 65535 /end CHARACTERISTIC
/begin CHARACTERISTIC FaultManager.Blend_Valve_Sensor_B_Intermittent.Total_Samples__Y_ "Fault manager configuration.  Select up to 4 actions for each fault." VALUE 0x8000089E RecordLayout_7 0 CompuMethod_1 0 65535 /end CHARACTERISTIC
/begin CHARACTERISTIC FaultManager.Blend_Valve_Sensor_B_Intermittent.Action_1 "Fault manager configuration.  Select up to 4 actions for each fault." VALUE 0x800008A0 RecordLayout_7 0 CompuMethod_491 0 65535 /end CHARACTERISTIC
/begin CHARACTERISTIC FaultManager.Blend_Valve_Sensor_B_Intermittent.Action_1_Condition "Fault manager configuration.  Select up to 4 actions for each fault." VALUE 0x800008A2 RecordLayout_7 0 CompuMethod_492 0 65535 /end CHARACTERISTIC
/begin CHARACTERISTIC FaultManager.Blend_Valve_Sensor_B_Intermittent.Action_2 "Fault manager configuration.  Select up to 4 actions for each fault." VALUE 0x800008A4 RecordLayout_7 0 CompuMethod_491 0 65535 /end CHARACTERISTIC
/begin CHARACTERISTIC FaultManager.Blend_Valve_Sensor_B_Intermittent.Action_2_Condition "Fault manager configuration.  Select up to 4 actions for each fault." VALUE 0x800008A6 RecordLayout_7 0 CompuMethod_492 0 65535 /end CHARACTERISTIC
/begin CHARACTERISTIC FaultManager.Blend_Valve_Sensor_B_Intermittent.Action_3 "Fault manager configuration.  Select up to 4 actions for each fault." VALUE 0x800008A8 RecordLayout_7 0 CompuMethod_491 0 65535 /end CHARACTERISTIC
/begin CHARACTERISTIC FaultManager.Blend_Valve_Sensor_B_Intermittent.Action_3_Condition "Fault manager configuration.  Select up to 4 actions for each fault." VALUE 0x800008AA RecordLayout_7 0 CompuMethod_492 0 65535 /end CHARACTERISTIC
/begin CHARACTERISTIC FaultManager.Blend_Valve_Sensor_B_Intermittent.Action_4 "Fault manager configuration.  Select up to 4 actions for each fault." VALUE 0x800008AC RecordLayout_7 0 CompuMethod_491 0 65535 /end CHARACTERISTIC
/begin CHARACTERISTIC FaultManager.Blend_Valve_Sensor_B_Intermittent.Action_4_Condition "Fault manager configuration.  Select up to 4 actions for each fault." VALUE 0x800008AE RecordLayout_7 0 CompuMethod_492 0 65535 /end CHARACTERISTIC
/begin CHARACTERISTIC FaultManager.Blend_Valve_Sensor_B_Low_Voltage.Mode "Fault manager configuration.  Select up to 4 actions for each fault." VALUE 0x800008B0 RecordLayout_7 0 CompuMethod_489 0 65535 /end CHARACTERISTIC
/begin CHARACTERISTIC FaultManager.Blend_Valve_Sensor_B_Low_Voltage.ID "Fault manager configuration.  Select up to 4 actions for each fault." VALUE 0x800008B2 RecordLayout_7 0 CompuMethod_1 0 65535 /end CHARACTERISTIC
/begin CHARACTERISTIC FaultManager.Blend_Valve_Sensor_B_Low_Voltage.Test "Fault manager configuration.  Select up to 4 actions for each fault." VALUE 0x800008B4 RecordLayout_7 0 CompuMethod_490 0 65535 /end CHARACTERISTIC
/begin CHARACTERISTIC FaultManager.Blend_Valve_Sensor_B_Low_Voltage.Faulty_Samples__X_ "Fault manager configuration.  Select up to 4 actions for each fault." VALUE 0x800008B6 RecordLayout_7 0 CompuMethod_1 0 65535 /end CHARACTERISTIC
/begin CHARACTERISTIC FaultManager.Blend_Valve_Sensor_B_Low_Voltage.Total_Samples__Y_ "Fault manager configuration.  Select up to 4 actions for each fault." VALUE 0x800008B8 RecordLayout_7 0 CompuMethod_1 0 65535 /end CHARACTERISTIC
/begin CHARACTERISTIC FaultManager.Blend_Valve_Sensor_B_Low_Voltage.Action_1 "Fault manager configuration.  Select up to 4 actions for each fault." VALUE 0x800008BA RecordLayout_7 0 CompuMethod_491 0 65535 /end CHARACTERISTIC
/begin CHARACTERISTIC FaultManager.Blend_Valve_Sensor_B_Low_Voltage.Action_1_Condition "Fault manager configuration.  Select up to 4 actions for each fault." VALUE 0x800008BC RecordLayout_7 0 CompuMethod_492 0 65535 /end CHARACTERISTIC
/begin CHARACTERISTIC FaultManager.Blend_Valve_Sensor_B_Low_Voltage.Action_2 "Fault manager configuration.  Select up to 4 actions for each fault." VALUE 0x800008BE RecordLayout_7 0 CompuMethod_491 0 65535 /end CHARACTERISTIC
/begin CHARACTERISTIC FaultManager.Blend_Valve_Sensor_B_Low_Voltage.Action_2_Condition "Fault manager configuration.  Select up to 4 actions for each fault." VALUE 0x800008C0 RecordLayout_7 0 CompuMethod_492 0 65535 /end CHARACTERISTIC
/begin CHARACTERISTIC FaultManager.Blend_Valve_Sensor_B_Low_Voltage.Action_3 "Fault manager configuration.  Select up to 4 actions for each fault." VALUE 0x800008C2 RecordLayout_7 0 CompuMethod_491 0 65535 /end CHARACTERISTIC
/begin CHARACTERISTIC FaultManager.Blend_Valve_Sensor_B_Low_Voltage.Action_3_Condition "Fault manager configuration.  Select up to 4 actions for each fault." VALUE 0x800008C4 RecordLayout_7 0 CompuMethod_492 0 65535 /end CHARACTERISTIC
/begin CHARACTERISTIC FaultManager.Blend_Valve_Sensor_B_Low_Voltage.Action_4 "Fault manager configuration.  Select up to 4 actions for each fault." VALUE 0x800008C6 RecordLayout_7 0 CompuMethod_491 0 65535 /end CHARACTERISTIC
/begin CHARACTERISTIC FaultManager.Blend_Valve_Sensor_B_Low_Voltage.Action_4_Condition "Fault manager configuration.  Select up to 4 actions for each fault." VALUE 0x800008C8 RecordLayout_7 0 CompuMethod_492 0 65535 /end CHARACTERISTIC
/begin CHARACTERISTIC FaultManager.Brake_Pedal_Position_Communication_Loss.Mode "Fault manager configuration.  Select up to 4 actions for each fault." VALUE 0x800008CA RecordLayout_7 0 CompuMethod_489 0 65535 /end CHARACTERISTIC
/begin CHARACTERISTIC FaultManager.Brake_Pedal_Position_Communication_Loss.ID "Fault manager configuration.  Select up to 4 actions for each fault." VALUE 0x800008CC RecordLayout_7 0 CompuMethod_1 0 65535 /end CHARACTERISTIC
/begin CHARACTERISTIC FaultManager.Brake_Pedal_Position_Communication_Loss.Test "Fault manager configuration.  Select up to 4 actions for each fault." VALUE 0x800008CE RecordLayout_7 0 CompuMethod_490 0 65535 /end CHARACTERISTIC
/begin CHARACTERISTIC FaultManager.Brake_Pedal_Position_Communication_Loss.Faulty_Samples__X_ "Fault manager configuration.  Select up to 4 actions for each fault." VALUE 0x800008D0 RecordLayout_7 0 CompuMethod_1 0 65535 /end CHARACTERISTIC
/begin CHARACTERISTIC FaultManager.Brake_Pedal_Position_Communication_Loss.Total_Samples__Y_ "Fault manager configuration.  Select up to 4 actions for each fault." VALUE 0x800008D2 RecordLayout_7 0 CompuMethod_1 0 65535 /end CHARACTERISTIC
/begin CHARACTERISTIC FaultManager.Brake_Pedal_Position_Communication_Loss.Action_1 "Fault manager configuration.  Select up to 4 actions for each fault." VALUE 0x800008D4 RecordLayout_7 0 CompuMethod_491 0 65535 /end CHARACTERISTIC
/begin CHARACTERISTIC FaultManager.Brake_Pedal_Position_Communication_Loss.Action_1_Condition "Fault manager configuration.  Select up to 4 actions for each fault." VALUE 0x800008D6 RecordLayout_7 0 CompuMethod_492 0 65535 /end CHARACTERISTIC
/begin CHARACTERISTIC FaultManager.Brake_Pedal_Position_Communication_Loss.Action_2 "Fault manager configuration.  Select up to 4 actions for each fault." VALUE 0x800008D8 RecordLayout_7 0 CompuMethod_491 0 65535 /end CHARACTERISTIC
/begin CHARACTERISTIC FaultManager.Brake_Pedal_Position_Communication_Loss.Action_2_Condition "Fault manager configuration.  Select up to 4 actions for each fault." VALUE 0x800008DA RecordLayout_7 0 CompuMethod_492 0 65535 /end CHARACTERISTIC
/begin CHARACTERISTIC FaultManager.Brake_Pedal_Position_Communication_Loss.Action_3 "Fault manager configuration.  Select up to 4 actions for each fault." VALUE 0x800008DC RecordLayout_7 0 CompuMethod_491 0 65535 /end CHARACTERISTIC
/begin CHARACTERISTIC FaultManager.Brake_Pedal_Position_Communication_Loss.Action_3_Condition "Fault manager configuration.  Select up to 4 actions for each fault." VALUE 0x800008DE RecordLayout_7 0 CompuMethod_492 0 65535 /end CHARACTERISTIC
/begin CHARACTERISTIC FaultManager.Brake_Pedal_Position_Communication_Loss.Action_4 "Fault manager configuration.  Select up to 4 actions for each fault." VALUE 0x800008E0 RecordLayout_7 0 CompuMethod_491 0 65535 /end CHARACTERISTIC
/begin CHARACTERISTIC FaultManager.Brake_Pedal_Position_Communication_Loss.Action_4_Condition "Fault manager configuration.  Select up to 4 actions for each fault." VALUE 0x800008E2 RecordLayout_7 0 CompuMethod_492 0 65535 /end CHARACTERISTIC
/begin CHARACTERISTIC FaultManager.Brake_Pedal_Position_Intermiitent.Mode "Fault manager configuration.  Select up to 4 actions for each fault." VALUE 0x800008E4 RecordLayout_7 0 CompuMethod_489 0 65535 /end CHARACTERISTIC
/begin CHARACTERISTIC FaultManager.Brake_Pedal_Position_Intermiitent.ID "Fault manager configuration.  Select up to 4 actions for each fault." VALUE 0x800008E6 RecordLayout_7 0 CompuMethod_1 0 65535 /end CHARACTERISTIC
/begin CHARACTERISTIC FaultManager.Brake_Pedal_Position_Intermiitent.Test "Fault manager configuration.  Select up to 4 actions for each fault." VALUE 0x800008E8 RecordLayout_7 0 CompuMethod_490 0 65535 /end CHARACTERISTIC
/begin CHARACTERISTIC FaultManager.Brake_Pedal_Position_Intermiitent.Faulty_Samples__X_ "Fault manager configuration.  Select up to 4 actions for each fault." VALUE 0x800008EA RecordLayout_7 0 CompuMethod_1 0 65535 /end CHARACTERISTIC
/begin CHARACTERISTIC FaultManager.Brake_Pedal_Position_Intermiitent.Total_Samples__Y_ "Fault manager configuration.  Select up to 4 actions for each fault." VALUE 0x800008EC RecordLayout_7 0 CompuMethod_1 0 65535 /end CHARACTERISTIC
/begin CHARACTERISTIC FaultManager.Brake_Pedal_Position_Intermiitent.Action_1 "Fault manager configuration.  Select up to 4 actions for each fault." VALUE 0x800008EE RecordLayout_7 0 CompuMethod_491 0 65535 /end CHARACTERISTIC
/begin CHARACTERISTIC FaultManager.Brake_Pedal_Position_Intermiitent.Action_1_Condition "Fault manager configuration.  Select up to 4 actions for each fault." VALUE 0x800008F0 RecordLayout_7 0 CompuMethod_492 0 65535 /end CHARACTERISTIC
/begin CHARACTERISTIC FaultManager.Brake_Pedal_Position_Intermiitent.Action_2 "Fault manager configuration.  Select up to 4 actions for each fault." VALUE 0x800008F2 RecordLayout_7 0 CompuMethod_491 0 65535 /end CHARACTERISTIC
/begin CHARACTERISTIC FaultManager.Brake_Pedal_Position_Intermiitent.Action_2_Condition "Fault manager configuration.  Select up to 4 actions for each fault." VALUE 0x800008F4 RecordLayout_7 0 CompuMethod_492 0 65535 /end CHARACTERISTIC
/begin CHARACTERISTIC FaultManager.Brake_Pedal_Position_Intermiitent.Action_3 "Fault manager configuration.  Select up to 4 actions for each fault." VALUE 0x800008F6 RecordLayout_7 0 CompuMethod_491 0 65535 /end CHARACTERISTIC
/begin CHARACTERISTIC FaultManager.Brake_Pedal_Position_Intermiitent.Action_3_Condition "Fault manager configuration.  Select up to 4 actions for each fault." VALUE 0x800008F8 RecordLayout_7 0 CompuMethod_492 0 65535 /end CHARACTERISTIC
/begin CHARACTERISTIC FaultManager.Brake_Pedal_Position_Intermiitent.Action_4 "Fault manager configuration.  Select up to 4 actions for each fault." VALUE 0x800008FA RecordLayout_7 0 CompuMethod_491 0 65535 /end CHARACTERISTIC
/begin CHARACTERISTIC FaultManager.Brake_Pedal_Position_Intermiitent.Action_4_Condition "Fault manager configuration.  Select up to 4 actions for each fault." VALUE 0x800008FC RecordLayout_7 0 CompuMethod_492 0 65535 /end CHARACTERISTIC
/begin CHARACTERISTIC FaultManager.Brake_Pedal_Position_Low.Mode "Fault manager configuration.  Select up to 4 actions for each fault." VALUE 0x800008FE RecordLayout_7 0 CompuMethod_489 0 65535 /end CHARACTERISTIC
/begin CHARACTERISTIC FaultManager.Brake_Pedal_Position_Low.ID "Fault manager configuration.  Select up to 4 actions for each fault." VALUE 0x80000900 RecordLayout_7 0 CompuMethod_1 0 65535 /end CHARACTERISTIC
/begin CHARACTERISTIC FaultManager.Brake_Pedal_Position_Low.Test "Fault manager configuration.  Select up to 4 actions for each fault." VALUE 0x80000902 RecordLayout_7 0 CompuMethod_490 0 65535 /end CHARACTERISTIC
/begin CHARACTERISTIC FaultManager.Brake_Pedal_Position_Low.Faulty_Samples__X_ "Fault manager configuration.  Select up to 4 actions for each fault." VALUE 0x80000904 RecordLayout_7 0 CompuMethod_1 0 65535 /end CHARACTERISTIC
/begin CHARACTERISTIC FaultManager.Brake_Pedal_Position_Low.Total_Samples__Y_ "Fault manager configuration.  Select up to 4 actions for each fault." VALUE 0x80000906 RecordLayout_7 0 CompuMethod_1 0 65535 /end CHARACTERISTIC
/begin CHARACTERISTIC FaultManager.Brake_Pedal_Position_Low.Action_1 "Fault manager configuration.  Select up to 4 actions for each fault." VALUE 0x80000908 RecordLayout_7 0 CompuMethod_491 0 65535 /end CHARACTERISTIC
/begin CHARACTERISTIC FaultManager.Brake_Pedal_Position_Low.Action_1_Condition "Fault manager configuration.  Select up to 4 actions for each fault." VALUE 0x8000090A RecordLayout_7 0 CompuMethod_492 0 65535 /end CHARACTERISTIC
/begin CHARACTERISTIC FaultManager.Brake_Pedal_Position_Low.Action_2 "Fault manager configuration.  Select up to 4 actions for each fault." VALUE 0x8000090C RecordLayout_7 0 CompuMethod_491 0 65535 /end CHARACTERISTIC
/begin CHARACTERISTIC FaultManager.Brake_Pedal_Position_Low.Action_2_Condition "Fault manager configuration.  Select up to 4 actions for each fault." VALUE 0x8000090E RecordLayout_7 0 CompuMethod_492 0 65535 /end CHARACTERISTIC
/begin CHARACTERISTIC FaultManager.Brake_Pedal_Position_Low.Action_3 "Fault manager configuration.  Select up to 4 actions for each fault." VALUE 0x80000910 RecordLayout_7 0 CompuMethod_491 0 65535 /end CHARACTERISTIC
/begin CHARACTERISTIC FaultManager.Brake_Pedal_Position_Low.Action_3_Condition "Fault manager configuration.  Select up to 4 actions for each fault." VALUE 0x80000912 RecordLayout_7 0 CompuMethod_492 0 65535 /end CHARACTERISTIC
/begin CHARACTERISTIC FaultManager.Brake_Pedal_Position_Low.Action_4 "Fault manager configuration.  Select up to 4 actions for each fault." VALUE 0x80000914 RecordLayout_7 0 CompuMethod_491 0 65535 /end CHARACTERISTIC
/begin CHARACTERISTIC FaultManager.Brake_Pedal_Position_Low.Action_4_Condition "Fault manager configuration.  Select up to 4 actions for each fault." VALUE 0x80000916 RecordLayout_7 0 CompuMethod_492 0 65535 /end CHARACTERISTIC
/begin CHARACTERISTIC FaultManager.Brake_Pedal_Position_Sensor_A_Circuit_High.Mode "Fault manager configuration.  Select up to 4 actions for each fault." VALUE 0x80000918 RecordLayout_7 0 CompuMethod_489 0 65535 /end CHARACTERISTIC
/begin CHARACTERISTIC FaultManager.Brake_Pedal_Position_Sensor_A_Circuit_High.ID "Fault manager configuration.  Select up to 4 actions for each fault." VALUE 0x8000091A RecordLayout_7 0 CompuMethod_1 0 65535 /end CHARACTERISTIC
/begin CHARACTERISTIC FaultManager.Brake_Pedal_Position_Sensor_A_Circuit_High.Test "Fault manager configuration.  Select up to 4 actions for each fault." VALUE 0x8000091C RecordLayout_7 0 CompuMethod_490 0 65535 /end CHARACTERISTIC
/begin CHARACTERISTIC FaultManager.Brake_Pedal_Position_Sensor_A_Circuit_High.Faulty_Samples__X_ "Fault manager configuration.  Select up to 4 actions for each fault." VALUE 0x8000091E RecordLayout_7 0 CompuMethod_1 0 65535 /end CHARACTERISTIC
/begin CHARACTERISTIC FaultManager.Brake_Pedal_Position_Sensor_A_Circuit_High.Total_Samples__Y_ "Fault manager configuration.  Select up to 4 actions for each fault." VALUE 0x80000920 RecordLayout_7 0 CompuMethod_1 0 65535 /end CHARACTERISTIC
/begin CHARACTERISTIC FaultManager.Brake_Pedal_Position_Sensor_A_Circuit_High.Action_1 "Fault manager configuration.  Select up to 4 actions for each fault." VALUE 0x80000922 RecordLayout_7 0 CompuMethod_491 0 65535 /end CHARACTERISTIC
/begin CHARACTERISTIC FaultManager.Brake_Pedal_Position_Sensor_A_Circuit_High.Action_1_Condition "Fault manager configuration.  Select up to 4 actions for each fault." VALUE 0x80000924 RecordLayout_7 0 CompuMethod_492 0 65535 /end CHARACTERISTIC
/begin CHARACTERISTIC FaultManager.Brake_Pedal_Position_Sensor_A_Circuit_High.Action_2 "Fault manager configuration.  Select up to 4 actions for each fault." VALUE 0x80000926 RecordLayout_7 0 CompuMethod_491 0 65535 /end CHARACTERISTIC
/begin CHARACTERISTIC FaultManager.Brake_Pedal_Position_Sensor_A_Circuit_High.Action_2_Condition "Fault manager configuration.  Select up to 4 actions for each fault." VALUE 0x80000928 RecordLayout_7 0 CompuMethod_492 0 65535 /end CHARACTERISTIC
/begin CHARACTERISTIC FaultManager.Brake_Pedal_Position_Sensor_A_Circuit_High.Action_3 "Fault manager configuration.  Select up to 4 actions for each fault." VALUE 0x8000092A RecordLayout_7 0 CompuMethod_491 0 65535 /end CHARACTERISTIC
/begin CHARACTERISTIC FaultManager.Brake_Pedal_Position_Sensor_A_Circuit_High.Action_3_Condition "Fault manager configuration.  Select up to 4 actions for each fault." VALUE 0x8000092C RecordLayout_7 0 CompuMethod_492 0 65535 /end CHARACTERISTIC
/begin CHARACTERISTIC FaultManager.Brake_Pedal_Position_Sensor_A_Circuit_High.Action_4 "Fault manager configuration.  Select up to 4 actions for each fault." VALUE 0x8000092E RecordLayout_7 0 CompuMethod_491 0 65535 /end CHARACTERISTIC
/begin CHARACTERISTIC FaultManager.Brake_Pedal_Position_Sensor_A_Circuit_High.Action_4_Condition "Fault manager configuration.  Select up to 4 actions for each fault." VALUE 0x80000930 RecordLayout_7 0 CompuMethod_492 0 65535 /end CHARACTERISTIC
/begin CHARACTERISTIC FaultManager.Brakes_AgeCount.Mode "Fault manager configuration.  Select up to 4 actions for each fault." VALUE 0x80000932 RecordLayout_7 0 CompuMethod_489 0 65535 /end CHARACTERISTIC
/begin CHARACTERISTIC FaultManager.Brakes_AgeCount.ID "Fault manager configuration.  Select up to 4 actions for each fault." VALUE 0x80000934 RecordLayout_7 0 CompuMethod_1 0 65535 /end CHARACTERISTIC
/begin CHARACTERISTIC FaultManager.Brakes_AgeCount.Test "Fault manager configuration.  Select up to 4 actions for each fault." VALUE 0x80000936 RecordLayout_7 0 CompuMethod_490 0 65535 /end CHARACTERISTIC
/begin CHARACTERISTIC FaultManager.Brakes_AgeCount.Faulty_Samples__X_ "Fault manager configuration.  Select up to 4 actions for each fault." VALUE 0x80000938 RecordLayout_7 0 CompuMethod_1 0 65535 /end CHARACTERISTIC
/begin CHARACTERISTIC FaultManager.Brakes_AgeCount.Total_Samples__Y_ "Fault manager configuration.  Select up to 4 actions for each fault." VALUE 0x8000093A RecordLayout_7 0 CompuMethod_1 0 65535 /end CHARACTERISTIC
/begin CHARACTERISTIC FaultManager.Brakes_AgeCount.Action_1 "Fault manager configuration.  Select up to 4 actions for each fault." VALUE 0x8000093C RecordLayout_7 0 CompuMethod_491 0 65535 /end CHARACTERISTIC
/begin CHARACTERISTIC FaultManager.Brakes_AgeCount.Action_1_Condition "Fault manager configuration.  Select up to 4 actions for each fault." VALUE 0x8000093E RecordLayout_7 0 CompuMethod_492 0 65535 /end CHARACTERISTIC
/begin CHARACTERISTIC FaultManager.Brakes_AgeCount.Action_2 "Fault manager configuration.  Select up to 4 actions for each fault." VALUE 0x80000940 RecordLayout_7 0 CompuMethod_491 0 65535 /end CHARACTERISTIC
/begin CHARACTERISTIC FaultManager.Brakes_AgeCount.Action_2_Condition "Fault manager configuration.  Select up to 4 actions for each fault." VALUE 0x80000942 RecordLayout_7 0 CompuMethod_492 0 65535 /end CHARACTERISTIC
/begin CHARACTERISTIC FaultManager.Brakes_AgeCount.Action_3 "Fault manager configuration.  Select up to 4 actions for each fault." VALUE 0x80000944 RecordLayout_7 0 CompuMethod_491 0 65535 /end CHARACTERISTIC
/begin CHARACTERISTIC FaultManager.Brakes_AgeCount.Action_3_Condition "Fault manager configuration.  Select up to 4 actions for each fault." VALUE 0x80000946 RecordLayout_7 0 CompuMethod_492 0 65535 /end CHARACTERISTIC
/begin CHARACTERISTIC FaultManager.Brakes_AgeCount.Action_4 "Fault manager configuration.  Select up to 4 actions for each fault." VALUE 0x80000948 RecordLayout_7 0 CompuMethod_491 0 65535 /end CHARACTERISTIC
/begin CHARACTERISTIC FaultManager.Brakes_AgeCount.Action_4_Condition "Fault manager configuration.  Select up to 4 actions for each fault." VALUE 0x8000094A RecordLayout_7 0 CompuMethod_492 0 65535 /end CHARACTERISTIC
/begin CHARACTERISTIC FaultManager.Charge_Complete_Cell_Max_Volt.Mode "Fault manager configuration.  Select up to 4 actions for each fault." VALUE 0x8000094C RecordLayout_7 0 CompuMethod_489 0 65535 /end CHARACTERISTIC
/begin CHARACTERISTIC FaultManager.Charge_Complete_Cell_Max_Volt.ID "Fault manager configuration.  Select up to 4 actions for each fault." VALUE 0x8000094E RecordLayout_7 0 CompuMethod_1 0 65535 /end CHARACTERISTIC
/begin CHARACTERISTIC FaultManager.Charge_Complete_Cell_Max_Volt.Test "Fault manager configuration.  Select up to 4 actions for each fault." VALUE 0x80000950 RecordLayout_7 0 CompuMethod_490 0 65535 /end CHARACTERISTIC
/begin CHARACTERISTIC FaultManager.Charge_Complete_Cell_Max_Volt.Faulty_Samples__X_ "Fault manager configuration.  Select up to 4 actions for each fault." VALUE 0x80000952 RecordLayout_7 0 CompuMethod_1 0 65535 /end CHARACTERISTIC
/begin CHARACTERISTIC FaultManager.Charge_Complete_Cell_Max_Volt.Total_Samples__Y_ "Fault manager configuration.  Select up to 4 actions for each fault." VALUE 0x80000954 RecordLayout_7 0 CompuMethod_1 0 65535 /end CHARACTERISTIC
/begin CHARACTERISTIC FaultManager.Charge_Complete_Cell_Max_Volt.Action_1 "Fault manager configuration.  Select up to 4 actions for each fault." VALUE 0x80000956 RecordLayout_7 0 CompuMethod_491 0 65535 /end CHARACTERISTIC
/begin CHARACTERISTIC FaultManager.Charge_Complete_Cell_Max_Volt.Action_1_Condition "Fault manager configuration.  Select up to 4 actions for each fault." VALUE 0x80000958 RecordLayout_7 0 CompuMethod_492 0 65535 /end CHARACTERISTIC
/begin CHARACTERISTIC FaultManager.Charge_Complete_Cell_Max_Volt.Action_2 "Fault manager configuration.  Select up to 4 actions for each fault." VALUE 0x8000095A RecordLayout_7 0 CompuMethod_491 0 65535 /end CHARACTERISTIC
/begin CHARACTERISTIC FaultManager.Charge_Complete_Cell_Max_Volt.Action_2_Condition "Fault manager configuration.  Select up to 4 actions for each fault." VALUE 0x8000095C RecordLayout_7 0 CompuMethod_492 0 65535 /end CHARACTERISTIC
/begin CHARACTERISTIC FaultManager.Charge_Complete_Cell_Max_Volt.Action_3 "Fault manager configuration.  Select up to 4 actions for each fault." VALUE 0x8000095E RecordLayout_7 0 CompuMethod_491 0 65535 /end CHARACTERISTIC
/begin CHARACTERISTIC FaultManager.Charge_Complete_Cell_Max_Volt.Action_3_Condition "Fault manager configuration.  Select up to 4 actions for each fault." VALUE 0x80000960 RecordLayout_7 0 CompuMethod_492 0 65535 /end CHARACTERISTIC
/begin CHARACTERISTIC FaultManager.Charge_Complete_Cell_Max_Volt.Action_4 "Fault manager configuration.  Select up to 4 actions for each fault." VALUE 0x80000962 RecordLayout_7 0 CompuMethod_491 0 65535 /end CHARACTERISTIC
/begin CHARACTERISTIC FaultManager.Charge_Complete_Cell_Max_Volt.Action_4_Condition "Fault manager configuration.  Select up to 4 actions for each fault." VALUE 0x80000964 RecordLayout_7 0 CompuMethod_492 0 65535 /end CHARACTERISTIC
/begin CHARACTERISTIC FaultManager.Charger_Amperage_Draw_Greater_Then_Supply.Mode "Fault manager configuration.  Select up to 4 actions for each fault." VALUE 0x80000966 RecordLayout_7 0 CompuMethod_489 0 65535 /end CHARACTERISTIC
/begin CHARACTERISTIC FaultManager.Charger_Amperage_Draw_Greater_Then_Supply.ID "Fault manager configuration.  Select up to 4 actions for each fault." VALUE 0x80000968 RecordLayout_7 0 CompuMethod_1 0 65535 /end CHARACTERISTIC
/begin CHARACTERISTIC FaultManager.Charger_Amperage_Draw_Greater_Then_Supply.Test "Fault manager configuration.  Select up to 4 actions for each fault." VALUE 0x8000096A RecordLayout_7 0 CompuMethod_490 0 65535 /end CHARACTERISTIC
/begin CHARACTERISTIC FaultManager.Charger_Amperage_Draw_Greater_Then_Supply.Faulty_Samples__X_ "Fault manager configuration.  Select up to 4 actions for each fault." VALUE 0x8000096C RecordLayout_7 0 CompuMethod_1 0 65535 /end CHARACTERISTIC
/begin CHARACTERISTIC FaultManager.Charger_Amperage_Draw_Greater_Then_Supply.Total_Samples__Y_ "Fault manager configuration.  Select up to 4 actions for each fault." VALUE 0x8000096E RecordLayout_7 0 CompuMethod_1 0 65535 /end CHARACTERISTIC
/begin CHARACTERISTIC FaultManager.Charger_Amperage_Draw_Greater_Then_Supply.Action_1 "Fault manager configuration.  Select up to 4 actions for each fault." VALUE 0x80000970 RecordLayout_7 0 CompuMethod_491 0 65535 /end CHARACTERISTIC
/begin CHARACTERISTIC FaultManager.Charger_Amperage_Draw_Greater_Then_Supply.Action_1_Condition "Fault manager configuration.  Select up to 4 actions for each fault." VALUE 0x80000972 RecordLayout_7 0 CompuMethod_492 0 65535 /end CHARACTERISTIC
/begin CHARACTERISTIC FaultManager.Charger_Amperage_Draw_Greater_Then_Supply.Action_2 "Fault manager configuration.  Select up to 4 actions for each fault." VALUE 0x80000974 RecordLayout_7 0 CompuMethod_491 0 65535 /end CHARACTERISTIC
/begin CHARACTERISTIC FaultManager.Charger_Amperage_Draw_Greater_Then_Supply.Action_2_Condition "Fault manager configuration.  Select up to 4 actions for each fault." VALUE 0x80000976 RecordLayout_7 0 CompuMethod_492 0 65535 /end CHARACTERISTIC
/begin CHARACTERISTIC FaultManager.Charger_Amperage_Draw_Greater_Then_Supply.Action_3 "Fault manager configuration.  Select up to 4 actions for each fault." VALUE 0x80000978 RecordLayout_7 0 CompuMethod_491 0 65535 /end CHARACTERISTIC
/begin CHARACTERISTIC FaultManager.Charger_Amperage_Draw_Greater_Then_Supply.Action_3_Condition "Fault manager configuration.  Select up to 4 actions for each fault." VALUE 0x8000097A RecordLayout_7 0 CompuMethod_492 0 65535 /end CHARACTERISTIC
/begin CHARACTERISTIC FaultManager.Charger_Amperage_Draw_Greater_Then_Supply.Action_4 "Fault manager configuration.  Select up to 4 actions for each fault." VALUE 0x8000097C RecordLayout_7 0 CompuMethod_491 0 65535 /end CHARACTERISTIC
/begin CHARACTERISTIC FaultManager.Charger_Amperage_Draw_Greater_Then_Supply.Action_4_Condition "Fault manager configuration.  Select up to 4 actions for each fault." VALUE 0x8000097E RecordLayout_7 0 CompuMethod_492 0 65535 /end CHARACTERISTIC
/begin CHARACTERISTIC FaultManager.Charger_Derated_Over_Temperature.Mode "Fault manager configuration.  Select up to 4 actions for each fault." VALUE 0x80000980 RecordLayout_7 0 CompuMethod_489 0 65535 /end CHARACTERISTIC
/begin CHARACTERISTIC FaultManager.Charger_Derated_Over_Temperature.ID "Fault manager configuration.  Select up to 4 actions for each fault." VALUE 0x80000982 RecordLayout_7 0 CompuMethod_1 0 65535 /end CHARACTERISTIC
/begin CHARACTERISTIC FaultManager.Charger_Derated_Over_Temperature.Test "Fault manager configuration.  Select up to 4 actions for each fault." VALUE 0x80000984 RecordLayout_7 0 CompuMethod_490 0 65535 /end CHARACTERISTIC
/begin CHARACTERISTIC FaultManager.Charger_Derated_Over_Temperature.Faulty_Samples__X_ "Fault manager configuration.  Select up to 4 actions for each fault." VALUE 0x80000986 RecordLayout_7 0 CompuMethod_1 0 65535 /end CHARACTERISTIC
/begin CHARACTERISTIC FaultManager.Charger_Derated_Over_Temperature.Total_Samples__Y_ "Fault manager configuration.  Select up to 4 actions for each fault." VALUE 0x80000988 RecordLayout_7 0 CompuMethod_1 0 65535 /end CHARACTERISTIC
/begin CHARACTERISTIC FaultManager.Charger_Derated_Over_Temperature.Action_1 "Fault manager configuration.  Select up to 4 actions for each fault." VALUE 0x8000098A RecordLayout_7 0 CompuMethod_491 0 65535 /end CHARACTERISTIC
/begin CHARACTERISTIC FaultManager.Charger_Derated_Over_Temperature.Action_1_Condition "Fault manager configuration.  Select up to 4 actions for each fault." VALUE 0x8000098C RecordLayout_7 0 CompuMethod_492 0 65535 /end CHARACTERISTIC
/begin CHARACTERISTIC FaultManager.Charger_Derated_Over_Temperature.Action_2 "Fault manager configuration.  Select up to 4 actions for each fault." VALUE 0x8000098E RecordLayout_7 0 CompuMethod_491 0 65535 /end CHARACTERISTIC
/begin CHARACTERISTIC FaultManager.Charger_Derated_Over_Temperature.Action_2_Condition "Fault manager configuration.  Select up to 4 actions for each fault." VALUE 0x80000990 RecordLayout_7 0 CompuMethod_492 0 65535 /end CHARACTERISTIC
/begin CHARACTERISTIC FaultManager.Charger_Derated_Over_Temperature.Action_3 "Fault manager configuration.  Select up to 4 actions for each fault." VALUE 0x80000992 RecordLayout_7 0 CompuMethod_491 0 65535 /end CHARACTERISTIC
/begin CHARACTERISTIC FaultManager.Charger_Derated_Over_Temperature.Action_3_Condition "Fault manager configuration.  Select up to 4 actions for each fault." VALUE 0x80000994 RecordLayout_7 0 CompuMethod_492 0 65535 /end CHARACTERISTIC
/begin CHARACTERISTIC FaultManager.Charger_Derated_Over_Temperature.Action_4 "Fault manager configuration.  Select up to 4 actions for each fault." VALUE 0x80000996 RecordLayout_7 0 CompuMethod_491 0 65535 /end CHARACTERISTIC
/begin CHARACTERISTIC FaultManager.Charger_Derated_Over_Temperature.Action_4_Condition "Fault manager configuration.  Select up to 4 actions for each fault." VALUE 0x80000998 RecordLayout_7 0 CompuMethod_492 0 65535 /end CHARACTERISTIC
/begin CHARACTERISTIC FaultManager.Charger_Derated_Under_Temperature.Mode "Fault manager configuration.  Select up to 4 actions for each fault." VALUE 0x8000099A RecordLayout_7 0 CompuMethod_489 0 65535 /end CHARACTERISTIC
/begin CHARACTERISTIC FaultManager.Charger_Derated_Under_Temperature.ID "Fault manager configuration.  Select up to 4 actions for each fault." VALUE 0x8000099C RecordLayout_7 0 CompuMethod_1 0 65535 /end CHARACTERISTIC
/begin CHARACTERISTIC FaultManager.Charger_Derated_Under_Temperature.Test "Fault manager configuration.  Select up to 4 actions for each fault." VALUE 0x8000099E RecordLayout_7 0 CompuMethod_490 0 65535 /end CHARACTERISTIC
/begin CHARACTERISTIC FaultManager.Charger_Derated_Under_Temperature.Faulty_Samples__X_ "Fault manager configuration.  Select up to 4 actions for each fault." VALUE 0x800009A0 RecordLayout_7 0 CompuMethod_1 0 65535 /end CHARACTERISTIC
/begin CHARACTERISTIC FaultManager.Charger_Derated_Under_Temperature.Total_Samples__Y_ "Fault manager configuration.  Select up to 4 actions for each fault." VALUE 0x800009A2 RecordLayout_7 0 CompuMethod_1 0 65535 /end CHARACTERISTIC
/begin CHARACTERISTIC FaultManager.Charger_Derated_Under_Temperature.Action_1 "Fault manager configuration.  Select up to 4 actions for each fault." VALUE 0x800009A4 RecordLayout_7 0 CompuMethod_491 0 65535 /end CHARACTERISTIC
/begin CHARACTERISTIC FaultManager.Charger_Derated_Under_Temperature.Action_1_Condition "Fault manager configuration.  Select up to 4 actions for each fault." VALUE 0x800009A6 RecordLayout_7 0 CompuMethod_492 0 65535 /end CHARACTERISTIC
/begin CHARACTERISTIC FaultManager.Charger_Derated_Under_Temperature.Action_2 "Fault manager configuration.  Select up to 4 actions for each fault." VALUE 0x800009A8 RecordLayout_7 0 CompuMethod_491 0 65535 /end CHARACTERISTIC
/begin CHARACTERISTIC FaultManager.Charger_Derated_Under_Temperature.Action_2_Condition "Fault manager configuration.  Select up to 4 actions for each fault." VALUE 0x800009AA RecordLayout_7 0 CompuMethod_492 0 65535 /end CHARACTERISTIC
/begin CHARACTERISTIC FaultManager.Charger_Derated_Under_Temperature.Action_3 "Fault manager configuration.  Select up to 4 actions for each fault." VALUE 0x800009AC RecordLayout_7 0 CompuMethod_491 0 65535 /end CHARACTERISTIC
/begin CHARACTERISTIC FaultManager.Charger_Derated_Under_Temperature.Action_3_Condition "Fault manager configuration.  Select up to 4 actions for each fault." VALUE 0x800009AE RecordLayout_7 0 CompuMethod_492 0 65535 /end CHARACTERISTIC
/begin CHARACTERISTIC FaultManager.Charger_Derated_Under_Temperature.Action_4 "Fault manager configuration.  Select up to 4 actions for each fault." VALUE 0x800009B0 RecordLayout_7 0 CompuMethod_491 0 65535 /end CHARACTERISTIC
/begin CHARACTERISTIC FaultManager.Charger_Derated_Under_Temperature.Action_4_Condition "Fault manager configuration.  Select up to 4 actions for each fault." VALUE 0x800009B2 RecordLayout_7 0 CompuMethod_492 0 65535 /end CHARACTERISTIC
/begin CHARACTERISTIC FaultManager.Charger_Internal_Fault.Mode "Fault manager configuration.  Select up to 4 actions for each fault." VALUE 0x800009B4 RecordLayout_7 0 CompuMethod_489 0 65535 /end CHARACTERISTIC
/begin CHARACTERISTIC FaultManager.Charger_Internal_Fault.ID "Fault manager configuration.  Select up to 4 actions for each fault." VALUE 0x800009B6 RecordLayout_7 0 CompuMethod_1 0 65535 /end CHARACTERISTIC
/begin CHARACTERISTIC FaultManager.Charger_Internal_Fault.Test "Fault manager configuration.  Select up to 4 actions for each fault." VALUE 0x800009B8 RecordLayout_7 0 CompuMethod_490 0 65535 /end CHARACTERISTIC
/begin CHARACTERISTIC FaultManager.Charger_Internal_Fault.Faulty_Samples__X_ "Fault manager configuration.  Select up to 4 actions for each fault." VALUE 0x800009BA RecordLayout_7 0 CompuMethod_1 0 65535 /end CHARACTERISTIC
/begin CHARACTERISTIC FaultManager.Charger_Internal_Fault.Total_Samples__Y_ "Fault manager configuration.  Select up to 4 actions for each fault." VALUE 0x800009BC RecordLayout_7 0 CompuMethod_1 0 65535 /end CHARACTERISTIC
/begin CHARACTERISTIC FaultManager.Charger_Internal_Fault.Action_1 "Fault manager configuration.  Select up to 4 actions for each fault." VALUE 0x800009BE RecordLayout_7 0 CompuMethod_491 0 65535 /end CHARACTERISTIC
/begin CHARACTERISTIC FaultManager.Charger_Internal_Fault.Action_1_Condition "Fault manager configuration.  Select up to 4 actions for each fault." VALUE 0x800009C0 RecordLayout_7 0 CompuMethod_492 0 65535 /end CHARACTERISTIC
/begin CHARACTERISTIC FaultManager.Charger_Internal_Fault.Action_2 "Fault manager configuration.  Select up to 4 actions for each fault." VALUE 0x800009C2 RecordLayout_7 0 CompuMethod_491 0 65535 /end CHARACTERISTIC
/begin CHARACTERISTIC FaultManager.Charger_Internal_Fault.Action_2_Condition "Fault manager configuration.  Select up to 4 actions for each fault." VALUE 0x800009C4 RecordLayout_7 0 CompuMethod_492 0 65535 /end CHARACTERISTIC
/begin CHARACTERISTIC FaultManager.Charger_Internal_Fault.Action_3 "Fault manager configuration.  Select up to 4 actions for each fault." VALUE 0x800009C6 RecordLayout_7 0 CompuMethod_491 0 65535 /end CHARACTERISTIC
/begin CHARACTERISTIC FaultManager.Charger_Internal_Fault.Action_3_Condition "Fault manager configuration.  Select up to 4 actions for each fault." VALUE 0x800009C8 RecordLayout_7 0 CompuMethod_492 0 65535 /end CHARACTERISTIC
/begin CHARACTERISTIC FaultManager.Charger_Internal_Fault.Action_4 "Fault manager configuration.  Select up to 4 actions for each fault." VALUE 0x800009CA RecordLayout_7 0 CompuMethod_491 0 65535 /end CHARACTERISTIC
/begin CHARACTERISTIC FaultManager.Charger_Internal_Fault.Action_4_Condition "Fault manager configuration.  Select up to 4 actions for each fault." VALUE 0x800009CC RecordLayout_7 0 CompuMethod_492 0 65535 /end CHARACTERISTIC
/begin CHARACTERISTIC FaultManager.Charger_Line_Voltage_Too_Low.Mode "Fault manager configuration.  Select up to 4 actions for each fault." VALUE 0x800009CE RecordLayout_7 0 CompuMethod_489 0 65535 /end CHARACTERISTIC
/begin CHARACTERISTIC FaultManager.Charger_Line_Voltage_Too_Low.ID "Fault manager configuration.  Select up to 4 actions for each fault." VALUE 0x800009D0 RecordLayout_7 0 CompuMethod_1 0 65535 /end CHARACTERISTIC
/begin CHARACTERISTIC FaultManager.Charger_Line_Voltage_Too_Low.Test "Fault manager configuration.  Select up to 4 actions for each fault." VALUE 0x800009D2 RecordLayout_7 0 CompuMethod_490 0 65535 /end CHARACTERISTIC
/begin CHARACTERISTIC FaultManager.Charger_Line_Voltage_Too_Low.Faulty_Samples__X_ "Fault manager configuration.  Select up to 4 actions for each fault." VALUE 0x800009D4 RecordLayout_7 0 CompuMethod_1 0 65535 /end CHARACTERISTIC
/begin CHARACTERISTIC FaultManager.Charger_Line_Voltage_Too_Low.Total_Samples__Y_ "Fault manager configuration.  Select up to 4 actions for each fault." VALUE 0x800009D6 RecordLayout_7 0 CompuMethod_1 0 65535 /end CHARACTERISTIC
/begin CHARACTERISTIC FaultManager.Charger_Line_Voltage_Too_Low.Action_1 "Fault manager configuration.  Select up to 4 actions for each fault." VALUE 0x800009D8 RecordLayout_7 0 CompuMethod_491 0 65535 /end CHARACTERISTIC
/begin CHARACTERISTIC FaultManager.Charger_Line_Voltage_Too_Low.Action_1_Condition "Fault manager configuration.  Select up to 4 actions for each fault." VALUE 0x800009DA RecordLayout_7 0 CompuMethod_492 0 65535 /end CHARACTERISTIC
/begin CHARACTERISTIC FaultManager.Charger_Line_Voltage_Too_Low.Action_2 "Fault manager configuration.  Select up to 4 actions for each fault." VALUE 0x800009DC RecordLayout_7 0 CompuMethod_491 0 65535 /end CHARACTERISTIC
/begin CHARACTERISTIC FaultManager.Charger_Line_Voltage_Too_Low.Action_2_Condition "Fault manager configuration.  Select up to 4 actions for each fault." VALUE 0x800009DE RecordLayout_7 0 CompuMethod_492 0 65535 /end CHARACTERISTIC
/begin CHARACTERISTIC FaultManager.Charger_Line_Voltage_Too_Low.Action_3 "Fault manager configuration.  Select up to 4 actions for each fault." VALUE 0x800009E0 RecordLayout_7 0 CompuMethod_491 0 65535 /end CHARACTERISTIC
/begin CHARACTERISTIC FaultManager.Charger_Line_Voltage_Too_Low.Action_3_Condition "Fault manager configuration.  Select up to 4 actions for each fault." VALUE 0x800009E2 RecordLayout_7 0 CompuMethod_492 0 65535 /end CHARACTERISTIC
/begin CHARACTERISTIC FaultManager.Charger_Line_Voltage_Too_Low.Action_4 "Fault manager configuration.  Select up to 4 actions for each fault." VALUE 0x800009E4 RecordLayout_7 0 CompuMethod_491 0 65535 /end CHARACTERISTIC
/begin CHARACTERISTIC FaultManager.Charger_Line_Voltage_Too_Low.Action_4_Condition "Fault manager configuration.  Select up to 4 actions for each fault." VALUE 0x800009E6 RecordLayout_7 0 CompuMethod_492 0 65535 /end CHARACTERISTIC
/begin CHARACTERISTIC FaultManager.Charger_Line_Votlage_Too_High.Mode "Fault manager configuration.  Select up to 4 actions for each fault." VALUE 0x800009E8 RecordLayout_7 0 CompuMethod_489 0 65535 /end CHARACTERISTIC
/begin CHARACTERISTIC FaultManager.Charger_Line_Votlage_Too_High.ID "Fault manager configuration.  Select up to 4 actions for each fault." VALUE 0x800009EA RecordLayout_7 0 CompuMethod_1 0 65535 /end CHARACTERISTIC
/begin CHARACTERISTIC FaultManager.Charger_Line_Votlage_Too_High.Test "Fault manager configuration.  Select up to 4 actions for each fault." VALUE 0x800009EC RecordLayout_7 0 CompuMethod_490 0 65535 /end CHARACTERISTIC
/begin CHARACTERISTIC FaultManager.Charger_Line_Votlage_Too_High.Faulty_Samples__X_ "Fault manager configuration.  Select up to 4 actions for each fault." VALUE 0x800009EE RecordLayout_7 0 CompuMethod_1 0 65535 /end CHARACTERISTIC
/begin CHARACTERISTIC FaultManager.Charger_Line_Votlage_Too_High.Total_Samples__Y_ "Fault manager configuration.  Select up to 4 actions for each fault." VALUE 0x800009F0 RecordLayout_7 0 CompuMethod_1 0 65535 /end CHARACTERISTIC
/begin CHARACTERISTIC FaultManager.Charger_Line_Votlage_Too_High.Action_1 "Fault manager configuration.  Select up to 4 actions for each fault." VALUE 0x800009F2 RecordLayout_7 0 CompuMethod_491 0 65535 /end CHARACTERISTIC
/begin CHARACTERISTIC FaultManager.Charger_Line_Votlage_Too_High.Action_1_Condition "Fault manager configuration.  Select up to 4 actions for each fault." VALUE 0x800009F4 RecordLayout_7 0 CompuMethod_492 0 65535 /end CHARACTERISTIC
/begin CHARACTERISTIC FaultManager.Charger_Line_Votlage_Too_High.Action_2 "Fault manager configuration.  Select up to 4 actions for each fault." VALUE 0x800009F6 RecordLayout_7 0 CompuMethod_491 0 65535 /end CHARACTERISTIC
/begin CHARACTERISTIC FaultManager.Charger_Line_Votlage_Too_High.Action_2_Condition "Fault manager configuration.  Select up to 4 actions for each fault." VALUE 0x800009F8 RecordLayout_7 0 CompuMethod_492 0 65535 /end CHARACTERISTIC
/begin CHARACTERISTIC FaultManager.Charger_Line_Votlage_Too_High.Action_3 "Fault manager configuration.  Select up to 4 actions for each fault." VALUE 0x800009FA RecordLayout_7 0 CompuMethod_491 0 65535 /end CHARACTERISTIC
/begin CHARACTERISTIC FaultManager.Charger_Line_Votlage_Too_High.Action_3_Condition "Fault manager configuration.  Select up to 4 actions for each fault." VALUE 0x800009FC RecordLayout_7 0 CompuMethod_492 0 65535 /end CHARACTERISTIC
/begin CHARACTERISTIC FaultManager.Charger_Line_Votlage_Too_High.Action_4 "Fault manager configuration.  Select up to 4 actions for each fault." VALUE 0x800009FE RecordLayout_7 0 CompuMethod_491 0 65535 /end CHARACTERISTIC
/begin CHARACTERISTIC FaultManager.Charger_Line_Votlage_Too_High.Action_4_Condition "Fault manager configuration.  Select up to 4 actions for each fault." VALUE 0x80000A00 RecordLayout_7 0 CompuMethod_492 0 65535 /end CHARACTERISTIC
/begin CHARACTERISTIC FaultManager.Charger_Requested_But_No_High_Voltage.Mode "Fault manager configuration.  Select up to 4 actions for each fault." VALUE 0x80000A02 RecordLayout_7 0 CompuMethod_489 0 65535 /end CHARACTERISTIC
/begin CHARACTERISTIC FaultManager.Charger_Requested_But_No_High_Voltage.ID "Fault manager configuration.  Select up to 4 actions for each fault." VALUE 0x80000A04 RecordLayout_7 0 CompuMethod_1 0 65535 /end CHARACTERISTIC
/begin CHARACTERISTIC FaultManager.Charger_Requested_But_No_High_Voltage.Test "Fault manager configuration.  Select up to 4 actions for each fault." VALUE 0x80000A06 RecordLayout_7 0 CompuMethod_490 0 65535 /end CHARACTERISTIC
/begin CHARACTERISTIC FaultManager.Charger_Requested_But_No_High_Voltage.Faulty_Samples__X_ "Fault manager configuration.  Select up to 4 actions for each fault." VALUE 0x80000A08 RecordLayout_7 0 CompuMethod_1 0 65535 /end CHARACTERISTIC
/begin CHARACTERISTIC FaultManager.Charger_Requested_But_No_High_Voltage.Total_Samples__Y_ "Fault manager configuration.  Select up to 4 actions for each fault." VALUE 0x80000A0A RecordLayout_7 0 CompuMethod_1 0 65535 /end CHARACTERISTIC
/begin CHARACTERISTIC FaultManager.Charger_Requested_But_No_High_Voltage.Action_1 "Fault manager configuration.  Select up to 4 actions for each fault." VALUE 0x80000A0C RecordLayout_7 0 CompuMethod_491 0 65535 /end CHARACTERISTIC
/begin CHARACTERISTIC FaultManager.Charger_Requested_But_No_High_Voltage.Action_1_Condition "Fault manager configuration.  Select up to 4 actions for each fault." VALUE 0x80000A0E RecordLayout_7 0 CompuMethod_492 0 65535 /end CHARACTERISTIC
/begin CHARACTERISTIC FaultManager.Charger_Requested_But_No_High_Voltage.Action_2 "Fault manager configuration.  Select up to 4 actions for each fault." VALUE 0x80000A10 RecordLayout_7 0 CompuMethod_491 0 65535 /end CHARACTERISTIC
/begin CHARACTERISTIC FaultManager.Charger_Requested_But_No_High_Voltage.Action_2_Condition "Fault manager configuration.  Select up to 4 actions for each fault." VALUE 0x80000A12 RecordLayout_7 0 CompuMethod_492 0 65535 /end CHARACTERISTIC
/begin CHARACTERISTIC FaultManager.Charger_Requested_But_No_High_Voltage.Action_3 "Fault manager configuration.  Select up to 4 actions for each fault." VALUE 0x80000A14 RecordLayout_7 0 CompuMethod_491 0 65535 /end CHARACTERISTIC
/begin CHARACTERISTIC FaultManager.Charger_Requested_But_No_High_Voltage.Action_3_Condition "Fault manager configuration.  Select up to 4 actions for each fault." VALUE 0x80000A16 RecordLayout_7 0 CompuMethod_492 0 65535 /end CHARACTERISTIC
/begin CHARACTERISTIC FaultManager.Charger_Requested_But_No_High_Voltage.Action_4 "Fault manager configuration.  Select up to 4 actions for each fault." VALUE 0x80000A18 RecordLayout_7 0 CompuMethod_491 0 65535 /end CHARACTERISTIC
/begin CHARACTERISTIC FaultManager.Charger_Requested_But_No_High_Voltage.Action_4_Condition "Fault manager configuration.  Select up to 4 actions for each fault." VALUE 0x80000A1A RecordLayout_7 0 CompuMethod_492 0 65535 /end CHARACTERISTIC
/begin CHARACTERISTIC FaultManager.Charger_Requested_But_No_Key_Singal.Mode "Fault manager configuration.  Select up to 4 actions for each fault." VALUE 0x80000A1C RecordLayout_7 0 CompuMethod_489 0 65535 /end CHARACTERISTIC
/begin CHARACTERISTIC FaultManager.Charger_Requested_But_No_Key_Singal.ID "Fault manager configuration.  Select up to 4 actions for each fault." VALUE 0x80000A1E RecordLayout_7 0 CompuMethod_1 0 65535 /end CHARACTERISTIC
/begin CHARACTERISTIC FaultManager.Charger_Requested_But_No_Key_Singal.Test "Fault manager configuration.  Select up to 4 actions for each fault." VALUE 0x80000A20 RecordLayout_7 0 CompuMethod_490 0 65535 /end CHARACTERISTIC
/begin CHARACTERISTIC FaultManager.Charger_Requested_But_No_Key_Singal.Faulty_Samples__X_ "Fault manager configuration.  Select up to 4 actions for each fault." VALUE 0x80000A22 RecordLayout_7 0 CompuMethod_1 0 65535 /end CHARACTERISTIC
/begin CHARACTERISTIC FaultManager.Charger_Requested_But_No_Key_Singal.Total_Samples__Y_ "Fault manager configuration.  Select up to 4 actions for each fault." VALUE 0x80000A24 RecordLayout_7 0 CompuMethod_1 0 65535 /end CHARACTERISTIC
/begin CHARACTERISTIC FaultManager.Charger_Requested_But_No_Key_Singal.Action_1 "Fault manager configuration.  Select up to 4 actions for each fault." VALUE 0x80000A26 RecordLayout_7 0 CompuMethod_491 0 65535 /end CHARACTERISTIC
/begin CHARACTERISTIC FaultManager.Charger_Requested_But_No_Key_Singal.Action_1_Condition "Fault manager configuration.  Select up to 4 actions for each fault." VALUE 0x80000A28 RecordLayout_7 0 CompuMethod_492 0 65535 /end CHARACTERISTIC
/begin CHARACTERISTIC FaultManager.Charger_Requested_But_No_Key_Singal.Action_2 "Fault manager configuration.  Select up to 4 actions for each fault." VALUE 0x80000A2A RecordLayout_7 0 CompuMethod_491 0 65535 /end CHARACTERISTIC
/begin CHARACTERISTIC FaultManager.Charger_Requested_But_No_Key_Singal.Action_2_Condition "Fault manager configuration.  Select up to 4 actions for each fault." VALUE 0x80000A2C RecordLayout_7 0 CompuMethod_492 0 65535 /end CHARACTERISTIC
/begin CHARACTERISTIC FaultManager.Charger_Requested_But_No_Key_Singal.Action_3 "Fault manager configuration.  Select up to 4 actions for each fault." VALUE 0x80000A2E RecordLayout_7 0 CompuMethod_491 0 65535 /end CHARACTERISTIC
/begin CHARACTERISTIC FaultManager.Charger_Requested_But_No_Key_Singal.Action_3_Condition "Fault manager configuration.  Select up to 4 actions for each fault." VALUE 0x80000A30 RecordLayout_7 0 CompuMethod_492 0 65535 /end CHARACTERISTIC
/begin CHARACTERISTIC FaultManager.Charger_Requested_But_No_Key_Singal.Action_4 "Fault manager configuration.  Select up to 4 actions for each fault." VALUE 0x80000A32 RecordLayout_7 0 CompuMethod_491 0 65535 /end CHARACTERISTIC
/begin CHARACTERISTIC FaultManager.Charger_Requested_But_No_Key_Singal.Action_4_Condition "Fault manager configuration.  Select up to 4 actions for each fault." VALUE 0x80000A34 RecordLayout_7 0 CompuMethod_492 0 65535 /end CHARACTERISTIC
/begin CHARACTERISTIC FaultManager.Charger_Requested_Current_Too_High.Mode "Fault manager configuration.  Select up to 4 actions for each fault." VALUE 0x80000A36 RecordLayout_7 0 CompuMethod_489 0 65535 /end CHARACTERISTIC
/begin CHARACTERISTIC FaultManager.Charger_Requested_Current_Too_High.ID "Fault manager configuration.  Select up to 4 actions for each fault." VALUE 0x80000A38 RecordLayout_7 0 CompuMethod_1 0 65535 /end CHARACTERISTIC
/begin CHARACTERISTIC FaultManager.Charger_Requested_Current_Too_High.Test "Fault manager configuration.  Select up to 4 actions for each fault." VALUE 0x80000A3A RecordLayout_7 0 CompuMethod_490 0 65535 /end CHARACTERISTIC
/begin CHARACTERISTIC FaultManager.Charger_Requested_Current_Too_High.Faulty_Samples__X_ "Fault manager configuration.  Select up to 4 actions for each fault." VALUE 0x80000A3C RecordLayout_7 0 CompuMethod_1 0 65535 /end CHARACTERISTIC
/begin CHARACTERISTIC FaultManager.Charger_Requested_Current_Too_High.Total_Samples__Y_ "Fault manager configuration.  Select up to 4 actions for each fault." VALUE 0x80000A3E RecordLayout_7 0 CompuMethod_1 0 65535 /end CHARACTERISTIC
/begin CHARACTERISTIC FaultManager.Charger_Requested_Current_Too_High.Action_1 "Fault manager configuration.  Select up to 4 actions for each fault." VALUE 0x80000A40 RecordLayout_7 0 CompuMethod_491 0 65535 /end CHARACTERISTIC
/begin CHARACTERISTIC FaultManager.Charger_Requested_Current_Too_High.Action_1_Condition "Fault manager configuration.  Select up to 4 actions for each fault." VALUE 0x80000A42 RecordLayout_7 0 CompuMethod_492 0 65535 /end CHARACTERISTIC
/begin CHARACTERISTIC FaultManager.Charger_Requested_Current_Too_High.Action_2 "Fault manager configuration.  Select up to 4 actions for each fault." VALUE 0x80000A44 RecordLayout_7 0 CompuMethod_491 0 65535 /end CHARACTERISTIC
/begin CHARACTERISTIC FaultManager.Charger_Requested_Current_Too_High.Action_2_Condition "Fault manager configuration.  Select up to 4 actions for each fault." VALUE 0x80000A46 RecordLayout_7 0 CompuMethod_492 0 65535 /end CHARACTERISTIC
/begin CHARACTERISTIC FaultManager.Charger_Requested_Current_Too_High.Action_3 "Fault manager configuration.  Select up to 4 actions for each fault." VALUE 0x80000A48 RecordLayout_7 0 CompuMethod_491 0 65535 /end CHARACTERISTIC
/begin CHARACTERISTIC FaultManager.Charger_Requested_Current_Too_High.Action_3_Condition "Fault manager configuration.  Select up to 4 actions for each fault." VALUE 0x80000A4A RecordLayout_7 0 CompuMethod_492 0 65535 /end CHARACTERISTIC
/begin CHARACTERISTIC FaultManager.Charger_Requested_Current_Too_High.Action_4 "Fault manager configuration.  Select up to 4 actions for each fault." VALUE 0x80000A4C RecordLayout_7 0 CompuMethod_491 0 65535 /end CHARACTERISTIC
/begin CHARACTERISTIC FaultManager.Charger_Requested_Current_Too_High.Action_4_Condition "Fault manager configuration.  Select up to 4 actions for each fault." VALUE 0x80000A4E RecordLayout_7 0 CompuMethod_492 0 65535 /end CHARACTERISTIC
/begin CHARACTERISTIC FaultManager.Charger_Requested_Voltage_Out_of_Bounds.Mode "Fault manager configuration.  Select up to 4 actions for each fault." VALUE 0x80000A50 RecordLayout_7 0 CompuMethod_489 0 65535 /end CHARACTERISTIC
/begin CHARACTERISTIC FaultManager.Charger_Requested_Voltage_Out_of_Bounds.ID "Fault manager configuration.  Select up to 4 actions for each fault." VALUE 0x80000A52 RecordLayout_7 0 CompuMethod_1 0 65535 /end CHARACTERISTIC
/begin CHARACTERISTIC FaultManager.Charger_Requested_Voltage_Out_of_Bounds.Test "Fault manager configuration.  Select up to 4 actions for each fault." VALUE 0x80000A54 RecordLayout_7 0 CompuMethod_490 0 65535 /end CHARACTERISTIC
/begin CHARACTERISTIC FaultManager.Charger_Requested_Voltage_Out_of_Bounds.Faulty_Samples__X_ "Fault manager configuration.  Select up to 4 actions for each fault." VALUE 0x80000A56 RecordLayout_7 0 CompuMethod_1 0 65535 /end CHARACTERISTIC
/begin CHARACTERISTIC FaultManager.Charger_Requested_Voltage_Out_of_Bounds.Total_Samples__Y_ "Fault manager configuration.  Select up to 4 actions for each fault." VALUE 0x80000A58 RecordLayout_7 0 CompuMethod_1 0 65535 /end CHARACTERISTIC
/begin CHARACTERISTIC FaultManager.Charger_Requested_Voltage_Out_of_Bounds.Action_1 "Fault manager configuration.  Select up to 4 actions for each fault." VALUE 0x80000A5A RecordLayout_7 0 CompuMethod_491 0 65535 /end CHARACTERISTIC
/begin CHARACTERISTIC FaultManager.Charger_Requested_Voltage_Out_of_Bounds.Action_1_Condition "Fault manager configuration.  Select up to 4 actions for each fault." VALUE 0x80000A5C RecordLayout_7 0 CompuMethod_492 0 65535 /end CHARACTERISTIC
/begin CHARACTERISTIC FaultManager.Charger_Requested_Voltage_Out_of_Bounds.Action_2 "Fault manager configuration.  Select up to 4 actions for each fault." VALUE 0x80000A5E RecordLayout_7 0 CompuMethod_491 0 65535 /end CHARACTERISTIC
/begin CHARACTERISTIC FaultManager.Charger_Requested_Voltage_Out_of_Bounds.Action_2_Condition "Fault manager configuration.  Select up to 4 actions for each fault." VALUE 0x80000A60 RecordLayout_7 0 CompuMethod_492 0 65535 /end CHARACTERISTIC
/begin CHARACTERISTIC FaultManager.Charger_Requested_Voltage_Out_of_Bounds.Action_3 "Fault manager configuration.  Select up to 4 actions for each fault." VALUE 0x80000A62 RecordLayout_7 0 CompuMethod_491 0 65535 /end CHARACTERISTIC
/begin CHARACTERISTIC FaultManager.Charger_Requested_Voltage_Out_of_Bounds.Action_3_Condition "Fault manager configuration.  Select up to 4 actions for each fault." VALUE 0x80000A64 RecordLayout_7 0 CompuMethod_492 0 65535 /end CHARACTERISTIC
/begin CHARACTERISTIC FaultManager.Charger_Requested_Voltage_Out_of_Bounds.Action_4 "Fault manager configuration.  Select up to 4 actions for each fault." VALUE 0x80000A66 RecordLayout_7 0 CompuMethod_491 0 65535 /end CHARACTERISTIC
/begin CHARACTERISTIC FaultManager.Charger_Requested_Voltage_Out_of_Bounds.Action_4_Condition "Fault manager configuration.  Select up to 4 actions for each fault." VALUE 0x80000A68 RecordLayout_7 0 CompuMethod_492 0 65535 /end CHARACTERISTIC
/begin CHARACTERISTIC FaultManager.Cruise_Control_Brake_Switch_A_Circuit_High.Mode "Fault manager configuration.  Select up to 4 actions for each fault." VALUE 0x80000A6A RecordLayout_7 0 CompuMethod_489 0 65535 /end CHARACTERISTIC
/begin CHARACTERISTIC FaultManager.Cruise_Control_Brake_Switch_A_Circuit_High.ID "Fault manager configuration.  Select up to 4 actions for each fault." VALUE 0x80000A6C RecordLayout_7 0 CompuMethod_1 0 65535 /end CHARACTERISTIC
/begin CHARACTERISTIC FaultManager.Cruise_Control_Brake_Switch_A_Circuit_High.Test "Fault manager configuration.  Select up to 4 actions for each fault." VALUE 0x80000A6E RecordLayout_7 0 CompuMethod_490 0 65535 /end CHARACTERISTIC
/begin CHARACTERISTIC FaultManager.Cruise_Control_Brake_Switch_A_Circuit_High.Faulty_Samples__X_ "Fault manager configuration.  Select up to 4 actions for each fault." VALUE 0x80000A70 RecordLayout_7 0 CompuMethod_1 0 65535 /end CHARACTERISTIC
/begin CHARACTERISTIC FaultManager.Cruise_Control_Brake_Switch_A_Circuit_High.Total_Samples__Y_ "Fault manager configuration.  Select up to 4 actions for each fault." VALUE 0x80000A72 RecordLayout_7 0 CompuMethod_1 0 65535 /end CHARACTERISTIC
/begin CHARACTERISTIC FaultManager.Cruise_Control_Brake_Switch_A_Circuit_High.Action_1 "Fault manager configuration.  Select up to 4 actions for each fault." VALUE 0x80000A74 RecordLayout_7 0 CompuMethod_491 0 65535 /end CHARACTERISTIC
/begin CHARACTERISTIC FaultManager.Cruise_Control_Brake_Switch_A_Circuit_High.Action_1_Condition "Fault manager configuration.  Select up to 4 actions for each fault." VALUE 0x80000A76 RecordLayout_7 0 CompuMethod_492 0 65535 /end CHARACTERISTIC
/begin CHARACTERISTIC FaultManager.Cruise_Control_Brake_Switch_A_Circuit_High.Action_2 "Fault manager configuration.  Select up to 4 actions for each fault." VALUE 0x80000A78 RecordLayout_7 0 CompuMethod_491 0 65535 /end CHARACTERISTIC
/begin CHARACTERISTIC FaultManager.Cruise_Control_Brake_Switch_A_Circuit_High.Action_2_Condition "Fault manager configuration.  Select up to 4 actions for each fault." VALUE 0x80000A7A RecordLayout_7 0 CompuMethod_492 0 65535 /end CHARACTERISTIC
/begin CHARACTERISTIC FaultManager.Cruise_Control_Brake_Switch_A_Circuit_High.Action_3 "Fault manager configuration.  Select up to 4 actions for each fault." VALUE 0x80000A7C RecordLayout_7 0 CompuMethod_491 0 65535 /end CHARACTERISTIC
/begin CHARACTERISTIC FaultManager.Cruise_Control_Brake_Switch_A_Circuit_High.Action_3_Condition "Fault manager configuration.  Select up to 4 actions for each fault." VALUE 0x80000A7E RecordLayout_7 0 CompuMethod_492 0 65535 /end CHARACTERISTIC
/begin CHARACTERISTIC FaultManager.Cruise_Control_Brake_Switch_A_Circuit_High.Action_4 "Fault manager configuration.  Select up to 4 actions for each fault." VALUE 0x80000A80 RecordLayout_7 0 CompuMethod_491 0 65535 /end CHARACTERISTIC
/begin CHARACTERISTIC FaultManager.Cruise_Control_Brake_Switch_A_Circuit_High.Action_4_Condition "Fault manager configuration.  Select up to 4 actions for each fault." VALUE 0x80000A82 RecordLayout_7 0 CompuMethod_492 0 65535 /end CHARACTERISTIC
/begin CHARACTERISTIC FaultManager.Cruise_Control_Brake_Switch_A_Circuit_Low.Mode "Fault manager configuration.  Select up to 4 actions for each fault." VALUE 0x80000A84 RecordLayout_7 0 CompuMethod_489 0 65535 /end CHARACTERISTIC
/begin CHARACTERISTIC FaultManager.Cruise_Control_Brake_Switch_A_Circuit_Low.ID "Fault manager configuration.  Select up to 4 actions for each fault." VALUE 0x80000A86 RecordLayout_7 0 CompuMethod_1 0 65535 /end CHARACTERISTIC
/begin CHARACTERISTIC FaultManager.Cruise_Control_Brake_Switch_A_Circuit_Low.Test "Fault manager configuration.  Select up to 4 actions for each fault." VALUE 0x80000A88 RecordLayout_7 0 CompuMethod_490 0 65535 /end CHARACTERISTIC
/begin CHARACTERISTIC FaultManager.Cruise_Control_Brake_Switch_A_Circuit_Low.Faulty_Samples__X_ "Fault manager configuration.  Select up to 4 actions for each fault." VALUE 0x80000A8A RecordLayout_7 0 CompuMethod_1 0 65535 /end CHARACTERISTIC
/begin CHARACTERISTIC FaultManager.Cruise_Control_Brake_Switch_A_Circuit_Low.Total_Samples__Y_ "Fault manager configuration.  Select up to 4 actions for each fault." VALUE 0x80000A8C RecordLayout_7 0 CompuMethod_1 0 65535 /end CHARACTERISTIC
/begin CHARACTERISTIC FaultManager.Cruise_Control_Brake_Switch_A_Circuit_Low.Action_1 "Fault manager configuration.  Select up to 4 actions for each fault." VALUE 0x80000A8E RecordLayout_7 0 CompuMethod_491 0 65535 /end CHARACTERISTIC
/begin CHARACTERISTIC FaultManager.Cruise_Control_Brake_Switch_A_Circuit_Low.Action_1_Condition "Fault manager configuration.  Select up to 4 actions for each fault." VALUE 0x80000A90 RecordLayout_7 0 CompuMethod_492 0 65535 /end CHARACTERISTIC
/begin CHARACTERISTIC FaultManager.Cruise_Control_Brake_Switch_A_Circuit_Low.Action_2 "Fault manager configuration.  Select up to 4 actions for each fault." VALUE 0x80000A92 RecordLayout_7 0 CompuMethod_491 0 65535 /end CHARACTERISTIC
/begin CHARACTERISTIC FaultManager.Cruise_Control_Brake_Switch_A_Circuit_Low.Action_2_Condition "Fault manager configuration.  Select up to 4 actions for each fault." VALUE 0x80000A94 RecordLayout_7 0 CompuMethod_492 0 65535 /end CHARACTERISTIC
/begin CHARACTERISTIC FaultManager.Cruise_Control_Brake_Switch_A_Circuit_Low.Action_3 "Fault manager configuration.  Select up to 4 actions for each fault." VALUE 0x80000A96 RecordLayout_7 0 CompuMethod_491 0 65535 /end CHARACTERISTIC
/begin CHARACTERISTIC FaultManager.Cruise_Control_Brake_Switch_A_Circuit_Low.Action_3_Condition "Fault manager configuration.  Select up to 4 actions for each fault." VALUE 0x80000A98 RecordLayout_7 0 CompuMethod_492 0 65535 /end CHARACTERISTIC
/begin CHARACTERISTIC FaultManager.Cruise_Control_Brake_Switch_A_Circuit_Low.Action_4 "Fault manager configuration.  Select up to 4 actions for each fault." VALUE 0x80000A9A RecordLayout_7 0 CompuMethod_491 0 65535 /end CHARACTERISTIC
/begin CHARACTERISTIC FaultManager.Cruise_Control_Brake_Switch_A_Circuit_Low.Action_4_Condition "Fault manager configuration.  Select up to 4 actions for each fault." VALUE 0x80000A9C RecordLayout_7 0 CompuMethod_492 0 65535 /end CHARACTERISTIC
/begin CHARACTERISTIC FaultManager.Cruise_Control_Brake_Switch_A_Circuit_Malfunction.Mode "Fault manager configuration.  Select up to 4 actions for each fault." VALUE 0x80000A9E RecordLayout_7 0 CompuMethod_489 0 65535 /end CHARACTERISTIC
/begin CHARACTERISTIC FaultManager.Cruise_Control_Brake_Switch_A_Circuit_Malfunction.ID "Fault manager configuration.  Select up to 4 actions for each fault." VALUE 0x80000AA0 RecordLayout_7 0 CompuMethod_1 0 65535 /end CHARACTERISTIC
/begin CHARACTERISTIC FaultManager.Cruise_Control_Brake_Switch_A_Circuit_Malfunction.Test "Fault manager configuration.  Select up to 4 actions for each fault." VALUE 0x80000AA2 RecordLayout_7 0 CompuMethod_490 0 65535 /end CHARACTERISTIC
/begin CHARACTERISTIC FaultManager.Cruise_Control_Brake_Switch_A_Circuit_Malfunction.Faulty_Samples__X_ "Fault manager configuration.  Select up to 4 actions for each fault." VALUE 0x80000AA4 RecordLayout_7 0 CompuMethod_1 0 65535 /end CHARACTERISTIC
/begin CHARACTERISTIC FaultManager.Cruise_Control_Brake_Switch_A_Circuit_Malfunction.Total_Samples__Y_ "Fault manager configuration.  Select up to 4 actions for each fault." VALUE 0x80000AA6 RecordLayout_7 0 CompuMethod_1 0 65535 /end CHARACTERISTIC
/begin CHARACTERISTIC FaultManager.Cruise_Control_Brake_Switch_A_Circuit_Malfunction.Action_1 "Fault manager configuration.  Select up to 4 actions for each fault." VALUE 0x80000AA8 RecordLayout_7 0 CompuMethod_491 0 65535 /end CHARACTERISTIC
/begin CHARACTERISTIC FaultManager.Cruise_Control_Brake_Switch_A_Circuit_Malfunction.Action_1_Condition "Fault manager configuration.  Select up to 4 actions for each fault." VALUE 0x80000AAA RecordLayout_7 0 CompuMethod_492 0 65535 /end CHARACTERISTIC
/begin CHARACTERISTIC FaultManager.Cruise_Control_Brake_Switch_A_Circuit_Malfunction.Action_2 "Fault manager configuration.  Select up to 4 actions for each fault." VALUE 0x80000AAC RecordLayout_7 0 CompuMethod_491 0 65535 /end CHARACTERISTIC
/begin CHARACTERISTIC FaultManager.Cruise_Control_Brake_Switch_A_Circuit_Malfunction.Action_2_Condition "Fault manager configuration.  Select up to 4 actions for each fault." VALUE 0x80000AAE RecordLayout_7 0 CompuMethod_492 0 65535 /end CHARACTERISTIC
/begin CHARACTERISTIC FaultManager.Cruise_Control_Brake_Switch_A_Circuit_Malfunction.Action_3 "Fault manager configuration.  Select up to 4 actions for each fault." VALUE 0x80000AB0 RecordLayout_7 0 CompuMethod_491 0 65535 /end CHARACTERISTIC
/begin CHARACTERISTIC FaultManager.Cruise_Control_Brake_Switch_A_Circuit_Malfunction.Action_3_Condition "Fault manager configuration.  Select up to 4 actions for each fault." VALUE 0x80000AB2 RecordLayout_7 0 CompuMethod_492 0 65535 /end CHARACTERISTIC
/begin CHARACTERISTIC FaultManager.Cruise_Control_Brake_Switch_A_Circuit_Malfunction.Action_4 "Fault manager configuration.  Select up to 4 actions for each fault." VALUE 0x80000AB4 RecordLayout_7 0 CompuMethod_491 0 65535 /end CHARACTERISTIC
/begin CHARACTERISTIC FiltConst "Filter time constant" VALUE 0x8000111E RecordLayout_4 0 CompuMethod_493 -1E+17 1E+17 /end CHARACTERISTIC
/begin CHARACTERISTIC Gear_Shift_Module_Communication_Circuit "" VALUE 0x80001160 RecordLayout_4 0 CompuMethod_2 -1E+17 1E+17 /end CHARACTERISTIC
/begin CHARACTERISTIC Mode_1_1 "" VALUE 0x800013A6 RecordLayout_4 0 CompuMethod_2 -1E+17 1E+17 /end CHARACTERISTIC
/begin CHARACTERISTIC Mode_1_2 "" VALUE 0x800013AF RecordLayout_4 0 CompuMethod_2 -1E+17 1E+17 /end CHARACTERISTIC
/begin CHARACTERISTIC Mode_2_1 "" VALUE 0x800013B8 RecordLayout_4 0 CompuMethod_2 -1E+17 1E+17 /end CHARACTERISTIC
/begin CHARACTERISTIC Mode_2_2 "" VALUE 0x800013C1 RecordLayout_4 0 CompuMethod_2 -1E+17 1E+17 /end CHARACTERISTIC
/begin CHARACTERISTIC Mode_3_1 "" VALUE 0x800013CA RecordLayout_4 0 CompuMethod_2 -1E+17 1E+17 /end CHARACTERISTIC
/begin CHARACTERISTIC Mode_3_2 "" VALUE 0x800013CE RecordLayout_4 0 CompuMethod_2 -1E+17 1E+17 /end CHARACTERISTIC
/begin CHARACTERISTIC Mode_4_1 "" VALUE 0x800013DC RecordLayout_4 0 CompuMethod_2 -1E+17 1E+17 /end CHARACTERISTIC
/begin CHARACTERISTIC Mode_4_2 "" VALUE 0x800013E0 RecordLayout_4 0 CompuMethod_2 -1E+17 1E+17 /end CHARACTERISTIC
/begin CHARACTERISTIC MPRD_KeepAlive "When enabled, keeps the MPRD output on and keeps the processor alive" VALUE 0x8000141A RecordLayout_3 0 CompuMethod_501 0 1 /end CHARACTERISTIC
/begin CHARACTERISTIC Park_Nuetral_Switch_Input_High_Fault "" VALUE 0x80001448 RecordLayout_4 0 CompuMethod_2 -1E+17 1E+17 /end CHARACTERISTIC
/begin CHARACTERISTIC Park_Nuetral_Switch_Input_Low_Fault "" VALUE 0x8000144C RecordLayout_4 0 CompuMethod_2 -1E+17 1E+17 /end CHARACTERISTIC
/begin CHARACTERISTIC ProcessorReboot "Reboots the processor when set." VALUE 0x8000147A RecordLayout_3 0 CompuMethod_509 0 1 /end CHARACTERISTIC
/begin CHARACTERISTIC RPM_to_Wheel_Speed_Multiplier2 "" VALUE 0x80001508 RecordLayout_4 0 CompuMethod_2 -1E+17 1E+17 /end CHARACTERISTIC
/begin CHARACTERISTIC Shutdown_Req "" VALUE 0x8000153A RecordLayout_3 0 CompuMethod_11 0 1 /end CHARACTERISTIC
/begin CHARACTERISTIC VEH_ID "" VALUE 0x800016DB RecordLayout_4 0 CompuMethod_2 -1E+17 1E+17 /end CHARACTERISTIC
/begin CHARACTERISTIC VIN_DATA_BYTE_1 "" VALUE 0x80001704 RecordLayout_4 0 CompuMethod_2 -1E+17 1E+17 /end CHARACTERISTIC
/begin CHARACTERISTIC VIN_DATA_BYTE_10 "" VALUE 0x8000170D RecordLayout_4 0 CompuMethod_2 -1E+17 1E+17 /end CHARACTERISTIC
/begin CHARACTERISTIC VIN_DATA_BYTE_11 "" VALUE 0x80001716 RecordLayout_4 0 CompuMethod_2 -1E+17 1E+17 /end CHARACTERISTIC
/begin CHARACTERISTIC VIN_DATA_BYTE_12 "" VALUE 0x8000171F RecordLayout_4 0 CompuMethod_2 -1E+17 1E+17 /end CHARACTERISTIC
/begin CHARACTERISTIC VIN_DATA_BYTE_13 "" VALUE 0x80001728 RecordLayout_4 0 CompuMethod_2 -1E+17 1E+17 /end CHARACTERISTIC
/begin CHARACTERISTIC VIN_DATA_BYTE_14 "" VALUE 0x80001731 RecordLayout_4 0 CompuMethod_2 -1E+17 1E+17 /end CHARACTERISTIC
/begin CHARACTERISTIC VIN_DATA_BYTE_15 "" VALUE 0x8000173A RecordLayout_4 0 CompuMethod_2 -1E+17 1E+17 /end CHARACTERISTIC
/begin CHARACTERISTIC VIN_DATA_BYTE_16 "" VALUE 0x80001743 RecordLayout_4 0 CompuMethod_2 -1E+17 1E+17 /end CHARACTERISTIC
/begin CHARACTERISTIC VIN_DATA_BYTE_17 "" VALUE 0x8000174C RecordLayout_4 0 CompuMethod_2 -1E+17 1E+17 /end CHARACTERISTIC
/begin CHARACTERISTIC VIN_DATA_BYTE_2 "" VALUE 0x80001755 RecordLayout_4 0 CompuMethod_2 -1E+17 1E+17 /end CHARACTERISTIC
/begin CHARACTERISTIC VIN_DATA_BYTE_3 "" VALUE 0x8000175E RecordLayout_4 0 CompuMethod_2 -1E+17 1E+17 /end CHARACTERISTIC
/begin CHARACTERISTIC VIN_DATA_BYTE_4 "" VALUE 0x80001767 RecordLayout_4 0 CompuMethod_2 -1E+17 1E+17 /end CHARACTERISTIC
/begin CHARACTERISTIC VIN_DATA_BYTE_5 "" VALUE 0x80001770 RecordLayout_4 0 CompuMethod_2 -1E+17 1E+17 /end CHARACTERISTIC
/begin CHARACTERISTIC VIN_DATA_BYTE_6 "" VALUE 0x80001779 RecordLayout_4 0 CompuMethod_2 -1E+17 1E+17 /end CHARACTERISTIC
/begin CHARACTERISTIC VIN_DATA_BYTE_7 "" VALUE 0x80001782 RecordLayout_4 0 CompuMethod_2 -1E+17 1E+17 /end CHARACTERISTIC
/begin CHARACTERISTIC VIN_DATA_BYTE_8 "" VALUE 0x8000178B RecordLayout_4 0 CompuMethod_2 -1E+17 1E+17 /end CHARACTERISTIC
/begin CHARACTERISTIC VIN_DATA_BYTE_9 "" VALUE 0x80001794 RecordLayout_4 0 CompuMethod_2 -1E+17 1E+17 /end CHARACTERISTIC
/begin AXIS_PTS Cruise_Control_PID_PreIdxArr "" 0x80000312 Cruise_Control_PID_PreIn RecordLayout_6 0 CompuMethod_2 11 -1E+17 1E+17 DEPOSIT ABSOLUTE /end AXIS_PTS
/begin AXIS_PTS Cruise_Control_VSpeed_PreIdxArr "" 0x8000052B Cruise_Control_VSpeed_PreIn RecordLayout_6 0 CompuMethod_2 11 -1E+17 1E+17 DEPOSIT ABSOLUTE /end AXIS_PTS
/begin RECORD_LAYOUT RecordLayout_2 FNC_VALUES 1 ULONG ROW_DIR DIRECT /end RECORD_LAYOUT
/begin RECORD_LAYOUT RecordLayout_3 FNC_VALUES 1 UBYTE ROW_DIR DIRECT /end RECORD_LAYOUT
/begin RECORD_LAYOUT RecordLayout_4 FNC_VALUES 1 FLOAT32_IEEE ROW_DIR DIRECT /end RECORD_LAYOUT
/begin RECORD_LAYOUT RecordLayout_6 AXIS_PTS_X 1 FLOAT32_IEEE /* IndexIncr */ INDEX_INCR /* Addressing */ DIRECT /end RECORD_LAYOUT
/begin RECORD_LAYOUT RecordLayout_7 FNC_VALUES 1 UWORD ROW_DIR DIRECT /end RECORD_LAYOUT
/*~~~~~~~~~ 6.3.31 COMPU_METHODs ~~~~~~~~~*/
/begin COMPU_METHOD CompuMethod_1 "" RAT_FUNC "%3.0" "" COEFFS 0 1 0 0 0 1 /end COMPU_METHOD
/begin COMPU_METHOD CompuMethod_2 "" RAT_FUNC "%6.2" "" COEFFS 0 1 0 0 0 1 /end COMPU_METHOD
/begin COMPU_METHOD CompuMethod_5 "" RAT_FUNC "%5.0" "" COEFFS 0 1 0 0 0 1 /end COMPU_METHOD
/begin COMPU_METHOD CompuMethod_6 "" RAT_FUNC "%8.0" "" COEFFS 0 1 0 0 0 1 /end COMPU_METHOD
/begin COMPU_METHOD CompuMethod_7 "" TAB_VERB "%1.0" "" COMPU_TAB_REF CompuVtab_2 /end COMPU_METHOD
/begin COMPU_METHOD CompuMethod_11 "" RAT_FUNC "%1.0" "" COEFFS 0 1 0 0 0 1 /end COMPU_METHOD
/begin COMPU_METHOD CompuMethod_12 "" RAT_FUNC "%6.2" "idx.frac" COEFFS 0 1 0 0 0 0.00195313 /end COMPU_METHOD
/begin COMPU_METHOD CompuMethod_484 "" RAT_FUNC "%6.2" "mult" COEFFS 0 1 0 0 0 1 /end COMPU_METHOD
/begin COMPU_METHOD CompuMethod_486 "" RAT_FUNC "%5.0" "ADC_counts" COEFFS 0 1 0 0 0 1 /end COMPU_METHOD
/begin COMPU_METHOD CompuMethod_487 "" TAB_VERB "%3.0" "" COMPU_TAB_REF CompuVtab_473 /end COMPU_METHOD
/begin COMPU_METHOD CompuMethod_488 "" TAB_VERB "%3.0" "" COMPU_TAB_REF CompuVtab_474 /end COMPU_METHOD
/begin COMPU_METHOD CompuMethod_489 "" TAB_VERB "%3.0" "" COMPU_TAB_REF CompuVtab_475 /end COMPU_METHOD
/begin COMPU_METHOD CompuMethod_490 "" TAB_VERB "%3.0" "" COMPU_TAB_REF CompuVtab_476 /end COMPU_METHOD
/begin COMPU_METHOD CompuMethod_491 "" TAB_VERB "%3.0" "" COMPU_TAB_REF CompuVtab_477 /end COMPU_METHOD
/begin COMPU_METHOD CompuMethod_492 "" TAB_VERB "%3.0" "" COMPU_TAB_REF CompuVtab_478 /end COMPU_METHOD
/begin COMPU_METHOD CompuMethod_493 "" RAT_FUNC "%6.2" "sec" COEFFS 0 1 0 0 0 1 /end COMPU_METHOD
/begin COMPU_METHOD CompuMethod_500 "" TAB_VERB "%1.0" "" COMPU_TAB_REF CompuVtab_481 /end COMPU_METHOD
/begin COMPU_METHOD CompuMethod_501 "" TAB_VERB "%1.0" "" COMPU_TAB_REF CompuVtab_482 /end COMPU_METHOD
/begin COMPU_METHOD CompuMethod_509 "" TAB_VERB "%1.0" "" COMPU_TAB_REF CompuVtab_487 /end COMPU_METHOD
/begin COMPU_VTAB CompuVtab_2 "" TAB_VERB 2 0 "Pass-Through" 1 "Override" /end COMPU_VTAB
/begin COMPU_VTAB CompuVtab_473 "" TAB_VERB 97 0 "ABS_ToneRing_AgeCount" 1 "ABS_Traction_Control_AgeCount" 2 "ABS_WheelSpeed_AgeCount" 3 "Battery_AgeCount" 4 "Battery_Voltage_Too_High" 5 "Battery_Voltage_Too_Low" 6 "Blend_Valve_A_No_Response" 7 "Blend_Valve_B_No_Response" 8 "Blend_Valve_Sensor_A_High_Voltage" 9 "Blend_Valve_Sensor_A_Intermittent" 10 "Blend_Valve_Sensor_A_Low_Voltage" 11 "Blend_Valve_Sensor_B_High_Voltage" 12 "Blend_Valve_Sensor_B_Intermittent" 13 "Blend_Valve_Sensor_B_Low_Voltage" 14 "Brake_Pedal_Position_Communication_Loss" 15 "Brake_Pedal_Position_Intermiitent" 16 "Brake_Pedal_Position_Low" 17 "Brake_Pedal_Position_Sensor_A_Circuit_High" 18 "Brakes_AgeCount" 19 "Charge_Complete_Cell_Max_Volt" 20 "Charger_Amperage_Draw_Greater_Then_Supply" 21 "Charger_Derated_Over_Temperature" 22 "Charger_Derated_Under_Temperature" 23 "Charger_Internal_Fault" 24 "Charger_Line_Voltage_Too_Low" 25 "Charger_Line_Votlage_Too_High" 26 "Charger_Requested_But_No_High_Voltage" 27 "Charger_Requested_But_No_Key_Singal" 28 "Charger_Requested_Current_Too_High" 29 "Charger_Requested_Voltage_Out_of_Bounds" 30 "Cruise_Control_Brake_Switch_A_Circuit_High" 31 "Cruise_Control_Brake_Switch_A_Circuit_Low" 32 "Cruise_Control_Brake_Switch_A_Circuit_Malfunction" 33 "Cruise_Control_Coast_Signal_Malfunction" 34 "Cruise_Control_Off_Signal_Malfunction" 35 "Cruise_Control_On_Signal_Malfunction" 36 "Cruise_Control_Resume_Signal_Malfunction" 37 "Cruise_Control_Set_Signal_Malfunction" 38 "DCDC_Converter_Not_Running" 39 "Drive_Switch_Input_Circuit" 40 "Drive_Switch_Input_High" 41 "Drive_Switch_Input_Low" 42 "Eaton_Charger_AgeCount" 43 "Electric_Motor_Approaching_Over_Temperature" 44 "Electric_Motor_Derated_Over_Temperature" 45 "Electric_Motor_Derated_Over_Voltage" 46 "Electric_Motor_Derated_Under_Temperature" 47 "Electric_Motor_Derated_Under_Voltage" 48 "Electric_Motor_General_Error" 49 "Electric_Motor_Over_Speed_Forward" 50 "Electric_Motor_Over_Speed_Reverse" 51 "Electric_Motor_Shutodwn_Error" 52 "Electric_Motor_Torque_Output_Fault" 53 "Gear_Shift_Communication_Circuit" 54 "HV_Battery_2G_BMS_Fault" 55 "HV_Battery_48_Controller_Communication_Fault" 56 "HV_Battery_Above_Safe_Charge_Point" 57 "HV_Battery_Cell_Balancing_Required_Fault" 58 "HV_Battery_Pack_Above_Operating_Temperature" 59 "HV_Battery_Pack_Below_Operating_Temperature" 60 "HV_Battery_Pack_High_Temperature" 61 "HV_Battery_Pack_Low_Temperature" 62 "HV_Battery_Precharge_Failure" 63 "HV_Battery_Too_Low_For_Load" 64 "HV_Battery_Try_To_Balance_Under_Load" 65 "HV_Heater_Over_Temperature" 66 "HV_Heater_Poor_Performance" 67 "HV_Heater_Temperature_Sensor_A_High_Voltage" 68 "HV_Heater_Temperature_Sensor_A_Intermittent" 69 "HV_Heater_Temperature_Sensor_A_Low_Voltage" 70 "IPT_DCDC_AgeCount" 71 "IPT_Status1_AgeCount" 72 "IPT_Status2_AgeCount" 73 "Key_Line_Voltage" 74 "Key_Off_Voltage_High" 75 "Park_Nuetral_Switch_Input_Circuit" 76 "Park_Nuetral_Switch_Input_High" 77 "Park_Nuetral_Switch_Input_Low" 78 "Pedal_Position_Sensor_A_Circuit_High" 79 "Pedal_Position_Sensor_A_Circuit_Intermittent" 80 "Pedal_Position_Sensor_A_Circuit_Low" 81 "Steering_Wheel_AgeCount" 82 "System_Voltage_High" 83 "System_Voltage_Low" 84 "System_Voltage_Malfunction" 85 "System_Voltage_Unstable" 86 "Traction_Control_General_Fault" 87 "Traction_Control_LeftFront_Malfunction" 88 "Traction_Control_LeftRear_Malfunction" 89 "Traction_Control_RightFront_Malfunction" 90 "Traction_Control_RightRear_Malfunction" 91 "Transmission_AgeCount" 92 "Vehcile_Speed_Sensor_Malfunction" 93 "Vehicle_Speed_Sensor_Circuit_Low" 94 "Vehicle_Speed_Sensor_Erratic" 95 "Vehicle_Speed_Sensor_Rang_Performance" 96 "(None)" /end COMPU_VTAB
/begin COMPU_VTAB CompuVtab_474 "" TAB_VERB 2 0 "-" 1 "Clear All Faults" /end COMPU_VTAB
/begin COMPU_VTAB CompuVtab_475 "" TAB_VERB 6 0 "Disabled" 1 "Enabled" 2 "Sticky" 3 "Enabled - Persistent" 4 "Sticky - Persistent" 5 "Save Occurred" /end COMPU_VTAB
/begin COMPU_VTAB CompuVtab_476 "" TAB_VERB 2 0 "-" 1 "Test" /end COMPU_VTAB
/begin COMPU_VTAB CompuVtab_477 "" TAB_VERB 17 0 "Batt_Light" 1 "Batt_Shutdown" 2 "Cell_Voltage_Max" 3 "Check_Engine_Light" 4 "Check_Engine_Light_Flashing" 5 "Cooling_Max" 6 "Cruise" 7 "Dyno_Shutdown" 8 "EatonChargerFault" 9 "HV_Light" 10 "Pump_On" 11 "Regen_Brakes_Disabled" 12 "Set_Crawl_Home" 13 "Temperature_Flash" 14 "Temperature_Solid" 15 "Wrench_Light" 16 "(None)" /end COMPU_VTAB
/begin COMPU_VTAB CompuVtab_478 "" TAB_VERB 8 0 "(None)" 1 "Suspected" 2 "Active" 3 "Suspected or Active" 4 "Occurred" 5 "Suspected or Occurred" 6 "Active or Occurred" 7 "Suspected or Active or Occurred" /end COMPU_VTAB
/begin COMPU_VTAB CompuVtab_481 "" TAB_VERB 2 0 "Disabled" 1 "Enabled" /end COMPU_VTAB
/begin COMPU_VTAB CompuVtab_482 "" TAB_VERB 2 0 "Disable on low ECUP" 1 "Keep alive" /end COMPU_VTAB
/begin COMPU_VTAB CompuVtab_487 "" TAB_VERB 2 0 "Run" 1 "Reboot" /end COMPU_VTAB
/begin FUNCTION Speed_Control ""
 /begin DEF_CHARACTERISTIC Cruise_Control_Tq_TableMap CRUISE_DampGainDown CRUISE_DampGainUp CRUISE_DCOffset CRUISE_DGain CRUISE_ErrorGain CRUISE_IGain CRUISE_IMax CRUISE_IMin CRUISE_LwrLim CRUISE_PGain CRUISE_UprLim /end DEF_CHARACTERISTIC
 /begin OUT_MEASUREMENT Cruise_Control_PID_PreIdx Cruise_Control_PID_PreIn Cruise_Control_Tq_Table Cruise_Control_VSpeed_PreIdx Cruise_Control_VSpeed_PreIn CRUISE_DampTerm CRUISE_DTerm CRUISE_Error CRUISE_ITerm CRUISE_Out CRUISE_PTerm /end OUT_MEASUREMENT
/end FUNCTION
/begin FUNCTION Cruise_Control_Raw_Ovr_Override "" /begin DEF_CHARACTERISTIC Cruise_Control_Raw_Ovr_new Cruise_Control_Raw_Ovr_ovr /end DEF_CHARACTERISTIC /end FUNCTION
/begin FUNCTION Cruise_Control_RSM_Ovr_Override "" /begin DEF_CHARACTERISTIC Cruise_Control_RSM_Ovr_new Cruise_Control_RSM_Ovr_ovr /end DEF_CHARACTERISTIC /end FUNCTION
/begin FUNCTION Cruise_Control_SetM_Ovr_Override "" /begin DEF_CHARACTERISTIC Cruise_Control_SetM_Ovr_new Cruise_Control_SetM_Ovr_ovr /end DEF_CHARACTERISTIC /end FUNCTION
/begin FUNCTION Cruise_Control_SetP_Ovr_Override "" /begin DEF_CHARACTERISTIC Cruise_Control_SetP_Ovr_new Cruise_Control_SetP_Ovr_ovr /end DEF_CHARACTERISTIC /end FUNCTION
/begin FUNCTION Cruise_Ctrl_Light_Ovr_Override "" /begin DEF_CHARACTERISTIC Cruise_Ctrl_Light_Ovr_new Cruise_Ctrl_Light_Ovr_ovr /end DEF_CHARACTERISTIC /end FUNCTION
/begin FUNCTION Cruise_Control_2 "" /begin DEF_CHARACTERISTIC Cruise_Disable_Brake_Fault1 Cruise_Disable_Brake_Fault2 /end DEF_CHARACTERISTIC /end FUNCTION
/begin FUNCTION Current_Limit_Override_Override "" /begin DEF_CHARACTERISTIC Current_Limit_Override_new Current_Limit_Override_ovr /end DEF_CHARACTERISTIC /end FUNCTION
/begin FUNCTION Current_Ovr_Override "" /begin DEF_CHARACTERISTIC Current_Ovr_new Current_Ovr_ovr /end DEF_CHARACTERISTIC /end FUNCTION
/begin FUNCTION IPT "" /begin DEF_CHARACTERISTIC CurrentLimitingEnabled FiltConst /end DEF_CHARACTERISTIC
 /begin OUT_MEASUREMENT IPT_Direction_Prb pre_Filter_Torque_Request Torque_Request_Probe /end OUT_MEASUREMENT
 /begin SUB_FUNCTION CurrentLimiting_TurboRequest Torque_Request_Override_Override Drive Reverse /end SUB_FUNCTION
/end FUNCTION
/begin FUNCTION VIN_Output_and_Button_Probing ""
 /begin DEF_CHARACTERISTIC Data_Mode_1 DATA_MODE_2 DATA_MODE_3 DATA_MODE_4 Mode_1_1 Mode_1_2 Mode_2_1 Mode_2_2 Mode_3_1 Mode_3_2 Mode_4_1 Mode_4_2 VEH_ID VIN_DATA_BYTE_1 VIN_DATA_BYTE_10 VIN_DATA_BYTE_11 VIN_DATA_BYTE_12 VIN_DATA_BYTE_13 VIN_DATA_BYTE_14 VIN_DATA_BYTE_15 VIN_DATA_BYTE_16 VIN_DATA_BYTE_17 VIN_DATA_BYTE_2 VIN_DATA_BYTE_3 VIN_DATA_BYTE_4 VIN_DATA_BYTE_5 VIN_DATA_BYTE_6 VIN_DATA_BYTE_7 VIN_DATA_BYTE_8 VIN_DATA_BYTE_9 /end DEF_CHARACTERISTIC
 /begin OUT_MEASUREMENT DATA_MODE_1_Prb DATA_MODE_2_Prb DATA_MODE_3_Prb DATA_MODE_4_Ovr Mode_1_1_Prb Mode_1_2_Prb Mode_2_1_Prb Mode_2_2_Prb Mode_3_2_Prb Mode_3_3_Prb Mode_4_2_Prb Mode_4_4_Prb VEH_ID_Prb VIN_DATA_BYTE_1_Prb VIN_DATA_BYTE_10_Prb VIN_DATA_BYTE_11_Prb VIN_DATA_BYTE_12_Prb VIN_DATA_BYTE_13_Prb VIN_DATA_BYTE_14_Prb VIN_DATA_BYTE_15_Prb VIN_DATA_BYte_16_Prb VIN_DATA_BYTE_17_Prb VIN_DATA_BYTE_2_Prb VIN_DATA_BYTE_3_Prb VIN_DATA_BYTE_4_Prb VIN_DATA_BYTE_5_Prb VIN_DATA_BYTE_6_Prb VIN_DATA_BYTE_7_Prb VIN_DATA_BYTE_8_Prb VIN_DATA_BYTE_9_Prb /end OUT_MEASUREMENT
 /begin SUB_FUNCTION DATA_MODE_1_Ovr_Override DATA_MODE_2_Ovr_Override DATA_MODE_3_Ovr_Override DATA_MODE_4_Ovr_Override Mode_1_1_Ovr_Override Mode_1_2_Ovr_Override Mode_2_1_Ovr_Override Mode_2_2_Ovr_Override Mode_3_2_Ovr_Override Mode_3_3_Ovr_Override Mode_4_2_Ovr_Override Mode_4_4_Ovr_Override VEH_ID_Ovr_Override VIN_DATA_BYTE_1_Ovr_Override VIN_DATA_BYTE_10_Ovr_Override VIN_DATA_BYTE_11_Ovr_Override VIN_DATA_BYTE_12_Ovr_Override VIN_DATA_BYTE_13_Ovr_Override VIN_DATA_BYTE_14_Ovr_Override VIN_DATA_BYTE_15_Ovr_Override VIN_DATA_BYTE_16_Ovr_Override VIN_DATA_BYTE_17_Ovr_Override VIN_DATA_BYTE_2_Ovr_Override VIN_DATA_BYTE_3_Ovr_Override VIN_DATA_BYTE_4_Ovr_Override VIN_DATA_BYTE_5_Ovr_Override VIN_DATA_BYTE_6_Ovr_Override VIN_DATA_BYTE_7_Ovr_Override VIN_DATA_BYTE_8_Ovr_Override VIN_DATA_BYTE_9_Ovr_Override /end SUB_FUNCTION
/end FUNCTION
/begin FUNCTION DATA_MODE_1_Ovr_Override "" /begin DEF_CHARACTERISTIC DATA_MODE_1_Ovr_new DATA_MODE_1_Ovr_ovr /end DEF_CHARACTERISTIC /end FUNCTION
/begin FUNCTION DATA_MODE_2_Ovr_Override "" /begin DEF_CHARACTERISTIC DATA_MODE_2_Ovr_new DATA_MODE_2_Ovr_ovr /end DEF_CHARACTERISTIC /end FUNCTION
/begin FUNCTION DATA_MODE_3_Ovr_Override "" /begin DEF_CHARACTERISTIC DATA_MODE_3_Ovr_new DATA_MODE_3_Ovr_ovr /end DEF_CHARACTERISTIC /end FUNCTION
/begin FUNCTION DATA_MODE_4_Ovr_Override "" /begin DEF_CHARACTERISTIC DATA_MODE_4_Ovr_new DATA_MODE_4_Ovr_ovr /end DEF_CHARACTERISTIC /end FUNCTION
/begin FUNCTION DateTime_Ovr_Override "" /begin DEF_CHARACTERISTIC DateTime_Ovr_new DateTime_Ovr_ovr /end DEF_CHARACTERISTIC /end FUNCTION
/begin FUNCTION DC_DC_Converter "" /begin DEF_CHARACTERISTIC DCDC_Converter_Not_Running_Fault /end DEF_CHARACTERISTIC /end FUNCTION
/begin FUNCTION DCDC_Status_Ovr_Override "" /begin DEF_CHARACTERISTIC DCDC_Status_Ovr_new DCDC_Status_Ovr_ovr /end DEF_CHARACTERISTIC /end FUNCTION
/begin FUNCTION DCDC_Converter "" /begin OUT_MEASUREMENT DCDC_Status_Prb /end OUT_MEASUREMENT /begin SUB_FUNCTION DCDC_Status_Ovr_Override /end SUB_FUNCTION /end FUNCTION
/begin FUNCTION Defrost_Mode_Ovr_Override "" /begin DEF_CHARACTERISTIC Defrost_Mode_Ovr_new Defrost_Mode_Ovr_ovr /end DEF_CHARACTERISTIC /end FUNCTION
/begin FUNCTION Defrost_Ovr_Override "" /begin DEF_CHARACTERISTIC Defrost_Ovr_new Defrost_Ovr_ovr /end DEF_CHARACTERISTIC /end FUNCTION
/begin FUNCTION Gear_Selector ""
 /begin DEF_CHARACTERISTIC Drive_Switch_Input_High_Fault Drive_Switch_Input_Low_Fault Gear_Shift_Module_Communication_Circuit Park_Nuetral_Switch_Input_High_Fault Park_Nuetral_Switch_Input_Low_Fault /end DEF_CHARACTERISTIC
/end FUNCTION
/begin FUNCTION Driver_1_Ovr_Override "" /begin DEF_CHARACTERISTIC Driver_1_Ovr_new Driver_1_Ovr_ovr /end DEF_CHARACTERISTIC /end FUNCTION
/begin FUNCTION Driver_10_Ovr_Override "" /begin DEF_CHARACTERISTIC Driver_10_Ovr_new Driver_10_Ovr_ovr /end DEF_CHARACTERISTIC /end FUNCTION
/begin FUNCTION Driver_Temp_Ovr_Override "" /begin DEF_CHARACTERISTIC Driver_Temp_Ovr_new Driver_Temp_Ovr_ovr /end DEF_CHARACTERISTIC /end FUNCTION
/begin FUNCTION Eaton_Charger_AgeCount_Ovr_Override ""
 /begin DEF_CHARACTERISTIC Eaton_Charger_AgeCount_Ovr_new Eaton_Charger_AgeCount_Ovr_ovr /end DEF_CHARACTERISTIC
/end FUNCTION
/begin FUNCTION Eaton_Charger_Message_Checksum_Ovr_Override ""
 /begin DEF_CHARACTERISTIC Eaton_Charger_Message_Checksum_Ovr_new Eaton_Charger_Message_Checksum_Ovr_ovr /end DEF_CHARACTERISTIC
/end FUNCTION
/begin FUNCTION Eaton_Charger_Message_Counter_Ovr_Override ""
 /begin DEF_CHARACTERISTIC Eaton_Charger_Message_Counter_Ovr_new Eaton_Charger_Message_Counter_Ovr_ovr /end DEF_CHARACTERISTIC
/end FUNCTION
/begin FUNCTION Eaton_HV_Charger_Temperature_Ovr_Override ""
 /begin DEF_CHARACTERISTIC Eaton_HV_Charger_Temperature_Ovr_new Eaton_HV_Charger_Temperature_Ovr_ovr /end DEF_CHARACTERISTIC
/end FUNCTION
/begin FUNCTION ecoMode_Ovr_Override "" /begin DEF_CHARACTERISTIC ecoMode_Ovr_new ecoMode_Ovr_ovr /end DEF_CHARACTERISTIC /end FUNCTION
/begin FUNCTION Background "" /begin DEF_CHARACTERISTIC ECUP /end DEF_CHARACTERISTIC /end FUNCTION
/begin FUNCTION Main_Power_Relay1 "" /begin SUB_FUNCTION Background /end SUB_FUNCTION /end FUNCTION
/begin FUNCTION Main_Power_Relay_Config "" /begin DEF_CHARACTERISTIC ECUP_Threshold /end DEF_CHARACTERISTIC /end FUNCTION
/begin FUNCTION Main_Power_Relay "" /begin DEF_CHARACTERISTIC MPRD_KeepAlive ProcessorReboot Shutdown_Req /end DEF_CHARACTERISTIC /begin OUT_MEASUREMENT MPRD /end OUT_MEASUREMENT /begin SUB_FUNCTION Main_Power_Relay_Config MPRD_Override /end SUB_FUNCTION /end FUNCTION
/begin FUNCTION Electric_Motor ""
 /begin DEF_CHARACTERISTIC Electric_Motor_Derated_Approaching_Over_Temperature_Fault_Over Electric_Motor_Derated_Approaching_Over_Temperature_Fault_Under Electric_Motor_Derated_Over_Temperature_Fault Electric_Motor_Derated_Over_Voltage_Fault Electric_Motor_Derated_Under_Temperature_Fault Electric_Motor_Derated_Under_Voltage_Fault Electric_Motor_General_Error_Fault_Over Electric_Motor_General_Error_Fault_Under Electric_Motor_Over_Speed_Forward_Fault Electric_Motor_Over_Speed_Reverse_Fault Electric_Motor_Shutdown_Error_Fault Electric_Motor_Torque_Output_Fault RPM_to_Wheel_Speed_Multiplier2 /end DEF_CHARACTERISTIC
/end FUNCTION
/begin FUNCTION Eng_Cool_Temp_Ovr_Override "" /begin DEF_CHARACTERISTIC Eng_Cool_Temp_Ovr_new Eng_Cool_Temp_Ovr_ovr /end DEF_CHARACTERISTIC /end FUNCTION
/begin FUNCTION Engine_Crank_Ovr_Override "" /begin DEF_CHARACTERISTIC Engine_Crank_Ovr_new Engine_Crank_Ovr_ovr /end DEF_CHARACTERISTIC /end FUNCTION
/begin FUNCTION Engine_Inputs ""
 /begin OUT_MEASUREMENT Engine_Crank_Prb Engine_On_Prb Fault_Prb Inv_Temp_Prb Load_On_Prb Oil_Pressure_Prb RPM_Prb Temp_Guage_Ovr /end OUT_MEASUREMENT
 /begin SUB_FUNCTION Engine_Crank_Ovr_Override Engine_On_Ovr_Override Fault_Ovr_Override Inv_Temp_Ovr_Override Load_On_Ovr_Override Oil_Pressure_Ovr_Override RPM_Ovr_Override Temp_Guage_Ovr_Override /end SUB_FUNCTION
/end FUNCTION
/begin FUNCTION Engine_On_ABS_Ovr_Override "" /begin DEF_CHARACTERISTIC Engine_On_ABS_Ovr_new Engine_On_ABS_Ovr_ovr /end DEF_CHARACTERISTIC /end FUNCTION
/begin FUNCTION Engine_On_Ovr_Override "" /begin DEF_CHARACTERISTIC Engine_On_Ovr_new Engine_On_Ovr_ovr /end DEF_CHARACTERISTIC /end FUNCTION
/begin FUNCTION Engine_States "" /begin DEF_CHARACTERISTIC Engine_On_Time_Threshold /end DEF_CHARACTERISTIC /end FUNCTION
/begin FUNCTION Engine_Speed_Ovr_Override "" /begin DEF_CHARACTERISTIC Engine_Speed_Ovr_new Engine_Speed_Ovr_ovr /end DEF_CHARACTERISTIC /end FUNCTION
/begin FUNCTION Fan1_Ovr_Override "" /begin DEF_CHARACTERISTIC Fan1_Ovr_new Fan1_Ovr_ovr /end DEF_CHARACTERISTIC /end FUNCTION
/begin FUNCTION Fan2_Ovr_Override "" /begin DEF_CHARACTERISTIC Fan2_Ovr_new Fan2_Ovr_ovr /end DEF_CHARACTERISTIC /end FUNCTION
/begin FUNCTION Fan3_Ovr_Override "" /begin DEF_CHARACTERISTIC Fan3_Ovr_new Fan3_Ovr_ovr /end DEF_CHARACTERISTIC /end FUNCTION
/begin FUNCTION Fault_Ovr_Override "" /begin DEF_CHARACTERISTIC Fault_Ovr_new Fault_Ovr_ovr /end DEF_CHARACTERISTIC /end FUNCTION
/begin FUNCTION Fault_Severity_Indicator_Ovr_Override ""
 /begin DEF_CHARACTERISTIC Fault_Severity_Indicator_Ovr_new Fault_Severity_Indicator_Ovr_ovr /end DEF_CHARACTERISTIC
/end FUNCTION
/begin FUNCTION Action_Reasons ""
 /begin OUT_MEASUREMENT FaultActionReason._.Batt_Light FaultActionReason._.Batt_Shutdown FaultActionReason._.Cell_Voltage_Max FaultActionReason._.Check_Engine_Light FaultActionReason._.Check_Engine_Light_Flashing FaultActionReason._.Cooling_Max FaultActionReason._.Cruise FaultActionReason._.Dyno_Shutdown FaultActionReason._.EatonChargerFault FaultActionReason._.HV_Light FaultActionReason._.Pump_On FaultActionReason._.Regen_Brakes_Disabled FaultActionReason._.Set_Crawl_Home FaultActionReason._.Temperature_Flash FaultActionReason._.Temperature_Solid FaultActionReason._.Wrench_Light /end OUT_MEASUREMENT
/end FUNCTION
/begin FUNCTION Faults_1 ""
 /begin DEF_CHARACTERISTIC FaultCommand FaultManager.ABS_ToneRing_AgeCount.Mode FaultManager.ABS_ToneRing_AgeCount.ID FaultManager.ABS_ToneRing_AgeCount.Test FaultManager.ABS_ToneRing_AgeCount.Faulty_Samples__X_ FaultManager.ABS_ToneRing_AgeCount.Total_Samples__Y_ FaultManager.ABS_ToneRing_AgeCount.Action_1 FaultManager.ABS_ToneRing_AgeCount.Action_1_Condition FaultManager.ABS_ToneRing_AgeCount.Action_2 FaultManager.ABS_ToneRing_AgeCount.Action_2_Condition FaultManager.ABS_ToneRing_AgeCount.Action_3 FaultManager.ABS_ToneRing_AgeCount.Action_3_Condition FaultManager.ABS_ToneRing_AgeCount.Action_4 FaultManager.ABS_ToneRing_AgeCount.Action_4_Condition FaultManager.ABS_Traction_Control_AgeCount.Mode FaultManager.ABS_Traction_Control_AgeCount.ID FaultManager.ABS_Traction_Control_AgeCount.Test FaultManager.ABS_Traction_Control_AgeCount.Faulty_Samples__X_ FaultManager.ABS_Traction_Control_AgeCount.Total_Samples__Y_ FaultManager.ABS_Traction_Control_AgeCount.Action_1 FaultManager.ABS_Traction_Control_AgeCount.Action_1_Condition FaultManager.ABS_Traction_Control_AgeCount.Action_2 FaultManager.ABS_Traction_Control_AgeCount.Action_2_Condition FaultManager.ABS_Traction_Control_AgeCount.Action_3 FaultManager.ABS_Traction_Control_AgeCount.Action_3_Condition FaultManager.ABS_Traction_Control_AgeCount.Action_4 FaultManager.ABS_Traction_Control_AgeCount.Action_4_Condition FaultManager.ABS_WheelSpeed_AgeCount.Mode FaultManager.ABS_WheelSpeed_AgeCount.ID FaultManager.ABS_WheelSpeed_AgeCount.Test FaultManager.ABS_WheelSpeed_AgeCount.Faulty_Samples__X_ FaultManager.ABS_WheelSpeed_AgeCount.Total_Samples__Y_ FaultManager.ABS_WheelSpeed_AgeCount.Action_1 FaultManager.ABS_WheelSpeed_AgeCount.Action_1_Condition FaultManager.ABS_WheelSpeed_AgeCount.Action_2 FaultManager.ABS_WheelSpeed_AgeCount.Action_2_Condition FaultManager.ABS_WheelSpeed_AgeCount.Action_3 FaultManager.ABS_WheelSpeed_AgeCount.Action_3_Condition FaultManager.ABS_WheelSpeed_AgeCount.Action_4 FaultManager.ABS_WheelSpeed_AgeCount.Action_4_Condition FaultManager.Battery_AgeCount.Mode FaultManager.Battery_AgeCount.ID FaultManager.Battery_AgeCount.Test FaultManager.Battery_AgeCount.Faulty_Samples__X_ FaultManager.Battery_AgeCount.Total_Samples__Y_ FaultManager.Battery_AgeCount.Action_1 FaultManager.Battery_AgeCount.Action_1_Condition FaultManager.Battery_AgeCount.Action_2 FaultManager.Battery_AgeCount.Action_2_Condition FaultManager.Battery_AgeCount.Action_3 FaultManager.Battery_AgeCount.Action_3_Condition FaultManager.Battery_AgeCount.Action_4 FaultManager.Battery_AgeCount.Action_4_Condition FaultManager.Battery_Voltage_Too_High.Mode FaultManager.Battery_Voltage_Too_High.ID FaultManager.Battery_Voltage_Too_High.Test FaultManager.Battery_Voltage_Too_High.Faulty_Samples__X_ FaultManager.Battery_Voltage_Too_High.Total_Samples__Y_ FaultManager.Battery_Voltage_Too_High.Action_1 FaultManager.Battery_Voltage_Too_High.Action_1_Condition FaultManager.Battery_Voltage_Too_High.Action_2 FaultManager.Battery_Voltage_Too_High.Action_2_Condition FaultManager.Battery_Voltage_Too_High.Action_3 FaultManager.Battery_Voltage_Too_High.Action_3_Condition FaultManager.Battery_Voltage_Too_High.Action_4 FaultManager.Battery_Voltage_Too_High.Action_4_Condition FaultManager.Battery_Voltage_Too_Low.Mode FaultManager.Battery_Voltage_Too_Low.ID FaultManager.Battery_Voltage_Too_Low.Test FaultManager.Battery_Voltage_Too_Low.Faulty_Samples__X_ FaultManager.Battery_Voltage_Too_Low.Total_Samples__Y_ FaultManager.Battery_Voltage_Too_Low.Action_1 FaultManager.Battery_Voltage_Too_Low.Action_1_Condition FaultManager.Battery_Voltage_Too_Low.Action_2 FaultManager.Battery_Voltage_Too_Low.Action_2_Condition FaultManager.Battery_Voltage_Too_Low.Action_3 FaultManager.Battery_Voltage_Too_Low.Action_3_Condition FaultManager.Battery_Voltage_Too_Low.Action_4 FaultManager.Battery_Voltage_Too_Low.Action_4_Condition FaultManager.Blend_Valve_A_No_Response.Mode FaultManager.Blend_Valve_A_No_Response.ID FaultManager.Blend_Valve_A_No_Response.Test FaultManager.Blend_Valve_A_No_Response.Faulty_Samples__X_ FaultManager.Blend_Valve_A_No_Response.Total_Samples__Y_ FaultManager.Blend_Valve_A_No_Response.Action_1 FaultManager.Blend_Valve_A_No_Response.Action_1_Condition FaultManager.Blend_Valve_A_No_Response.Action_2 FaultManager.Blend_Valve_A_No_Response.Action_2_Condition FaultManager.Blend_Valve_A_No_Response.Action_3 FaultManager.Blend_Valve_A_No_Response.Action_3_Condition FaultManager.Blend_Valve_A_No_Response.Action_4 FaultManager.Blend_Valve_A_No_Response.Action_4_Condition FaultManager.Blend_Valve_B_No_Response.Mode FaultManager.Blend_Valve_B_No_Response.ID FaultManager.Blend_Valve_B_No_Response.Test FaultManager.Blend_Valve_B_No_Response.Faulty_Samples__X_ FaultManager.Blend_Valve_B_No_Response.Total_Samples__Y_ FaultManager.Blend_Valve_B_No_Response.Action_1 FaultManager.Blend_Valve_B_No_Response.Action_1_Condition FaultManager.Blend_Valve_B_No_Response.Action_2 FaultManager.Blend_Valve_B_No_Response.Action_2_Condition FaultManager.Blend_Valve_B_No_Response.Action_3 FaultManager.Blend_Valve_B_No_Response.Action_3_Condition FaultManager.Blend_Valve_B_No_Response.Action_4 FaultManager.Blend_Valve_B_No_Response.Action_4_Condition FaultManager.Blend_Valve_Sensor_A_High_Voltage.Mode FaultManager.Blend_Valve_Sensor_A_High_Voltage.ID FaultManager.Blend_Valve_Sensor_A_High_Voltage.Test FaultManager.Blend_Valve_Sensor_A_High_Voltage.Faulty_Samples__X_ FaultManager.Blend_Valve_Sensor_A_High_Voltage.Total_Samples__Y_ FaultManager.Blend_Valve_Sensor_A_High_Voltage.Action_1 FaultManager.Blend_Valve_Sensor_A_High_Voltage.Action_1_Condition FaultManager.Blend_Valve_Sensor_A_High_Voltage.Action_2 FaultManager.Blend_Valve_Sensor_A_High_Voltage.Action_2_Condition FaultManager.Blend_Valve_Sensor_A_High_Voltage.Action_3 FaultManager.Blend_Valve_Sensor_A_High_Voltage.Action_3_Condition FaultManager.Blend_Valve_Sensor_A_High_Voltage.Action_4 FaultManager.Blend_Valve_Sensor_A_High_Voltage.Action_4_Condition FaultManager.Blend_Valve_Sensor_A_Intermittent.Mode FaultManager.Blend_Valve_Sensor_A_Intermittent.ID FaultManager.Blend_Valve_Sensor_A_Intermittent.Test FaultManager.Blend_Valve_Sensor_A_Intermittent.Faulty_Samples__X_ FaultManager.Blend_Valve_Sensor_A_Intermittent.Total_Samples__Y_ FaultManager.Blend_Valve_Sensor_A_Intermittent.Action_1 FaultManager.Blend_Valve_Sensor_A_Intermittent.Action_1_Condition FaultManager.Blend_Valve_Sensor_A_Intermittent.Action_2 FaultManager.Blend_Valve_Sensor_A_Intermittent.Action_2_Condition FaultManager.Blend_Valve_Sensor_A_Intermittent.Action_3 FaultManager.Blend_Valve_Sensor_A_Intermittent.Action_3_Condition FaultManager.Blend_Valve_Sensor_A_Intermittent.Action_4 FaultManager.Blend_Valve_Sensor_A_Intermittent.Action_4_Condition FaultManager.Blend_Valve_Sensor_A_Low_Voltage.Mode FaultManager.Blend_Valve_Sensor_A_Low_Voltage.ID FaultManager.Blend_Valve_Sensor_A_Low_Voltage.Test FaultManager.Blend_Valve_Sensor_A_Low_Voltage.Faulty_Samples__X_ FaultManager.Blend_Valve_Sensor_A_Low_Voltage.Total_Samples__Y_ FaultManager.Blend_Valve_Sensor_A_Low_Voltage.Action_1 FaultManager.Blend_Valve_Sensor_A_Low_Voltage.Action_1_Condition FaultManager.Blend_Valve_Sensor_A_Low_Voltage.Action_2 FaultManager.Blend_Valve_Sensor_A_Low_Voltage.Action_2_Condition FaultManager.Blend_Valve_Sensor_A_Low_Voltage.Action_3 FaultManager.Blend_Valve_Sensor_A_Low_Voltage.Action_3_Condition FaultManager.Blend_Valve_Sensor_A_Low_Voltage.Action_4 FaultManager.Blend_Valve_Sensor_A_Low_Voltage.Action_4_Condition FaultManager.Blend_Valve_Sensor_B_High_Voltage.Mode FaultManager.Blend_Valve_Sensor_B_High_Voltage.ID FaultManager.Blend_Valve_Sensor_B_High_Voltage.Test FaultManager.Blend_Valve_Sensor_B_High_Voltage.Faulty_Samples__X_ FaultManager.Blend_Valve_Sensor_B_High_Voltage.Total_Samples__Y_ FaultManager.Blend_Valve_Sensor_B_High_Voltage.Action_1 FaultManager.Blend_Valve_Sensor_B_High_Voltage.Action_1_Condition FaultManager.Blend_Valve_Sensor_B_High_Voltage.Action_2 FaultManager.Blend_Valve_Sensor_B_High_Voltage.Action_2_Condition FaultManager.Blend_Valve_Sensor_B_High_Voltage.Action_3 FaultManager.Blend_Valve_Sensor_B_High_Voltage.Action_3_Condition FaultManager.Blend_Valve_Sensor_B_High_Voltage.Action_4 FaultManager.Blend_Valve_Sensor_B_High_Voltage.Action_4_Condition FaultManager.Blend_Valve_Sensor_B_Intermittent.Mode FaultManager.Blend_Valve_Sensor_B_Intermittent.ID FaultManager.Blend_Valve_Sensor_B_Intermittent.Test FaultManager.Blend_Valve_Sensor_B_Intermittent.Faulty_Samples__X_ FaultManager.Blend_Valve_Sensor_B_Intermittent.Total_Samples__Y_ FaultManager.Blend_Valve_Sensor_B_Intermittent.Action_1 FaultManager.Blend_Valve_Sensor_B_Intermittent.Action_1_Condition FaultManager.Blend_Valve_Sensor_B_Intermittent.Action_2 FaultManager.Blend_Valve_Sensor_B_Intermittent.Action_2_Condition FaultManager.Blend_Valve_Sensor_B_Intermittent.Action_3 FaultManager.Blend_Valve_Sensor_B_Intermittent.Action_3_Condition FaultManager.Blend_Valve_Sensor_B_Intermittent.Action_4 FaultManager.Blend_Valve_Sensor_B_Intermittent.Action_4_Condition FaultManager.Blend_Valve_Sensor_B_Low_Voltage.Mode FaultManager.Blend_Valve_Sensor_B_Low_Voltage.ID FaultManager.Blend_Valve_Sensor_B_Low_Voltage.Test FaultManager.Blend_Valve_Sensor_B_Low_Voltage.Faulty_Samples__X_ FaultManager.Blend_Valve_Sensor_B_Low_Voltage.Total_Samples__Y_ FaultManager.Blend_Valve_Sensor_B_Low_Voltage.Action_1 FaultManager.Blend_Valve_Sensor_B_Low_Voltage.Action_1_Condition FaultManager.Blend_Valve_Sensor_B_Low_Voltage.Action_2 FaultManager.Blend_Valve_Sensor_B_Low_Voltage.Action_2_Condition FaultManager.Blend_Valve_Sensor_B_Low_Voltage.Action_3 FaultManager.Blend_Valve_Sensor_B_Low_Voltage.Action_3_Condition FaultManager.Blend_Valve_Sensor_B_Low_Voltage.Action_4 FaultManager.Blend_Valve_Sensor_B_Low_Voltage.Action_4_Condition FaultManager.Brake_Pedal_Position_Communication_Loss.Mode FaultManager.Brake_Pedal_Position_Communication_Loss.ID FaultManager.Brake_Pedal_Position_Communication_Loss.Test FaultManager.Brake_Pedal_Position_Communication_Loss.Faulty_Samples__X_ FaultManager.Brake_Pedal_Position_Communication_Loss.Total_Samples__Y_ FaultManager.Brake_Pedal_Position_Communication_Loss.Action_1 FaultManager.Brake_Pedal_Position_Communication_Loss.Action_1_Condition FaultManager.Brake_Pedal_Position_Communication_Loss.Action_2 FaultManager.Brake_Pedal_Position_Communication_Loss.Action_2_Condition FaultManager.Brake_Pedal_Position_Communication_Loss.Action_3 FaultManager.Brake_Pedal_Position_Communication_Loss.Action_3_Condition FaultManager.Brake_Pedal_Position_Communication_Loss.Action_4 FaultManager.Brake_Pedal_Position_Communication_Loss.Action_4_Condition FaultManager.Brake_Pedal_Position_Intermiitent.Mode FaultManager.Brake_Pedal_Position_Intermiitent.ID FaultManager.Brake_Pedal_Position_Intermiitent.Test FaultManager.Brake_Pedal_Position_Intermiitent.Faulty_Samples__X_ FaultManager.Brake_Pedal_Position_Intermiitent.Total_Samples__Y_ FaultManager.Brake_Pedal_Position_Intermiitent.Action_1 FaultManager.Brake_Pedal_Position_Intermiitent.Action_1_Condition FaultManager.Brake_Pedal_Position_Intermiitent.Action_2 FaultManager.Brake_Pedal_Position_Intermiitent.Action_2_Condition FaultManager.Brake_Pedal_Position_Intermiitent.Action_3 FaultManager.Brake_Pedal_Position_Intermiitent.Action_3_Condition FaultManager.Brake_Pedal_Position_Intermiitent.Action_4 FaultManager.Brake_Pedal_Position_Intermiitent.Action_4_Condition FaultManager.Brake_Pedal_Position_Low.Mode FaultManager.Brake_Pedal_Position_Low.ID FaultManager.Brake_Pedal_Position_Low.Test FaultManager.Brake_Pedal_Position_Low.Faulty_Samples__X_ FaultManager.Brake_Pedal_Position_Low.Total_Samples__Y_ FaultManager.Brake_Pedal_Position_Low.Action_1 FaultManager.Brake_Pedal_Position_Low.Action_1_Condition FaultManager.Brake_Pedal_Position_Low.Action_2 FaultManager.Brake_Pedal_Position_Low.Action_2_Condition FaultManager.Brake_Pedal_Position_Low.Action_3 FaultManager.Brake_Pedal_Position_Low.Action_3_Condition FaultManager.Brake_Pedal_Position_Low.Action_4 FaultManager.Brake_Pedal_Position_Low.Action_4_Condition FaultManager.Brake_Pedal_Position_Sensor_A_Circuit_High.Mode FaultManager.Brake_Pedal_Position_Sensor_A_Circuit_High.ID FaultManager.Brake_Pedal_Position_Sensor_A_Circuit_High.Test FaultManager.Brake_Pedal_Position_Sensor_A_Circuit_High.Faulty_Samples__X_ FaultManager.Brake_Pedal_Position_Sensor_A_Circuit_High.Total_Samples__Y_ FaultManager.Brake_Pedal_Position_Sensor_A_Circuit_High.Action_1 FaultManager.Brake_Pedal_Position_Sensor_A_Circuit_High.Action_1_Condition FaultManager.Brake_Pedal_Position_Sensor_A_Circuit_High.Action_2 FaultManager.Brake_Pedal_Position_Sensor_A_Circuit_High.Action_2_Condition FaultManager.Brake_Pedal_Position_Sensor_A_Circuit_High.Action_3 FaultManager.Brake_Pedal_Position_Sensor_A_Circuit_High.Action_3_Condition FaultManager.Brake_Pedal_Position_Sensor_A_Circuit_High.Action_4 FaultManager.Brake_Pedal_Position_Sensor_A_Circuit_High.Action_4_Condition FaultManager.Brakes_AgeCount.Mode FaultManager.Brakes_AgeCount.ID FaultManager.Brakes_AgeCount.Test FaultManager.Brakes_AgeCount.Faulty_Samples__X_ FaultManager.Brakes_AgeCount.Total_Samples__Y_ FaultManager.Brakes_AgeCount.Action_1 FaultManager.Brakes_AgeCount.Action_1_Condition FaultManager.Brakes_AgeCount.Action_2 FaultManager.Brakes_AgeCount.Action_2_Condition FaultManager.Brakes_AgeCount.Action_3 FaultManager.Brakes_AgeCount.Action_3_Condition FaultManager.Brakes_AgeCount.Action_4 FaultManager.Brakes_AgeCount.Action_4_Condition FaultManager.Charge_Complete_Cell_Max_Volt.Mode FaultManager.Charge_Complete_Cell_Max_Volt.ID FaultManager.Charge_Complete_Cell_Max_Volt.Test FaultManager.Charge_Complete_Cell_Max_Volt.Faulty_Samples__X_ FaultManager.Charge_Complete_Cell_Max_Volt.Total_Samples__Y_ FaultManager.Charge_Complete_Cell_Max_Volt.Action_1 FaultManager.Charge_Complete_Cell_Max_Volt.Action_1_Condition FaultManager.Charge_Complete_Cell_Max_Volt.Action_2 FaultManager.Charge_Complete_Cell_Max_Volt.Action_2_Condition FaultManager.Charge_Complete_Cell_Max_Volt.Action_3 FaultManager.Charge_Complete_Cell_Max_Volt.Action_3_Condition FaultManager.Charge_Complete_Cell_Max_Volt.Action_4 FaultManager.Charge_Complete_Cell_Max_Volt.Action_4_Condition FaultManager.Charger_Amperage_Draw_Greater_Then_Supply.Mode FaultManager.Charger_Amperage_Draw_Greater_Then_Supply.ID FaultManager.Charger_Amperage_Draw_Greater_Then_Supply.Test FaultManager.Charger_Amperage_Draw_Greater_Then_Supply.Faulty_Samples__X_ FaultManager.Charger_Amperage_Draw_Greater_Then_Supply.Total_Samples__Y_ FaultManager.Charger_Amperage_Draw_Greater_Then_Supply.Action_1 FaultManager.Charger_Amperage_Draw_Greater_Then_Supply.Action_1_Condition FaultManager.Charger_Amperage_Draw_Greater_Then_Supply.Action_2 FaultManager.Charger_Amperage_Draw_Greater_Then_Supply.Action_2_Condition FaultManager.Charger_Amperage_Draw_Greater_Then_Supply.Action_3 FaultManager.Charger_Amperage_Draw_Greater_Then_Supply.Action_3_Condition FaultManager.Charger_Amperage_Draw_Greater_Then_Supply.Action_4 FaultManager.Charger_Amperage_Draw_Greater_Then_Supply.Action_4_Condition FaultManager.Charger_Derated_Over_Temperature.Mode FaultManager.Charger_Derated_Over_Temperature.ID FaultManager.Charger_Derated_Over_Temperature.Test FaultManager.Charger_Derated_Over_Temperature.Faulty_Samples__X_ FaultManager.Charger_Derated_Over_Temperature.Total_Samples__Y_ FaultManager.Charger_Derated_Over_Temperature.Action_1 FaultManager.Charger_Derated_Over_Temperature.Action_1_Condition FaultManager.Charger_Derated_Over_Temperature.Action_2 FaultManager.Charger_Derated_Over_Temperature.Action_2_Condition FaultManager.Charger_Derated_Over_Temperature.Action_3 FaultManager.Charger_Derated_Over_Temperature.Action_3_Condition FaultManager.Charger_Derated_Over_Temperature.Action_4 FaultManager.Charger_Derated_Over_Temperature.Action_4_Condition FaultManager.Charger_Derated_Under_Temperature.Mode FaultManager.Charger_Derated_Under_Temperature.ID FaultManager.Charger_Derated_Under_Temperature.Test FaultManager.Charger_Derated_Under_Temperature.Faulty_Samples__X_ FaultManager.Charger_Derated_Under_Temperature.Total_Samples__Y_ FaultManager.Charger_Derated_Under_Temperature.Action_1 FaultManager.Charger_Derated_Under_Temperature.Action_1_Condition FaultManager.Charger_Derated_Under_Temperature.Action_2 FaultManager.Charger_Derated_Under_Temperature.Action_2_Condition FaultManager.Charger_Derated_Under_Temperature.Action_3 FaultManager.Charger_Derated_Under_Temperature.Action_3_Condition FaultManager.Charger_Derated_Under_Temperature.Action_4 FaultManager.Charger_Derated_Under_Temperature.Action_4_Condition FaultManager.Charger_Internal_Fault.Mode FaultManager.Charger_Internal_Fault.ID FaultManager.Charger_Internal_Fault.Test FaultManager.Charger_Internal_Fault.Faulty_Samples__X_ FaultManager.Charger_Internal_Fault.Total_Samples__Y_ FaultManager.Charger_Internal_Fault.Action_1 FaultManager.Charger_Internal_Fault.Action_1_Condition FaultManager.Charger_Internal_Fault.Action_2 FaultManager.Charger_Internal_Fault.Action_2_Condition FaultManager.Charger_Internal_Fault.Action_3 FaultManager.Charger_Internal_Fault.Action_3_Condition FaultManager.Charger_Internal_Fault.Action_4 FaultManager.Charger_Internal_Fault.Action_4_Condition FaultManager.Charger_Line_Voltage_Too_Low.Mode FaultManager.Charger_Line_Voltage_Too_Low.ID FaultManager.Charger_Line_Voltage_Too_Low.Test FaultManager.Charger_Line_Voltage_Too_Low.Faulty_Samples__X_ FaultManager.Charger_Line_Voltage_Too_Low.Total_Samples__Y_ FaultManager.Charger_Line_Voltage_Too_Low.Action_1 FaultManager.Charger_Line_Voltage_Too_Low.Action_1_Condition FaultManager.Charger_Line_Voltage_Too_Low.Action_2 FaultManager.Charger_Line_Voltage_Too_Low.Action_2_Condition FaultManager.Charger_Line_Voltage_Too_Low.Action_3 FaultManager.Charger_Line_Voltage_Too_Low.Action_3_Condition FaultManager.Charger_Line_Voltage_Too_Low.Action_4 FaultManager.Charger_Line_Voltage_Too_Low.Action_4_Condition FaultManager.Charger_Line_Votlage_Too_High.Mode FaultManager.Charger_Line_Votlage_Too_High.ID FaultManager.Charger_Line_Votlage_Too_High.Test FaultManager.Charger_Line_Votlage_Too_High.Faulty_Samples__X_ FaultManager.Charger_Line_Votlage_Too_High.Total_Samples__Y_ FaultManager.Charger_Line_Votlage_Too_High.Action_1 FaultManager.Charger_Line_Votlage_Too_High.Action_1_Condition FaultManager.Charger_Line_Votlage_Too_High.Action_2 FaultManager.Charger_Line_Votlage_Too_High.Action_2_Condition FaultManager.Charger_Line_Votlage_Too_High.Action_3 FaultManager.Charger_Line_Votlage_Too_High.Action_3_Condition FaultManager.Charger_Line_Votlage_Too_High.Action_4 FaultManager.Charger_Line_Votlage_Too_High.Action_4_Condition FaultManager.Charger_Requested_But_No_High_Voltage.Mode FaultManager.Charger_Requested_But_No_High_Voltage.ID FaultManager.Charger_Requested_But_No_High_Voltage.Test FaultManager.Charger_Requested_But_No_High_Voltage.Faulty_Samples__X_ FaultManager.Charger_Requested_But_No_High_Voltage.Total_Samples__Y_ FaultManager.Charger_Requested_But_No_High_Voltage.Action_1 FaultManager.Charger_Requested_But_No_High_Voltage.Action_1_Condition FaultManager.Charger_Requested_But_No_High_Voltage.Action_2 FaultManager.Charger_Requested_But_No_High_Voltage.Action_2_Condition FaultManager.Charger_Requested_But_No_High_Voltage.Action_3 FaultManager.Charger_Requested_But_No_High_Voltage.Action_3_Condition FaultManager.Charger_Requested_But_No_High_Voltage.Action_4 FaultManager.Charger_Requested_But_No_High_Voltage.Action_4_Condition FaultManager.Charger_Requested_But_No_Key_Singal.Mode FaultManager.Charger_Requested_But_No_Key_Singal.ID FaultManager.Charger_Requested_But_No_Key_Singal.Test FaultManager.Charger_Requested_But_No_Key_Singal.Faulty_Samples__X_ FaultManager.Charger_Requested_But_No_Key_Singal.Total_Samples__Y_ FaultManager.Charger_Requested_But_No_Key_Singal.Action_1 FaultManager.Charger_Requested_But_No_Key_Singal.Action_1_Condition FaultManager.Charger_Requested_But_No_Key_Singal.Action_2 FaultManager.Charger_Requested_But_No_Key_Singal.Action_2_Condition FaultManager.Charger_Requested_But_No_Key_Singal.Action_3 FaultManager.Charger_Requested_But_No_Key_Singal.Action_3_Condition FaultManager.Charger_Requested_But_No_Key_Singal.Action_4 FaultManager.Charger_Requested_But_No_Key_Singal.Action_4_Condition FaultManager.Charger_Requested_Current_Too_High.Mode FaultManager.Charger_Requested_Current_Too_High.ID FaultManager.Charger_Requested_Current_Too_High.Test FaultManager.Charger_Requested_Current_Too_High.Faulty_Samples__X_ FaultManager.Charger_Requested_Current_Too_High.Total_Samples__Y_ FaultManager.Charger_Requested_Current_Too_High.Action_1 FaultManager.Charger_Requested_Current_Too_High.Action_1_Condition FaultManager.Charger_Requested_Current_Too_High.Action_2 FaultManager.Charger_Requested_Current_Too_High.Action_2_Condition FaultManager.Charger_Requested_Current_Too_High.Action_3 FaultManager.Charger_Requested_Current_Too_High.Action_3_Condition FaultManager.Charger_Requested_Current_Too_High.Action_4 FaultManager.Charger_Requested_Current_Too_High.Action_4_Condition FaultManager.Charger_Requested_Voltage_Out_of_Bounds.Mode FaultManager.Charger_Requested_Voltage_Out_of_Bounds.ID FaultManager.Charger_Requested_Voltage_Out_of_Bounds.Test FaultManager.Charger_Requested_Voltage_Out_of_Bounds.Faulty_Samples__X_ FaultManager.Charger_Requested_Voltage_Out_of_Bounds.Total_Samples__Y_ FaultManager.Charger_Requested_Voltage_Out_of_Bounds.Action_1 FaultManager.Charger_Requested_Voltage_Out_of_Bounds.Action_1_Condition FaultManager.Charger_Requested_Voltage_Out_of_Bounds.Action_2 FaultManager.Charger_Requested_Voltage_Out_of_Bounds.Action_2_Condition FaultManager.Charger_Requested_Voltage_Out_of_Bounds.Action_3 FaultManager.Charger_Requested_Voltage_Out_of_Bounds.Action_3_Condition FaultManager.Charger_Requested_Voltage_Out_of_Bounds.Action_4 FaultManager.Charger_Requested_Voltage_Out_of_Bounds.Action_4_Condition FaultManager.Cruise_Control_Brake_Switch_A_Circuit_High.Mode FaultManager.Cruise_Control_Brake_Switch_A_Circuit_High.ID FaultManager.Cruise_Control_Brake_Switch_A_Circuit_High.Test FaultManager.Cruise_Control_Brake_Switch_A_Circuit_High.Faulty_Samples__X_ FaultManager.Cruise_Control_Brake_Switch_A_Circuit_High.Total_Samples__Y_ FaultManager.Cruise_Control_Brake_Switch_A_Circuit_High.Action_1 FaultManager.Cruise_Control_Brake_Switch_A_Circuit_High.Action_1_Condition FaultManager.Cruise_Control_Brake_Switch_A_Circuit_High.Action_2 FaultManager.Cruise_Control_Brake_Switch_A_Circuit_High.Action_2_Condition FaultManager.Cruise_Control_Brake_Switch_A_Circuit_High.Action_3 FaultManager.Cruise_Control_Brake_Switch_A_Circuit_High.Action_3_Condition FaultManager.Cruise_Control_Brake_Switch_A_Circuit_High.Action_4 FaultManager.Cruise_Control_Brake_Switch_A_Circuit_High.Action_4_Condition FaultManager.Cruise_Control_Brake_Switch_A_Circuit_Low.Mode FaultManager.Cruise_Control_Brake_Switch_A_Circuit_Low.ID FaultManager.Cruise_Control_Brake_Switch_A_Circuit_Low.Test FaultManager.Cruise_Control_Brake_Switch_A_Circuit_Low.Faulty_Samples__X_ FaultManager.Cruise_Control_Brake_Switch_A_Circuit_Low.Total_Samples__Y_ FaultManager.Cruise_Control_Brake_Switch_A_Circuit_Low.Action_1 FaultManager.Cruise_Control_Brake_Switch_A_Circuit_Low.Action_1_Condition FaultManager.Cruise_Control_Brake_Switch_A_Circuit_Low.Action_2 FaultManager.Cruise_Control_Brake_Switch_A_Circuit_Low.Action_2_Condition FaultManager.Cruise_Control_Brake_Switch_A_Circuit_Low.Action_3 FaultManager.Cruise_Control_Brake_Switch_A_Circuit_Low.Action_3_Condition FaultManager.Cruise_Control_Brake_Switch_A_Circuit_Low.Action_4 FaultManager.Cruise_Control_Brake_Switch_A_Circuit_Low.Action_4_Condition FaultManager.Cruise_Control_Brake_Switch_A_Circuit_Malfunction.Mode FaultManager.Cruise_Control_Brake_Switch_A_Circuit_Malfunction.ID FaultManager.Cruise_Control_Brake_Switch_A_Circuit_Malfunction.Test FaultManager.Cruise_Control_Brake_Switch_A_Circuit_Malfunction.Faulty_Samples__X_ FaultManager.Cruise_Control_Brake_Switch_A_Circuit_Malfunction.Total_Samples__Y_ FaultManager.Cruise_Control_Brake_Switch_A_Circuit_Malfunction.Action_1 FaultManager.Cruise_Control_Brake_Switch_A_Circuit_Malfunction.Action_1_Condition FaultManager.Cruise_Control_Brake_Switch_A_Circuit_Malfunction.Action_2 FaultManager.Cruise_Control_Brake_Switch_A_Circuit_Malfunction.Action_2_Condition FaultManager.Cruise_Control_Brake_Switch_A_Circuit_Malfunction.Action_3 FaultManager.Cruise_Control_Brake_Switch_A_Circuit_Malfunction.Action_3_Condition FaultManager.Cruise_Control_Brake_Switch_A_Circuit_Malfunction.Action_4 /end DEF_CHARACTERISTIC
 /begin OUT_MEASUREMENT FaultMarquees.FaultMarquees.Current_Suspected FaultMarquees.FaultMarquees.Current_Active FaultMarquees.FaultMarquees.Current_Occurred /end OUT_MEASUREMENT
 /begin SUB_FUNCTION Action_Reasons /end SUB_FUNCTION
/end FUNCTION
/end MODULE
/end PROJECT
