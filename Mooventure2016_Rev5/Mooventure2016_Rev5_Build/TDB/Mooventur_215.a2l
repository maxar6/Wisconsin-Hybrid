ASAP2_VERSION 1 51
/begin PROJECT Project ""
/begin MODULE Mooventur_215 ""
/begin MOD_COMMON /* MOD_COMMON Comment */ "" BYTE_ORDER MSB_FIRST ALIGNMENT_BYTE 1 ALIGNMENT_FLOAT32_IEEE 1 ALIGNMENT_FLOAT64_IEEE 1 ALIGNMENT_LONG 1 ALIGNMENT_WORD 1 /end MOD_COMMON
/begin CHARACTERISTIC FaultManager.Cruise_Control_Coast_Signal_Malfunction.Action_4 "Fault manager configuration.  Select up to 4 actions for each fault." VALUE 0x80000C41 RecordLayout_7 0 CompuMethod_483 0 65535 /end CHARACTERISTIC
/begin CHARACTERISTIC FaultManager.Cruise_Control_Coast_Signal_Malfunction.Action_4_Condition "Fault manager configuration.  Select up to 4 actions for each fault." VALUE 0x80000C43 RecordLayout_7 0 CompuMethod_484 0 65535 /end CHARACTERISTIC
/begin CHARACTERISTIC FaultManager.Cruise_Control_Off_Signal_Malfunction.Mode "Fault manager configuration.  Select up to 4 actions for each fault." VALUE 0x80000C45 RecordLayout_7 0 CompuMethod_481 0 65535 /end CHARACTERISTIC
/begin CHARACTERISTIC FaultManager.Cruise_Control_Off_Signal_Malfunction.ID "Fault manager configuration.  Select up to 4 actions for each fault." VALUE 0x80000C47 RecordLayout_7 0 CompuMethod_1 0 65535 /end CHARACTERISTIC
/begin CHARACTERISTIC FaultManager.Cruise_Control_Off_Signal_Malfunction.Test "Fault manager configuration.  Select up to 4 actions for each fault." VALUE 0x80000C49 RecordLayout_7 0 CompuMethod_482 0 65535 /end CHARACTERISTIC
/begin CHARACTERISTIC FaultManager.Cruise_Control_Off_Signal_Malfunction.Faulty_Samples__X_ "Fault manager configuration.  Select up to 4 actions for each fault." VALUE 0x80000C4B RecordLayout_7 0 CompuMethod_1 0 65535 /end CHARACTERISTIC
/begin CHARACTERISTIC FaultManager.Cruise_Control_Off_Signal_Malfunction.Total_Samples__Y_ "Fault manager configuration.  Select up to 4 actions for each fault." VALUE 0x80000C4D RecordLayout_7 0 CompuMethod_1 0 65535 /end CHARACTERISTIC
/begin CHARACTERISTIC FaultManager.Cruise_Control_Off_Signal_Malfunction.Action_1 "Fault manager configuration.  Select up to 4 actions for each fault." VALUE 0x80000C4F RecordLayout_7 0 CompuMethod_483 0 65535 /end CHARACTERISTIC
/begin CHARACTERISTIC FaultManager.Cruise_Control_Off_Signal_Malfunction.Action_1_Condition "Fault manager configuration.  Select up to 4 actions for each fault." VALUE 0x80000C51 RecordLayout_7 0 CompuMethod_484 0 65535 /end CHARACTERISTIC
/begin CHARACTERISTIC FaultManager.Cruise_Control_Off_Signal_Malfunction.Action_2 "Fault manager configuration.  Select up to 4 actions for each fault." VALUE 0x80000C53 RecordLayout_7 0 CompuMethod_483 0 65535 /end CHARACTERISTIC
/begin CHARACTERISTIC FaultManager.Cruise_Control_Off_Signal_Malfunction.Action_2_Condition "Fault manager configuration.  Select up to 4 actions for each fault." VALUE 0x80000C55 RecordLayout_7 0 CompuMethod_484 0 65535 /end CHARACTERISTIC
/begin CHARACTERISTIC FaultManager.Cruise_Control_Off_Signal_Malfunction.Action_3 "Fault manager configuration.  Select up to 4 actions for each fault." VALUE 0x80000C57 RecordLayout_7 0 CompuMethod_483 0 65535 /end CHARACTERISTIC
/begin CHARACTERISTIC FaultManager.Cruise_Control_Off_Signal_Malfunction.Action_3_Condition "Fault manager configuration.  Select up to 4 actions for each fault." VALUE 0x80000C59 RecordLayout_7 0 CompuMethod_484 0 65535 /end CHARACTERISTIC
/begin CHARACTERISTIC FaultManager.Cruise_Control_Off_Signal_Malfunction.Action_4 "Fault manager configuration.  Select up to 4 actions for each fault." VALUE 0x80000C5B RecordLayout_7 0 CompuMethod_483 0 65535 /end CHARACTERISTIC
/begin CHARACTERISTIC FaultManager.Cruise_Control_Off_Signal_Malfunction.Action_4_Condition "Fault manager configuration.  Select up to 4 actions for each fault." VALUE 0x80000C5D RecordLayout_7 0 CompuMethod_484 0 65535 /end CHARACTERISTIC
/begin CHARACTERISTIC FaultManager.Cruise_Control_On_Signal_Malfunction.Mode "Fault manager configuration.  Select up to 4 actions for each fault." VALUE 0x80000C5F RecordLayout_7 0 CompuMethod_481 0 65535 /end CHARACTERISTIC
/begin CHARACTERISTIC FaultManager.Cruise_Control_On_Signal_Malfunction.ID "Fault manager configuration.  Select up to 4 actions for each fault." VALUE 0x80000C61 RecordLayout_7 0 CompuMethod_1 0 65535 /end CHARACTERISTIC
/begin CHARACTERISTIC FaultManager.Cruise_Control_On_Signal_Malfunction.Test "Fault manager configuration.  Select up to 4 actions for each fault." VALUE 0x80000C63 RecordLayout_7 0 CompuMethod_482 0 65535 /end CHARACTERISTIC
/begin CHARACTERISTIC FaultManager.Cruise_Control_On_Signal_Malfunction.Faulty_Samples__X_ "Fault manager configuration.  Select up to 4 actions for each fault." VALUE 0x80000C65 RecordLayout_7 0 CompuMethod_1 0 65535 /end CHARACTERISTIC
/begin CHARACTERISTIC FaultManager.Cruise_Control_On_Signal_Malfunction.Total_Samples__Y_ "Fault manager configuration.  Select up to 4 actions for each fault." VALUE 0x80000C67 RecordLayout_7 0 CompuMethod_1 0 65535 /end CHARACTERISTIC
/begin CHARACTERISTIC FaultManager.Cruise_Control_On_Signal_Malfunction.Action_1 "Fault manager configuration.  Select up to 4 actions for each fault." VALUE 0x80000C69 RecordLayout_7 0 CompuMethod_483 0 65535 /end CHARACTERISTIC
/begin CHARACTERISTIC FaultManager.Cruise_Control_On_Signal_Malfunction.Action_1_Condition "Fault manager configuration.  Select up to 4 actions for each fault." VALUE 0x80000C6B RecordLayout_7 0 CompuMethod_484 0 65535 /end CHARACTERISTIC
/begin CHARACTERISTIC FaultManager.Cruise_Control_On_Signal_Malfunction.Action_2 "Fault manager configuration.  Select up to 4 actions for each fault." VALUE 0x80000C6D RecordLayout_7 0 CompuMethod_483 0 65535 /end CHARACTERISTIC
/begin CHARACTERISTIC FaultManager.Cruise_Control_On_Signal_Malfunction.Action_2_Condition "Fault manager configuration.  Select up to 4 actions for each fault." VALUE 0x80000C6F RecordLayout_7 0 CompuMethod_484 0 65535 /end CHARACTERISTIC
/begin CHARACTERISTIC FaultManager.Cruise_Control_On_Signal_Malfunction.Action_3 "Fault manager configuration.  Select up to 4 actions for each fault." VALUE 0x80000C71 RecordLayout_7 0 CompuMethod_483 0 65535 /end CHARACTERISTIC
/begin CHARACTERISTIC FaultManager.Cruise_Control_On_Signal_Malfunction.Action_3_Condition "Fault manager configuration.  Select up to 4 actions for each fault." VALUE 0x80000C73 RecordLayout_7 0 CompuMethod_484 0 65535 /end CHARACTERISTIC
/begin CHARACTERISTIC FaultManager.Cruise_Control_On_Signal_Malfunction.Action_4 "Fault manager configuration.  Select up to 4 actions for each fault." VALUE 0x80000C75 RecordLayout_7 0 CompuMethod_483 0 65535 /end CHARACTERISTIC
/begin CHARACTERISTIC FaultManager.Cruise_Control_On_Signal_Malfunction.Action_4_Condition "Fault manager configuration.  Select up to 4 actions for each fault." VALUE 0x80000C77 RecordLayout_7 0 CompuMethod_484 0 65535 /end CHARACTERISTIC
/begin CHARACTERISTIC FaultManager.Cruise_Control_Resume_Signal_Malfunction.Mode "Fault manager configuration.  Select up to 4 actions for each fault." VALUE 0x80000C79 RecordLayout_7 0 CompuMethod_481 0 65535 /end CHARACTERISTIC
/begin CHARACTERISTIC FaultManager.Cruise_Control_Resume_Signal_Malfunction.ID "Fault manager configuration.  Select up to 4 actions for each fault." VALUE 0x80000C7B RecordLayout_7 0 CompuMethod_1 0 65535 /end CHARACTERISTIC
/begin CHARACTERISTIC FaultManager.Cruise_Control_Resume_Signal_Malfunction.Test "Fault manager configuration.  Select up to 4 actions for each fault." VALUE 0x80000C7D RecordLayout_7 0 CompuMethod_482 0 65535 /end CHARACTERISTIC
/begin CHARACTERISTIC FaultManager.Cruise_Control_Resume_Signal_Malfunction.Faulty_Samples__X_ "Fault manager configuration.  Select up to 4 actions for each fault." VALUE 0x80000C7F RecordLayout_7 0 CompuMethod_1 0 65535 /end CHARACTERISTIC
/begin CHARACTERISTIC FaultManager.Cruise_Control_Resume_Signal_Malfunction.Total_Samples__Y_ "Fault manager configuration.  Select up to 4 actions for each fault." VALUE 0x80000C81 RecordLayout_7 0 CompuMethod_1 0 65535 /end CHARACTERISTIC
/begin CHARACTERISTIC FaultManager.Cruise_Control_Resume_Signal_Malfunction.Action_1 "Fault manager configuration.  Select up to 4 actions for each fault." VALUE 0x80000C83 RecordLayout_7 0 CompuMethod_483 0 65535 /end CHARACTERISTIC
/begin CHARACTERISTIC FaultManager.Cruise_Control_Resume_Signal_Malfunction.Action_1_Condition "Fault manager configuration.  Select up to 4 actions for each fault." VALUE 0x80000C85 RecordLayout_7 0 CompuMethod_484 0 65535 /end CHARACTERISTIC
/begin CHARACTERISTIC FaultManager.Cruise_Control_Resume_Signal_Malfunction.Action_2 "Fault manager configuration.  Select up to 4 actions for each fault." VALUE 0x80000C87 RecordLayout_7 0 CompuMethod_483 0 65535 /end CHARACTERISTIC
/begin CHARACTERISTIC FaultManager.Cruise_Control_Resume_Signal_Malfunction.Action_2_Condition "Fault manager configuration.  Select up to 4 actions for each fault." VALUE 0x80000C89 RecordLayout_7 0 CompuMethod_484 0 65535 /end CHARACTERISTIC
/begin CHARACTERISTIC FaultManager.Cruise_Control_Resume_Signal_Malfunction.Action_3 "Fault manager configuration.  Select up to 4 actions for each fault." VALUE 0x80000C8B RecordLayout_7 0 CompuMethod_483 0 65535 /end CHARACTERISTIC
/begin CHARACTERISTIC FaultManager.Cruise_Control_Resume_Signal_Malfunction.Action_3_Condition "Fault manager configuration.  Select up to 4 actions for each fault." VALUE 0x80000C8D RecordLayout_7 0 CompuMethod_484 0 65535 /end CHARACTERISTIC
/begin CHARACTERISTIC FaultManager.Cruise_Control_Resume_Signal_Malfunction.Action_4 "Fault manager configuration.  Select up to 4 actions for each fault." VALUE 0x80000C8F RecordLayout_7 0 CompuMethod_483 0 65535 /end CHARACTERISTIC
/begin CHARACTERISTIC FaultManager.Cruise_Control_Resume_Signal_Malfunction.Action_4_Condition "Fault manager configuration.  Select up to 4 actions for each fault." VALUE 0x80000C91 RecordLayout_7 0 CompuMethod_484 0 65535 /end CHARACTERISTIC
/begin CHARACTERISTIC FaultManager.Cruise_Control_Set_Signal_Malfunction.Mode "Fault manager configuration.  Select up to 4 actions for each fault." VALUE 0x80000C93 RecordLayout_7 0 CompuMethod_481 0 65535 /end CHARACTERISTIC
/begin CHARACTERISTIC FaultManager.Cruise_Control_Set_Signal_Malfunction.ID "Fault manager configuration.  Select up to 4 actions for each fault." VALUE 0x80000C95 RecordLayout_7 0 CompuMethod_1 0 65535 /end CHARACTERISTIC
/begin CHARACTERISTIC FaultManager.Cruise_Control_Set_Signal_Malfunction.Test "Fault manager configuration.  Select up to 4 actions for each fault." VALUE 0x80000C97 RecordLayout_7 0 CompuMethod_482 0 65535 /end CHARACTERISTIC
/begin CHARACTERISTIC FaultManager.Cruise_Control_Set_Signal_Malfunction.Faulty_Samples__X_ "Fault manager configuration.  Select up to 4 actions for each fault." VALUE 0x80000C99 RecordLayout_7 0 CompuMethod_1 0 65535 /end CHARACTERISTIC
/begin CHARACTERISTIC FaultManager.Cruise_Control_Set_Signal_Malfunction.Total_Samples__Y_ "Fault manager configuration.  Select up to 4 actions for each fault." VALUE 0x80000C9B RecordLayout_7 0 CompuMethod_1 0 65535 /end CHARACTERISTIC
/begin CHARACTERISTIC FaultManager.Cruise_Control_Set_Signal_Malfunction.Action_1 "Fault manager configuration.  Select up to 4 actions for each fault." VALUE 0x80000C9D RecordLayout_7 0 CompuMethod_483 0 65535 /end CHARACTERISTIC
/begin CHARACTERISTIC FaultManager.Cruise_Control_Set_Signal_Malfunction.Action_1_Condition "Fault manager configuration.  Select up to 4 actions for each fault." VALUE 0x80000C9F RecordLayout_7 0 CompuMethod_484 0 65535 /end CHARACTERISTIC
/begin CHARACTERISTIC FaultManager.Cruise_Control_Set_Signal_Malfunction.Action_2 "Fault manager configuration.  Select up to 4 actions for each fault." VALUE 0x80000CA1 RecordLayout_7 0 CompuMethod_483 0 65535 /end CHARACTERISTIC
/begin CHARACTERISTIC FaultManager.Cruise_Control_Set_Signal_Malfunction.Action_2_Condition "Fault manager configuration.  Select up to 4 actions for each fault." VALUE 0x80000CA3 RecordLayout_7 0 CompuMethod_484 0 65535 /end CHARACTERISTIC
/begin CHARACTERISTIC FaultManager.Cruise_Control_Set_Signal_Malfunction.Action_3 "Fault manager configuration.  Select up to 4 actions for each fault." VALUE 0x80000CA5 RecordLayout_7 0 CompuMethod_483 0 65535 /end CHARACTERISTIC
/begin CHARACTERISTIC FaultManager.Cruise_Control_Set_Signal_Malfunction.Action_3_Condition "Fault manager configuration.  Select up to 4 actions for each fault." VALUE 0x80000CA7 RecordLayout_7 0 CompuMethod_484 0 65535 /end CHARACTERISTIC
/begin CHARACTERISTIC FaultManager.Cruise_Control_Set_Signal_Malfunction.Action_4 "Fault manager configuration.  Select up to 4 actions for each fault." VALUE 0x80000CA9 RecordLayout_7 0 CompuMethod_483 0 65535 /end CHARACTERISTIC
/begin CHARACTERISTIC FaultManager.Cruise_Control_Set_Signal_Malfunction.Action_4_Condition "Fault manager configuration.  Select up to 4 actions for each fault." VALUE 0x80000CAB RecordLayout_7 0 CompuMethod_484 0 65535 /end CHARACTERISTIC
/begin CHARACTERISTIC FaultManager.DCDC_Converter_Not_Running.Mode "Fault manager configuration.  Select up to 4 actions for each fault." VALUE 0x80000CAD RecordLayout_7 0 CompuMethod_481 0 65535 /end CHARACTERISTIC
/begin CHARACTERISTIC FaultManager.DCDC_Converter_Not_Running.ID "Fault manager configuration.  Select up to 4 actions for each fault." VALUE 0x80000CAF RecordLayout_7 0 CompuMethod_1 0 65535 /end CHARACTERISTIC
/begin CHARACTERISTIC FaultManager.DCDC_Converter_Not_Running.Test "Fault manager configuration.  Select up to 4 actions for each fault." VALUE 0x80000CB1 RecordLayout_7 0 CompuMethod_482 0 65535 /end CHARACTERISTIC
/begin CHARACTERISTIC FaultManager.DCDC_Converter_Not_Running.Faulty_Samples__X_ "Fault manager configuration.  Select up to 4 actions for each fault." VALUE 0x80000CB3 RecordLayout_7 0 CompuMethod_1 0 65535 /end CHARACTERISTIC
/begin CHARACTERISTIC FaultManager.DCDC_Converter_Not_Running.Total_Samples__Y_ "Fault manager configuration.  Select up to 4 actions for each fault." VALUE 0x80000CB5 RecordLayout_7 0 CompuMethod_1 0 65535 /end CHARACTERISTIC
/begin CHARACTERISTIC FaultManager.DCDC_Converter_Not_Running.Action_1 "Fault manager configuration.  Select up to 4 actions for each fault." VALUE 0x80000CB7 RecordLayout_7 0 CompuMethod_483 0 65535 /end CHARACTERISTIC
/begin CHARACTERISTIC FaultManager.DCDC_Converter_Not_Running.Action_1_Condition "Fault manager configuration.  Select up to 4 actions for each fault." VALUE 0x80000CB9 RecordLayout_7 0 CompuMethod_484 0 65535 /end CHARACTERISTIC
/begin CHARACTERISTIC FaultManager.DCDC_Converter_Not_Running.Action_2 "Fault manager configuration.  Select up to 4 actions for each fault." VALUE 0x80000CBB RecordLayout_7 0 CompuMethod_483 0 65535 /end CHARACTERISTIC
/begin CHARACTERISTIC FaultManager.DCDC_Converter_Not_Running.Action_2_Condition "Fault manager configuration.  Select up to 4 actions for each fault." VALUE 0x80000CBD RecordLayout_7 0 CompuMethod_484 0 65535 /end CHARACTERISTIC
/begin CHARACTERISTIC FaultManager.DCDC_Converter_Not_Running.Action_3 "Fault manager configuration.  Select up to 4 actions for each fault." VALUE 0x80000CBF RecordLayout_7 0 CompuMethod_483 0 65535 /end CHARACTERISTIC
/begin CHARACTERISTIC FaultManager.DCDC_Converter_Not_Running.Action_3_Condition "Fault manager configuration.  Select up to 4 actions for each fault." VALUE 0x80000CC1 RecordLayout_7 0 CompuMethod_484 0 65535 /end CHARACTERISTIC
/begin CHARACTERISTIC FaultManager.DCDC_Converter_Not_Running.Action_4 "Fault manager configuration.  Select up to 4 actions for each fault." VALUE 0x80000CC3 RecordLayout_7 0 CompuMethod_483 0 65535 /end CHARACTERISTIC
/begin CHARACTERISTIC FaultManager.DCDC_Converter_Not_Running.Action_4_Condition "Fault manager configuration.  Select up to 4 actions for each fault." VALUE 0x80000CC5 RecordLayout_7 0 CompuMethod_484 0 65535 /end CHARACTERISTIC
/begin CHARACTERISTIC FaultManager.Drive_Switch_Input_Circuit.Mode "Fault manager configuration.  Select up to 4 actions for each fault." VALUE 0x80000CC7 RecordLayout_7 0 CompuMethod_481 0 65535 /end CHARACTERISTIC
/begin CHARACTERISTIC FaultManager.Drive_Switch_Input_Circuit.ID "Fault manager configuration.  Select up to 4 actions for each fault." VALUE 0x80000CC9 RecordLayout_7 0 CompuMethod_1 0 65535 /end CHARACTERISTIC
/begin CHARACTERISTIC FaultManager.Drive_Switch_Input_Circuit.Test "Fault manager configuration.  Select up to 4 actions for each fault." VALUE 0x80000CCB RecordLayout_7 0 CompuMethod_482 0 65535 /end CHARACTERISTIC
/begin CHARACTERISTIC FaultManager.Drive_Switch_Input_Circuit.Faulty_Samples__X_ "Fault manager configuration.  Select up to 4 actions for each fault." VALUE 0x80000CCD RecordLayout_7 0 CompuMethod_1 0 65535 /end CHARACTERISTIC
/begin CHARACTERISTIC FaultManager.Drive_Switch_Input_Circuit.Total_Samples__Y_ "Fault manager configuration.  Select up to 4 actions for each fault." VALUE 0x80000CCF RecordLayout_7 0 CompuMethod_1 0 65535 /end CHARACTERISTIC
/begin CHARACTERISTIC FaultManager.Drive_Switch_Input_Circuit.Action_1 "Fault manager configuration.  Select up to 4 actions for each fault." VALUE 0x80000CD1 RecordLayout_7 0 CompuMethod_483 0 65535 /end CHARACTERISTIC
/begin CHARACTERISTIC FaultManager.Drive_Switch_Input_Circuit.Action_1_Condition "Fault manager configuration.  Select up to 4 actions for each fault." VALUE 0x80000CD3 RecordLayout_7 0 CompuMethod_484 0 65535 /end CHARACTERISTIC
/begin CHARACTERISTIC FaultManager.Drive_Switch_Input_Circuit.Action_2 "Fault manager configuration.  Select up to 4 actions for each fault." VALUE 0x80000CD5 RecordLayout_7 0 CompuMethod_483 0 65535 /end CHARACTERISTIC
/begin CHARACTERISTIC FaultManager.Drive_Switch_Input_Circuit.Action_2_Condition "Fault manager configuration.  Select up to 4 actions for each fault." VALUE 0x80000CD7 RecordLayout_7 0 CompuMethod_484 0 65535 /end CHARACTERISTIC
/begin CHARACTERISTIC FaultManager.Drive_Switch_Input_Circuit.Action_3 "Fault manager configuration.  Select up to 4 actions for each fault." VALUE 0x80000CD9 RecordLayout_7 0 CompuMethod_483 0 65535 /end CHARACTERISTIC
/begin CHARACTERISTIC FaultManager.Drive_Switch_Input_Circuit.Action_3_Condition "Fault manager configuration.  Select up to 4 actions for each fault." VALUE 0x80000CDB RecordLayout_7 0 CompuMethod_484 0 65535 /end CHARACTERISTIC
/begin CHARACTERISTIC FaultManager.Drive_Switch_Input_Circuit.Action_4 "Fault manager configuration.  Select up to 4 actions for each fault." VALUE 0x80000CDD RecordLayout_7 0 CompuMethod_483 0 65535 /end CHARACTERISTIC
/begin CHARACTERISTIC FaultManager.Drive_Switch_Input_Circuit.Action_4_Condition "Fault manager configuration.  Select up to 4 actions for each fault." VALUE 0x80000CDF RecordLayout_7 0 CompuMethod_484 0 65535 /end CHARACTERISTIC
/begin CHARACTERISTIC FaultManager.Drive_Switch_Input_High.Mode "Fault manager configuration.  Select up to 4 actions for each fault." VALUE 0x80000CE1 RecordLayout_7 0 CompuMethod_481 0 65535 /end CHARACTERISTIC
/begin CHARACTERISTIC FaultManager.Drive_Switch_Input_High.ID "Fault manager configuration.  Select up to 4 actions for each fault." VALUE 0x80000CE3 RecordLayout_7 0 CompuMethod_1 0 65535 /end CHARACTERISTIC
/begin CHARACTERISTIC FaultManager.Drive_Switch_Input_High.Test "Fault manager configuration.  Select up to 4 actions for each fault." VALUE 0x80000CE5 RecordLayout_7 0 CompuMethod_482 0 65535 /end CHARACTERISTIC
/begin CHARACTERISTIC FaultManager.Drive_Switch_Input_High.Faulty_Samples__X_ "Fault manager configuration.  Select up to 4 actions for each fault." VALUE 0x80000CE7 RecordLayout_7 0 CompuMethod_1 0 65535 /end CHARACTERISTIC
/begin CHARACTERISTIC FaultManager.Drive_Switch_Input_High.Total_Samples__Y_ "Fault manager configuration.  Select up to 4 actions for each fault." VALUE 0x80000CE9 RecordLayout_7 0 CompuMethod_1 0 65535 /end CHARACTERISTIC
/begin CHARACTERISTIC FaultManager.Drive_Switch_Input_High.Action_1 "Fault manager configuration.  Select up to 4 actions for each fault." VALUE 0x80000CEB RecordLayout_7 0 CompuMethod_483 0 65535 /end CHARACTERISTIC
/begin CHARACTERISTIC FaultManager.Drive_Switch_Input_High.Action_1_Condition "Fault manager configuration.  Select up to 4 actions for each fault." VALUE 0x80000CED RecordLayout_7 0 CompuMethod_484 0 65535 /end CHARACTERISTIC
/begin CHARACTERISTIC FaultManager.Drive_Switch_Input_High.Action_2 "Fault manager configuration.  Select up to 4 actions for each fault." VALUE 0x80000CEF RecordLayout_7 0 CompuMethod_483 0 65535 /end CHARACTERISTIC
/begin CHARACTERISTIC FaultManager.Drive_Switch_Input_High.Action_2_Condition "Fault manager configuration.  Select up to 4 actions for each fault." VALUE 0x80000CF1 RecordLayout_7 0 CompuMethod_484 0 65535 /end CHARACTERISTIC
/begin CHARACTERISTIC FaultManager.Drive_Switch_Input_High.Action_3 "Fault manager configuration.  Select up to 4 actions for each fault." VALUE 0x80000CF3 RecordLayout_7 0 CompuMethod_483 0 65535 /end CHARACTERISTIC
/begin CHARACTERISTIC FaultManager.Drive_Switch_Input_High.Action_3_Condition "Fault manager configuration.  Select up to 4 actions for each fault." VALUE 0x80000CF5 RecordLayout_7 0 CompuMethod_484 0 65535 /end CHARACTERISTIC
/begin CHARACTERISTIC FaultManager.Drive_Switch_Input_High.Action_4 "Fault manager configuration.  Select up to 4 actions for each fault." VALUE 0x80000CF7 RecordLayout_7 0 CompuMethod_483 0 65535 /end CHARACTERISTIC
/begin CHARACTERISTIC FaultManager.Drive_Switch_Input_High.Action_4_Condition "Fault manager configuration.  Select up to 4 actions for each fault." VALUE 0x80000CF9 RecordLayout_7 0 CompuMethod_484 0 65535 /end CHARACTERISTIC
/begin CHARACTERISTIC FaultManager.Drive_Switch_Input_Low.Mode "Fault manager configuration.  Select up to 4 actions for each fault." VALUE 0x80000CFB RecordLayout_7 0 CompuMethod_481 0 65535 /end CHARACTERISTIC
/begin CHARACTERISTIC FaultManager.Drive_Switch_Input_Low.ID "Fault manager configuration.  Select up to 4 actions for each fault." VALUE 0x80000CFD RecordLayout_7 0 CompuMethod_1 0 65535 /end CHARACTERISTIC
/begin CHARACTERISTIC FaultManager.Drive_Switch_Input_Low.Test "Fault manager configuration.  Select up to 4 actions for each fault." VALUE 0x80000CFF RecordLayout_7 0 CompuMethod_482 0 65535 /end CHARACTERISTIC
/begin CHARACTERISTIC FaultManager.Drive_Switch_Input_Low.Faulty_Samples__X_ "Fault manager configuration.  Select up to 4 actions for each fault." VALUE 0x80000D01 RecordLayout_7 0 CompuMethod_1 0 65535 /end CHARACTERISTIC
/begin CHARACTERISTIC FaultManager.Drive_Switch_Input_Low.Total_Samples__Y_ "Fault manager configuration.  Select up to 4 actions for each fault." VALUE 0x80000D03 RecordLayout_7 0 CompuMethod_1 0 65535 /end CHARACTERISTIC
/begin CHARACTERISTIC FaultManager.Drive_Switch_Input_Low.Action_1 "Fault manager configuration.  Select up to 4 actions for each fault." VALUE 0x80000D05 RecordLayout_7 0 CompuMethod_483 0 65535 /end CHARACTERISTIC
/begin CHARACTERISTIC FaultManager.Drive_Switch_Input_Low.Action_1_Condition "Fault manager configuration.  Select up to 4 actions for each fault." VALUE 0x80000D07 RecordLayout_7 0 CompuMethod_484 0 65535 /end CHARACTERISTIC
/begin CHARACTERISTIC FaultManager.Drive_Switch_Input_Low.Action_2 "Fault manager configuration.  Select up to 4 actions for each fault." VALUE 0x80000D09 RecordLayout_7 0 CompuMethod_483 0 65535 /end CHARACTERISTIC
/begin CHARACTERISTIC FaultManager.Drive_Switch_Input_Low.Action_2_Condition "Fault manager configuration.  Select up to 4 actions for each fault." VALUE 0x80000D0B RecordLayout_7 0 CompuMethod_484 0 65535 /end CHARACTERISTIC
/begin CHARACTERISTIC FaultManager.Drive_Switch_Input_Low.Action_3 "Fault manager configuration.  Select up to 4 actions for each fault." VALUE 0x80000D0D RecordLayout_7 0 CompuMethod_483 0 65535 /end CHARACTERISTIC
/begin CHARACTERISTIC FaultManager.Drive_Switch_Input_Low.Action_3_Condition "Fault manager configuration.  Select up to 4 actions for each fault." VALUE 0x80000D0F RecordLayout_7 0 CompuMethod_484 0 65535 /end CHARACTERISTIC
/begin CHARACTERISTIC FaultManager.Drive_Switch_Input_Low.Action_4 "Fault manager configuration.  Select up to 4 actions for each fault." VALUE 0x80000D11 RecordLayout_7 0 CompuMethod_483 0 65535 /end CHARACTERISTIC
/begin CHARACTERISTIC FaultManager.Drive_Switch_Input_Low.Action_4_Condition "Fault manager configuration.  Select up to 4 actions for each fault." VALUE 0x80000D13 RecordLayout_7 0 CompuMethod_484 0 65535 /end CHARACTERISTIC
/begin CHARACTERISTIC FaultManager.Eaton_Charger_AgeCount.Mode "Fault manager configuration.  Select up to 4 actions for each fault." VALUE 0x80000D15 RecordLayout_7 0 CompuMethod_481 0 65535 /end CHARACTERISTIC
/begin CHARACTERISTIC FaultManager.Eaton_Charger_AgeCount.ID "Fault manager configuration.  Select up to 4 actions for each fault." VALUE 0x80000D17 RecordLayout_7 0 CompuMethod_1 0 65535 /end CHARACTERISTIC
/begin CHARACTERISTIC FaultManager.Eaton_Charger_AgeCount.Test "Fault manager configuration.  Select up to 4 actions for each fault." VALUE 0x80000D19 RecordLayout_7 0 CompuMethod_482 0 65535 /end CHARACTERISTIC
/begin CHARACTERISTIC FaultManager.Eaton_Charger_AgeCount.Faulty_Samples__X_ "Fault manager configuration.  Select up to 4 actions for each fault." VALUE 0x80000D1B RecordLayout_7 0 CompuMethod_1 0 65535 /end CHARACTERISTIC
/begin CHARACTERISTIC FaultManager.Eaton_Charger_AgeCount.Total_Samples__Y_ "Fault manager configuration.  Select up to 4 actions for each fault." VALUE 0x80000D1D RecordLayout_7 0 CompuMethod_1 0 65535 /end CHARACTERISTIC
/begin CHARACTERISTIC FaultManager.Eaton_Charger_AgeCount.Action_1 "Fault manager configuration.  Select up to 4 actions for each fault." VALUE 0x80000D1F RecordLayout_7 0 CompuMethod_483 0 65535 /end CHARACTERISTIC
/begin CHARACTERISTIC FaultManager.Eaton_Charger_AgeCount.Action_1_Condition "Fault manager configuration.  Select up to 4 actions for each fault." VALUE 0x80000D21 RecordLayout_7 0 CompuMethod_484 0 65535 /end CHARACTERISTIC
/begin CHARACTERISTIC FaultManager.Eaton_Charger_AgeCount.Action_2 "Fault manager configuration.  Select up to 4 actions for each fault." VALUE 0x80000D23 RecordLayout_7 0 CompuMethod_483 0 65535 /end CHARACTERISTIC
/begin CHARACTERISTIC FaultManager.Eaton_Charger_AgeCount.Action_2_Condition "Fault manager configuration.  Select up to 4 actions for each fault." VALUE 0x80000D25 RecordLayout_7 0 CompuMethod_484 0 65535 /end CHARACTERISTIC
/begin CHARACTERISTIC FaultManager.Eaton_Charger_AgeCount.Action_3 "Fault manager configuration.  Select up to 4 actions for each fault." VALUE 0x80000D27 RecordLayout_7 0 CompuMethod_483 0 65535 /end CHARACTERISTIC
/begin CHARACTERISTIC FaultManager.Eaton_Charger_AgeCount.Action_3_Condition "Fault manager configuration.  Select up to 4 actions for each fault." VALUE 0x80000D29 RecordLayout_7 0 CompuMethod_484 0 65535 /end CHARACTERISTIC
/begin CHARACTERISTIC FaultManager.Eaton_Charger_AgeCount.Action_4 "Fault manager configuration.  Select up to 4 actions for each fault." VALUE 0x80000D2B RecordLayout_7 0 CompuMethod_483 0 65535 /end CHARACTERISTIC
/begin CHARACTERISTIC FaultManager.Eaton_Charger_AgeCount.Action_4_Condition "Fault manager configuration.  Select up to 4 actions for each fault." VALUE 0x80000D2D RecordLayout_7 0 CompuMethod_484 0 65535 /end CHARACTERISTIC
/begin CHARACTERISTIC FaultManager.Electric_Motor_Approaching_Over_Temperature.Mode "Fault manager configuration.  Select up to 4 actions for each fault." VALUE 0x80000D2F RecordLayout_7 0 CompuMethod_481 0 65535 /end CHARACTERISTIC
/begin CHARACTERISTIC FaultManager.Electric_Motor_Approaching_Over_Temperature.ID "Fault manager configuration.  Select up to 4 actions for each fault." VALUE 0x80000D31 RecordLayout_7 0 CompuMethod_1 0 65535 /end CHARACTERISTIC
/begin CHARACTERISTIC FaultManager.Electric_Motor_Approaching_Over_Temperature.Test "Fault manager configuration.  Select up to 4 actions for each fault." VALUE 0x80000D33 RecordLayout_7 0 CompuMethod_482 0 65535 /end CHARACTERISTIC
/begin CHARACTERISTIC FaultManager.Electric_Motor_Approaching_Over_Temperature.Faulty_Samples__X_ "Fault manager configuration.  Select up to 4 actions for each fault." VALUE 0x80000D35 RecordLayout_7 0 CompuMethod_1 0 65535 /end CHARACTERISTIC
/begin CHARACTERISTIC FaultManager.Electric_Motor_Approaching_Over_Temperature.Total_Samples__Y_ "Fault manager configuration.  Select up to 4 actions for each fault." VALUE 0x80000D37 RecordLayout_7 0 CompuMethod_1 0 65535 /end CHARACTERISTIC
/begin CHARACTERISTIC FaultManager.Electric_Motor_Approaching_Over_Temperature.Action_1 "Fault manager configuration.  Select up to 4 actions for each fault." VALUE 0x80000D39 RecordLayout_7 0 CompuMethod_483 0 65535 /end CHARACTERISTIC
/begin CHARACTERISTIC FaultManager.Electric_Motor_Approaching_Over_Temperature.Action_1_Condition "Fault manager configuration.  Select up to 4 actions for each fault." VALUE 0x80000D3B RecordLayout_7 0 CompuMethod_484 0 65535 /end CHARACTERISTIC
/begin CHARACTERISTIC FaultManager.Electric_Motor_Approaching_Over_Temperature.Action_2 "Fault manager configuration.  Select up to 4 actions for each fault." VALUE 0x80000D3D RecordLayout_7 0 CompuMethod_483 0 65535 /end CHARACTERISTIC
/begin CHARACTERISTIC FaultManager.Electric_Motor_Approaching_Over_Temperature.Action_2_Condition "Fault manager configuration.  Select up to 4 actions for each fault." VALUE 0x80000D3F RecordLayout_7 0 CompuMethod_484 0 65535 /end CHARACTERISTIC
/begin CHARACTERISTIC FaultManager.Electric_Motor_Approaching_Over_Temperature.Action_3 "Fault manager configuration.  Select up to 4 actions for each fault." VALUE 0x80000D41 RecordLayout_7 0 CompuMethod_483 0 65535 /end CHARACTERISTIC
/begin CHARACTERISTIC FaultManager.Electric_Motor_Approaching_Over_Temperature.Action_3_Condition "Fault manager configuration.  Select up to 4 actions for each fault." VALUE 0x80000D43 RecordLayout_7 0 CompuMethod_484 0 65535 /end CHARACTERISTIC
/begin CHARACTERISTIC FaultManager.Electric_Motor_Approaching_Over_Temperature.Action_4 "Fault manager configuration.  Select up to 4 actions for each fault." VALUE 0x80000D45 RecordLayout_7 0 CompuMethod_483 0 65535 /end CHARACTERISTIC
/begin CHARACTERISTIC FaultManager.Electric_Motor_Approaching_Over_Temperature.Action_4_Condition "Fault manager configuration.  Select up to 4 actions for each fault." VALUE 0x80000D47 RecordLayout_7 0 CompuMethod_484 0 65535 /end CHARACTERISTIC
/begin CHARACTERISTIC FaultManager.Electric_Motor_Derated_Over_Temperature.Mode "Fault manager configuration.  Select up to 4 actions for each fault." VALUE 0x80000D49 RecordLayout_7 0 CompuMethod_481 0 65535 /end CHARACTERISTIC
/begin CHARACTERISTIC FaultManager.Electric_Motor_Derated_Over_Temperature.ID "Fault manager configuration.  Select up to 4 actions for each fault." VALUE 0x80000D4B RecordLayout_7 0 CompuMethod_1 0 65535 /end CHARACTERISTIC
/begin CHARACTERISTIC FaultManager.Electric_Motor_Derated_Over_Temperature.Test "Fault manager configuration.  Select up to 4 actions for each fault." VALUE 0x80000D4D RecordLayout_7 0 CompuMethod_482 0 65535 /end CHARACTERISTIC
/begin CHARACTERISTIC FaultManager.Electric_Motor_Derated_Over_Temperature.Faulty_Samples__X_ "Fault manager configuration.  Select up to 4 actions for each fault." VALUE 0x80000D4F RecordLayout_7 0 CompuMethod_1 0 65535 /end CHARACTERISTIC
/begin CHARACTERISTIC FaultManager.Electric_Motor_Derated_Over_Temperature.Total_Samples__Y_ "Fault manager configuration.  Select up to 4 actions for each fault." VALUE 0x80000D51 RecordLayout_7 0 CompuMethod_1 0 65535 /end CHARACTERISTIC
/begin CHARACTERISTIC FaultManager.Electric_Motor_Derated_Over_Temperature.Action_1 "Fault manager configuration.  Select up to 4 actions for each fault." VALUE 0x80000D53 RecordLayout_7 0 CompuMethod_483 0 65535 /end CHARACTERISTIC
/begin CHARACTERISTIC FaultManager.Electric_Motor_Derated_Over_Temperature.Action_1_Condition "Fault manager configuration.  Select up to 4 actions for each fault." VALUE 0x80000D55 RecordLayout_7 0 CompuMethod_484 0 65535 /end CHARACTERISTIC
/begin CHARACTERISTIC FaultManager.Electric_Motor_Derated_Over_Temperature.Action_2 "Fault manager configuration.  Select up to 4 actions for each fault." VALUE 0x80000D57 RecordLayout_7 0 CompuMethod_483 0 65535 /end CHARACTERISTIC
/begin CHARACTERISTIC FaultManager.Electric_Motor_Derated_Over_Temperature.Action_2_Condition "Fault manager configuration.  Select up to 4 actions for each fault." VALUE 0x80000D59 RecordLayout_7 0 CompuMethod_484 0 65535 /end CHARACTERISTIC
/begin CHARACTERISTIC FaultManager.Electric_Motor_Derated_Over_Temperature.Action_3 "Fault manager configuration.  Select up to 4 actions for each fault." VALUE 0x80000D5B RecordLayout_7 0 CompuMethod_483 0 65535 /end CHARACTERISTIC
/begin CHARACTERISTIC FaultManager.Electric_Motor_Derated_Over_Temperature.Action_3_Condition "Fault manager configuration.  Select up to 4 actions for each fault." VALUE 0x80000D5D RecordLayout_7 0 CompuMethod_484 0 65535 /end CHARACTERISTIC
/begin CHARACTERISTIC FaultManager.Electric_Motor_Derated_Over_Temperature.Action_4 "Fault manager configuration.  Select up to 4 actions for each fault." VALUE 0x80000D5F RecordLayout_7 0 CompuMethod_483 0 65535 /end CHARACTERISTIC
/begin CHARACTERISTIC FaultManager.Electric_Motor_Derated_Over_Temperature.Action_4_Condition "Fault manager configuration.  Select up to 4 actions for each fault." VALUE 0x80000D61 RecordLayout_7 0 CompuMethod_484 0 65535 /end CHARACTERISTIC
/begin CHARACTERISTIC FaultManager.Electric_Motor_Derated_Over_Voltage.Mode "Fault manager configuration.  Select up to 4 actions for each fault." VALUE 0x80000D63 RecordLayout_7 0 CompuMethod_481 0 65535 /end CHARACTERISTIC
/begin CHARACTERISTIC FaultManager.Electric_Motor_Derated_Over_Voltage.ID "Fault manager configuration.  Select up to 4 actions for each fault." VALUE 0x80000D65 RecordLayout_7 0 CompuMethod_1 0 65535 /end CHARACTERISTIC
/begin CHARACTERISTIC FaultManager.Electric_Motor_Derated_Over_Voltage.Test "Fault manager configuration.  Select up to 4 actions for each fault." VALUE 0x80000D67 RecordLayout_7 0 CompuMethod_482 0 65535 /end CHARACTERISTIC
/begin CHARACTERISTIC FaultManager.Electric_Motor_Derated_Over_Voltage.Faulty_Samples__X_ "Fault manager configuration.  Select up to 4 actions for each fault." VALUE 0x80000D69 RecordLayout_7 0 CompuMethod_1 0 65535 /end CHARACTERISTIC
/begin CHARACTERISTIC FaultManager.Electric_Motor_Derated_Over_Voltage.Total_Samples__Y_ "Fault manager configuration.  Select up to 4 actions for each fault." VALUE 0x80000D6B RecordLayout_7 0 CompuMethod_1 0 65535 /end CHARACTERISTIC
/begin CHARACTERISTIC FaultManager.Electric_Motor_Derated_Over_Voltage.Action_1 "Fault manager configuration.  Select up to 4 actions for each fault." VALUE 0x80000D6D RecordLayout_7 0 CompuMethod_483 0 65535 /end CHARACTERISTIC
/begin CHARACTERISTIC FaultManager.Electric_Motor_Derated_Over_Voltage.Action_1_Condition "Fault manager configuration.  Select up to 4 actions for each fault." VALUE 0x80000D6F RecordLayout_7 0 CompuMethod_484 0 65535 /end CHARACTERISTIC
/begin CHARACTERISTIC FaultManager.Electric_Motor_Derated_Over_Voltage.Action_2 "Fault manager configuration.  Select up to 4 actions for each fault." VALUE 0x80000D71 RecordLayout_7 0 CompuMethod_483 0 65535 /end CHARACTERISTIC
/begin CHARACTERISTIC FaultManager.Electric_Motor_Derated_Over_Voltage.Action_2_Condition "Fault manager configuration.  Select up to 4 actions for each fault." VALUE 0x80000D73 RecordLayout_7 0 CompuMethod_484 0 65535 /end CHARACTERISTIC
/begin CHARACTERISTIC FaultManager.Electric_Motor_Derated_Over_Voltage.Action_3 "Fault manager configuration.  Select up to 4 actions for each fault." VALUE 0x80000D75 RecordLayout_7 0 CompuMethod_483 0 65535 /end CHARACTERISTIC
/begin CHARACTERISTIC FaultManager.Electric_Motor_Derated_Over_Voltage.Action_3_Condition "Fault manager configuration.  Select up to 4 actions for each fault." VALUE 0x80000D77 RecordLayout_7 0 CompuMethod_484 0 65535 /end CHARACTERISTIC
/begin CHARACTERISTIC FaultManager.Electric_Motor_Derated_Over_Voltage.Action_4 "Fault manager configuration.  Select up to 4 actions for each fault." VALUE 0x80000D79 RecordLayout_7 0 CompuMethod_483 0 65535 /end CHARACTERISTIC
/begin CHARACTERISTIC FaultManager.Electric_Motor_Derated_Over_Voltage.Action_4_Condition "Fault manager configuration.  Select up to 4 actions for each fault." VALUE 0x80000D7B RecordLayout_7 0 CompuMethod_484 0 65535 /end CHARACTERISTIC
/begin CHARACTERISTIC FaultManager.Electric_Motor_Derated_Under_Temperature.Mode "Fault manager configuration.  Select up to 4 actions for each fault." VALUE 0x80000D7D RecordLayout_7 0 CompuMethod_481 0 65535 /end CHARACTERISTIC
/begin CHARACTERISTIC FaultManager.Electric_Motor_Derated_Under_Temperature.ID "Fault manager configuration.  Select up to 4 actions for each fault." VALUE 0x80000D7F RecordLayout_7 0 CompuMethod_1 0 65535 /end CHARACTERISTIC
/begin CHARACTERISTIC FaultManager.Electric_Motor_Derated_Under_Temperature.Test "Fault manager configuration.  Select up to 4 actions for each fault." VALUE 0x80000D81 RecordLayout_7 0 CompuMethod_482 0 65535 /end CHARACTERISTIC
/begin CHARACTERISTIC FaultManager.Electric_Motor_Derated_Under_Temperature.Faulty_Samples__X_ "Fault manager configuration.  Select up to 4 actions for each fault." VALUE 0x80000D83 RecordLayout_7 0 CompuMethod_1 0 65535 /end CHARACTERISTIC
/begin CHARACTERISTIC FaultManager.Electric_Motor_Derated_Under_Temperature.Total_Samples__Y_ "Fault manager configuration.  Select up to 4 actions for each fault." VALUE 0x80000D85 RecordLayout_7 0 CompuMethod_1 0 65535 /end CHARACTERISTIC
/begin CHARACTERISTIC FaultManager.Electric_Motor_Derated_Under_Temperature.Action_1 "Fault manager configuration.  Select up to 4 actions for each fault." VALUE 0x80000D87 RecordLayout_7 0 CompuMethod_483 0 65535 /end CHARACTERISTIC
/begin CHARACTERISTIC FaultManager.Electric_Motor_Derated_Under_Temperature.Action_1_Condition "Fault manager configuration.  Select up to 4 actions for each fault." VALUE 0x80000D89 RecordLayout_7 0 CompuMethod_484 0 65535 /end CHARACTERISTIC
/begin CHARACTERISTIC FaultManager.Electric_Motor_Derated_Under_Temperature.Action_2 "Fault manager configuration.  Select up to 4 actions for each fault." VALUE 0x80000D8B RecordLayout_7 0 CompuMethod_483 0 65535 /end CHARACTERISTIC
/begin CHARACTERISTIC FaultManager.Electric_Motor_Derated_Under_Temperature.Action_2_Condition "Fault manager configuration.  Select up to 4 actions for each fault." VALUE 0x80000D8D RecordLayout_7 0 CompuMethod_484 0 65535 /end CHARACTERISTIC
/begin CHARACTERISTIC FaultManager.Electric_Motor_Derated_Under_Temperature.Action_3 "Fault manager configuration.  Select up to 4 actions for each fault." VALUE 0x80000D8F RecordLayout_7 0 CompuMethod_483 0 65535 /end CHARACTERISTIC
/begin CHARACTERISTIC FaultManager.Electric_Motor_Derated_Under_Temperature.Action_3_Condition "Fault manager configuration.  Select up to 4 actions for each fault." VALUE 0x80000D91 RecordLayout_7 0 CompuMethod_484 0 65535 /end CHARACTERISTIC
/begin CHARACTERISTIC FaultManager.Electric_Motor_Derated_Under_Temperature.Action_4 "Fault manager configuration.  Select up to 4 actions for each fault." VALUE 0x80000D93 RecordLayout_7 0 CompuMethod_483 0 65535 /end CHARACTERISTIC
/begin CHARACTERISTIC FaultManager.Electric_Motor_Derated_Under_Temperature.Action_4_Condition "Fault manager configuration.  Select up to 4 actions for each fault." VALUE 0x80000D95 RecordLayout_7 0 CompuMethod_484 0 65535 /end CHARACTERISTIC
/begin CHARACTERISTIC FaultManager.Electric_Motor_Derated_Under_Voltage.Mode "Fault manager configuration.  Select up to 4 actions for each fault." VALUE 0x80000D97 RecordLayout_7 0 CompuMethod_481 0 65535 /end CHARACTERISTIC
/begin CHARACTERISTIC FaultManager.Electric_Motor_Derated_Under_Voltage.ID "Fault manager configuration.  Select up to 4 actions for each fault." VALUE 0x80000D99 RecordLayout_7 0 CompuMethod_1 0 65535 /end CHARACTERISTIC
/begin CHARACTERISTIC FaultManager.Electric_Motor_Derated_Under_Voltage.Test "Fault manager configuration.  Select up to 4 actions for each fault." VALUE 0x80000D9B RecordLayout_7 0 CompuMethod_482 0 65535 /end CHARACTERISTIC
/begin CHARACTERISTIC FaultManager.Electric_Motor_Derated_Under_Voltage.Faulty_Samples__X_ "Fault manager configuration.  Select up to 4 actions for each fault." VALUE 0x80000D9D RecordLayout_7 0 CompuMethod_1 0 65535 /end CHARACTERISTIC
/begin CHARACTERISTIC FaultManager.Electric_Motor_Derated_Under_Voltage.Total_Samples__Y_ "Fault manager configuration.  Select up to 4 actions for each fault." VALUE 0x80000D9F RecordLayout_7 0 CompuMethod_1 0 65535 /end CHARACTERISTIC
/begin CHARACTERISTIC FaultManager.Electric_Motor_Derated_Under_Voltage.Action_1 "Fault manager configuration.  Select up to 4 actions for each fault." VALUE 0x80000DA1 RecordLayout_7 0 CompuMethod_483 0 65535 /end CHARACTERISTIC
/begin CHARACTERISTIC FaultManager.Electric_Motor_Derated_Under_Voltage.Action_1_Condition "Fault manager configuration.  Select up to 4 actions for each fault." VALUE 0x80000DA3 RecordLayout_7 0 CompuMethod_484 0 65535 /end CHARACTERISTIC
/begin CHARACTERISTIC FaultManager.Electric_Motor_Derated_Under_Voltage.Action_2 "Fault manager configuration.  Select up to 4 actions for each fault." VALUE 0x80000DA5 RecordLayout_7 0 CompuMethod_483 0 65535 /end CHARACTERISTIC
/begin CHARACTERISTIC FaultManager.Electric_Motor_Derated_Under_Voltage.Action_2_Condition "Fault manager configuration.  Select up to 4 actions for each fault." VALUE 0x80000DA7 RecordLayout_7 0 CompuMethod_484 0 65535 /end CHARACTERISTIC
/begin CHARACTERISTIC FaultManager.Electric_Motor_Derated_Under_Voltage.Action_3 "Fault manager configuration.  Select up to 4 actions for each fault." VALUE 0x80000DA9 RecordLayout_7 0 CompuMethod_483 0 65535 /end CHARACTERISTIC
/begin CHARACTERISTIC FaultManager.Electric_Motor_Derated_Under_Voltage.Action_3_Condition "Fault manager configuration.  Select up to 4 actions for each fault." VALUE 0x80000DAB RecordLayout_7 0 CompuMethod_484 0 65535 /end CHARACTERISTIC
/begin CHARACTERISTIC FaultManager.Electric_Motor_Derated_Under_Voltage.Action_4 "Fault manager configuration.  Select up to 4 actions for each fault." VALUE 0x80000DAD RecordLayout_7 0 CompuMethod_483 0 65535 /end CHARACTERISTIC
/begin CHARACTERISTIC FaultManager.Electric_Motor_Derated_Under_Voltage.Action_4_Condition "Fault manager configuration.  Select up to 4 actions for each fault." VALUE 0x80000DAF RecordLayout_7 0 CompuMethod_484 0 65535 /end CHARACTERISTIC
/begin CHARACTERISTIC FaultManager.Electric_Motor_General_Error.Mode "Fault manager configuration.  Select up to 4 actions for each fault." VALUE 0x80000DB1 RecordLayout_7 0 CompuMethod_481 0 65535 /end CHARACTERISTIC
/begin CHARACTERISTIC FaultManager.Electric_Motor_General_Error.ID "Fault manager configuration.  Select up to 4 actions for each fault." VALUE 0x80000DB3 RecordLayout_7 0 CompuMethod_1 0 65535 /end CHARACTERISTIC
/begin CHARACTERISTIC FaultManager.Electric_Motor_General_Error.Test "Fault manager configuration.  Select up to 4 actions for each fault." VALUE 0x80000DB5 RecordLayout_7 0 CompuMethod_482 0 65535 /end CHARACTERISTIC
/begin CHARACTERISTIC FaultManager.Electric_Motor_General_Error.Faulty_Samples__X_ "Fault manager configuration.  Select up to 4 actions for each fault." VALUE 0x80000DB7 RecordLayout_7 0 CompuMethod_1 0 65535 /end CHARACTERISTIC
/begin CHARACTERISTIC FaultManager.Electric_Motor_General_Error.Total_Samples__Y_ "Fault manager configuration.  Select up to 4 actions for each fault." VALUE 0x80000DB9 RecordLayout_7 0 CompuMethod_1 0 65535 /end CHARACTERISTIC
/begin CHARACTERISTIC FaultManager.Electric_Motor_General_Error.Action_1 "Fault manager configuration.  Select up to 4 actions for each fault." VALUE 0x80000DBB RecordLayout_7 0 CompuMethod_483 0 65535 /end CHARACTERISTIC
/begin CHARACTERISTIC FaultManager.Electric_Motor_General_Error.Action_1_Condition "Fault manager configuration.  Select up to 4 actions for each fault." VALUE 0x80000DBD RecordLayout_7 0 CompuMethod_484 0 65535 /end CHARACTERISTIC
/begin CHARACTERISTIC FaultManager.Electric_Motor_General_Error.Action_2 "Fault manager configuration.  Select up to 4 actions for each fault." VALUE 0x80000DBF RecordLayout_7 0 CompuMethod_483 0 65535 /end CHARACTERISTIC
/begin CHARACTERISTIC FaultManager.Electric_Motor_General_Error.Action_2_Condition "Fault manager configuration.  Select up to 4 actions for each fault." VALUE 0x80000DC1 RecordLayout_7 0 CompuMethod_484 0 65535 /end CHARACTERISTIC
/begin CHARACTERISTIC FaultManager.Electric_Motor_General_Error.Action_3 "Fault manager configuration.  Select up to 4 actions for each fault." VALUE 0x80000DC3 RecordLayout_7 0 CompuMethod_483 0 65535 /end CHARACTERISTIC
/begin CHARACTERISTIC FaultManager.Electric_Motor_General_Error.Action_3_Condition "Fault manager configuration.  Select up to 4 actions for each fault." VALUE 0x80000DC5 RecordLayout_7 0 CompuMethod_484 0 65535 /end CHARACTERISTIC
/begin CHARACTERISTIC FaultManager.Electric_Motor_General_Error.Action_4 "Fault manager configuration.  Select up to 4 actions for each fault." VALUE 0x80000DC7 RecordLayout_7 0 CompuMethod_483 0 65535 /end CHARACTERISTIC
/begin CHARACTERISTIC FaultManager.Electric_Motor_General_Error.Action_4_Condition "Fault manager configuration.  Select up to 4 actions for each fault." VALUE 0x80000DC9 RecordLayout_7 0 CompuMethod_484 0 65535 /end CHARACTERISTIC
/begin CHARACTERISTIC FaultManager.Electric_Motor_Over_Speed_Forward.Mode "Fault manager configuration.  Select up to 4 actions for each fault." VALUE 0x80000DCB RecordLayout_7 0 CompuMethod_481 0 65535 /end CHARACTERISTIC
/begin CHARACTERISTIC FaultManager.Electric_Motor_Over_Speed_Forward.ID "Fault manager configuration.  Select up to 4 actions for each fault." VALUE 0x80000DCD RecordLayout_7 0 CompuMethod_1 0 65535 /end CHARACTERISTIC
/begin CHARACTERISTIC FaultManager.Electric_Motor_Over_Speed_Forward.Test "Fault manager configuration.  Select up to 4 actions for each fault." VALUE 0x80000DCF RecordLayout_7 0 CompuMethod_482 0 65535 /end CHARACTERISTIC
/begin CHARACTERISTIC FaultManager.Electric_Motor_Over_Speed_Forward.Faulty_Samples__X_ "Fault manager configuration.  Select up to 4 actions for each fault." VALUE 0x80000DD1 RecordLayout_7 0 CompuMethod_1 0 65535 /end CHARACTERISTIC
/begin CHARACTERISTIC FaultManager.Electric_Motor_Over_Speed_Forward.Total_Samples__Y_ "Fault manager configuration.  Select up to 4 actions for each fault." VALUE 0x80000DD3 RecordLayout_7 0 CompuMethod_1 0 65535 /end CHARACTERISTIC
/begin CHARACTERISTIC FaultManager.Electric_Motor_Over_Speed_Forward.Action_1 "Fault manager configuration.  Select up to 4 actions for each fault." VALUE 0x80000DD5 RecordLayout_7 0 CompuMethod_483 0 65535 /end CHARACTERISTIC
/begin CHARACTERISTIC FaultManager.Electric_Motor_Over_Speed_Forward.Action_1_Condition "Fault manager configuration.  Select up to 4 actions for each fault." VALUE 0x80000DD7 RecordLayout_7 0 CompuMethod_484 0 65535 /end CHARACTERISTIC
/begin CHARACTERISTIC FaultManager.Electric_Motor_Over_Speed_Forward.Action_2 "Fault manager configuration.  Select up to 4 actions for each fault." VALUE 0x80000DD9 RecordLayout_7 0 CompuMethod_483 0 65535 /end CHARACTERISTIC
/begin CHARACTERISTIC FaultManager.Electric_Motor_Over_Speed_Forward.Action_2_Condition "Fault manager configuration.  Select up to 4 actions for each fault." VALUE 0x80000DDB RecordLayout_7 0 CompuMethod_484 0 65535 /end CHARACTERISTIC
/begin CHARACTERISTIC FaultManager.Electric_Motor_Over_Speed_Forward.Action_3 "Fault manager configuration.  Select up to 4 actions for each fault." VALUE 0x80000DDD RecordLayout_7 0 CompuMethod_483 0 65535 /end CHARACTERISTIC
/begin CHARACTERISTIC FaultManager.Electric_Motor_Over_Speed_Forward.Action_3_Condition "Fault manager configuration.  Select up to 4 actions for each fault." VALUE 0x80000DDF RecordLayout_7 0 CompuMethod_484 0 65535 /end CHARACTERISTIC
/begin CHARACTERISTIC FaultManager.Electric_Motor_Over_Speed_Forward.Action_4 "Fault manager configuration.  Select up to 4 actions for each fault." VALUE 0x80000DE1 RecordLayout_7 0 CompuMethod_483 0 65535 /end CHARACTERISTIC
/begin CHARACTERISTIC FaultManager.Electric_Motor_Over_Speed_Forward.Action_4_Condition "Fault manager configuration.  Select up to 4 actions for each fault." VALUE 0x80000DE3 RecordLayout_7 0 CompuMethod_484 0 65535 /end CHARACTERISTIC
/begin CHARACTERISTIC FaultManager.Electric_Motor_Over_Speed_Reverse.Mode "Fault manager configuration.  Select up to 4 actions for each fault." VALUE 0x80000DE5 RecordLayout_7 0 CompuMethod_481 0 65535 /end CHARACTERISTIC
/begin CHARACTERISTIC FaultManager.Electric_Motor_Over_Speed_Reverse.ID "Fault manager configuration.  Select up to 4 actions for each fault." VALUE 0x80000DE7 RecordLayout_7 0 CompuMethod_1 0 65535 /end CHARACTERISTIC
/begin CHARACTERISTIC FaultManager.Electric_Motor_Over_Speed_Reverse.Test "Fault manager configuration.  Select up to 4 actions for each fault." VALUE 0x80000DE9 RecordLayout_7 0 CompuMethod_482 0 65535 /end CHARACTERISTIC
/begin CHARACTERISTIC FaultManager.Electric_Motor_Over_Speed_Reverse.Faulty_Samples__X_ "Fault manager configuration.  Select up to 4 actions for each fault." VALUE 0x80000DEB RecordLayout_7 0 CompuMethod_1 0 65535 /end CHARACTERISTIC
/begin CHARACTERISTIC FaultManager.Electric_Motor_Over_Speed_Reverse.Total_Samples__Y_ "Fault manager configuration.  Select up to 4 actions for each fault." VALUE 0x80000DED RecordLayout_7 0 CompuMethod_1 0 65535 /end CHARACTERISTIC
/begin CHARACTERISTIC FaultManager.Electric_Motor_Over_Speed_Reverse.Action_1 "Fault manager configuration.  Select up to 4 actions for each fault." VALUE 0x80000DEF RecordLayout_7 0 CompuMethod_483 0 65535 /end CHARACTERISTIC
/begin CHARACTERISTIC FaultManager.Electric_Motor_Over_Speed_Reverse.Action_1_Condition "Fault manager configuration.  Select up to 4 actions for each fault." VALUE 0x80000DF1 RecordLayout_7 0 CompuMethod_484 0 65535 /end CHARACTERISTIC
/begin CHARACTERISTIC FaultManager.Electric_Motor_Over_Speed_Reverse.Action_2 "Fault manager configuration.  Select up to 4 actions for each fault." VALUE 0x80000DF3 RecordLayout_7 0 CompuMethod_483 0 65535 /end CHARACTERISTIC
/begin CHARACTERISTIC FaultManager.Electric_Motor_Over_Speed_Reverse.Action_2_Condition "Fault manager configuration.  Select up to 4 actions for each fault." VALUE 0x80000DF5 RecordLayout_7 0 CompuMethod_484 0 65535 /end CHARACTERISTIC
/begin CHARACTERISTIC FaultManager.Electric_Motor_Over_Speed_Reverse.Action_3 "Fault manager configuration.  Select up to 4 actions for each fault." VALUE 0x80000DF7 RecordLayout_7 0 CompuMethod_483 0 65535 /end CHARACTERISTIC
/begin CHARACTERISTIC FaultManager.Electric_Motor_Over_Speed_Reverse.Action_3_Condition "Fault manager configuration.  Select up to 4 actions for each fault." VALUE 0x80000DF9 RecordLayout_7 0 CompuMethod_484 0 65535 /end CHARACTERISTIC
/begin CHARACTERISTIC FaultManager.Electric_Motor_Over_Speed_Reverse.Action_4 "Fault manager configuration.  Select up to 4 actions for each fault." VALUE 0x80000DFB RecordLayout_7 0 CompuMethod_483 0 65535 /end CHARACTERISTIC
/begin CHARACTERISTIC FaultManager.Electric_Motor_Over_Speed_Reverse.Action_4_Condition "Fault manager configuration.  Select up to 4 actions for each fault." VALUE 0x80000DFD RecordLayout_7 0 CompuMethod_484 0 65535 /end CHARACTERISTIC
/begin CHARACTERISTIC FaultManager.Electric_Motor_Shutodwn_Error.Mode "Fault manager configuration.  Select up to 4 actions for each fault." VALUE 0x80000DFF RecordLayout_7 0 CompuMethod_481 0 65535 /end CHARACTERISTIC
/begin CHARACTERISTIC FaultManager.Electric_Motor_Shutodwn_Error.ID "Fault manager configuration.  Select up to 4 actions for each fault." VALUE 0x80000E01 RecordLayout_7 0 CompuMethod_1 0 65535 /end CHARACTERISTIC
/begin CHARACTERISTIC FaultManager.Electric_Motor_Shutodwn_Error.Test "Fault manager configuration.  Select up to 4 actions for each fault." VALUE 0x80000E03 RecordLayout_7 0 CompuMethod_482 0 65535 /end CHARACTERISTIC
/begin CHARACTERISTIC FaultManager.Electric_Motor_Shutodwn_Error.Faulty_Samples__X_ "Fault manager configuration.  Select up to 4 actions for each fault." VALUE 0x80000E05 RecordLayout_7 0 CompuMethod_1 0 65535 /end CHARACTERISTIC
/begin CHARACTERISTIC FaultManager.Electric_Motor_Shutodwn_Error.Total_Samples__Y_ "Fault manager configuration.  Select up to 4 actions for each fault." VALUE 0x80000E07 RecordLayout_7 0 CompuMethod_1 0 65535 /end CHARACTERISTIC
/begin CHARACTERISTIC FaultManager.Electric_Motor_Shutodwn_Error.Action_1 "Fault manager configuration.  Select up to 4 actions for each fault." VALUE 0x80000E09 RecordLayout_7 0 CompuMethod_483 0 65535 /end CHARACTERISTIC
/begin CHARACTERISTIC FaultManager.Electric_Motor_Shutodwn_Error.Action_1_Condition "Fault manager configuration.  Select up to 4 actions for each fault." VALUE 0x80000E0B RecordLayout_7 0 CompuMethod_484 0 65535 /end CHARACTERISTIC
/begin CHARACTERISTIC FaultManager.Electric_Motor_Shutodwn_Error.Action_2 "Fault manager configuration.  Select up to 4 actions for each fault." VALUE 0x80000E0D RecordLayout_7 0 CompuMethod_483 0 65535 /end CHARACTERISTIC
/begin CHARACTERISTIC FaultManager.Electric_Motor_Shutodwn_Error.Action_2_Condition "Fault manager configuration.  Select up to 4 actions for each fault." VALUE 0x80000E0F RecordLayout_7 0 CompuMethod_484 0 65535 /end CHARACTERISTIC
/begin CHARACTERISTIC FaultManager.Electric_Motor_Shutodwn_Error.Action_3 "Fault manager configuration.  Select up to 4 actions for each fault." VALUE 0x80000E11 RecordLayout_7 0 CompuMethod_483 0 65535 /end CHARACTERISTIC
/begin CHARACTERISTIC FaultManager.Electric_Motor_Shutodwn_Error.Action_3_Condition "Fault manager configuration.  Select up to 4 actions for each fault." VALUE 0x80000E13 RecordLayout_7 0 CompuMethod_484 0 65535 /end CHARACTERISTIC
/begin CHARACTERISTIC FaultManager.Electric_Motor_Shutodwn_Error.Action_4 "Fault manager configuration.  Select up to 4 actions for each fault." VALUE 0x80000E15 RecordLayout_7 0 CompuMethod_483 0 65535 /end CHARACTERISTIC
/begin CHARACTERISTIC FaultManager.Electric_Motor_Shutodwn_Error.Action_4_Condition "Fault manager configuration.  Select up to 4 actions for each fault." VALUE 0x80000E17 RecordLayout_7 0 CompuMethod_484 0 65535 /end CHARACTERISTIC
/begin CHARACTERISTIC FaultManager.Electric_Motor_Torque_Output_Fault.Mode "Fault manager configuration.  Select up to 4 actions for each fault." VALUE 0x80000E19 RecordLayout_7 0 CompuMethod_481 0 65535 /end CHARACTERISTIC
/begin CHARACTERISTIC FaultManager.Electric_Motor_Torque_Output_Fault.ID "Fault manager configuration.  Select up to 4 actions for each fault." VALUE 0x80000E1B RecordLayout_7 0 CompuMethod_1 0 65535 /end CHARACTERISTIC
/begin CHARACTERISTIC FaultManager.Electric_Motor_Torque_Output_Fault.Test "Fault manager configuration.  Select up to 4 actions for each fault." VALUE 0x80000E1D RecordLayout_7 0 CompuMethod_482 0 65535 /end CHARACTERISTIC
/begin CHARACTERISTIC FaultManager.Electric_Motor_Torque_Output_Fault.Faulty_Samples__X_ "Fault manager configuration.  Select up to 4 actions for each fault." VALUE 0x80000E1F RecordLayout_7 0 CompuMethod_1 0 65535 /end CHARACTERISTIC
/begin CHARACTERISTIC FaultManager.Electric_Motor_Torque_Output_Fault.Total_Samples__Y_ "Fault manager configuration.  Select up to 4 actions for each fault." VALUE 0x80000E21 RecordLayout_7 0 CompuMethod_1 0 65535 /end CHARACTERISTIC
/begin CHARACTERISTIC FaultManager.Electric_Motor_Torque_Output_Fault.Action_1 "Fault manager configuration.  Select up to 4 actions for each fault." VALUE 0x80000E23 RecordLayout_7 0 CompuMethod_483 0 65535 /end CHARACTERISTIC
/begin CHARACTERISTIC FaultManager.Electric_Motor_Torque_Output_Fault.Action_1_Condition "Fault manager configuration.  Select up to 4 actions for each fault." VALUE 0x80000E25 RecordLayout_7 0 CompuMethod_484 0 65535 /end CHARACTERISTIC
/begin CHARACTERISTIC FaultManager.Electric_Motor_Torque_Output_Fault.Action_2 "Fault manager configuration.  Select up to 4 actions for each fault." VALUE 0x80000E27 RecordLayout_7 0 CompuMethod_483 0 65535 /end CHARACTERISTIC
/begin CHARACTERISTIC FaultManager.Electric_Motor_Torque_Output_Fault.Action_2_Condition "Fault manager configuration.  Select up to 4 actions for each fault." VALUE 0x80000E29 RecordLayout_7 0 CompuMethod_484 0 65535 /end CHARACTERISTIC
/begin CHARACTERISTIC FaultManager.Electric_Motor_Torque_Output_Fault.Action_3 "Fault manager configuration.  Select up to 4 actions for each fault." VALUE 0x80000E2B RecordLayout_7 0 CompuMethod_483 0 65535 /end CHARACTERISTIC
/begin CHARACTERISTIC FaultManager.Electric_Motor_Torque_Output_Fault.Action_3_Condition "Fault manager configuration.  Select up to 4 actions for each fault." VALUE 0x80000E2D RecordLayout_7 0 CompuMethod_484 0 65535 /end CHARACTERISTIC
/begin CHARACTERISTIC FaultManager.Electric_Motor_Torque_Output_Fault.Action_4 "Fault manager configuration.  Select up to 4 actions for each fault." VALUE 0x80000E2F RecordLayout_7 0 CompuMethod_483 0 65535 /end CHARACTERISTIC
/begin CHARACTERISTIC FaultManager.Electric_Motor_Torque_Output_Fault.Action_4_Condition "Fault manager configuration.  Select up to 4 actions for each fault." VALUE 0x80000E31 RecordLayout_7 0 CompuMethod_484 0 65535 /end CHARACTERISTIC
/begin CHARACTERISTIC FaultManager.Gear_Shift_Communication_Circuit.Mode "Fault manager configuration.  Select up to 4 actions for each fault." VALUE 0x80000E33 RecordLayout_7 0 CompuMethod_481 0 65535 /end CHARACTERISTIC
/begin CHARACTERISTIC FaultManager.Gear_Shift_Communication_Circuit.ID "Fault manager configuration.  Select up to 4 actions for each fault." VALUE 0x80000E35 RecordLayout_7 0 CompuMethod_1 0 65535 /end CHARACTERISTIC
/begin CHARACTERISTIC FaultManager.Gear_Shift_Communication_Circuit.Test "Fault manager configuration.  Select up to 4 actions for each fault." VALUE 0x80000E37 RecordLayout_7 0 CompuMethod_482 0 65535 /end CHARACTERISTIC
/begin CHARACTERISTIC FaultManager.Gear_Shift_Communication_Circuit.Faulty_Samples__X_ "Fault manager configuration.  Select up to 4 actions for each fault." VALUE 0x80000E39 RecordLayout_7 0 CompuMethod_1 0 65535 /end CHARACTERISTIC
/begin CHARACTERISTIC FaultManager.Gear_Shift_Communication_Circuit.Total_Samples__Y_ "Fault manager configuration.  Select up to 4 actions for each fault." VALUE 0x80000E3B RecordLayout_7 0 CompuMethod_1 0 65535 /end CHARACTERISTIC
/begin CHARACTERISTIC FaultManager.Gear_Shift_Communication_Circuit.Action_1 "Fault manager configuration.  Select up to 4 actions for each fault." VALUE 0x80000E3D RecordLayout_7 0 CompuMethod_483 0 65535 /end CHARACTERISTIC
/begin CHARACTERISTIC FaultManager.Gear_Shift_Communication_Circuit.Action_1_Condition "Fault manager configuration.  Select up to 4 actions for each fault." VALUE 0x80000E3F RecordLayout_7 0 CompuMethod_484 0 65535 /end CHARACTERISTIC
/begin CHARACTERISTIC FaultManager.Gear_Shift_Communication_Circuit.Action_2 "Fault manager configuration.  Select up to 4 actions for each fault." VALUE 0x80000E41 RecordLayout_7 0 CompuMethod_483 0 65535 /end CHARACTERISTIC
/begin CHARACTERISTIC FaultManager.Gear_Shift_Communication_Circuit.Action_2_Condition "Fault manager configuration.  Select up to 4 actions for each fault." VALUE 0x80000E43 RecordLayout_7 0 CompuMethod_484 0 65535 /end CHARACTERISTIC
/begin CHARACTERISTIC FaultManager.Gear_Shift_Communication_Circuit.Action_3 "Fault manager configuration.  Select up to 4 actions for each fault." VALUE 0x80000E45 RecordLayout_7 0 CompuMethod_483 0 65535 /end CHARACTERISTIC
/begin CHARACTERISTIC FaultManager.Gear_Shift_Communication_Circuit.Action_3_Condition "Fault manager configuration.  Select up to 4 actions for each fault." VALUE 0x80000E47 RecordLayout_7 0 CompuMethod_484 0 65535 /end CHARACTERISTIC
/begin CHARACTERISTIC FaultManager.Gear_Shift_Communication_Circuit.Action_4 "Fault manager configuration.  Select up to 4 actions for each fault." VALUE 0x80000E49 RecordLayout_7 0 CompuMethod_483 0 65535 /end CHARACTERISTIC
/begin CHARACTERISTIC FaultManager.Gear_Shift_Communication_Circuit.Action_4_Condition "Fault manager configuration.  Select up to 4 actions for each fault." VALUE 0x80000E4B RecordLayout_7 0 CompuMethod_484 0 65535 /end CHARACTERISTIC
/begin CHARACTERISTIC FaultManager.HV_Battery_2G_BMS_Fault.Mode "Fault manager configuration.  Select up to 4 actions for each fault." VALUE 0x80000E4D RecordLayout_7 0 CompuMethod_481 0 65535 /end CHARACTERISTIC
/begin CHARACTERISTIC FaultManager.HV_Battery_2G_BMS_Fault.ID "Fault manager configuration.  Select up to 4 actions for each fault." VALUE 0x80000E4F RecordLayout_7 0 CompuMethod_1 0 65535 /end CHARACTERISTIC
/begin CHARACTERISTIC FaultManager.HV_Battery_2G_BMS_Fault.Test "Fault manager configuration.  Select up to 4 actions for each fault." VALUE 0x80000E51 RecordLayout_7 0 CompuMethod_482 0 65535 /end CHARACTERISTIC
/begin CHARACTERISTIC FaultManager.HV_Battery_2G_BMS_Fault.Faulty_Samples__X_ "Fault manager configuration.  Select up to 4 actions for each fault." VALUE 0x80000E53 RecordLayout_7 0 CompuMethod_1 0 65535 /end CHARACTERISTIC
/begin CHARACTERISTIC FaultManager.HV_Battery_2G_BMS_Fault.Total_Samples__Y_ "Fault manager configuration.  Select up to 4 actions for each fault." VALUE 0x80000E55 RecordLayout_7 0 CompuMethod_1 0 65535 /end CHARACTERISTIC
/begin CHARACTERISTIC FaultManager.HV_Battery_2G_BMS_Fault.Action_1 "Fault manager configuration.  Select up to 4 actions for each fault." VALUE 0x80000E57 RecordLayout_7 0 CompuMethod_483 0 65535 /end CHARACTERISTIC
/begin CHARACTERISTIC FaultManager.HV_Battery_2G_BMS_Fault.Action_1_Condition "Fault manager configuration.  Select up to 4 actions for each fault." VALUE 0x80000E59 RecordLayout_7 0 CompuMethod_484 0 65535 /end CHARACTERISTIC
/begin CHARACTERISTIC FaultManager.HV_Battery_2G_BMS_Fault.Action_2 "Fault manager configuration.  Select up to 4 actions for each fault." VALUE 0x80000E5B RecordLayout_7 0 CompuMethod_483 0 65535 /end CHARACTERISTIC
/begin CHARACTERISTIC FaultManager.HV_Battery_2G_BMS_Fault.Action_2_Condition "Fault manager configuration.  Select up to 4 actions for each fault." VALUE 0x80000E5D RecordLayout_7 0 CompuMethod_484 0 65535 /end CHARACTERISTIC
/begin CHARACTERISTIC FaultManager.HV_Battery_2G_BMS_Fault.Action_3 "Fault manager configuration.  Select up to 4 actions for each fault." VALUE 0x80000E5F RecordLayout_7 0 CompuMethod_483 0 65535 /end CHARACTERISTIC
/begin CHARACTERISTIC FaultManager.HV_Battery_2G_BMS_Fault.Action_3_Condition "Fault manager configuration.  Select up to 4 actions for each fault." VALUE 0x80000E61 RecordLayout_7 0 CompuMethod_484 0 65535 /end CHARACTERISTIC
/begin CHARACTERISTIC FaultManager.HV_Battery_2G_BMS_Fault.Action_4 "Fault manager configuration.  Select up to 4 actions for each fault." VALUE 0x80000E63 RecordLayout_7 0 CompuMethod_483 0 65535 /end CHARACTERISTIC
/begin CHARACTERISTIC FaultManager.HV_Battery_2G_BMS_Fault.Action_4_Condition "Fault manager configuration.  Select up to 4 actions for each fault." VALUE 0x80000E65 RecordLayout_7 0 CompuMethod_484 0 65535 /end CHARACTERISTIC
/begin CHARACTERISTIC FaultManager.HV_Battery_48_Controller_Communication_Fault.Mode "Fault manager configuration.  Select up to 4 actions for each fault." VALUE 0x80000E67 RecordLayout_7 0 CompuMethod_481 0 65535 /end CHARACTERISTIC
/begin CHARACTERISTIC FaultManager.HV_Battery_48_Controller_Communication_Fault.ID "Fault manager configuration.  Select up to 4 actions for each fault." VALUE 0x80000E69 RecordLayout_7 0 CompuMethod_1 0 65535 /end CHARACTERISTIC
/begin CHARACTERISTIC FaultManager.HV_Battery_48_Controller_Communication_Fault.Test "Fault manager configuration.  Select up to 4 actions for each fault." VALUE 0x80000E6B RecordLayout_7 0 CompuMethod_482 0 65535 /end CHARACTERISTIC
/begin CHARACTERISTIC FaultManager.HV_Battery_48_Controller_Communication_Fault.Faulty_Samples__X_ "Fault manager configuration.  Select up to 4 actions for each fault." VALUE 0x80000E6D RecordLayout_7 0 CompuMethod_1 0 65535 /end CHARACTERISTIC
/begin CHARACTERISTIC FaultManager.HV_Battery_48_Controller_Communication_Fault.Total_Samples__Y_ "Fault manager configuration.  Select up to 4 actions for each fault." VALUE 0x80000E6F RecordLayout_7 0 CompuMethod_1 0 65535 /end CHARACTERISTIC
/begin CHARACTERISTIC FaultManager.HV_Battery_48_Controller_Communication_Fault.Action_1 "Fault manager configuration.  Select up to 4 actions for each fault." VALUE 0x80000E71 RecordLayout_7 0 CompuMethod_483 0 65535 /end CHARACTERISTIC
/begin CHARACTERISTIC FaultManager.HV_Battery_48_Controller_Communication_Fault.Action_1_Condition "Fault manager configuration.  Select up to 4 actions for each fault." VALUE 0x80000E73 RecordLayout_7 0 CompuMethod_484 0 65535 /end CHARACTERISTIC
/begin CHARACTERISTIC FaultManager.HV_Battery_48_Controller_Communication_Fault.Action_2 "Fault manager configuration.  Select up to 4 actions for each fault." VALUE 0x80000E75 RecordLayout_7 0 CompuMethod_483 0 65535 /end CHARACTERISTIC
/begin CHARACTERISTIC FaultManager.HV_Battery_48_Controller_Communication_Fault.Action_2_Condition "Fault manager configuration.  Select up to 4 actions for each fault." VALUE 0x80000E77 RecordLayout_7 0 CompuMethod_484 0 65535 /end CHARACTERISTIC
/begin CHARACTERISTIC FaultManager.HV_Battery_48_Controller_Communication_Fault.Action_3 "Fault manager configuration.  Select up to 4 actions for each fault." VALUE 0x80000E79 RecordLayout_7 0 CompuMethod_483 0 65535 /end CHARACTERISTIC
/begin CHARACTERISTIC FaultManager.HV_Battery_48_Controller_Communication_Fault.Action_3_Condition "Fault manager configuration.  Select up to 4 actions for each fault." VALUE 0x80000E7B RecordLayout_7 0 CompuMethod_484 0 65535 /end CHARACTERISTIC
/begin CHARACTERISTIC FaultManager.HV_Battery_48_Controller_Communication_Fault.Action_4 "Fault manager configuration.  Select up to 4 actions for each fault." VALUE 0x80000E7D RecordLayout_7 0 CompuMethod_483 0 65535 /end CHARACTERISTIC
/begin CHARACTERISTIC FaultManager.HV_Battery_48_Controller_Communication_Fault.Action_4_Condition "Fault manager configuration.  Select up to 4 actions for each fault." VALUE 0x80000E7F RecordLayout_7 0 CompuMethod_484 0 65535 /end CHARACTERISTIC
/begin CHARACTERISTIC FaultManager.HV_Battery_Above_Safe_Charge_Point.Mode "Fault manager configuration.  Select up to 4 actions for each fault." VALUE 0x80000E81 RecordLayout_7 0 CompuMethod_481 0 65535 /end CHARACTERISTIC
/begin CHARACTERISTIC FaultManager.HV_Battery_Above_Safe_Charge_Point.ID "Fault manager configuration.  Select up to 4 actions for each fault." VALUE 0x80000E83 RecordLayout_7 0 CompuMethod_1 0 65535 /end CHARACTERISTIC
/begin CHARACTERISTIC FaultManager.HV_Battery_Above_Safe_Charge_Point.Test "Fault manager configuration.  Select up to 4 actions for each fault." VALUE 0x80000E85 RecordLayout_7 0 CompuMethod_482 0 65535 /end CHARACTERISTIC
/begin CHARACTERISTIC FaultManager.HV_Battery_Above_Safe_Charge_Point.Faulty_Samples__X_ "Fault manager configuration.  Select up to 4 actions for each fault." VALUE 0x80000E87 RecordLayout_7 0 CompuMethod_1 0 65535 /end CHARACTERISTIC
/begin CHARACTERISTIC FaultManager.HV_Battery_Above_Safe_Charge_Point.Total_Samples__Y_ "Fault manager configuration.  Select up to 4 actions for each fault." VALUE 0x80000E89 RecordLayout_7 0 CompuMethod_1 0 65535 /end CHARACTERISTIC
/begin CHARACTERISTIC FaultManager.HV_Battery_Above_Safe_Charge_Point.Action_1 "Fault manager configuration.  Select up to 4 actions for each fault." VALUE 0x80000E8B RecordLayout_7 0 CompuMethod_483 0 65535 /end CHARACTERISTIC
/begin CHARACTERISTIC FaultManager.HV_Battery_Above_Safe_Charge_Point.Action_1_Condition "Fault manager configuration.  Select up to 4 actions for each fault." VALUE 0x80000E8D RecordLayout_7 0 CompuMethod_484 0 65535 /end CHARACTERISTIC
/begin CHARACTERISTIC FaultManager.HV_Battery_Above_Safe_Charge_Point.Action_2 "Fault manager configuration.  Select up to 4 actions for each fault." VALUE 0x80000E8F RecordLayout_7 0 CompuMethod_483 0 65535 /end CHARACTERISTIC
/begin CHARACTERISTIC FaultManager.HV_Battery_Above_Safe_Charge_Point.Action_2_Condition "Fault manager configuration.  Select up to 4 actions for each fault." VALUE 0x80000E91 RecordLayout_7 0 CompuMethod_484 0 65535 /end CHARACTERISTIC
/begin CHARACTERISTIC FaultManager.HV_Battery_Above_Safe_Charge_Point.Action_3 "Fault manager configuration.  Select up to 4 actions for each fault." VALUE 0x80000E93 RecordLayout_7 0 CompuMethod_483 0 65535 /end CHARACTERISTIC
/begin CHARACTERISTIC FaultManager.HV_Battery_Above_Safe_Charge_Point.Action_3_Condition "Fault manager configuration.  Select up to 4 actions for each fault." VALUE 0x80000E95 RecordLayout_7 0 CompuMethod_484 0 65535 /end CHARACTERISTIC
/begin CHARACTERISTIC FaultManager.HV_Battery_Above_Safe_Charge_Point.Action_4 "Fault manager configuration.  Select up to 4 actions for each fault." VALUE 0x80000E97 RecordLayout_7 0 CompuMethod_483 0 65535 /end CHARACTERISTIC
/begin CHARACTERISTIC FaultManager.HV_Battery_Above_Safe_Charge_Point.Action_4_Condition "Fault manager configuration.  Select up to 4 actions for each fault." VALUE 0x80000E99 RecordLayout_7 0 CompuMethod_484 0 65535 /end CHARACTERISTIC
/begin CHARACTERISTIC FaultManager.HV_Battery_Cell_Balancing_Required_Fault.Mode "Fault manager configuration.  Select up to 4 actions for each fault." VALUE 0x80000E9B RecordLayout_7 0 CompuMethod_481 0 65535 /end CHARACTERISTIC
/begin CHARACTERISTIC FaultManager.HV_Battery_Cell_Balancing_Required_Fault.ID "Fault manager configuration.  Select up to 4 actions for each fault." VALUE 0x80000E9D RecordLayout_7 0 CompuMethod_1 0 65535 /end CHARACTERISTIC
/begin CHARACTERISTIC FaultManager.HV_Battery_Cell_Balancing_Required_Fault.Test "Fault manager configuration.  Select up to 4 actions for each fault." VALUE 0x80000E9F RecordLayout_7 0 CompuMethod_482 0 65535 /end CHARACTERISTIC
/begin CHARACTERISTIC FaultManager.HV_Battery_Cell_Balancing_Required_Fault.Faulty_Samples__X_ "Fault manager configuration.  Select up to 4 actions for each fault." VALUE 0x80000EA1 RecordLayout_7 0 CompuMethod_1 0 65535 /end CHARACTERISTIC
/begin CHARACTERISTIC FaultManager.HV_Battery_Cell_Balancing_Required_Fault.Total_Samples__Y_ "Fault manager configuration.  Select up to 4 actions for each fault." VALUE 0x80000EA3 RecordLayout_7 0 CompuMethod_1 0 65535 /end CHARACTERISTIC
/begin CHARACTERISTIC FaultManager.HV_Battery_Cell_Balancing_Required_Fault.Action_1 "Fault manager configuration.  Select up to 4 actions for each fault." VALUE 0x80000EA5 RecordLayout_7 0 CompuMethod_483 0 65535 /end CHARACTERISTIC
/begin CHARACTERISTIC FaultManager.HV_Battery_Cell_Balancing_Required_Fault.Action_1_Condition "Fault manager configuration.  Select up to 4 actions for each fault." VALUE 0x80000EA7 RecordLayout_7 0 CompuMethod_484 0 65535 /end CHARACTERISTIC
/begin CHARACTERISTIC FaultManager.HV_Battery_Cell_Balancing_Required_Fault.Action_2 "Fault manager configuration.  Select up to 4 actions for each fault." VALUE 0x80000EA9 RecordLayout_7 0 CompuMethod_483 0 65535 /end CHARACTERISTIC
/begin CHARACTERISTIC FaultManager.HV_Battery_Cell_Balancing_Required_Fault.Action_2_Condition "Fault manager configuration.  Select up to 4 actions for each fault." VALUE 0x80000EAB RecordLayout_7 0 CompuMethod_484 0 65535 /end CHARACTERISTIC
/begin CHARACTERISTIC FaultManager.HV_Battery_Cell_Balancing_Required_Fault.Action_3 "Fault manager configuration.  Select up to 4 actions for each fault." VALUE 0x80000EAD RecordLayout_7 0 CompuMethod_483 0 65535 /end CHARACTERISTIC
/begin CHARACTERISTIC FaultManager.HV_Battery_Cell_Balancing_Required_Fault.Action_3_Condition "Fault manager configuration.  Select up to 4 actions for each fault." VALUE 0x80000EAF RecordLayout_7 0 CompuMethod_484 0 65535 /end CHARACTERISTIC
/begin CHARACTERISTIC FaultManager.HV_Battery_Cell_Balancing_Required_Fault.Action_4 "Fault manager configuration.  Select up to 4 actions for each fault." VALUE 0x80000EB1 RecordLayout_7 0 CompuMethod_483 0 65535 /end CHARACTERISTIC
/begin CHARACTERISTIC FaultManager.HV_Battery_Cell_Balancing_Required_Fault.Action_4_Condition "Fault manager configuration.  Select up to 4 actions for each fault." VALUE 0x80000EB3 RecordLayout_7 0 CompuMethod_484 0 65535 /end CHARACTERISTIC
/begin CHARACTERISTIC FaultManager.HV_Battery_Pack_Above_Operating_Temperature.Mode "Fault manager configuration.  Select up to 4 actions for each fault." VALUE 0x80000EB5 RecordLayout_7 0 CompuMethod_481 0 65535 /end CHARACTERISTIC
/begin CHARACTERISTIC FaultManager.HV_Battery_Pack_Above_Operating_Temperature.ID "Fault manager configuration.  Select up to 4 actions for each fault." VALUE 0x80000EB7 RecordLayout_7 0 CompuMethod_1 0 65535 /end CHARACTERISTIC
/begin CHARACTERISTIC FaultManager.HV_Battery_Pack_Above_Operating_Temperature.Test "Fault manager configuration.  Select up to 4 actions for each fault." VALUE 0x80000EB9 RecordLayout_7 0 CompuMethod_482 0 65535 /end CHARACTERISTIC
/begin CHARACTERISTIC FaultManager.HV_Battery_Pack_Above_Operating_Temperature.Faulty_Samples__X_ "Fault manager configuration.  Select up to 4 actions for each fault." VALUE 0x80000EBB RecordLayout_7 0 CompuMethod_1 0 65535 /end CHARACTERISTIC
/begin CHARACTERISTIC FaultManager.HV_Battery_Pack_Above_Operating_Temperature.Total_Samples__Y_ "Fault manager configuration.  Select up to 4 actions for each fault." VALUE 0x80000EBD RecordLayout_7 0 CompuMethod_1 0 65535 /end CHARACTERISTIC
/begin CHARACTERISTIC FaultManager.HV_Battery_Pack_Above_Operating_Temperature.Action_1 "Fault manager configuration.  Select up to 4 actions for each fault." VALUE 0x80000EBF RecordLayout_7 0 CompuMethod_483 0 65535 /end CHARACTERISTIC
/begin CHARACTERISTIC FaultManager.HV_Battery_Pack_Above_Operating_Temperature.Action_1_Condition "Fault manager configuration.  Select up to 4 actions for each fault." VALUE 0x80000EC1 RecordLayout_7 0 CompuMethod_484 0 65535 /end CHARACTERISTIC
/begin CHARACTERISTIC FaultManager.HV_Battery_Pack_Above_Operating_Temperature.Action_2 "Fault manager configuration.  Select up to 4 actions for each fault." VALUE 0x80000EC3 RecordLayout_7 0 CompuMethod_483 0 65535 /end CHARACTERISTIC
/begin CHARACTERISTIC FaultManager.HV_Battery_Pack_Above_Operating_Temperature.Action_2_Condition "Fault manager configuration.  Select up to 4 actions for each fault." VALUE 0x80000EC5 RecordLayout_7 0 CompuMethod_484 0 65535 /end CHARACTERISTIC
/begin CHARACTERISTIC FaultManager.HV_Battery_Pack_Above_Operating_Temperature.Action_3 "Fault manager configuration.  Select up to 4 actions for each fault." VALUE 0x80000EC7 RecordLayout_7 0 CompuMethod_483 0 65535 /end CHARACTERISTIC
/begin CHARACTERISTIC FaultManager.HV_Battery_Pack_Above_Operating_Temperature.Action_3_Condition "Fault manager configuration.  Select up to 4 actions for each fault." VALUE 0x80000EC9 RecordLayout_7 0 CompuMethod_484 0 65535 /end CHARACTERISTIC
/begin CHARACTERISTIC FaultManager.HV_Battery_Pack_Above_Operating_Temperature.Action_4 "Fault manager configuration.  Select up to 4 actions for each fault." VALUE 0x80000ECB RecordLayout_7 0 CompuMethod_483 0 65535 /end CHARACTERISTIC
/begin CHARACTERISTIC FaultManager.HV_Battery_Pack_Above_Operating_Temperature.Action_4_Condition "Fault manager configuration.  Select up to 4 actions for each fault." VALUE 0x80000ECD RecordLayout_7 0 CompuMethod_484 0 65535 /end CHARACTERISTIC
/begin CHARACTERISTIC FaultManager.HV_Battery_Pack_Below_Operating_Temperature.Mode "Fault manager configuration.  Select up to 4 actions for each fault." VALUE 0x80000ECF RecordLayout_7 0 CompuMethod_481 0 65535 /end CHARACTERISTIC
/begin CHARACTERISTIC FaultManager.HV_Battery_Pack_Below_Operating_Temperature.ID "Fault manager configuration.  Select up to 4 actions for each fault." VALUE 0x80000ED1 RecordLayout_7 0 CompuMethod_1 0 65535 /end CHARACTERISTIC
/begin CHARACTERISTIC FaultManager.HV_Battery_Pack_Below_Operating_Temperature.Test "Fault manager configuration.  Select up to 4 actions for each fault." VALUE 0x80000ED3 RecordLayout_7 0 CompuMethod_482 0 65535 /end CHARACTERISTIC
/begin CHARACTERISTIC FaultManager.HV_Battery_Pack_Below_Operating_Temperature.Faulty_Samples__X_ "Fault manager configuration.  Select up to 4 actions for each fault." VALUE 0x80000ED5 RecordLayout_7 0 CompuMethod_1 0 65535 /end CHARACTERISTIC
/begin CHARACTERISTIC FaultManager.HV_Battery_Pack_Below_Operating_Temperature.Total_Samples__Y_ "Fault manager configuration.  Select up to 4 actions for each fault." VALUE 0x80000ED7 RecordLayout_7 0 CompuMethod_1 0 65535 /end CHARACTERISTIC
/begin CHARACTERISTIC FaultManager.HV_Battery_Pack_Below_Operating_Temperature.Action_1 "Fault manager configuration.  Select up to 4 actions for each fault." VALUE 0x80000ED9 RecordLayout_7 0 CompuMethod_483 0 65535 /end CHARACTERISTIC
/begin CHARACTERISTIC FaultManager.HV_Battery_Pack_Below_Operating_Temperature.Action_1_Condition "Fault manager configuration.  Select up to 4 actions for each fault." VALUE 0x80000EDB RecordLayout_7 0 CompuMethod_484 0 65535 /end CHARACTERISTIC
/begin CHARACTERISTIC FaultManager.HV_Battery_Pack_Below_Operating_Temperature.Action_2 "Fault manager configuration.  Select up to 4 actions for each fault." VALUE 0x80000EDD RecordLayout_7 0 CompuMethod_483 0 65535 /end CHARACTERISTIC
/begin CHARACTERISTIC FaultManager.HV_Battery_Pack_Below_Operating_Temperature.Action_2_Condition "Fault manager configuration.  Select up to 4 actions for each fault." VALUE 0x80000EDF RecordLayout_7 0 CompuMethod_484 0 65535 /end CHARACTERISTIC
/begin CHARACTERISTIC FaultManager.HV_Battery_Pack_Below_Operating_Temperature.Action_3 "Fault manager configuration.  Select up to 4 actions for each fault." VALUE 0x80000EE1 RecordLayout_7 0 CompuMethod_483 0 65535 /end CHARACTERISTIC
/begin CHARACTERISTIC FaultManager.HV_Battery_Pack_Below_Operating_Temperature.Action_3_Condition "Fault manager configuration.  Select up to 4 actions for each fault." VALUE 0x80000EE3 RecordLayout_7 0 CompuMethod_484 0 65535 /end CHARACTERISTIC
/begin CHARACTERISTIC FaultManager.HV_Battery_Pack_Below_Operating_Temperature.Action_4 "Fault manager configuration.  Select up to 4 actions for each fault." VALUE 0x80000EE5 RecordLayout_7 0 CompuMethod_483 0 65535 /end CHARACTERISTIC
/begin CHARACTERISTIC FaultManager.HV_Battery_Pack_Below_Operating_Temperature.Action_4_Condition "Fault manager configuration.  Select up to 4 actions for each fault." VALUE 0x80000EE7 RecordLayout_7 0 CompuMethod_484 0 65535 /end CHARACTERISTIC
/begin CHARACTERISTIC FaultManager.HV_Battery_Pack_High_Temperature.Mode "Fault manager configuration.  Select up to 4 actions for each fault." VALUE 0x80000EE9 RecordLayout_7 0 CompuMethod_481 0 65535 /end CHARACTERISTIC
/begin CHARACTERISTIC FaultManager.HV_Battery_Pack_High_Temperature.ID "Fault manager configuration.  Select up to 4 actions for each fault." VALUE 0x80000EEB RecordLayout_7 0 CompuMethod_1 0 65535 /end CHARACTERISTIC
/begin CHARACTERISTIC FaultManager.HV_Battery_Pack_High_Temperature.Test "Fault manager configuration.  Select up to 4 actions for each fault." VALUE 0x80000EED RecordLayout_7 0 CompuMethod_482 0 65535 /end CHARACTERISTIC
/begin CHARACTERISTIC FaultManager.HV_Battery_Pack_High_Temperature.Faulty_Samples__X_ "Fault manager configuration.  Select up to 4 actions for each fault." VALUE 0x80000EEF RecordLayout_7 0 CompuMethod_1 0 65535 /end CHARACTERISTIC
/begin CHARACTERISTIC FaultManager.HV_Battery_Pack_High_Temperature.Total_Samples__Y_ "Fault manager configuration.  Select up to 4 actions for each fault." VALUE 0x80000EF1 RecordLayout_7 0 CompuMethod_1 0 65535 /end CHARACTERISTIC
/begin CHARACTERISTIC FaultManager.HV_Battery_Pack_High_Temperature.Action_1 "Fault manager configuration.  Select up to 4 actions for each fault." VALUE 0x80000EF3 RecordLayout_7 0 CompuMethod_483 0 65535 /end CHARACTERISTIC
/begin CHARACTERISTIC FaultManager.HV_Battery_Pack_High_Temperature.Action_1_Condition "Fault manager configuration.  Select up to 4 actions for each fault." VALUE 0x80000EF5 RecordLayout_7 0 CompuMethod_484 0 65535 /end CHARACTERISTIC
/begin CHARACTERISTIC FaultManager.HV_Battery_Pack_High_Temperature.Action_2 "Fault manager configuration.  Select up to 4 actions for each fault." VALUE 0x80000EF7 RecordLayout_7 0 CompuMethod_483 0 65535 /end CHARACTERISTIC
/begin CHARACTERISTIC FaultManager.HV_Battery_Pack_High_Temperature.Action_2_Condition "Fault manager configuration.  Select up to 4 actions for each fault." VALUE 0x80000EF9 RecordLayout_7 0 CompuMethod_484 0 65535 /end CHARACTERISTIC
/begin CHARACTERISTIC FaultManager.HV_Battery_Pack_High_Temperature.Action_3 "Fault manager configuration.  Select up to 4 actions for each fault." VALUE 0x80000EFB RecordLayout_7 0 CompuMethod_483 0 65535 /end CHARACTERISTIC
/begin CHARACTERISTIC FaultManager.HV_Battery_Pack_High_Temperature.Action_3_Condition "Fault manager configuration.  Select up to 4 actions for each fault." VALUE 0x80000EFD RecordLayout_7 0 CompuMethod_484 0 65535 /end CHARACTERISTIC
/begin CHARACTERISTIC FaultManager.HV_Battery_Pack_High_Temperature.Action_4 "Fault manager configuration.  Select up to 4 actions for each fault." VALUE 0x80000EFF RecordLayout_7 0 CompuMethod_483 0 65535 /end CHARACTERISTIC
/begin CHARACTERISTIC FaultManager.HV_Battery_Pack_High_Temperature.Action_4_Condition "Fault manager configuration.  Select up to 4 actions for each fault." VALUE 0x80000F01 RecordLayout_7 0 CompuMethod_484 0 65535 /end CHARACTERISTIC
/begin CHARACTERISTIC FaultManager.HV_Battery_Pack_Low_Temperature.Mode "Fault manager configuration.  Select up to 4 actions for each fault." VALUE 0x80000F03 RecordLayout_7 0 CompuMethod_481 0 65535 /end CHARACTERISTIC
/begin CHARACTERISTIC FaultManager.HV_Battery_Pack_Low_Temperature.ID "Fault manager configuration.  Select up to 4 actions for each fault." VALUE 0x80000F05 RecordLayout_7 0 CompuMethod_1 0 65535 /end CHARACTERISTIC
/begin CHARACTERISTIC FaultManager.HV_Battery_Pack_Low_Temperature.Test "Fault manager configuration.  Select up to 4 actions for each fault." VALUE 0x80000F07 RecordLayout_7 0 CompuMethod_482 0 65535 /end CHARACTERISTIC
/begin CHARACTERISTIC FaultManager.HV_Battery_Pack_Low_Temperature.Faulty_Samples__X_ "Fault manager configuration.  Select up to 4 actions for each fault." VALUE 0x80000F09 RecordLayout_7 0 CompuMethod_1 0 65535 /end CHARACTERISTIC
/begin CHARACTERISTIC FaultManager.HV_Battery_Pack_Low_Temperature.Total_Samples__Y_ "Fault manager configuration.  Select up to 4 actions for each fault." VALUE 0x80000F0B RecordLayout_7 0 CompuMethod_1 0 65535 /end CHARACTERISTIC
/begin CHARACTERISTIC FaultManager.HV_Battery_Pack_Low_Temperature.Action_1 "Fault manager configuration.  Select up to 4 actions for each fault." VALUE 0x80000F0D RecordLayout_7 0 CompuMethod_483 0 65535 /end CHARACTERISTIC
/begin CHARACTERISTIC FaultManager.HV_Battery_Pack_Low_Temperature.Action_1_Condition "Fault manager configuration.  Select up to 4 actions for each fault." VALUE 0x80000F0F RecordLayout_7 0 CompuMethod_484 0 65535 /end CHARACTERISTIC
/begin CHARACTERISTIC FaultManager.HV_Battery_Pack_Low_Temperature.Action_2 "Fault manager configuration.  Select up to 4 actions for each fault." VALUE 0x80000F11 RecordLayout_7 0 CompuMethod_483 0 65535 /end CHARACTERISTIC
/begin CHARACTERISTIC FaultManager.HV_Battery_Pack_Low_Temperature.Action_2_Condition "Fault manager configuration.  Select up to 4 actions for each fault." VALUE 0x80000F13 RecordLayout_7 0 CompuMethod_484 0 65535 /end CHARACTERISTIC
/begin CHARACTERISTIC FaultManager.HV_Battery_Pack_Low_Temperature.Action_3 "Fault manager configuration.  Select up to 4 actions for each fault." VALUE 0x80000F15 RecordLayout_7 0 CompuMethod_483 0 65535 /end CHARACTERISTIC
/begin CHARACTERISTIC FaultManager.HV_Battery_Pack_Low_Temperature.Action_3_Condition "Fault manager configuration.  Select up to 4 actions for each fault." VALUE 0x80000F17 RecordLayout_7 0 CompuMethod_484 0 65535 /end CHARACTERISTIC
/begin CHARACTERISTIC FaultManager.HV_Battery_Pack_Low_Temperature.Action_4 "Fault manager configuration.  Select up to 4 actions for each fault." VALUE 0x80000F19 RecordLayout_7 0 CompuMethod_483 0 65535 /end CHARACTERISTIC
/begin CHARACTERISTIC FaultManager.HV_Battery_Pack_Low_Temperature.Action_4_Condition "Fault manager configuration.  Select up to 4 actions for each fault." VALUE 0x80000F1B RecordLayout_7 0 CompuMethod_484 0 65535 /end CHARACTERISTIC
/begin CHARACTERISTIC FaultManager.HV_Battery_Precharge_Failure.Mode "Fault manager configuration.  Select up to 4 actions for each fault." VALUE 0x80000F1D RecordLayout_7 0 CompuMethod_481 0 65535 /end CHARACTERISTIC
/begin CHARACTERISTIC FaultManager.HV_Battery_Precharge_Failure.ID "Fault manager configuration.  Select up to 4 actions for each fault." VALUE 0x80000F1F RecordLayout_7 0 CompuMethod_1 0 65535 /end CHARACTERISTIC
/begin CHARACTERISTIC FaultManager.HV_Battery_Precharge_Failure.Test "Fault manager configuration.  Select up to 4 actions for each fault." VALUE 0x80000F21 RecordLayout_7 0 CompuMethod_482 0 65535 /end CHARACTERISTIC
/begin CHARACTERISTIC FaultManager.HV_Battery_Precharge_Failure.Faulty_Samples__X_ "Fault manager configuration.  Select up to 4 actions for each fault." VALUE 0x80000F23 RecordLayout_7 0 CompuMethod_1 0 65535 /end CHARACTERISTIC
/begin CHARACTERISTIC FaultManager.HV_Battery_Precharge_Failure.Total_Samples__Y_ "Fault manager configuration.  Select up to 4 actions for each fault." VALUE 0x80000F25 RecordLayout_7 0 CompuMethod_1 0 65535 /end CHARACTERISTIC
/begin CHARACTERISTIC FaultManager.HV_Battery_Precharge_Failure.Action_1 "Fault manager configuration.  Select up to 4 actions for each fault." VALUE 0x80000F27 RecordLayout_7 0 CompuMethod_483 0 65535 /end CHARACTERISTIC
/begin CHARACTERISTIC FaultManager.HV_Battery_Precharge_Failure.Action_1_Condition "Fault manager configuration.  Select up to 4 actions for each fault." VALUE 0x80000F29 RecordLayout_7 0 CompuMethod_484 0 65535 /end CHARACTERISTIC
/begin CHARACTERISTIC FaultManager.HV_Battery_Precharge_Failure.Action_2 "Fault manager configuration.  Select up to 4 actions for each fault." VALUE 0x80000F2B RecordLayout_7 0 CompuMethod_483 0 65535 /end CHARACTERISTIC
/begin CHARACTERISTIC FaultManager.HV_Battery_Precharge_Failure.Action_2_Condition "Fault manager configuration.  Select up to 4 actions for each fault." VALUE 0x80000F2D RecordLayout_7 0 CompuMethod_484 0 65535 /end CHARACTERISTIC
/begin CHARACTERISTIC FaultManager.HV_Battery_Precharge_Failure.Action_3 "Fault manager configuration.  Select up to 4 actions for each fault." VALUE 0x80000F2F RecordLayout_7 0 CompuMethod_483 0 65535 /end CHARACTERISTIC
/begin CHARACTERISTIC FaultManager.HV_Battery_Precharge_Failure.Action_3_Condition "Fault manager configuration.  Select up to 4 actions for each fault." VALUE 0x80000F31 RecordLayout_7 0 CompuMethod_484 0 65535 /end CHARACTERISTIC
/begin CHARACTERISTIC FaultManager.HV_Battery_Precharge_Failure.Action_4 "Fault manager configuration.  Select up to 4 actions for each fault." VALUE 0x80000F33 RecordLayout_7 0 CompuMethod_483 0 65535 /end CHARACTERISTIC
/begin CHARACTERISTIC FaultManager.HV_Battery_Precharge_Failure.Action_4_Condition "Fault manager configuration.  Select up to 4 actions for each fault." VALUE 0x80000F35 RecordLayout_7 0 CompuMethod_484 0 65535 /end CHARACTERISTIC
/begin CHARACTERISTIC FaultManager.HV_Battery_Too_Low_For_Load.Mode "Fault manager configuration.  Select up to 4 actions for each fault." VALUE 0x80000F37 RecordLayout_7 0 CompuMethod_481 0 65535 /end CHARACTERISTIC
/begin CHARACTERISTIC FaultManager.HV_Battery_Too_Low_For_Load.ID "Fault manager configuration.  Select up to 4 actions for each fault." VALUE 0x80000F39 RecordLayout_7 0 CompuMethod_1 0 65535 /end CHARACTERISTIC
/begin CHARACTERISTIC FaultManager.HV_Battery_Too_Low_For_Load.Test "Fault manager configuration.  Select up to 4 actions for each fault." VALUE 0x80000F3B RecordLayout_7 0 CompuMethod_482 0 65535 /end CHARACTERISTIC
/begin CHARACTERISTIC FaultManager.HV_Battery_Too_Low_For_Load.Faulty_Samples__X_ "Fault manager configuration.  Select up to 4 actions for each fault." VALUE 0x80000F3D RecordLayout_7 0 CompuMethod_1 0 65535 /end CHARACTERISTIC
/begin CHARACTERISTIC FaultManager.HV_Battery_Too_Low_For_Load.Total_Samples__Y_ "Fault manager configuration.  Select up to 4 actions for each fault." VALUE 0x80000F3F RecordLayout_7 0 CompuMethod_1 0 65535 /end CHARACTERISTIC
/begin CHARACTERISTIC FaultManager.HV_Battery_Too_Low_For_Load.Action_1 "Fault manager configuration.  Select up to 4 actions for each fault." VALUE 0x80000F41 RecordLayout_7 0 CompuMethod_483 0 65535 /end CHARACTERISTIC
/begin CHARACTERISTIC FaultManager.HV_Battery_Too_Low_For_Load.Action_1_Condition "Fault manager configuration.  Select up to 4 actions for each fault." VALUE 0x80000F43 RecordLayout_7 0 CompuMethod_484 0 65535 /end CHARACTERISTIC
/begin CHARACTERISTIC FaultManager.HV_Battery_Too_Low_For_Load.Action_2 "Fault manager configuration.  Select up to 4 actions for each fault." VALUE 0x80000F45 RecordLayout_7 0 CompuMethod_483 0 65535 /end CHARACTERISTIC
/begin CHARACTERISTIC FaultManager.HV_Battery_Too_Low_For_Load.Action_2_Condition "Fault manager configuration.  Select up to 4 actions for each fault." VALUE 0x80000F47 RecordLayout_7 0 CompuMethod_484 0 65535 /end CHARACTERISTIC
/begin CHARACTERISTIC FaultManager.HV_Battery_Too_Low_For_Load.Action_3 "Fault manager configuration.  Select up to 4 actions for each fault." VALUE 0x80000F49 RecordLayout_7 0 CompuMethod_483 0 65535 /end CHARACTERISTIC
/begin CHARACTERISTIC FaultManager.HV_Battery_Too_Low_For_Load.Action_3_Condition "Fault manager configuration.  Select up to 4 actions for each fault." VALUE 0x80000F4B RecordLayout_7 0 CompuMethod_484 0 65535 /end CHARACTERISTIC
/begin CHARACTERISTIC FaultManager.HV_Battery_Too_Low_For_Load.Action_4 "Fault manager configuration.  Select up to 4 actions for each fault." VALUE 0x80000F4D RecordLayout_7 0 CompuMethod_483 0 65535 /end CHARACTERISTIC
/begin CHARACTERISTIC FaultManager.HV_Battery_Too_Low_For_Load.Action_4_Condition "Fault manager configuration.  Select up to 4 actions for each fault." VALUE 0x80000F4F RecordLayout_7 0 CompuMethod_484 0 65535 /end CHARACTERISTIC
/begin CHARACTERISTIC FaultManager.HV_Battery_Try_To_Balance_Under_Load.Mode "Fault manager configuration.  Select up to 4 actions for each fault." VALUE 0x80000F51 RecordLayout_7 0 CompuMethod_481 0 65535 /end CHARACTERISTIC
/begin CHARACTERISTIC FaultManager.HV_Battery_Try_To_Balance_Under_Load.ID "Fault manager configuration.  Select up to 4 actions for each fault." VALUE 0x80000F53 RecordLayout_7 0 CompuMethod_1 0 65535 /end CHARACTERISTIC
/begin CHARACTERISTIC FaultManager.HV_Battery_Try_To_Balance_Under_Load.Test "Fault manager configuration.  Select up to 4 actions for each fault." VALUE 0x80000F55 RecordLayout_7 0 CompuMethod_482 0 65535 /end CHARACTERISTIC
/begin CHARACTERISTIC FaultManager.HV_Battery_Try_To_Balance_Under_Load.Faulty_Samples__X_ "Fault manager configuration.  Select up to 4 actions for each fault." VALUE 0x80000F57 RecordLayout_7 0 CompuMethod_1 0 65535 /end CHARACTERISTIC
/begin CHARACTERISTIC FaultManager.HV_Battery_Try_To_Balance_Under_Load.Total_Samples__Y_ "Fault manager configuration.  Select up to 4 actions for each fault." VALUE 0x80000F59 RecordLayout_7 0 CompuMethod_1 0 65535 /end CHARACTERISTIC
/begin CHARACTERISTIC FaultManager.HV_Battery_Try_To_Balance_Under_Load.Action_1 "Fault manager configuration.  Select up to 4 actions for each fault." VALUE 0x80000F5B RecordLayout_7 0 CompuMethod_483 0 65535 /end CHARACTERISTIC
/begin CHARACTERISTIC FaultManager.HV_Battery_Try_To_Balance_Under_Load.Action_1_Condition "Fault manager configuration.  Select up to 4 actions for each fault." VALUE 0x80000F5D RecordLayout_7 0 CompuMethod_484 0 65535 /end CHARACTERISTIC
/begin CHARACTERISTIC FaultManager.HV_Battery_Try_To_Balance_Under_Load.Action_2 "Fault manager configuration.  Select up to 4 actions for each fault." VALUE 0x80000F5F RecordLayout_7 0 CompuMethod_483 0 65535 /end CHARACTERISTIC
/begin CHARACTERISTIC FaultManager.HV_Battery_Try_To_Balance_Under_Load.Action_2_Condition "Fault manager configuration.  Select up to 4 actions for each fault." VALUE 0x80000F61 RecordLayout_7 0 CompuMethod_484 0 65535 /end CHARACTERISTIC
/begin CHARACTERISTIC FaultManager.HV_Battery_Try_To_Balance_Under_Load.Action_3 "Fault manager configuration.  Select up to 4 actions for each fault." VALUE 0x80000F63 RecordLayout_7 0 CompuMethod_483 0 65535 /end CHARACTERISTIC
/begin CHARACTERISTIC FaultManager.HV_Battery_Try_To_Balance_Under_Load.Action_3_Condition "Fault manager configuration.  Select up to 4 actions for each fault." VALUE 0x80000F65 RecordLayout_7 0 CompuMethod_484 0 65535 /end CHARACTERISTIC
/begin CHARACTERISTIC FaultManager.HV_Battery_Try_To_Balance_Under_Load.Action_4 "Fault manager configuration.  Select up to 4 actions for each fault." VALUE 0x80000F67 RecordLayout_7 0 CompuMethod_483 0 65535 /end CHARACTERISTIC
/begin CHARACTERISTIC FaultManager.HV_Battery_Try_To_Balance_Under_Load.Action_4_Condition "Fault manager configuration.  Select up to 4 actions for each fault." VALUE 0x80000F69 RecordLayout_7 0 CompuMethod_484 0 65535 /end CHARACTERISTIC
/begin CHARACTERISTIC FaultManager.HV_Heater_Over_Temperature.Mode "Fault manager configuration.  Select up to 4 actions for each fault." VALUE 0x80000F6B RecordLayout_7 0 CompuMethod_481 0 65535 /end CHARACTERISTIC
/begin CHARACTERISTIC FaultManager.HV_Heater_Over_Temperature.ID "Fault manager configuration.  Select up to 4 actions for each fault." VALUE 0x80000F6D RecordLayout_7 0 CompuMethod_1 0 65535 /end CHARACTERISTIC
/begin CHARACTERISTIC FaultManager.HV_Heater_Over_Temperature.Test "Fault manager configuration.  Select up to 4 actions for each fault." VALUE 0x80000F6F RecordLayout_7 0 CompuMethod_482 0 65535 /end CHARACTERISTIC
/begin CHARACTERISTIC FaultManager.HV_Heater_Over_Temperature.Faulty_Samples__X_ "Fault manager configuration.  Select up to 4 actions for each fault." VALUE 0x80000F71 RecordLayout_7 0 CompuMethod_1 0 65535 /end CHARACTERISTIC
/begin CHARACTERISTIC FaultManager.HV_Heater_Over_Temperature.Total_Samples__Y_ "Fault manager configuration.  Select up to 4 actions for each fault." VALUE 0x80000F73 RecordLayout_7 0 CompuMethod_1 0 65535 /end CHARACTERISTIC
/begin CHARACTERISTIC FaultManager.HV_Heater_Over_Temperature.Action_1 "Fault manager configuration.  Select up to 4 actions for each fault." VALUE 0x80000F75 RecordLayout_7 0 CompuMethod_483 0 65535 /end CHARACTERISTIC
/begin CHARACTERISTIC FaultManager.HV_Heater_Over_Temperature.Action_1_Condition "Fault manager configuration.  Select up to 4 actions for each fault." VALUE 0x80000F77 RecordLayout_7 0 CompuMethod_484 0 65535 /end CHARACTERISTIC
/begin CHARACTERISTIC FaultManager.HV_Heater_Over_Temperature.Action_2 "Fault manager configuration.  Select up to 4 actions for each fault." VALUE 0x80000F79 RecordLayout_7 0 CompuMethod_483 0 65535 /end CHARACTERISTIC
/begin CHARACTERISTIC FaultManager.HV_Heater_Over_Temperature.Action_2_Condition "Fault manager configuration.  Select up to 4 actions for each fault." VALUE 0x80000F7B RecordLayout_7 0 CompuMethod_484 0 65535 /end CHARACTERISTIC
/begin CHARACTERISTIC FaultManager.HV_Heater_Over_Temperature.Action_3 "Fault manager configuration.  Select up to 4 actions for each fault." VALUE 0x80000F7D RecordLayout_7 0 CompuMethod_483 0 65535 /end CHARACTERISTIC
/begin CHARACTERISTIC FaultManager.HV_Heater_Over_Temperature.Action_3_Condition "Fault manager configuration.  Select up to 4 actions for each fault." VALUE 0x80000F7F RecordLayout_7 0 CompuMethod_484 0 65535 /end CHARACTERISTIC
/begin CHARACTERISTIC FaultManager.HV_Heater_Over_Temperature.Action_4 "Fault manager configuration.  Select up to 4 actions for each fault." VALUE 0x80000F81 RecordLayout_7 0 CompuMethod_483 0 65535 /end CHARACTERISTIC
/begin CHARACTERISTIC FaultManager.HV_Heater_Over_Temperature.Action_4_Condition "Fault manager configuration.  Select up to 4 actions for each fault." VALUE 0x80000F83 RecordLayout_7 0 CompuMethod_484 0 65535 /end CHARACTERISTIC
/begin CHARACTERISTIC FaultManager.HV_Heater_Poor_Performance.Mode "Fault manager configuration.  Select up to 4 actions for each fault." VALUE 0x80000F85 RecordLayout_7 0 CompuMethod_481 0 65535 /end CHARACTERISTIC
/begin CHARACTERISTIC FaultManager.HV_Heater_Poor_Performance.ID "Fault manager configuration.  Select up to 4 actions for each fault." VALUE 0x80000F87 RecordLayout_7 0 CompuMethod_1 0 65535 /end CHARACTERISTIC
/begin CHARACTERISTIC FaultManager.HV_Heater_Poor_Performance.Test "Fault manager configuration.  Select up to 4 actions for each fault." VALUE 0x80000F89 RecordLayout_7 0 CompuMethod_482 0 65535 /end CHARACTERISTIC
/begin CHARACTERISTIC FaultManager.HV_Heater_Poor_Performance.Faulty_Samples__X_ "Fault manager configuration.  Select up to 4 actions for each fault." VALUE 0x80000F8B RecordLayout_7 0 CompuMethod_1 0 65535 /end CHARACTERISTIC
/begin CHARACTERISTIC FaultManager.HV_Heater_Poor_Performance.Total_Samples__Y_ "Fault manager configuration.  Select up to 4 actions for each fault." VALUE 0x80000F8D RecordLayout_7 0 CompuMethod_1 0 65535 /end CHARACTERISTIC
/begin CHARACTERISTIC FaultManager.HV_Heater_Poor_Performance.Action_1 "Fault manager configuration.  Select up to 4 actions for each fault." VALUE 0x80000F8F RecordLayout_7 0 CompuMethod_483 0 65535 /end CHARACTERISTIC
/begin CHARACTERISTIC FaultManager.HV_Heater_Poor_Performance.Action_1_Condition "Fault manager configuration.  Select up to 4 actions for each fault." VALUE 0x80000F91 RecordLayout_7 0 CompuMethod_484 0 65535 /end CHARACTERISTIC
/begin CHARACTERISTIC FaultManager.HV_Heater_Poor_Performance.Action_2 "Fault manager configuration.  Select up to 4 actions for each fault." VALUE 0x80000F93 RecordLayout_7 0 CompuMethod_483 0 65535 /end CHARACTERISTIC
/begin CHARACTERISTIC FaultManager.HV_Heater_Poor_Performance.Action_2_Condition "Fault manager configuration.  Select up to 4 actions for each fault." VALUE 0x80000F95 RecordLayout_7 0 CompuMethod_484 0 65535 /end CHARACTERISTIC
/begin CHARACTERISTIC FaultManager.HV_Heater_Poor_Performance.Action_3 "Fault manager configuration.  Select up to 4 actions for each fault." VALUE 0x80000F97 RecordLayout_7 0 CompuMethod_483 0 65535 /end CHARACTERISTIC
/begin CHARACTERISTIC FaultManager.HV_Heater_Poor_Performance.Action_3_Condition "Fault manager configuration.  Select up to 4 actions for each fault." VALUE 0x80000F99 RecordLayout_7 0 CompuMethod_484 0 65535 /end CHARACTERISTIC
/begin CHARACTERISTIC FaultManager.HV_Heater_Poor_Performance.Action_4 "Fault manager configuration.  Select up to 4 actions for each fault." VALUE 0x80000F9B RecordLayout_7 0 CompuMethod_483 0 65535 /end CHARACTERISTIC
/begin CHARACTERISTIC FaultManager.HV_Heater_Poor_Performance.Action_4_Condition "Fault manager configuration.  Select up to 4 actions for each fault." VALUE 0x80000F9D RecordLayout_7 0 CompuMethod_484 0 65535 /end CHARACTERISTIC
/begin CHARACTERISTIC FaultManager.HV_Heater_Temperature_Sensor_A_High_Voltage.Mode "Fault manager configuration.  Select up to 4 actions for each fault." VALUE 0x80000F9F RecordLayout_7 0 CompuMethod_481 0 65535 /end CHARACTERISTIC
/begin CHARACTERISTIC FaultManager.HV_Heater_Temperature_Sensor_A_High_Voltage.ID "Fault manager configuration.  Select up to 4 actions for each fault." VALUE 0x80000FA1 RecordLayout_7 0 CompuMethod_1 0 65535 /end CHARACTERISTIC
/begin CHARACTERISTIC FaultManager.HV_Heater_Temperature_Sensor_A_High_Voltage.Test "Fault manager configuration.  Select up to 4 actions for each fault." VALUE 0x80000FA3 RecordLayout_7 0 CompuMethod_482 0 65535 /end CHARACTERISTIC
/begin CHARACTERISTIC FaultManager.HV_Heater_Temperature_Sensor_A_High_Voltage.Faulty_Samples__X_ "Fault manager configuration.  Select up to 4 actions for each fault." VALUE 0x80000FA5 RecordLayout_7 0 CompuMethod_1 0 65535 /end CHARACTERISTIC
/begin CHARACTERISTIC FaultManager.HV_Heater_Temperature_Sensor_A_High_Voltage.Total_Samples__Y_ "Fault manager configuration.  Select up to 4 actions for each fault." VALUE 0x80000FA7 RecordLayout_7 0 CompuMethod_1 0 65535 /end CHARACTERISTIC
/begin CHARACTERISTIC FaultManager.HV_Heater_Temperature_Sensor_A_High_Voltage.Action_1 "Fault manager configuration.  Select up to 4 actions for each fault." VALUE 0x80000FA9 RecordLayout_7 0 CompuMethod_483 0 65535 /end CHARACTERISTIC
/begin CHARACTERISTIC FaultManager.HV_Heater_Temperature_Sensor_A_High_Voltage.Action_1_Condition "Fault manager configuration.  Select up to 4 actions for each fault." VALUE 0x80000FAB RecordLayout_7 0 CompuMethod_484 0 65535 /end CHARACTERISTIC
/begin CHARACTERISTIC FaultManager.HV_Heater_Temperature_Sensor_A_High_Voltage.Action_2 "Fault manager configuration.  Select up to 4 actions for each fault." VALUE 0x80000FAD RecordLayout_7 0 CompuMethod_483 0 65535 /end CHARACTERISTIC
/begin CHARACTERISTIC FaultManager.HV_Heater_Temperature_Sensor_A_High_Voltage.Action_2_Condition "Fault manager configuration.  Select up to 4 actions for each fault." VALUE 0x80000FAF RecordLayout_7 0 CompuMethod_484 0 65535 /end CHARACTERISTIC
/begin CHARACTERISTIC FaultManager.HV_Heater_Temperature_Sensor_A_High_Voltage.Action_3 "Fault manager configuration.  Select up to 4 actions for each fault." VALUE 0x80000FB1 RecordLayout_7 0 CompuMethod_483 0 65535 /end CHARACTERISTIC
/begin CHARACTERISTIC FaultManager.HV_Heater_Temperature_Sensor_A_High_Voltage.Action_3_Condition "Fault manager configuration.  Select up to 4 actions for each fault." VALUE 0x80000FB3 RecordLayout_7 0 CompuMethod_484 0 65535 /end CHARACTERISTIC
/begin CHARACTERISTIC FaultManager.HV_Heater_Temperature_Sensor_A_High_Voltage.Action_4 "Fault manager configuration.  Select up to 4 actions for each fault." VALUE 0x80000FB5 RecordLayout_7 0 CompuMethod_483 0 65535 /end CHARACTERISTIC
/begin CHARACTERISTIC FaultManager.HV_Heater_Temperature_Sensor_A_High_Voltage.Action_4_Condition "Fault manager configuration.  Select up to 4 actions for each fault." VALUE 0x80000FB7 RecordLayout_7 0 CompuMethod_484 0 65535 /end CHARACTERISTIC
/begin CHARACTERISTIC FaultManager.HV_Heater_Temperature_Sensor_A_Intermittent.Mode "Fault manager configuration.  Select up to 4 actions for each fault." VALUE 0x80000FB9 RecordLayout_7 0 CompuMethod_481 0 65535 /end CHARACTERISTIC
/begin CHARACTERISTIC FaultManager.HV_Heater_Temperature_Sensor_A_Intermittent.ID "Fault manager configuration.  Select up to 4 actions for each fault." VALUE 0x80000FBB RecordLayout_7 0 CompuMethod_1 0 65535 /end CHARACTERISTIC
/begin CHARACTERISTIC FaultManager.HV_Heater_Temperature_Sensor_A_Intermittent.Test "Fault manager configuration.  Select up to 4 actions for each fault." VALUE 0x80000FBD RecordLayout_7 0 CompuMethod_482 0 65535 /end CHARACTERISTIC
/begin CHARACTERISTIC FaultManager.HV_Heater_Temperature_Sensor_A_Intermittent.Faulty_Samples__X_ "Fault manager configuration.  Select up to 4 actions for each fault." VALUE 0x80000FBF RecordLayout_7 0 CompuMethod_1 0 65535 /end CHARACTERISTIC
/begin CHARACTERISTIC FaultManager.HV_Heater_Temperature_Sensor_A_Intermittent.Total_Samples__Y_ "Fault manager configuration.  Select up to 4 actions for each fault." VALUE 0x80000FC1 RecordLayout_7 0 CompuMethod_1 0 65535 /end CHARACTERISTIC
/begin CHARACTERISTIC FaultManager.HV_Heater_Temperature_Sensor_A_Intermittent.Action_1 "Fault manager configuration.  Select up to 4 actions for each fault." VALUE 0x80000FC3 RecordLayout_7 0 CompuMethod_483 0 65535 /end CHARACTERISTIC
/begin CHARACTERISTIC FaultManager.HV_Heater_Temperature_Sensor_A_Intermittent.Action_1_Condition "Fault manager configuration.  Select up to 4 actions for each fault." VALUE 0x80000FC5 RecordLayout_7 0 CompuMethod_484 0 65535 /end CHARACTERISTIC
/begin CHARACTERISTIC FaultManager.HV_Heater_Temperature_Sensor_A_Intermittent.Action_2 "Fault manager configuration.  Select up to 4 actions for each fault." VALUE 0x80000FC7 RecordLayout_7 0 CompuMethod_483 0 65535 /end CHARACTERISTIC
/begin CHARACTERISTIC FaultManager.HV_Heater_Temperature_Sensor_A_Intermittent.Action_2_Condition "Fault manager configuration.  Select up to 4 actions for each fault." VALUE 0x80000FC9 RecordLayout_7 0 CompuMethod_484 0 65535 /end CHARACTERISTIC
/begin CHARACTERISTIC FaultManager.HV_Heater_Temperature_Sensor_A_Intermittent.Action_3 "Fault manager configuration.  Select up to 4 actions for each fault." VALUE 0x80000FCB RecordLayout_7 0 CompuMethod_483 0 65535 /end CHARACTERISTIC
/begin CHARACTERISTIC FaultManager.HV_Heater_Temperature_Sensor_A_Intermittent.Action_3_Condition "Fault manager configuration.  Select up to 4 actions for each fault." VALUE 0x80000FCD RecordLayout_7 0 CompuMethod_484 0 65535 /end CHARACTERISTIC
/begin CHARACTERISTIC FaultManager.HV_Heater_Temperature_Sensor_A_Intermittent.Action_4 "Fault manager configuration.  Select up to 4 actions for each fault." VALUE 0x80000FCF RecordLayout_7 0 CompuMethod_483 0 65535 /end CHARACTERISTIC
/begin CHARACTERISTIC FaultManager.HV_Heater_Temperature_Sensor_A_Intermittent.Action_4_Condition "Fault manager configuration.  Select up to 4 actions for each fault." VALUE 0x80000FD1 RecordLayout_7 0 CompuMethod_484 0 65535 /end CHARACTERISTIC
/begin CHARACTERISTIC FaultManager.HV_Heater_Temperature_Sensor_A_Low_Voltage.Mode "Fault manager configuration.  Select up to 4 actions for each fault." VALUE 0x80000FD3 RecordLayout_7 0 CompuMethod_481 0 65535 /end CHARACTERISTIC
/begin CHARACTERISTIC FaultManager.HV_Heater_Temperature_Sensor_A_Low_Voltage.ID "Fault manager configuration.  Select up to 4 actions for each fault." VALUE 0x80000FD5 RecordLayout_7 0 CompuMethod_1 0 65535 /end CHARACTERISTIC
/begin CHARACTERISTIC FaultManager.HV_Heater_Temperature_Sensor_A_Low_Voltage.Test "Fault manager configuration.  Select up to 4 actions for each fault." VALUE 0x80000FD7 RecordLayout_7 0 CompuMethod_482 0 65535 /end CHARACTERISTIC
/begin CHARACTERISTIC FaultManager.HV_Heater_Temperature_Sensor_A_Low_Voltage.Faulty_Samples__X_ "Fault manager configuration.  Select up to 4 actions for each fault." VALUE 0x80000FD9 RecordLayout_7 0 CompuMethod_1 0 65535 /end CHARACTERISTIC
/begin CHARACTERISTIC FaultManager.HV_Heater_Temperature_Sensor_A_Low_Voltage.Total_Samples__Y_ "Fault manager configuration.  Select up to 4 actions for each fault." VALUE 0x80000FDB RecordLayout_7 0 CompuMethod_1 0 65535 /end CHARACTERISTIC
/begin CHARACTERISTIC FaultManager.HV_Heater_Temperature_Sensor_A_Low_Voltage.Action_1 "Fault manager configuration.  Select up to 4 actions for each fault." VALUE 0x80000FDD RecordLayout_7 0 CompuMethod_483 0 65535 /end CHARACTERISTIC
/begin CHARACTERISTIC FaultManager.HV_Heater_Temperature_Sensor_A_Low_Voltage.Action_1_Condition "Fault manager configuration.  Select up to 4 actions for each fault." VALUE 0x80000FDF RecordLayout_7 0 CompuMethod_484 0 65535 /end CHARACTERISTIC
/begin CHARACTERISTIC FaultManager.HV_Heater_Temperature_Sensor_A_Low_Voltage.Action_2 "Fault manager configuration.  Select up to 4 actions for each fault." VALUE 0x80000FE1 RecordLayout_7 0 CompuMethod_483 0 65535 /end CHARACTERISTIC
/begin CHARACTERISTIC FaultManager.HV_Heater_Temperature_Sensor_A_Low_Voltage.Action_2_Condition "Fault manager configuration.  Select up to 4 actions for each fault." VALUE 0x80000FE3 RecordLayout_7 0 CompuMethod_484 0 65535 /end CHARACTERISTIC
/begin CHARACTERISTIC FaultManager.HV_Heater_Temperature_Sensor_A_Low_Voltage.Action_3 "Fault manager configuration.  Select up to 4 actions for each fault." VALUE 0x80000FE5 RecordLayout_7 0 CompuMethod_483 0 65535 /end CHARACTERISTIC
/begin CHARACTERISTIC FaultManager.HV_Heater_Temperature_Sensor_A_Low_Voltage.Action_3_Condition "Fault manager configuration.  Select up to 4 actions for each fault." VALUE 0x80000FE7 RecordLayout_7 0 CompuMethod_484 0 65535 /end CHARACTERISTIC
/begin CHARACTERISTIC FaultManager.HV_Heater_Temperature_Sensor_A_Low_Voltage.Action_4 "Fault manager configuration.  Select up to 4 actions for each fault." VALUE 0x80000FE9 RecordLayout_7 0 CompuMethod_483 0 65535 /end CHARACTERISTIC
/begin CHARACTERISTIC FaultManager.HV_Heater_Temperature_Sensor_A_Low_Voltage.Action_4_Condition "Fault manager configuration.  Select up to 4 actions for each fault." VALUE 0x80000FEB RecordLayout_7 0 CompuMethod_484 0 65535 /end CHARACTERISTIC
/begin CHARACTERISTIC FaultManager.IPT_DCDC_AgeCount.Mode "Fault manager configuration.  Select up to 4 actions for each fault." VALUE 0x80000FED RecordLayout_7 0 CompuMethod_481 0 65535 /end CHARACTERISTIC
/begin CHARACTERISTIC FaultManager.IPT_DCDC_AgeCount.ID "Fault manager configuration.  Select up to 4 actions for each fault." VALUE 0x80000FEF RecordLayout_7 0 CompuMethod_1 0 65535 /end CHARACTERISTIC
/begin CHARACTERISTIC FaultManager.IPT_DCDC_AgeCount.Test "Fault manager configuration.  Select up to 4 actions for each fault." VALUE 0x80000FF1 RecordLayout_7 0 CompuMethod_482 0 65535 /end CHARACTERISTIC
/begin CHARACTERISTIC FaultManager.IPT_DCDC_AgeCount.Faulty_Samples__X_ "Fault manager configuration.  Select up to 4 actions for each fault." VALUE 0x80000FF3 RecordLayout_7 0 CompuMethod_1 0 65535 /end CHARACTERISTIC
/begin CHARACTERISTIC FaultManager.IPT_DCDC_AgeCount.Total_Samples__Y_ "Fault manager configuration.  Select up to 4 actions for each fault." VALUE 0x80000FF5 RecordLayout_7 0 CompuMethod_1 0 65535 /end CHARACTERISTIC
/begin CHARACTERISTIC FaultManager.IPT_DCDC_AgeCount.Action_1 "Fault manager configuration.  Select up to 4 actions for each fault." VALUE 0x80000FF7 RecordLayout_7 0 CompuMethod_483 0 65535 /end CHARACTERISTIC
/begin CHARACTERISTIC FaultManager.IPT_DCDC_AgeCount.Action_1_Condition "Fault manager configuration.  Select up to 4 actions for each fault." VALUE 0x80000FF9 RecordLayout_7 0 CompuMethod_484 0 65535 /end CHARACTERISTIC
/begin CHARACTERISTIC FaultManager.IPT_DCDC_AgeCount.Action_2 "Fault manager configuration.  Select up to 4 actions for each fault." VALUE 0x80000FFB RecordLayout_7 0 CompuMethod_483 0 65535 /end CHARACTERISTIC
/begin CHARACTERISTIC FaultManager.IPT_DCDC_AgeCount.Action_2_Condition "Fault manager configuration.  Select up to 4 actions for each fault." VALUE 0x80000FFD RecordLayout_7 0 CompuMethod_484 0 65535 /end CHARACTERISTIC
/begin CHARACTERISTIC FaultManager.IPT_DCDC_AgeCount.Action_3 "Fault manager configuration.  Select up to 4 actions for each fault." VALUE 0x80000FFF RecordLayout_7 0 CompuMethod_483 0 65535 /end CHARACTERISTIC
/begin CHARACTERISTIC FaultManager.IPT_DCDC_AgeCount.Action_3_Condition "Fault manager configuration.  Select up to 4 actions for each fault." VALUE 0x80001001 RecordLayout_7 0 CompuMethod_484 0 65535 /end CHARACTERISTIC
/begin CHARACTERISTIC FaultManager.IPT_DCDC_AgeCount.Action_4 "Fault manager configuration.  Select up to 4 actions for each fault." VALUE 0x80001003 RecordLayout_7 0 CompuMethod_483 0 65535 /end CHARACTERISTIC
/begin CHARACTERISTIC FaultManager.IPT_DCDC_AgeCount.Action_4_Condition "Fault manager configuration.  Select up to 4 actions for each fault." VALUE 0x80001005 RecordLayout_7 0 CompuMethod_484 0 65535 /end CHARACTERISTIC
/begin CHARACTERISTIC FaultManager.IPT_Status1_AgeCount.Mode "Fault manager configuration.  Select up to 4 actions for each fault." VALUE 0x80001007 RecordLayout_7 0 CompuMethod_481 0 65535 /end CHARACTERISTIC
/begin CHARACTERISTIC FaultManager.IPT_Status1_AgeCount.ID "Fault manager configuration.  Select up to 4 actions for each fault." VALUE 0x80001009 RecordLayout_7 0 CompuMethod_1 0 65535 /end CHARACTERISTIC
/begin CHARACTERISTIC FaultManager.IPT_Status1_AgeCount.Test "Fault manager configuration.  Select up to 4 actions for each fault." VALUE 0x8000100B RecordLayout_7 0 CompuMethod_482 0 65535 /end CHARACTERISTIC
/begin CHARACTERISTIC FaultManager.IPT_Status1_AgeCount.Faulty_Samples__X_ "Fault manager configuration.  Select up to 4 actions for each fault." VALUE 0x8000100D RecordLayout_7 0 CompuMethod_1 0 65535 /end CHARACTERISTIC
/begin CHARACTERISTIC FaultManager.IPT_Status1_AgeCount.Total_Samples__Y_ "Fault manager configuration.  Select up to 4 actions for each fault." VALUE 0x8000100F RecordLayout_7 0 CompuMethod_1 0 65535 /end CHARACTERISTIC
/begin CHARACTERISTIC FaultManager.IPT_Status1_AgeCount.Action_1 "Fault manager configuration.  Select up to 4 actions for each fault." VALUE 0x80001011 RecordLayout_7 0 CompuMethod_483 0 65535 /end CHARACTERISTIC
/begin CHARACTERISTIC FaultManager.IPT_Status1_AgeCount.Action_1_Condition "Fault manager configuration.  Select up to 4 actions for each fault." VALUE 0x80001013 RecordLayout_7 0 CompuMethod_484 0 65535 /end CHARACTERISTIC
/begin CHARACTERISTIC FaultManager.IPT_Status1_AgeCount.Action_2 "Fault manager configuration.  Select up to 4 actions for each fault." VALUE 0x80001015 RecordLayout_7 0 CompuMethod_483 0 65535 /end CHARACTERISTIC
/begin CHARACTERISTIC FaultManager.IPT_Status1_AgeCount.Action_2_Condition "Fault manager configuration.  Select up to 4 actions for each fault." VALUE 0x80001017 RecordLayout_7 0 CompuMethod_484 0 65535 /end CHARACTERISTIC
/begin CHARACTERISTIC FaultManager.IPT_Status1_AgeCount.Action_3 "Fault manager configuration.  Select up to 4 actions for each fault." VALUE 0x80001019 RecordLayout_7 0 CompuMethod_483 0 65535 /end CHARACTERISTIC
/begin CHARACTERISTIC FaultManager.IPT_Status1_AgeCount.Action_3_Condition "Fault manager configuration.  Select up to 4 actions for each fault." VALUE 0x8000101B RecordLayout_7 0 CompuMethod_484 0 65535 /end CHARACTERISTIC
/begin CHARACTERISTIC FaultManager.IPT_Status1_AgeCount.Action_4 "Fault manager configuration.  Select up to 4 actions for each fault." VALUE 0x8000101D RecordLayout_7 0 CompuMethod_483 0 65535 /end CHARACTERISTIC
/begin CHARACTERISTIC FaultManager.IPT_Status1_AgeCount.Action_4_Condition "Fault manager configuration.  Select up to 4 actions for each fault." VALUE 0x8000101F RecordLayout_7 0 CompuMethod_484 0 65535 /end CHARACTERISTIC
/begin CHARACTERISTIC FaultManager.IPT_Status2_AgeCount.Mode "Fault manager configuration.  Select up to 4 actions for each fault." VALUE 0x80001021 RecordLayout_7 0 CompuMethod_481 0 65535 /end CHARACTERISTIC
/begin CHARACTERISTIC FaultManager.IPT_Status2_AgeCount.ID "Fault manager configuration.  Select up to 4 actions for each fault." VALUE 0x80001023 RecordLayout_7 0 CompuMethod_1 0 65535 /end CHARACTERISTIC
/begin CHARACTERISTIC FaultManager.IPT_Status2_AgeCount.Test "Fault manager configuration.  Select up to 4 actions for each fault." VALUE 0x80001025 RecordLayout_7 0 CompuMethod_482 0 65535 /end CHARACTERISTIC
/begin CHARACTERISTIC FaultManager.IPT_Status2_AgeCount.Faulty_Samples__X_ "Fault manager configuration.  Select up to 4 actions for each fault." VALUE 0x80001027 RecordLayout_7 0 CompuMethod_1 0 65535 /end CHARACTERISTIC
/begin CHARACTERISTIC FaultManager.IPT_Status2_AgeCount.Total_Samples__Y_ "Fault manager configuration.  Select up to 4 actions for each fault." VALUE 0x80001029 RecordLayout_7 0 CompuMethod_1 0 65535 /end CHARACTERISTIC
/begin CHARACTERISTIC FaultManager.IPT_Status2_AgeCount.Action_1 "Fault manager configuration.  Select up to 4 actions for each fault." VALUE 0x8000102B RecordLayout_7 0 CompuMethod_483 0 65535 /end CHARACTERISTIC
/begin CHARACTERISTIC FaultManager.IPT_Status2_AgeCount.Action_1_Condition "Fault manager configuration.  Select up to 4 actions for each fault." VALUE 0x8000102D RecordLayout_7 0 CompuMethod_484 0 65535 /end CHARACTERISTIC
/begin CHARACTERISTIC FaultManager.IPT_Status2_AgeCount.Action_2 "Fault manager configuration.  Select up to 4 actions for each fault." VALUE 0x8000102F RecordLayout_7 0 CompuMethod_483 0 65535 /end CHARACTERISTIC
/begin CHARACTERISTIC FaultManager.IPT_Status2_AgeCount.Action_2_Condition "Fault manager configuration.  Select up to 4 actions for each fault." VALUE 0x80001031 RecordLayout_7 0 CompuMethod_484 0 65535 /end CHARACTERISTIC
/begin CHARACTERISTIC FaultManager.IPT_Status2_AgeCount.Action_3 "Fault manager configuration.  Select up to 4 actions for each fault." VALUE 0x80001033 RecordLayout_7 0 CompuMethod_483 0 65535 /end CHARACTERISTIC
/begin CHARACTERISTIC FaultManager.IPT_Status2_AgeCount.Action_3_Condition "Fault manager configuration.  Select up to 4 actions for each fault." VALUE 0x80001035 RecordLayout_7 0 CompuMethod_484 0 65535 /end CHARACTERISTIC
/begin CHARACTERISTIC FaultManager.IPT_Status2_AgeCount.Action_4 "Fault manager configuration.  Select up to 4 actions for each fault." VALUE 0x80001037 RecordLayout_7 0 CompuMethod_483 0 65535 /end CHARACTERISTIC
/begin CHARACTERISTIC FaultManager.IPT_Status2_AgeCount.Action_4_Condition "Fault manager configuration.  Select up to 4 actions for each fault." VALUE 0x80001039 RecordLayout_7 0 CompuMethod_484 0 65535 /end CHARACTERISTIC
/begin CHARACTERISTIC FaultManager.Key_Line_Voltage.Mode "Fault manager configuration.  Select up to 4 actions for each fault." VALUE 0x8000103B RecordLayout_7 0 CompuMethod_481 0 65535 /end CHARACTERISTIC
/begin CHARACTERISTIC FaultManager.Key_Line_Voltage.ID "Fault manager configuration.  Select up to 4 actions for each fault." VALUE 0x8000103D RecordLayout_7 0 CompuMethod_1 0 65535 /end CHARACTERISTIC
/begin CHARACTERISTIC FaultManager.Key_Line_Voltage.Test "Fault manager configuration.  Select up to 4 actions for each fault." VALUE 0x8000103F RecordLayout_7 0 CompuMethod_482 0 65535 /end CHARACTERISTIC
/begin CHARACTERISTIC FaultManager.Key_Line_Voltage.Faulty_Samples__X_ "Fault manager configuration.  Select up to 4 actions for each fault." VALUE 0x80001041 RecordLayout_7 0 CompuMethod_1 0 65535 /end CHARACTERISTIC
/begin CHARACTERISTIC FaultManager.Key_Line_Voltage.Total_Samples__Y_ "Fault manager configuration.  Select up to 4 actions for each fault." VALUE 0x80001043 RecordLayout_7 0 CompuMethod_1 0 65535 /end CHARACTERISTIC
/begin CHARACTERISTIC FaultManager.Key_Line_Voltage.Action_1 "Fault manager configuration.  Select up to 4 actions for each fault." VALUE 0x80001045 RecordLayout_7 0 CompuMethod_483 0 65535 /end CHARACTERISTIC
/begin CHARACTERISTIC FaultManager.Key_Line_Voltage.Action_1_Condition "Fault manager configuration.  Select up to 4 actions for each fault." VALUE 0x80001047 RecordLayout_7 0 CompuMethod_484 0 65535 /end CHARACTERISTIC
/begin CHARACTERISTIC FaultManager.Key_Line_Voltage.Action_2 "Fault manager configuration.  Select up to 4 actions for each fault." VALUE 0x80001049 RecordLayout_7 0 CompuMethod_483 0 65535 /end CHARACTERISTIC
/begin CHARACTERISTIC FaultManager.Key_Line_Voltage.Action_2_Condition "Fault manager configuration.  Select up to 4 actions for each fault." VALUE 0x8000104B RecordLayout_7 0 CompuMethod_484 0 65535 /end CHARACTERISTIC
/begin CHARACTERISTIC FaultManager.Key_Line_Voltage.Action_3 "Fault manager configuration.  Select up to 4 actions for each fault." VALUE 0x8000104D RecordLayout_7 0 CompuMethod_483 0 65535 /end CHARACTERISTIC
/begin CHARACTERISTIC FaultManager.Key_Line_Voltage.Action_3_Condition "Fault manager configuration.  Select up to 4 actions for each fault." VALUE 0x8000104F RecordLayout_7 0 CompuMethod_484 0 65535 /end CHARACTERISTIC
/begin CHARACTERISTIC FaultManager.Key_Line_Voltage.Action_4 "Fault manager configuration.  Select up to 4 actions for each fault." VALUE 0x80001051 RecordLayout_7 0 CompuMethod_483 0 65535 /end CHARACTERISTIC
/begin CHARACTERISTIC FaultManager.Key_Line_Voltage.Action_4_Condition "Fault manager configuration.  Select up to 4 actions for each fault." VALUE 0x80001053 RecordLayout_7 0 CompuMethod_484 0 65535 /end CHARACTERISTIC
/begin CHARACTERISTIC FaultManager.Key_Off_Voltage_High.Mode "Fault manager configuration.  Select up to 4 actions for each fault." VALUE 0x80001055 RecordLayout_7 0 CompuMethod_481 0 65535 /end CHARACTERISTIC
/begin CHARACTERISTIC FaultManager.Key_Off_Voltage_High.ID "Fault manager configuration.  Select up to 4 actions for each fault." VALUE 0x80001057 RecordLayout_7 0 CompuMethod_1 0 65535 /end CHARACTERISTIC
/begin CHARACTERISTIC FaultManager.Key_Off_Voltage_High.Test "Fault manager configuration.  Select up to 4 actions for each fault." VALUE 0x80001059 RecordLayout_7 0 CompuMethod_482 0 65535 /end CHARACTERISTIC
/begin CHARACTERISTIC FaultManager.Key_Off_Voltage_High.Faulty_Samples__X_ "Fault manager configuration.  Select up to 4 actions for each fault." VALUE 0x8000105B RecordLayout_7 0 CompuMethod_1 0 65535 /end CHARACTERISTIC
/begin CHARACTERISTIC FaultManager.Key_Off_Voltage_High.Total_Samples__Y_ "Fault manager configuration.  Select up to 4 actions for each fault." VALUE 0x8000105D RecordLayout_7 0 CompuMethod_1 0 65535 /end CHARACTERISTIC
/begin CHARACTERISTIC FaultManager.Key_Off_Voltage_High.Action_1 "Fault manager configuration.  Select up to 4 actions for each fault." VALUE 0x8000105F RecordLayout_7 0 CompuMethod_483 0 65535 /end CHARACTERISTIC
/begin CHARACTERISTIC FaultManager.Key_Off_Voltage_High.Action_1_Condition "Fault manager configuration.  Select up to 4 actions for each fault." VALUE 0x80001061 RecordLayout_7 0 CompuMethod_484 0 65535 /end CHARACTERISTIC
/begin CHARACTERISTIC FaultManager.Key_Off_Voltage_High.Action_2 "Fault manager configuration.  Select up to 4 actions for each fault." VALUE 0x80001063 RecordLayout_7 0 CompuMethod_483 0 65535 /end CHARACTERISTIC
/begin CHARACTERISTIC FaultManager.Key_Off_Voltage_High.Action_2_Condition "Fault manager configuration.  Select up to 4 actions for each fault." VALUE 0x80001065 RecordLayout_7 0 CompuMethod_484 0 65535 /end CHARACTERISTIC
/begin CHARACTERISTIC FaultManager.Key_Off_Voltage_High.Action_3 "Fault manager configuration.  Select up to 4 actions for each fault." VALUE 0x80001067 RecordLayout_7 0 CompuMethod_483 0 65535 /end CHARACTERISTIC
/begin CHARACTERISTIC FaultManager.Key_Off_Voltage_High.Action_3_Condition "Fault manager configuration.  Select up to 4 actions for each fault." VALUE 0x80001069 RecordLayout_7 0 CompuMethod_484 0 65535 /end CHARACTERISTIC
/begin CHARACTERISTIC FaultManager.Key_Off_Voltage_High.Action_4 "Fault manager configuration.  Select up to 4 actions for each fault." VALUE 0x8000106B RecordLayout_7 0 CompuMethod_483 0 65535 /end CHARACTERISTIC
/begin CHARACTERISTIC FaultManager.Key_Off_Voltage_High.Action_4_Condition "Fault manager configuration.  Select up to 4 actions for each fault." VALUE 0x8000106D RecordLayout_7 0 CompuMethod_484 0 65535 /end CHARACTERISTIC
/begin CHARACTERISTIC FaultManager.Park_Nuetral_Switch_Input_Circuit.Mode "Fault manager configuration.  Select up to 4 actions for each fault." VALUE 0x8000106F RecordLayout_7 0 CompuMethod_481 0 65535 /end CHARACTERISTIC
/begin CHARACTERISTIC FaultManager.Park_Nuetral_Switch_Input_Circuit.ID "Fault manager configuration.  Select up to 4 actions for each fault." VALUE 0x80001071 RecordLayout_7 0 CompuMethod_1 0 65535 /end CHARACTERISTIC
/begin CHARACTERISTIC FaultManager.Park_Nuetral_Switch_Input_Circuit.Test "Fault manager configuration.  Select up to 4 actions for each fault." VALUE 0x80001073 RecordLayout_7 0 CompuMethod_482 0 65535 /end CHARACTERISTIC
/begin CHARACTERISTIC FaultManager.Park_Nuetral_Switch_Input_Circuit.Faulty_Samples__X_ "Fault manager configuration.  Select up to 4 actions for each fault." VALUE 0x80001075 RecordLayout_7 0 CompuMethod_1 0 65535 /end CHARACTERISTIC
/begin CHARACTERISTIC FaultManager.Park_Nuetral_Switch_Input_Circuit.Total_Samples__Y_ "Fault manager configuration.  Select up to 4 actions for each fault." VALUE 0x80001077 RecordLayout_7 0 CompuMethod_1 0 65535 /end CHARACTERISTIC
/begin CHARACTERISTIC FaultManager.Park_Nuetral_Switch_Input_Circuit.Action_1 "Fault manager configuration.  Select up to 4 actions for each fault." VALUE 0x80001079 RecordLayout_7 0 CompuMethod_483 0 65535 /end CHARACTERISTIC
/begin CHARACTERISTIC FaultManager.Park_Nuetral_Switch_Input_Circuit.Action_1_Condition "Fault manager configuration.  Select up to 4 actions for each fault." VALUE 0x8000107B RecordLayout_7 0 CompuMethod_484 0 65535 /end CHARACTERISTIC
/begin CHARACTERISTIC FaultManager.Park_Nuetral_Switch_Input_Circuit.Action_2 "Fault manager configuration.  Select up to 4 actions for each fault." VALUE 0x8000107D RecordLayout_7 0 CompuMethod_483 0 65535 /end CHARACTERISTIC
/begin CHARACTERISTIC FaultManager.Park_Nuetral_Switch_Input_Circuit.Action_2_Condition "Fault manager configuration.  Select up to 4 actions for each fault." VALUE 0x8000107F RecordLayout_7 0 CompuMethod_484 0 65535 /end CHARACTERISTIC
/begin CHARACTERISTIC FaultManager.Park_Nuetral_Switch_Input_Circuit.Action_3 "Fault manager configuration.  Select up to 4 actions for each fault." VALUE 0x80001081 RecordLayout_7 0 CompuMethod_483 0 65535 /end CHARACTERISTIC
/begin CHARACTERISTIC FaultManager.Park_Nuetral_Switch_Input_Circuit.Action_3_Condition "Fault manager configuration.  Select up to 4 actions for each fault." VALUE 0x80001083 RecordLayout_7 0 CompuMethod_484 0 65535 /end CHARACTERISTIC
/begin CHARACTERISTIC FaultManager.Park_Nuetral_Switch_Input_Circuit.Action_4 "Fault manager configuration.  Select up to 4 actions for each fault." VALUE 0x80001085 RecordLayout_7 0 CompuMethod_483 0 65535 /end CHARACTERISTIC
/begin CHARACTERISTIC FaultManager.Park_Nuetral_Switch_Input_Circuit.Action_4_Condition "Fault manager configuration.  Select up to 4 actions for each fault." VALUE 0x80001087 RecordLayout_7 0 CompuMethod_484 0 65535 /end CHARACTERISTIC
/begin CHARACTERISTIC FaultManager.Park_Nuetral_Switch_Input_High.Mode "Fault manager configuration.  Select up to 4 actions for each fault." VALUE 0x80001089 RecordLayout_7 0 CompuMethod_481 0 65535 /end CHARACTERISTIC
/begin CHARACTERISTIC FaultManager.Park_Nuetral_Switch_Input_High.ID "Fault manager configuration.  Select up to 4 actions for each fault." VALUE 0x8000108B RecordLayout_7 0 CompuMethod_1 0 65535 /end CHARACTERISTIC
/begin CHARACTERISTIC FaultManager.Park_Nuetral_Switch_Input_High.Test "Fault manager configuration.  Select up to 4 actions for each fault." VALUE 0x8000108D RecordLayout_7 0 CompuMethod_482 0 65535 /end CHARACTERISTIC
/begin CHARACTERISTIC FaultManager.Park_Nuetral_Switch_Input_High.Faulty_Samples__X_ "Fault manager configuration.  Select up to 4 actions for each fault." VALUE 0x8000108F RecordLayout_7 0 CompuMethod_1 0 65535 /end CHARACTERISTIC
/begin CHARACTERISTIC FaultManager.Park_Nuetral_Switch_Input_High.Total_Samples__Y_ "Fault manager configuration.  Select up to 4 actions for each fault." VALUE 0x80001091 RecordLayout_7 0 CompuMethod_1 0 65535 /end CHARACTERISTIC
/begin CHARACTERISTIC FaultManager.Park_Nuetral_Switch_Input_High.Action_1 "Fault manager configuration.  Select up to 4 actions for each fault." VALUE 0x80001093 RecordLayout_7 0 CompuMethod_483 0 65535 /end CHARACTERISTIC
/begin CHARACTERISTIC FaultManager.Park_Nuetral_Switch_Input_High.Action_1_Condition "Fault manager configuration.  Select up to 4 actions for each fault." VALUE 0x80001095 RecordLayout_7 0 CompuMethod_484 0 65535 /end CHARACTERISTIC
/begin CHARACTERISTIC FaultManager.Park_Nuetral_Switch_Input_High.Action_2 "Fault manager configuration.  Select up to 4 actions for each fault." VALUE 0x80001097 RecordLayout_7 0 CompuMethod_483 0 65535 /end CHARACTERISTIC
/begin CHARACTERISTIC FaultManager.Park_Nuetral_Switch_Input_High.Action_2_Condition "Fault manager configuration.  Select up to 4 actions for each fault." VALUE 0x80001099 RecordLayout_7 0 CompuMethod_484 0 65535 /end CHARACTERISTIC
/begin CHARACTERISTIC FaultManager.Park_Nuetral_Switch_Input_High.Action_3 "Fault manager configuration.  Select up to 4 actions for each fault." VALUE 0x8000109B RecordLayout_7 0 CompuMethod_483 0 65535 /end CHARACTERISTIC
/begin CHARACTERISTIC FaultManager.Park_Nuetral_Switch_Input_High.Action_3_Condition "Fault manager configuration.  Select up to 4 actions for each fault." VALUE 0x8000109D RecordLayout_7 0 CompuMethod_484 0 65535 /end CHARACTERISTIC
/begin CHARACTERISTIC FaultManager.Park_Nuetral_Switch_Input_High.Action_4 "Fault manager configuration.  Select up to 4 actions for each fault." VALUE 0x8000109F RecordLayout_7 0 CompuMethod_483 0 65535 /end CHARACTERISTIC
/begin CHARACTERISTIC FaultManager.Park_Nuetral_Switch_Input_High.Action_4_Condition "Fault manager configuration.  Select up to 4 actions for each fault." VALUE 0x800010A1 RecordLayout_7 0 CompuMethod_484 0 65535 /end CHARACTERISTIC
/begin CHARACTERISTIC FaultManager.Park_Nuetral_Switch_Input_Low.Mode "Fault manager configuration.  Select up to 4 actions for each fault." VALUE 0x800010A3 RecordLayout_7 0 CompuMethod_481 0 65535 /end CHARACTERISTIC
/begin CHARACTERISTIC FaultManager.Park_Nuetral_Switch_Input_Low.ID "Fault manager configuration.  Select up to 4 actions for each fault." VALUE 0x800010A5 RecordLayout_7 0 CompuMethod_1 0 65535 /end CHARACTERISTIC
/begin CHARACTERISTIC FaultManager.Park_Nuetral_Switch_Input_Low.Test "Fault manager configuration.  Select up to 4 actions for each fault." VALUE 0x800010A7 RecordLayout_7 0 CompuMethod_482 0 65535 /end CHARACTERISTIC
/begin CHARACTERISTIC FaultManager.Park_Nuetral_Switch_Input_Low.Faulty_Samples__X_ "Fault manager configuration.  Select up to 4 actions for each fault." VALUE 0x800010A9 RecordLayout_7 0 CompuMethod_1 0 65535 /end CHARACTERISTIC
/begin CHARACTERISTIC FaultManager.Park_Nuetral_Switch_Input_Low.Total_Samples__Y_ "Fault manager configuration.  Select up to 4 actions for each fault." VALUE 0x800010AB RecordLayout_7 0 CompuMethod_1 0 65535 /end CHARACTERISTIC
/begin CHARACTERISTIC FaultManager.Park_Nuetral_Switch_Input_Low.Action_1 "Fault manager configuration.  Select up to 4 actions for each fault." VALUE 0x800010AD RecordLayout_7 0 CompuMethod_483 0 65535 /end CHARACTERISTIC
/begin CHARACTERISTIC FaultManager.Park_Nuetral_Switch_Input_Low.Action_1_Condition "Fault manager configuration.  Select up to 4 actions for each fault." VALUE 0x800010AF RecordLayout_7 0 CompuMethod_484 0 65535 /end CHARACTERISTIC
/begin CHARACTERISTIC FaultManager.Park_Nuetral_Switch_Input_Low.Action_2 "Fault manager configuration.  Select up to 4 actions for each fault." VALUE 0x800010B1 RecordLayout_7 0 CompuMethod_483 0 65535 /end CHARACTERISTIC
/begin CHARACTERISTIC FaultManager.Park_Nuetral_Switch_Input_Low.Action_2_Condition "Fault manager configuration.  Select up to 4 actions for each fault." VALUE 0x800010B3 RecordLayout_7 0 CompuMethod_484 0 65535 /end CHARACTERISTIC
/begin CHARACTERISTIC FaultManager.Park_Nuetral_Switch_Input_Low.Action_3 "Fault manager configuration.  Select up to 4 actions for each fault." VALUE 0x800010B5 RecordLayout_7 0 CompuMethod_483 0 65535 /end CHARACTERISTIC
/begin CHARACTERISTIC FaultManager.Park_Nuetral_Switch_Input_Low.Action_3_Condition "Fault manager configuration.  Select up to 4 actions for each fault." VALUE 0x800010B7 RecordLayout_7 0 CompuMethod_484 0 65535 /end CHARACTERISTIC
/begin CHARACTERISTIC FaultManager.Park_Nuetral_Switch_Input_Low.Action_4 "Fault manager configuration.  Select up to 4 actions for each fault." VALUE 0x800010B9 RecordLayout_7 0 CompuMethod_483 0 65535 /end CHARACTERISTIC
/begin CHARACTERISTIC FaultManager.Park_Nuetral_Switch_Input_Low.Action_4_Condition "Fault manager configuration.  Select up to 4 actions for each fault." VALUE 0x800010BB RecordLayout_7 0 CompuMethod_484 0 65535 /end CHARACTERISTIC
/begin CHARACTERISTIC FaultManager.Pedal_Position_Sensor_A_Circuit_High.Mode "Fault manager configuration.  Select up to 4 actions for each fault." VALUE 0x800010BD RecordLayout_7 0 CompuMethod_481 0 65535 /end CHARACTERISTIC
/begin CHARACTERISTIC FaultManager.Pedal_Position_Sensor_A_Circuit_High.ID "Fault manager configuration.  Select up to 4 actions for each fault." VALUE 0x800010BF RecordLayout_7 0 CompuMethod_1 0 65535 /end CHARACTERISTIC
/begin CHARACTERISTIC FaultManager.Pedal_Position_Sensor_A_Circuit_High.Test "Fault manager configuration.  Select up to 4 actions for each fault." VALUE 0x800010C1 RecordLayout_7 0 CompuMethod_482 0 65535 /end CHARACTERISTIC
/begin CHARACTERISTIC FaultManager.Pedal_Position_Sensor_A_Circuit_High.Faulty_Samples__X_ "Fault manager configuration.  Select up to 4 actions for each fault." VALUE 0x800010C3 RecordLayout_7 0 CompuMethod_1 0 65535 /end CHARACTERISTIC
/begin CHARACTERISTIC FaultManager.Pedal_Position_Sensor_A_Circuit_High.Total_Samples__Y_ "Fault manager configuration.  Select up to 4 actions for each fault." VALUE 0x800010C5 RecordLayout_7 0 CompuMethod_1 0 65535 /end CHARACTERISTIC
/begin CHARACTERISTIC FaultManager.Pedal_Position_Sensor_A_Circuit_High.Action_1 "Fault manager configuration.  Select up to 4 actions for each fault." VALUE 0x800010C7 RecordLayout_7 0 CompuMethod_483 0 65535 /end CHARACTERISTIC
/begin CHARACTERISTIC FaultManager.Pedal_Position_Sensor_A_Circuit_High.Action_1_Condition "Fault manager configuration.  Select up to 4 actions for each fault." VALUE 0x800010C9 RecordLayout_7 0 CompuMethod_484 0 65535 /end CHARACTERISTIC
/begin CHARACTERISTIC FaultManager.Pedal_Position_Sensor_A_Circuit_High.Action_2 "Fault manager configuration.  Select up to 4 actions for each fault." VALUE 0x800010CB RecordLayout_7 0 CompuMethod_483 0 65535 /end CHARACTERISTIC
/begin CHARACTERISTIC FaultManager.Pedal_Position_Sensor_A_Circuit_High.Action_2_Condition "Fault manager configuration.  Select up to 4 actions for each fault." VALUE 0x800010CD RecordLayout_7 0 CompuMethod_484 0 65535 /end CHARACTERISTIC
/begin CHARACTERISTIC FaultManager.Pedal_Position_Sensor_A_Circuit_High.Action_3 "Fault manager configuration.  Select up to 4 actions for each fault." VALUE 0x800010CF RecordLayout_7 0 CompuMethod_483 0 65535 /end CHARACTERISTIC
/begin CHARACTERISTIC FaultManager.Pedal_Position_Sensor_A_Circuit_High.Action_3_Condition "Fault manager configuration.  Select up to 4 actions for each fault." VALUE 0x800010D1 RecordLayout_7 0 CompuMethod_484 0 65535 /end CHARACTERISTIC
/begin CHARACTERISTIC FaultManager.Pedal_Position_Sensor_A_Circuit_High.Action_4 "Fault manager configuration.  Select up to 4 actions for each fault." VALUE 0x800010D3 RecordLayout_7 0 CompuMethod_483 0 65535 /end CHARACTERISTIC
/begin RECORD_LAYOUT RecordLayout_7 FNC_VALUES 1 UWORD ROW_DIR DIRECT /end RECORD_LAYOUT
/*~~~~~~~~~ 6.3.31 COMPU_METHODs ~~~~~~~~~*/
/begin COMPU_METHOD CompuMethod_1 "" RAT_FUNC "%3.0" "" COEFFS 0 1 0 0 0 1 /end COMPU_METHOD
/begin COMPU_METHOD CompuMethod_481 "" TAB_VERB "%3.0" "" COMPU_TAB_REF CompuVtab_467 /end COMPU_METHOD
/begin COMPU_METHOD CompuMethod_482 "" TAB_VERB "%3.0" "" COMPU_TAB_REF CompuVtab_468 /end COMPU_METHOD
/begin COMPU_METHOD CompuMethod_483 "" TAB_VERB "%3.0" "" COMPU_TAB_REF CompuVtab_469 /end COMPU_METHOD
/begin COMPU_METHOD CompuMethod_484 "" TAB_VERB "%3.0" "" COMPU_TAB_REF CompuVtab_470 /end COMPU_METHOD
/begin COMPU_VTAB CompuVtab_467 "" TAB_VERB 6 0 "Disabled" 1 "Enabled" 2 "Sticky" 3 "Enabled - Persistent" 4 "Sticky - Persistent" 5 "Save Occurred" /end COMPU_VTAB
/begin COMPU_VTAB CompuVtab_468 "" TAB_VERB 2 0 "-" 1 "Test" /end COMPU_VTAB
/begin COMPU_VTAB CompuVtab_469 "" TAB_VERB 17 0 "Batt_Light" 1 "Batt_Shutdown" 2 "Cell_Voltage_Max" 3 "Check_Engine_Light" 4 "Check_Engine_Light_Flashing" 5 "Cooling_Max" 6 "Cruise" 7 "Dyno_Shutdown" 8 "EatonChargerFault" 9 "HV_Light" 10 "Pump_On" 11 "Regen_Brakes_Disabled" 12 "Set_Crawl_Home" 13 "Temperature_Flash" 14 "Temperature_Solid" 15 "Wrench_Light" 16 "(None)" /end COMPU_VTAB
/begin COMPU_VTAB CompuVtab_470 "" TAB_VERB 8 0 "(None)" 1 "Suspected" 2 "Active" 3 "Suspected or Active" 4 "Occurred" 5 "Suspected or Occurred" 6 "Active or Occurred" 7 "Suspected or Active or Occurred" /end COMPU_VTAB
/begin FUNCTION Faults_1 ""
 /begin DEF_CHARACTERISTIC FaultManager.Cruise_Control_Coast_Signal_Malfunction.Action_4 FaultManager.Cruise_Control_Coast_Signal_Malfunction.Action_4_Condition FaultManager.Cruise_Control_Off_Signal_Malfunction.Mode FaultManager.Cruise_Control_Off_Signal_Malfunction.ID FaultManager.Cruise_Control_Off_Signal_Malfunction.Test FaultManager.Cruise_Control_Off_Signal_Malfunction.Faulty_Samples__X_ FaultManager.Cruise_Control_Off_Signal_Malfunction.Total_Samples__Y_ FaultManager.Cruise_Control_Off_Signal_Malfunction.Action_1 FaultManager.Cruise_Control_Off_Signal_Malfunction.Action_1_Condition FaultManager.Cruise_Control_Off_Signal_Malfunction.Action_2 FaultManager.Cruise_Control_Off_Signal_Malfunction.Action_2_Condition FaultManager.Cruise_Control_Off_Signal_Malfunction.Action_3 FaultManager.Cruise_Control_Off_Signal_Malfunction.Action_3_Condition FaultManager.Cruise_Control_Off_Signal_Malfunction.Action_4 FaultManager.Cruise_Control_Off_Signal_Malfunction.Action_4_Condition FaultManager.Cruise_Control_On_Signal_Malfunction.Mode FaultManager.Cruise_Control_On_Signal_Malfunction.ID FaultManager.Cruise_Control_On_Signal_Malfunction.Test FaultManager.Cruise_Control_On_Signal_Malfunction.Faulty_Samples__X_ FaultManager.Cruise_Control_On_Signal_Malfunction.Total_Samples__Y_ FaultManager.Cruise_Control_On_Signal_Malfunction.Action_1 FaultManager.Cruise_Control_On_Signal_Malfunction.Action_1_Condition FaultManager.Cruise_Control_On_Signal_Malfunction.Action_2 FaultManager.Cruise_Control_On_Signal_Malfunction.Action_2_Condition FaultManager.Cruise_Control_On_Signal_Malfunction.Action_3 FaultManager.Cruise_Control_On_Signal_Malfunction.Action_3_Condition FaultManager.Cruise_Control_On_Signal_Malfunction.Action_4 FaultManager.Cruise_Control_On_Signal_Malfunction.Action_4_Condition FaultManager.Cruise_Control_Resume_Signal_Malfunction.Mode FaultManager.Cruise_Control_Resume_Signal_Malfunction.ID FaultManager.Cruise_Control_Resume_Signal_Malfunction.Test FaultManager.Cruise_Control_Resume_Signal_Malfunction.Faulty_Samples__X_ FaultManager.Cruise_Control_Resume_Signal_Malfunction.Total_Samples__Y_ FaultManager.Cruise_Control_Resume_Signal_Malfunction.Action_1 FaultManager.Cruise_Control_Resume_Signal_Malfunction.Action_1_Condition FaultManager.Cruise_Control_Resume_Signal_Malfunction.Action_2 FaultManager.Cruise_Control_Resume_Signal_Malfunction.Action_2_Condition FaultManager.Cruise_Control_Resume_Signal_Malfunction.Action_3 FaultManager.Cruise_Control_Resume_Signal_Malfunction.Action_3_Condition FaultManager.Cruise_Control_Resume_Signal_Malfunction.Action_4 FaultManager.Cruise_Control_Resume_Signal_Malfunction.Action_4_Condition FaultManager.Cruise_Control_Set_Signal_Malfunction.Mode FaultManager.Cruise_Control_Set_Signal_Malfunction.ID FaultManager.Cruise_Control_Set_Signal_Malfunction.Test FaultManager.Cruise_Control_Set_Signal_Malfunction.Faulty_Samples__X_ FaultManager.Cruise_Control_Set_Signal_Malfunction.Total_Samples__Y_ FaultManager.Cruise_Control_Set_Signal_Malfunction.Action_1 FaultManager.Cruise_Control_Set_Signal_Malfunction.Action_1_Condition FaultManager.Cruise_Control_Set_Signal_Malfunction.Action_2 FaultManager.Cruise_Control_Set_Signal_Malfunction.Action_2_Condition FaultManager.Cruise_Control_Set_Signal_Malfunction.Action_3 FaultManager.Cruise_Control_Set_Signal_Malfunction.Action_3_Condition FaultManager.Cruise_Control_Set_Signal_Malfunction.Action_4 FaultManager.Cruise_Control_Set_Signal_Malfunction.Action_4_Condition FaultManager.DCDC_Converter_Not_Running.Mode FaultManager.DCDC_Converter_Not_Running.ID FaultManager.DCDC_Converter_Not_Running.Test FaultManager.DCDC_Converter_Not_Running.Faulty_Samples__X_ FaultManager.DCDC_Converter_Not_Running.Total_Samples__Y_ FaultManager.DCDC_Converter_Not_Running.Action_1 FaultManager.DCDC_Converter_Not_Running.Action_1_Condition FaultManager.DCDC_Converter_Not_Running.Action_2 FaultManager.DCDC_Converter_Not_Running.Action_2_Condition FaultManager.DCDC_Converter_Not_Running.Action_3 FaultManager.DCDC_Converter_Not_Running.Action_3_Condition FaultManager.DCDC_Converter_Not_Running.Action_4 FaultManager.DCDC_Converter_Not_Running.Action_4_Condition FaultManager.Drive_Switch_Input_Circuit.Mode FaultManager.Drive_Switch_Input_Circuit.ID FaultManager.Drive_Switch_Input_Circuit.Test FaultManager.Drive_Switch_Input_Circuit.Faulty_Samples__X_ FaultManager.Drive_Switch_Input_Circuit.Total_Samples__Y_ FaultManager.Drive_Switch_Input_Circuit.Action_1 FaultManager.Drive_Switch_Input_Circuit.Action_1_Condition FaultManager.Drive_Switch_Input_Circuit.Action_2 FaultManager.Drive_Switch_Input_Circuit.Action_2_Condition FaultManager.Drive_Switch_Input_Circuit.Action_3 FaultManager.Drive_Switch_Input_Circuit.Action_3_Condition FaultManager.Drive_Switch_Input_Circuit.Action_4 FaultManager.Drive_Switch_Input_Circuit.Action_4_Condition FaultManager.Drive_Switch_Input_High.Mode FaultManager.Drive_Switch_Input_High.ID FaultManager.Drive_Switch_Input_High.Test FaultManager.Drive_Switch_Input_High.Faulty_Samples__X_ FaultManager.Drive_Switch_Input_High.Total_Samples__Y_ FaultManager.Drive_Switch_Input_High.Action_1 FaultManager.Drive_Switch_Input_High.Action_1_Condition FaultManager.Drive_Switch_Input_High.Action_2 FaultManager.Drive_Switch_Input_High.Action_2_Condition FaultManager.Drive_Switch_Input_High.Action_3 FaultManager.Drive_Switch_Input_High.Action_3_Condition FaultManager.Drive_Switch_Input_High.Action_4 FaultManager.Drive_Switch_Input_High.Action_4_Condition FaultManager.Drive_Switch_Input_Low.Mode FaultManager.Drive_Switch_Input_Low.ID FaultManager.Drive_Switch_Input_Low.Test FaultManager.Drive_Switch_Input_Low.Faulty_Samples__X_ FaultManager.Drive_Switch_Input_Low.Total_Samples__Y_ FaultManager.Drive_Switch_Input_Low.Action_1 FaultManager.Drive_Switch_Input_Low.Action_1_Condition FaultManager.Drive_Switch_Input_Low.Action_2 FaultManager.Drive_Switch_Input_Low.Action_2_Condition FaultManager.Drive_Switch_Input_Low.Action_3 FaultManager.Drive_Switch_Input_Low.Action_3_Condition FaultManager.Drive_Switch_Input_Low.Action_4 FaultManager.Drive_Switch_Input_Low.Action_4_Condition FaultManager.Eaton_Charger_AgeCount.Mode FaultManager.Eaton_Charger_AgeCount.ID FaultManager.Eaton_Charger_AgeCount.Test FaultManager.Eaton_Charger_AgeCount.Faulty_Samples__X_ FaultManager.Eaton_Charger_AgeCount.Total_Samples__Y_ FaultManager.Eaton_Charger_AgeCount.Action_1 FaultManager.Eaton_Charger_AgeCount.Action_1_Condition FaultManager.Eaton_Charger_AgeCount.Action_2 FaultManager.Eaton_Charger_AgeCount.Action_2_Condition FaultManager.Eaton_Charger_AgeCount.Action_3 FaultManager.Eaton_Charger_AgeCount.Action_3_Condition FaultManager.Eaton_Charger_AgeCount.Action_4 FaultManager.Eaton_Charger_AgeCount.Action_4_Condition FaultManager.Electric_Motor_Approaching_Over_Temperature.Mode FaultManager.Electric_Motor_Approaching_Over_Temperature.ID FaultManager.Electric_Motor_Approaching_Over_Temperature.Test FaultManager.Electric_Motor_Approaching_Over_Temperature.Faulty_Samples__X_ FaultManager.Electric_Motor_Approaching_Over_Temperature.Total_Samples__Y_ FaultManager.Electric_Motor_Approaching_Over_Temperature.Action_1 FaultManager.Electric_Motor_Approaching_Over_Temperature.Action_1_Condition FaultManager.Electric_Motor_Approaching_Over_Temperature.Action_2 FaultManager.Electric_Motor_Approaching_Over_Temperature.Action_2_Condition FaultManager.Electric_Motor_Approaching_Over_Temperature.Action_3 FaultManager.Electric_Motor_Approaching_Over_Temperature.Action_3_Condition FaultManager.Electric_Motor_Approaching_Over_Temperature.Action_4 FaultManager.Electric_Motor_Approaching_Over_Temperature.Action_4_Condition FaultManager.Electric_Motor_Derated_Over_Temperature.Mode FaultManager.Electric_Motor_Derated_Over_Temperature.ID FaultManager.Electric_Motor_Derated_Over_Temperature.Test FaultManager.Electric_Motor_Derated_Over_Temperature.Faulty_Samples__X_ FaultManager.Electric_Motor_Derated_Over_Temperature.Total_Samples__Y_ FaultManager.Electric_Motor_Derated_Over_Temperature.Action_1 FaultManager.Electric_Motor_Derated_Over_Temperature.Action_1_Condition FaultManager.Electric_Motor_Derated_Over_Temperature.Action_2 FaultManager.Electric_Motor_Derated_Over_Temperature.Action_2_Condition FaultManager.Electric_Motor_Derated_Over_Temperature.Action_3 FaultManager.Electric_Motor_Derated_Over_Temperature.Action_3_Condition FaultManager.Electric_Motor_Derated_Over_Temperature.Action_4 FaultManager.Electric_Motor_Derated_Over_Temperature.Action_4_Condition FaultManager.Electric_Motor_Derated_Over_Voltage.Mode FaultManager.Electric_Motor_Derated_Over_Voltage.ID FaultManager.Electric_Motor_Derated_Over_Voltage.Test FaultManager.Electric_Motor_Derated_Over_Voltage.Faulty_Samples__X_ FaultManager.Electric_Motor_Derated_Over_Voltage.Total_Samples__Y_ FaultManager.Electric_Motor_Derated_Over_Voltage.Action_1 FaultManager.Electric_Motor_Derated_Over_Voltage.Action_1_Condition FaultManager.Electric_Motor_Derated_Over_Voltage.Action_2 FaultManager.Electric_Motor_Derated_Over_Voltage.Action_2_Condition FaultManager.Electric_Motor_Derated_Over_Voltage.Action_3 FaultManager.Electric_Motor_Derated_Over_Voltage.Action_3_Condition FaultManager.Electric_Motor_Derated_Over_Voltage.Action_4 FaultManager.Electric_Motor_Derated_Over_Voltage.Action_4_Condition FaultManager.Electric_Motor_Derated_Under_Temperature.Mode FaultManager.Electric_Motor_Derated_Under_Temperature.ID FaultManager.Electric_Motor_Derated_Under_Temperature.Test FaultManager.Electric_Motor_Derated_Under_Temperature.Faulty_Samples__X_ FaultManager.Electric_Motor_Derated_Under_Temperature.Total_Samples__Y_ FaultManager.Electric_Motor_Derated_Under_Temperature.Action_1 FaultManager.Electric_Motor_Derated_Under_Temperature.Action_1_Condition FaultManager.Electric_Motor_Derated_Under_Temperature.Action_2 FaultManager.Electric_Motor_Derated_Under_Temperature.Action_2_Condition FaultManager.Electric_Motor_Derated_Under_Temperature.Action_3 FaultManager.Electric_Motor_Derated_Under_Temperature.Action_3_Condition FaultManager.Electric_Motor_Derated_Under_Temperature.Action_4 FaultManager.Electric_Motor_Derated_Under_Temperature.Action_4_Condition FaultManager.Electric_Motor_Derated_Under_Voltage.Mode FaultManager.Electric_Motor_Derated_Under_Voltage.ID FaultManager.Electric_Motor_Derated_Under_Voltage.Test FaultManager.Electric_Motor_Derated_Under_Voltage.Faulty_Samples__X_ FaultManager.Electric_Motor_Derated_Under_Voltage.Total_Samples__Y_ FaultManager.Electric_Motor_Derated_Under_Voltage.Action_1 FaultManager.Electric_Motor_Derated_Under_Voltage.Action_1_Condition FaultManager.Electric_Motor_Derated_Under_Voltage.Action_2 FaultManager.Electric_Motor_Derated_Under_Voltage.Action_2_Condition FaultManager.Electric_Motor_Derated_Under_Voltage.Action_3 FaultManager.Electric_Motor_Derated_Under_Voltage.Action_3_Condition FaultManager.Electric_Motor_Derated_Under_Voltage.Action_4 FaultManager.Electric_Motor_Derated_Under_Voltage.Action_4_Condition FaultManager.Electric_Motor_General_Error.Mode FaultManager.Electric_Motor_General_Error.ID FaultManager.Electric_Motor_General_Error.Test FaultManager.Electric_Motor_General_Error.Faulty_Samples__X_ FaultManager.Electric_Motor_General_Error.Total_Samples__Y_ FaultManager.Electric_Motor_General_Error.Action_1 FaultManager.Electric_Motor_General_Error.Action_1_Condition FaultManager.Electric_Motor_General_Error.Action_2 FaultManager.Electric_Motor_General_Error.Action_2_Condition FaultManager.Electric_Motor_General_Error.Action_3 FaultManager.Electric_Motor_General_Error.Action_3_Condition FaultManager.Electric_Motor_General_Error.Action_4 FaultManager.Electric_Motor_General_Error.Action_4_Condition FaultManager.Electric_Motor_Over_Speed_Forward.Mode FaultManager.Electric_Motor_Over_Speed_Forward.ID FaultManager.Electric_Motor_Over_Speed_Forward.Test FaultManager.Electric_Motor_Over_Speed_Forward.Faulty_Samples__X_ FaultManager.Electric_Motor_Over_Speed_Forward.Total_Samples__Y_ FaultManager.Electric_Motor_Over_Speed_Forward.Action_1 FaultManager.Electric_Motor_Over_Speed_Forward.Action_1_Condition FaultManager.Electric_Motor_Over_Speed_Forward.Action_2 FaultManager.Electric_Motor_Over_Speed_Forward.Action_2_Condition FaultManager.Electric_Motor_Over_Speed_Forward.Action_3 FaultManager.Electric_Motor_Over_Speed_Forward.Action_3_Condition FaultManager.Electric_Motor_Over_Speed_Forward.Action_4 FaultManager.Electric_Motor_Over_Speed_Forward.Action_4_Condition FaultManager.Electric_Motor_Over_Speed_Reverse.Mode FaultManager.Electric_Motor_Over_Speed_Reverse.ID FaultManager.Electric_Motor_Over_Speed_Reverse.Test FaultManager.Electric_Motor_Over_Speed_Reverse.Faulty_Samples__X_ FaultManager.Electric_Motor_Over_Speed_Reverse.Total_Samples__Y_ FaultManager.Electric_Motor_Over_Speed_Reverse.Action_1 FaultManager.Electric_Motor_Over_Speed_Reverse.Action_1_Condition FaultManager.Electric_Motor_Over_Speed_Reverse.Action_2 FaultManager.Electric_Motor_Over_Speed_Reverse.Action_2_Condition FaultManager.Electric_Motor_Over_Speed_Reverse.Action_3 FaultManager.Electric_Motor_Over_Speed_Reverse.Action_3_Condition FaultManager.Electric_Motor_Over_Speed_Reverse.Action_4 FaultManager.Electric_Motor_Over_Speed_Reverse.Action_4_Condition FaultManager.Electric_Motor_Shutodwn_Error.Mode FaultManager.Electric_Motor_Shutodwn_Error.ID FaultManager.Electric_Motor_Shutodwn_Error.Test FaultManager.Electric_Motor_Shutodwn_Error.Faulty_Samples__X_ FaultManager.Electric_Motor_Shutodwn_Error.Total_Samples__Y_ FaultManager.Electric_Motor_Shutodwn_Error.Action_1 FaultManager.Electric_Motor_Shutodwn_Error.Action_1_Condition FaultManager.Electric_Motor_Shutodwn_Error.Action_2 FaultManager.Electric_Motor_Shutodwn_Error.Action_2_Condition FaultManager.Electric_Motor_Shutodwn_Error.Action_3 FaultManager.Electric_Motor_Shutodwn_Error.Action_3_Condition FaultManager.Electric_Motor_Shutodwn_Error.Action_4 FaultManager.Electric_Motor_Shutodwn_Error.Action_4_Condition FaultManager.Electric_Motor_Torque_Output_Fault.Mode FaultManager.Electric_Motor_Torque_Output_Fault.ID FaultManager.Electric_Motor_Torque_Output_Fault.Test FaultManager.Electric_Motor_Torque_Output_Fault.Faulty_Samples__X_ FaultManager.Electric_Motor_Torque_Output_Fault.Total_Samples__Y_ FaultManager.Electric_Motor_Torque_Output_Fault.Action_1 FaultManager.Electric_Motor_Torque_Output_Fault.Action_1_Condition FaultManager.Electric_Motor_Torque_Output_Fault.Action_2 FaultManager.Electric_Motor_Torque_Output_Fault.Action_2_Condition FaultManager.Electric_Motor_Torque_Output_Fault.Action_3 FaultManager.Electric_Motor_Torque_Output_Fault.Action_3_Condition FaultManager.Electric_Motor_Torque_Output_Fault.Action_4 FaultManager.Electric_Motor_Torque_Output_Fault.Action_4_Condition FaultManager.Gear_Shift_Communication_Circuit.Mode FaultManager.Gear_Shift_Communication_Circuit.ID FaultManager.Gear_Shift_Communication_Circuit.Test FaultManager.Gear_Shift_Communication_Circuit.Faulty_Samples__X_ FaultManager.Gear_Shift_Communication_Circuit.Total_Samples__Y_ FaultManager.Gear_Shift_Communication_Circuit.Action_1 FaultManager.Gear_Shift_Communication_Circuit.Action_1_Condition FaultManager.Gear_Shift_Communication_Circuit.Action_2 FaultManager.Gear_Shift_Communication_Circuit.Action_2_Condition FaultManager.Gear_Shift_Communication_Circuit.Action_3 FaultManager.Gear_Shift_Communication_Circuit.Action_3_Condition FaultManager.Gear_Shift_Communication_Circuit.Action_4 FaultManager.Gear_Shift_Communication_Circuit.Action_4_Condition FaultManager.HV_Battery_2G_BMS_Fault.Mode FaultManager.HV_Battery_2G_BMS_Fault.ID FaultManager.HV_Battery_2G_BMS_Fault.Test FaultManager.HV_Battery_2G_BMS_Fault.Faulty_Samples__X_ FaultManager.HV_Battery_2G_BMS_Fault.Total_Samples__Y_ FaultManager.HV_Battery_2G_BMS_Fault.Action_1 FaultManager.HV_Battery_2G_BMS_Fault.Action_1_Condition FaultManager.HV_Battery_2G_BMS_Fault.Action_2 FaultManager.HV_Battery_2G_BMS_Fault.Action_2_Condition FaultManager.HV_Battery_2G_BMS_Fault.Action_3 FaultManager.HV_Battery_2G_BMS_Fault.Action_3_Condition FaultManager.HV_Battery_2G_BMS_Fault.Action_4 FaultManager.HV_Battery_2G_BMS_Fault.Action_4_Condition FaultManager.HV_Battery_48_Controller_Communication_Fault.Mode FaultManager.HV_Battery_48_Controller_Communication_Fault.ID FaultManager.HV_Battery_48_Controller_Communication_Fault.Test FaultManager.HV_Battery_48_Controller_Communication_Fault.Faulty_Samples__X_ FaultManager.HV_Battery_48_Controller_Communication_Fault.Total_Samples__Y_ FaultManager.HV_Battery_48_Controller_Communication_Fault.Action_1 FaultManager.HV_Battery_48_Controller_Communication_Fault.Action_1_Condition FaultManager.HV_Battery_48_Controller_Communication_Fault.Action_2 FaultManager.HV_Battery_48_Controller_Communication_Fault.Action_2_Condition FaultManager.HV_Battery_48_Controller_Communication_Fault.Action_3 FaultManager.HV_Battery_48_Controller_Communication_Fault.Action_3_Condition FaultManager.HV_Battery_48_Controller_Communication_Fault.Action_4 FaultManager.HV_Battery_48_Controller_Communication_Fault.Action_4_Condition FaultManager.HV_Battery_Above_Safe_Charge_Point.Mode FaultManager.HV_Battery_Above_Safe_Charge_Point.ID FaultManager.HV_Battery_Above_Safe_Charge_Point.Test FaultManager.HV_Battery_Above_Safe_Charge_Point.Faulty_Samples__X_ FaultManager.HV_Battery_Above_Safe_Charge_Point.Total_Samples__Y_ FaultManager.HV_Battery_Above_Safe_Charge_Point.Action_1 FaultManager.HV_Battery_Above_Safe_Charge_Point.Action_1_Condition FaultManager.HV_Battery_Above_Safe_Charge_Point.Action_2 FaultManager.HV_Battery_Above_Safe_Charge_Point.Action_2_Condition FaultManager.HV_Battery_Above_Safe_Charge_Point.Action_3 FaultManager.HV_Battery_Above_Safe_Charge_Point.Action_3_Condition FaultManager.HV_Battery_Above_Safe_Charge_Point.Action_4 FaultManager.HV_Battery_Above_Safe_Charge_Point.Action_4_Condition FaultManager.HV_Battery_Cell_Balancing_Required_Fault.Mode FaultManager.HV_Battery_Cell_Balancing_Required_Fault.ID FaultManager.HV_Battery_Cell_Balancing_Required_Fault.Test FaultManager.HV_Battery_Cell_Balancing_Required_Fault.Faulty_Samples__X_ FaultManager.HV_Battery_Cell_Balancing_Required_Fault.Total_Samples__Y_ FaultManager.HV_Battery_Cell_Balancing_Required_Fault.Action_1 FaultManager.HV_Battery_Cell_Balancing_Required_Fault.Action_1_Condition FaultManager.HV_Battery_Cell_Balancing_Required_Fault.Action_2 FaultManager.HV_Battery_Cell_Balancing_Required_Fault.Action_2_Condition FaultManager.HV_Battery_Cell_Balancing_Required_Fault.Action_3 FaultManager.HV_Battery_Cell_Balancing_Required_Fault.Action_3_Condition FaultManager.HV_Battery_Cell_Balancing_Required_Fault.Action_4 FaultManager.HV_Battery_Cell_Balancing_Required_Fault.Action_4_Condition FaultManager.HV_Battery_Pack_Above_Operating_Temperature.Mode FaultManager.HV_Battery_Pack_Above_Operating_Temperature.ID FaultManager.HV_Battery_Pack_Above_Operating_Temperature.Test FaultManager.HV_Battery_Pack_Above_Operating_Temperature.Faulty_Samples__X_ FaultManager.HV_Battery_Pack_Above_Operating_Temperature.Total_Samples__Y_ FaultManager.HV_Battery_Pack_Above_Operating_Temperature.Action_1 FaultManager.HV_Battery_Pack_Above_Operating_Temperature.Action_1_Condition FaultManager.HV_Battery_Pack_Above_Operating_Temperature.Action_2 FaultManager.HV_Battery_Pack_Above_Operating_Temperature.Action_2_Condition FaultManager.HV_Battery_Pack_Above_Operating_Temperature.Action_3 FaultManager.HV_Battery_Pack_Above_Operating_Temperature.Action_3_Condition FaultManager.HV_Battery_Pack_Above_Operating_Temperature.Action_4 FaultManager.HV_Battery_Pack_Above_Operating_Temperature.Action_4_Condition FaultManager.HV_Battery_Pack_Below_Operating_Temperature.Mode FaultManager.HV_Battery_Pack_Below_Operating_Temperature.ID FaultManager.HV_Battery_Pack_Below_Operating_Temperature.Test FaultManager.HV_Battery_Pack_Below_Operating_Temperature.Faulty_Samples__X_ FaultManager.HV_Battery_Pack_Below_Operating_Temperature.Total_Samples__Y_ FaultManager.HV_Battery_Pack_Below_Operating_Temperature.Action_1 FaultManager.HV_Battery_Pack_Below_Operating_Temperature.Action_1_Condition FaultManager.HV_Battery_Pack_Below_Operating_Temperature.Action_2 FaultManager.HV_Battery_Pack_Below_Operating_Temperature.Action_2_Condition FaultManager.HV_Battery_Pack_Below_Operating_Temperature.Action_3 FaultManager.HV_Battery_Pack_Below_Operating_Temperature.Action_3_Condition FaultManager.HV_Battery_Pack_Below_Operating_Temperature.Action_4 FaultManager.HV_Battery_Pack_Below_Operating_Temperature.Action_4_Condition FaultManager.HV_Battery_Pack_High_Temperature.Mode FaultManager.HV_Battery_Pack_High_Temperature.ID FaultManager.HV_Battery_Pack_High_Temperature.Test FaultManager.HV_Battery_Pack_High_Temperature.Faulty_Samples__X_ FaultManager.HV_Battery_Pack_High_Temperature.Total_Samples__Y_ FaultManager.HV_Battery_Pack_High_Temperature.Action_1 FaultManager.HV_Battery_Pack_High_Temperature.Action_1_Condition FaultManager.HV_Battery_Pack_High_Temperature.Action_2 FaultManager.HV_Battery_Pack_High_Temperature.Action_2_Condition FaultManager.HV_Battery_Pack_High_Temperature.Action_3 FaultManager.HV_Battery_Pack_High_Temperature.Action_3_Condition FaultManager.HV_Battery_Pack_High_Temperature.Action_4 FaultManager.HV_Battery_Pack_High_Temperature.Action_4_Condition FaultManager.HV_Battery_Pack_Low_Temperature.Mode FaultManager.HV_Battery_Pack_Low_Temperature.ID FaultManager.HV_Battery_Pack_Low_Temperature.Test FaultManager.HV_Battery_Pack_Low_Temperature.Faulty_Samples__X_ FaultManager.HV_Battery_Pack_Low_Temperature.Total_Samples__Y_ FaultManager.HV_Battery_Pack_Low_Temperature.Action_1 FaultManager.HV_Battery_Pack_Low_Temperature.Action_1_Condition FaultManager.HV_Battery_Pack_Low_Temperature.Action_2 FaultManager.HV_Battery_Pack_Low_Temperature.Action_2_Condition FaultManager.HV_Battery_Pack_Low_Temperature.Action_3 FaultManager.HV_Battery_Pack_Low_Temperature.Action_3_Condition FaultManager.HV_Battery_Pack_Low_Temperature.Action_4 FaultManager.HV_Battery_Pack_Low_Temperature.Action_4_Condition FaultManager.HV_Battery_Precharge_Failure.Mode FaultManager.HV_Battery_Precharge_Failure.ID FaultManager.HV_Battery_Precharge_Failure.Test FaultManager.HV_Battery_Precharge_Failure.Faulty_Samples__X_ FaultManager.HV_Battery_Precharge_Failure.Total_Samples__Y_ FaultManager.HV_Battery_Precharge_Failure.Action_1 FaultManager.HV_Battery_Precharge_Failure.Action_1_Condition FaultManager.HV_Battery_Precharge_Failure.Action_2 FaultManager.HV_Battery_Precharge_Failure.Action_2_Condition FaultManager.HV_Battery_Precharge_Failure.Action_3 FaultManager.HV_Battery_Precharge_Failure.Action_3_Condition FaultManager.HV_Battery_Precharge_Failure.Action_4 FaultManager.HV_Battery_Precharge_Failure.Action_4_Condition FaultManager.HV_Battery_Too_Low_For_Load.Mode FaultManager.HV_Battery_Too_Low_For_Load.ID FaultManager.HV_Battery_Too_Low_For_Load.Test FaultManager.HV_Battery_Too_Low_For_Load.Faulty_Samples__X_ FaultManager.HV_Battery_Too_Low_For_Load.Total_Samples__Y_ FaultManager.HV_Battery_Too_Low_For_Load.Action_1 FaultManager.HV_Battery_Too_Low_For_Load.Action_1_Condition FaultManager.HV_Battery_Too_Low_For_Load.Action_2 FaultManager.HV_Battery_Too_Low_For_Load.Action_2_Condition FaultManager.HV_Battery_Too_Low_For_Load.Action_3 FaultManager.HV_Battery_Too_Low_For_Load.Action_3_Condition FaultManager.HV_Battery_Too_Low_For_Load.Action_4 FaultManager.HV_Battery_Too_Low_For_Load.Action_4_Condition FaultManager.HV_Battery_Try_To_Balance_Under_Load.Mode FaultManager.HV_Battery_Try_To_Balance_Under_Load.ID FaultManager.HV_Battery_Try_To_Balance_Under_Load.Test FaultManager.HV_Battery_Try_To_Balance_Under_Load.Faulty_Samples__X_ FaultManager.HV_Battery_Try_To_Balance_Under_Load.Total_Samples__Y_ FaultManager.HV_Battery_Try_To_Balance_Under_Load.Action_1 FaultManager.HV_Battery_Try_To_Balance_Under_Load.Action_1_Condition FaultManager.HV_Battery_Try_To_Balance_Under_Load.Action_2 FaultManager.HV_Battery_Try_To_Balance_Under_Load.Action_2_Condition FaultManager.HV_Battery_Try_To_Balance_Under_Load.Action_3 FaultManager.HV_Battery_Try_To_Balance_Under_Load.Action_3_Condition FaultManager.HV_Battery_Try_To_Balance_Under_Load.Action_4 FaultManager.HV_Battery_Try_To_Balance_Under_Load.Action_4_Condition FaultManager.HV_Heater_Over_Temperature.Mode FaultManager.HV_Heater_Over_Temperature.ID FaultManager.HV_Heater_Over_Temperature.Test FaultManager.HV_Heater_Over_Temperature.Faulty_Samples__X_ FaultManager.HV_Heater_Over_Temperature.Total_Samples__Y_ FaultManager.HV_Heater_Over_Temperature.Action_1 FaultManager.HV_Heater_Over_Temperature.Action_1_Condition FaultManager.HV_Heater_Over_Temperature.Action_2 FaultManager.HV_Heater_Over_Temperature.Action_2_Condition FaultManager.HV_Heater_Over_Temperature.Action_3 FaultManager.HV_Heater_Over_Temperature.Action_3_Condition FaultManager.HV_Heater_Over_Temperature.Action_4 FaultManager.HV_Heater_Over_Temperature.Action_4_Condition FaultManager.HV_Heater_Poor_Performance.Mode FaultManager.HV_Heater_Poor_Performance.ID FaultManager.HV_Heater_Poor_Performance.Test FaultManager.HV_Heater_Poor_Performance.Faulty_Samples__X_ FaultManager.HV_Heater_Poor_Performance.Total_Samples__Y_ FaultManager.HV_Heater_Poor_Performance.Action_1 FaultManager.HV_Heater_Poor_Performance.Action_1_Condition FaultManager.HV_Heater_Poor_Performance.Action_2 FaultManager.HV_Heater_Poor_Performance.Action_2_Condition FaultManager.HV_Heater_Poor_Performance.Action_3 FaultManager.HV_Heater_Poor_Performance.Action_3_Condition FaultManager.HV_Heater_Poor_Performance.Action_4 FaultManager.HV_Heater_Poor_Performance.Action_4_Condition FaultManager.HV_Heater_Temperature_Sensor_A_High_Voltage.Mode FaultManager.HV_Heater_Temperature_Sensor_A_High_Voltage.ID FaultManager.HV_Heater_Temperature_Sensor_A_High_Voltage.Test FaultManager.HV_Heater_Temperature_Sensor_A_High_Voltage.Faulty_Samples__X_ FaultManager.HV_Heater_Temperature_Sensor_A_High_Voltage.Total_Samples__Y_ FaultManager.HV_Heater_Temperature_Sensor_A_High_Voltage.Action_1 FaultManager.HV_Heater_Temperature_Sensor_A_High_Voltage.Action_1_Condition FaultManager.HV_Heater_Temperature_Sensor_A_High_Voltage.Action_2 FaultManager.HV_Heater_Temperature_Sensor_A_High_Voltage.Action_2_Condition FaultManager.HV_Heater_Temperature_Sensor_A_High_Voltage.Action_3 FaultManager.HV_Heater_Temperature_Sensor_A_High_Voltage.Action_3_Condition FaultManager.HV_Heater_Temperature_Sensor_A_High_Voltage.Action_4 FaultManager.HV_Heater_Temperature_Sensor_A_High_Voltage.Action_4_Condition FaultManager.HV_Heater_Temperature_Sensor_A_Intermittent.Mode FaultManager.HV_Heater_Temperature_Sensor_A_Intermittent.ID FaultManager.HV_Heater_Temperature_Sensor_A_Intermittent.Test FaultManager.HV_Heater_Temperature_Sensor_A_Intermittent.Faulty_Samples__X_ FaultManager.HV_Heater_Temperature_Sensor_A_Intermittent.Total_Samples__Y_ FaultManager.HV_Heater_Temperature_Sensor_A_Intermittent.Action_1 FaultManager.HV_Heater_Temperature_Sensor_A_Intermittent.Action_1_Condition FaultManager.HV_Heater_Temperature_Sensor_A_Intermittent.Action_2 FaultManager.HV_Heater_Temperature_Sensor_A_Intermittent.Action_2_Condition FaultManager.HV_Heater_Temperature_Sensor_A_Intermittent.Action_3 FaultManager.HV_Heater_Temperature_Sensor_A_Intermittent.Action_3_Condition FaultManager.HV_Heater_Temperature_Sensor_A_Intermittent.Action_4 FaultManager.HV_Heater_Temperature_Sensor_A_Intermittent.Action_4_Condition FaultManager.HV_Heater_Temperature_Sensor_A_Low_Voltage.Mode FaultManager.HV_Heater_Temperature_Sensor_A_Low_Voltage.ID FaultManager.HV_Heater_Temperature_Sensor_A_Low_Voltage.Test FaultManager.HV_Heater_Temperature_Sensor_A_Low_Voltage.Faulty_Samples__X_ FaultManager.HV_Heater_Temperature_Sensor_A_Low_Voltage.Total_Samples__Y_ FaultManager.HV_Heater_Temperature_Sensor_A_Low_Voltage.Action_1 FaultManager.HV_Heater_Temperature_Sensor_A_Low_Voltage.Action_1_Condition FaultManager.HV_Heater_Temperature_Sensor_A_Low_Voltage.Action_2 FaultManager.HV_Heater_Temperature_Sensor_A_Low_Voltage.Action_2_Condition FaultManager.HV_Heater_Temperature_Sensor_A_Low_Voltage.Action_3 FaultManager.HV_Heater_Temperature_Sensor_A_Low_Voltage.Action_3_Condition FaultManager.HV_Heater_Temperature_Sensor_A_Low_Voltage.Action_4 FaultManager.HV_Heater_Temperature_Sensor_A_Low_Voltage.Action_4_Condition FaultManager.IPT_DCDC_AgeCount.Mode FaultManager.IPT_DCDC_AgeCount.ID FaultManager.IPT_DCDC_AgeCount.Test FaultManager.IPT_DCDC_AgeCount.Faulty_Samples__X_ FaultManager.IPT_DCDC_AgeCount.Total_Samples__Y_ FaultManager.IPT_DCDC_AgeCount.Action_1 FaultManager.IPT_DCDC_AgeCount.Action_1_Condition FaultManager.IPT_DCDC_AgeCount.Action_2 FaultManager.IPT_DCDC_AgeCount.Action_2_Condition FaultManager.IPT_DCDC_AgeCount.Action_3 FaultManager.IPT_DCDC_AgeCount.Action_3_Condition FaultManager.IPT_DCDC_AgeCount.Action_4 FaultManager.IPT_DCDC_AgeCount.Action_4_Condition FaultManager.IPT_Status1_AgeCount.Mode FaultManager.IPT_Status1_AgeCount.ID FaultManager.IPT_Status1_AgeCount.Test FaultManager.IPT_Status1_AgeCount.Faulty_Samples__X_ FaultManager.IPT_Status1_AgeCount.Total_Samples__Y_ FaultManager.IPT_Status1_AgeCount.Action_1 FaultManager.IPT_Status1_AgeCount.Action_1_Condition FaultManager.IPT_Status1_AgeCount.Action_2 FaultManager.IPT_Status1_AgeCount.Action_2_Condition FaultManager.IPT_Status1_AgeCount.Action_3 FaultManager.IPT_Status1_AgeCount.Action_3_Condition FaultManager.IPT_Status1_AgeCount.Action_4 FaultManager.IPT_Status1_AgeCount.Action_4_Condition FaultManager.IPT_Status2_AgeCount.Mode FaultManager.IPT_Status2_AgeCount.ID FaultManager.IPT_Status2_AgeCount.Test FaultManager.IPT_Status2_AgeCount.Faulty_Samples__X_ FaultManager.IPT_Status2_AgeCount.Total_Samples__Y_ FaultManager.IPT_Status2_AgeCount.Action_1 FaultManager.IPT_Status2_AgeCount.Action_1_Condition FaultManager.IPT_Status2_AgeCount.Action_2 FaultManager.IPT_Status2_AgeCount.Action_2_Condition FaultManager.IPT_Status2_AgeCount.Action_3 FaultManager.IPT_Status2_AgeCount.Action_3_Condition FaultManager.IPT_Status2_AgeCount.Action_4 FaultManager.IPT_Status2_AgeCount.Action_4_Condition FaultManager.Key_Line_Voltage.Mode FaultManager.Key_Line_Voltage.ID FaultManager.Key_Line_Voltage.Test FaultManager.Key_Line_Voltage.Faulty_Samples__X_ FaultManager.Key_Line_Voltage.Total_Samples__Y_ FaultManager.Key_Line_Voltage.Action_1 FaultManager.Key_Line_Voltage.Action_1_Condition FaultManager.Key_Line_Voltage.Action_2 FaultManager.Key_Line_Voltage.Action_2_Condition FaultManager.Key_Line_Voltage.Action_3 FaultManager.Key_Line_Voltage.Action_3_Condition FaultManager.Key_Line_Voltage.Action_4 FaultManager.Key_Line_Voltage.Action_4_Condition FaultManager.Key_Off_Voltage_High.Mode FaultManager.Key_Off_Voltage_High.ID FaultManager.Key_Off_Voltage_High.Test FaultManager.Key_Off_Voltage_High.Faulty_Samples__X_ FaultManager.Key_Off_Voltage_High.Total_Samples__Y_ FaultManager.Key_Off_Voltage_High.Action_1 FaultManager.Key_Off_Voltage_High.Action_1_Condition FaultManager.Key_Off_Voltage_High.Action_2 FaultManager.Key_Off_Voltage_High.Action_2_Condition FaultManager.Key_Off_Voltage_High.Action_3 FaultManager.Key_Off_Voltage_High.Action_3_Condition FaultManager.Key_Off_Voltage_High.Action_4 FaultManager.Key_Off_Voltage_High.Action_4_Condition FaultManager.Park_Nuetral_Switch_Input_Circuit.Mode FaultManager.Park_Nuetral_Switch_Input_Circuit.ID FaultManager.Park_Nuetral_Switch_Input_Circuit.Test FaultManager.Park_Nuetral_Switch_Input_Circuit.Faulty_Samples__X_ FaultManager.Park_Nuetral_Switch_Input_Circuit.Total_Samples__Y_ FaultManager.Park_Nuetral_Switch_Input_Circuit.Action_1 FaultManager.Park_Nuetral_Switch_Input_Circuit.Action_1_Condition FaultManager.Park_Nuetral_Switch_Input_Circuit.Action_2 FaultManager.Park_Nuetral_Switch_Input_Circuit.Action_2_Condition FaultManager.Park_Nuetral_Switch_Input_Circuit.Action_3 FaultManager.Park_Nuetral_Switch_Input_Circuit.Action_3_Condition FaultManager.Park_Nuetral_Switch_Input_Circuit.Action_4 FaultManager.Park_Nuetral_Switch_Input_Circuit.Action_4_Condition FaultManager.Park_Nuetral_Switch_Input_High.Mode FaultManager.Park_Nuetral_Switch_Input_High.ID FaultManager.Park_Nuetral_Switch_Input_High.Test FaultManager.Park_Nuetral_Switch_Input_High.Faulty_Samples__X_ FaultManager.Park_Nuetral_Switch_Input_High.Total_Samples__Y_ FaultManager.Park_Nuetral_Switch_Input_High.Action_1 FaultManager.Park_Nuetral_Switch_Input_High.Action_1_Condition FaultManager.Park_Nuetral_Switch_Input_High.Action_2 FaultManager.Park_Nuetral_Switch_Input_High.Action_2_Condition FaultManager.Park_Nuetral_Switch_Input_High.Action_3 FaultManager.Park_Nuetral_Switch_Input_High.Action_3_Condition FaultManager.Park_Nuetral_Switch_Input_High.Action_4 FaultManager.Park_Nuetral_Switch_Input_High.Action_4_Condition FaultManager.Park_Nuetral_Switch_Input_Low.Mode FaultManager.Park_Nuetral_Switch_Input_Low.ID FaultManager.Park_Nuetral_Switch_Input_Low.Test FaultManager.Park_Nuetral_Switch_Input_Low.Faulty_Samples__X_ FaultManager.Park_Nuetral_Switch_Input_Low.Total_Samples__Y_ FaultManager.Park_Nuetral_Switch_Input_Low.Action_1 FaultManager.Park_Nuetral_Switch_Input_Low.Action_1_Condition FaultManager.Park_Nuetral_Switch_Input_Low.Action_2 FaultManager.Park_Nuetral_Switch_Input_Low.Action_2_Condition FaultManager.Park_Nuetral_Switch_Input_Low.Action_3 FaultManager.Park_Nuetral_Switch_Input_Low.Action_3_Condition FaultManager.Park_Nuetral_Switch_Input_Low.Action_4 FaultManager.Park_Nuetral_Switch_Input_Low.Action_4_Condition FaultManager.Pedal_Position_Sensor_A_Circuit_High.Mode FaultManager.Pedal_Position_Sensor_A_Circuit_High.ID FaultManager.Pedal_Position_Sensor_A_Circuit_High.Test FaultManager.Pedal_Position_Sensor_A_Circuit_High.Faulty_Samples__X_ FaultManager.Pedal_Position_Sensor_A_Circuit_High.Total_Samples__Y_ FaultManager.Pedal_Position_Sensor_A_Circuit_High.Action_1 FaultManager.Pedal_Position_Sensor_A_Circuit_High.Action_1_Condition FaultManager.Pedal_Position_Sensor_A_Circuit_High.Action_2 FaultManager.Pedal_Position_Sensor_A_Circuit_High.Action_2_Condition FaultManager.Pedal_Position_Sensor_A_Circuit_High.Action_3 FaultManager.Pedal_Position_Sensor_A_Circuit_High.Action_3_Condition FaultManager.Pedal_Position_Sensor_A_Circuit_High.Action_4 /end DEF_CHARACTERISTIC
/end FUNCTION
/end MODULE
/end PROJECT
