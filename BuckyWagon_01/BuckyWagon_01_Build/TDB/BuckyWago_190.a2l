ASAP2_VERSION 1 51
/begin PROJECT Project ""
/begin MODULE BuckyWago_190 ""
/begin MOD_COMMON /* MOD_COMMON Comment */ "" BYTE_ORDER MSB_FIRST ALIGNMENT_BYTE 1 ALIGNMENT_FLOAT32_IEEE 1 ALIGNMENT_FLOAT64_IEEE 1 ALIGNMENT_LONG 1 ALIGNMENT_WORD 1 /end MOD_COMMON
/begin MEASUREMENT din_create_EStop_Switch_Pin "Debug Variable" UBYTE CompuMethod_19 1 0 0 0 ECU_ADDRESS 0x40000308 /end MEASUREMENT
/begin MEASUREMENT din_read_EStop_Switch_Pin "Debug Variable" UBYTE CompuMethod_19 1 0 0 0 ECU_ADDRESS 0x40000309 /end MEASUREMENT
/begin MEASUREMENT dout_create_DOut178p0011 "Debug Variable" UBYTE CompuMethod_19 1 0 0 0 ECU_ADDRESS 0x4000030A /end MEASUREMENT
/begin MEASUREMENT dout_create_DOut179p0011 "Debug Variable" UBYTE CompuMethod_19 1 0 0 0 ECU_ADDRESS 0x4000030B /end MEASUREMENT
/begin MEASUREMENT dout_create_DOut180p0011 "Debug Variable" UBYTE CompuMethod_19 1 0 0 0 ECU_ADDRESS 0x4000030C /end MEASUREMENT
/begin MEASUREMENT dout_create_DOut3445p0009 "Debug Variable" UBYTE CompuMethod_19 1 0 0 0 ECU_ADDRESS 0x4000030D /end MEASUREMENT
/begin MEASUREMENT EHPAS_Operating_Mode_Command "" UBYTE CompuMethod_1 1 0 0 255 ECU_ADDRESS 0x40000324 /end MEASUREMENT
/begin MEASUREMENT EMP_Board_Temp "" FLOAT32_IEEE CompuMethod_2 1 0 -1E+17 1E+17 ECU_ADDRESS 0x40000332 /end MEASUREMENT
/begin MEASUREMENT EMP_Cooling_Fan_Board_Temp "" FLOAT32_IEEE CompuMethod_2 1 0 -1E+17 1E+17 ECU_ADDRESS 0x40000336 /end MEASUREMENT
/begin MEASUREMENT EMP_Cooling_Fan_Mode "" FLOAT32_IEEE CompuMethod_2 1 0 -1E+17 1E+17 ECU_ADDRESS 0x4000033A /end MEASUREMENT
/begin MEASUREMENT EMP_Cooling_Fan_Power "" FLOAT32_IEEE CompuMethod_2 1 0 -1E+17 1E+17 ECU_ADDRESS 0x4000033E /end MEASUREMENT
/begin MEASUREMENT EMP_Cooling_Fan_Speed "" FLOAT32_IEEE CompuMethod_2 1 0 -1E+17 1E+17 ECU_ADDRESS 0x40000342 /end MEASUREMENT
/begin MEASUREMENT EMP_Cooling_Fan_Speed_Percent "" FLOAT32_IEEE CompuMethod_2 1 0 -1E+17 1E+17 ECU_ADDRESS 0x40000346 /end MEASUREMENT
/begin MEASUREMENT EMP_Cooling_Fan_Status "" FLOAT32_IEEE CompuMethod_2 1 0 -1E+17 1E+17 ECU_ADDRESS 0x4000034A /end MEASUREMENT
/begin MEASUREMENT EMP_Fan_Speed "" FLOAT32_IEEE CompuMethod_2 1 0 -1E+17 1E+17 ECU_ADDRESS 0x4000034E /end MEASUREMENT
/begin MEASUREMENT EMP_Pump_Mode "" FLOAT32_IEEE CompuMethod_2 1 0 -1E+17 1E+17 ECU_ADDRESS 0x40000352 /end MEASUREMENT
/begin MEASUREMENT EMP_Pump_Power "" FLOAT32_IEEE CompuMethod_2 1 0 -1E+17 1E+17 ECU_ADDRESS 0x40000356 /end MEASUREMENT
/begin MEASUREMENT EMP_Pump_Speed "" FLOAT32_IEEE CompuMethod_2 1 0 -1E+17 1E+17 ECU_ADDRESS 0x4000035A /end MEASUREMENT
/begin MEASUREMENT EMP_Pump_Status "" FLOAT32_IEEE CompuMethod_2 1 0 -1E+17 1E+17 ECU_ADDRESS 0x4000035E /end MEASUREMENT
/begin MEASUREMENT EMP_Speed "" FLOAT32_IEEE CompuMethod_2 1 0 -1E+17 1E+17 ECU_ADDRESS 0x40000362 /end MEASUREMENT
/begin MEASUREMENT EMP_Speed_Percent "" FLOAT32_IEEE CompuMethod_2 1 0 -1E+17 1E+17 ECU_ADDRESS 0x40000366 /end MEASUREMENT
/begin MEASUREMENT Estop_switch_probe "" UBYTE CompuMethod_27 1 0 0 1 ECU_ADDRESS 0x4000036A /end MEASUREMENT
/begin MEASUREMENT FanOut_DutyCycle "Actual duty cycle of actuator" FLOAT32_IEEE CompuMethod_6 1 0 -1E+17 1E+17 ECU_ADDRESS 0x4000036B /end MEASUREMENT
/begin MEASUREMENT FaultActionReason._.Bat_limit_high "Displays a rolling marquee of the reasons for fault action: FaultActionReason." UBYTE CompuMethod_207 1 0 0 255 ECU_ADDRESS 0x4000036F /end MEASUREMENT
/begin MEASUREMENT FaultActionReason._.Bat_limit_low "Displays a rolling marquee of the reasons for fault action: FaultActionReason." UBYTE CompuMethod_207 1 0 0 255 ECU_ADDRESS 0x40000370 /end MEASUREMENT
/begin MEASUREMENT FaultActionReason._.Battery_Warning "Displays a rolling marquee of the reasons for fault action: FaultActionReason." UBYTE CompuMethod_207 1 0 0 255 ECU_ADDRESS 0x40000371 /end MEASUREMENT
/begin MEASUREMENT FaultActionReason._.DisableDrive "Displays a rolling marquee of the reasons for fault action: FaultActionReason." UBYTE CompuMethod_207 1 0 0 255 ECU_ADDRESS 0x40000372 /end MEASUREMENT
/begin MEASUREMENT FaultActionReason._.EmergencyPowerOff "Displays a rolling marquee of the reasons for fault action: FaultActionReason." UBYTE CompuMethod_207 1 0 0 255 ECU_ADDRESS 0x40000373 /end MEASUREMENT
/begin MEASUREMENT FaultActionReason._.OpenContactors "Displays a rolling marquee of the reasons for fault action: FaultActionReason." UBYTE CompuMethod_207 1 0 0 255 ECU_ADDRESS 0x40000374 /end MEASUREMENT
/begin MEASUREMENT FaultActionReason._.PumpFan_Full "Displays a rolling marquee of the reasons for fault action: FaultActionReason." UBYTE CompuMethod_207 1 0 0 255 ECU_ADDRESS 0x40000375 /end MEASUREMENT
/begin MEASUREMENT FaultMarquees.FaultMarquees.Current_Suspected "Displays a rolling marquee for suspected, active and occurred faults." UBYTE CompuMethod_207 1 0 0 255 ECU_ADDRESS 0x40000376 /end MEASUREMENT
/begin MEASUREMENT FaultMarquees.FaultMarquees.Current_Active "Displays a rolling marquee for suspected, active and occurred faults." UBYTE CompuMethod_207 1 0 0 255 ECU_ADDRESS 0x40000377 /end MEASUREMENT
/begin MEASUREMENT FaultMarquees.FaultMarquees.Current_Occurred "Displays a rolling marquee for suspected, active and occurred faults." UBYTE CompuMethod_207 1 0 0 255 ECU_ADDRESS 0x40000378 /end MEASUREMENT
/begin MEASUREMENT FrameworkGlueErrors "This indicates the currently Active Errors within the Framework Glue module." UWORD CompuMethod_213 1 0 0 65535 ECU_ADDRESS 0x40000392 /end MEASUREMENT
/begin MEASUREMENT GaugeChain_EZLinkCallbackCounter "Debug Variable" ULONG CompuMethod_18 1 0 0 0 ECU_ADDRESS 0x40000394 /end MEASUREMENT
/begin MEASUREMENT GaugeChain_EZLinkNoPendingTxCounter "Debug Variable" ULONG CompuMethod_18 1 0 0 0 ECU_ADDRESS 0x40000398 /end MEASUREMENT
/begin MEASUREMENT GaugeChain_EZlinkTx "Debug Variable" UBYTE CompuMethod_19 1 0 0 0 ECU_ADDRESS 0x4000039C /end MEASUREMENT
/begin MEASUREMENT In_Reverse "" FLOAT32_IEEE CompuMethod_2 1 0 -1E+17 1E+17 ECU_ADDRESS 0x400003AD /end MEASUREMENT
/begin MEASUREMENT InhibitDCDC_Out_ "Display output in engineering units" UBYTE CompuMethod_216 1 0 0 1 ECU_ADDRESS 0x400003B1 /end MEASUREMENT
/begin MEASUREMENT InstBattKW "" FLOAT32_IEEE CompuMethod_2 1 0 -1E+17 1E+17 ECU_ADDRESS 0x400003B6 /end MEASUREMENT
/begin MEASUREMENT InstDCDCWatts "" FLOAT32_IEEE CompuMethod_2 1 0 -1E+17 1E+17 ECU_ADDRESS 0x400003BA /end MEASUREMENT
/begin MEASUREMENT InstPhxCurrent "" FLOAT32_IEEE CompuMethod_2 1 0 -1E+17 1E+17 ECU_ADDRESS 0x400003BE /end MEASUREMENT
/begin MEASUREMENT InstPhxKW "" FLOAT32_IEEE CompuMethod_2 1 0 -1E+17 1E+17 ECU_ADDRESS 0x400003C2 /end MEASUREMENT
/begin MEASUREMENT InstUQMKW "" FLOAT32_IEEE CompuMethod_2 1 0 -1E+17 1E+17 ECU_ADDRESS 0x400003C6 /end MEASUREMENT
/begin MEASUREMENT InstVehicleKWUsed "" FLOAT32_IEEE CompuMethod_2 1 0 -1E+17 1E+17 ECU_ADDRESS 0x400003CA /end MEASUREMENT
/begin MEASUREMENT InstWhperMile "" FLOAT32_IEEE CompuMethod_2 1 0 -1E+17 1E+17 ECU_ADDRESS 0x400003CE /end MEASUREMENT
/begin MEASUREMENT KeyCycleKWh "" FLOAT32_IEEE CompuMethod_2 1 0 -1E+17 1E+17 ECU_ADDRESS 0x400003F8 /end MEASUREMENT
/begin MEASUREMENT KeyCycleKWh_without_12v_dcdc_current "" FLOAT32_IEEE CompuMethod_2 1 0 -1E+17 1E+17 ECU_ADDRESS 0x400003FC /end MEASUREMENT
/begin MEASUREMENT LVVolt "Final value after Linear Sensor Characterization" FLOAT32_IEEE CompuMethod_214 1 0 -1E+17 1E+17 ECU_ADDRESS 0x40000412 /end MEASUREMENT
/begin MEASUREMENT LVVolt_ADC "Singal measured directly from sensor" UWORD CompuMethod_5 1 0 0 65535 ECU_ADDRESS 0x40000416 /end MEASUREMENT
/begin MEASUREMENT LVVolt_Raw "After conversion to engineering units, before range checking" FLOAT32_IEEE CompuMethod_214 1 0 -1E+17 1E+17 ECU_ADDRESS 0x40000418 /end MEASUREMENT
/begin MEASUREMENT MaxQueueDepth "Debug Variable" UBYTE CompuMethod_1 1 0 0 0 ECU_ADDRESS 0x40000474 /end MEASUREMENT
/begin MEASUREMENT mh_EZlink "Debug Variable" UBYTE CompuMethod_19 1 0 0 0 ECU_ADDRESS 0x4000047D /end MEASUREMENT
/begin MEASUREMENT MilesSinceKeyed "" FLOAT32_IEEE CompuMethod_2 1 0 -1E+17 1E+17 ECU_ADDRESS 0x4000047E /end MEASUREMENT
/begin MEASUREMENT minTimer "" UWORD CompuMethod_227 1 0 0 327.675 ECU_ADDRESS 0x40000482 /end MEASUREMENT
/begin MEASUREMENT MPRD "Indicates whether the main power relay is active" UBYTE CompuMethod_196 1 0 0 1 ECU_ADDRESS 0x40000619 /end MEASUREMENT
/begin MEASUREMENT NonVolatileCRC "Calculated NonVolatile CRC" ULONG CompuMethod_27 1 0 0 65535 ECU_ADDRESS 0x4000061A /end MEASUREMENT
/begin MEASUREMENT NonVolatileFormatID "Unique identifier of the NonVolatile memory format.  Used to validate whether stored variables are in the correct form for the program" ULONG CompuMethod_18 1 0 0 4294970000 ECU_ADDRESS 0x4000061E /end MEASUREMENT
/begin MEASUREMENT NonVolatileStatus "Indicates how NonVolatile memory was loaded" UBYTE CompuMethod_233 1 0 0 6 ECU_ADDRESS 0x40000622 /end MEASUREMENT
/begin MEASUREMENT pwm_create_Fan_Pin_PWMOutput "Debug Variable" UBYTE CompuMethod_19 1 0 0 0 ECU_ADDRESS 0x4000069E /end MEASUREMENT
/begin MEASUREMENT pwm_set_Fan_Pin_PWMOutput "Debug Variable" UBYTE CompuMethod_19 1 0 0 0 ECU_ADDRESS 0x4000069F /end MEASUREMENT
/begin MEASUREMENT resource_allocation "Debug Variable" UBYTE CompuMethod_19 1 0 0 0 ECU_ADDRESS 0x400006B4 /end MEASUREMENT
/begin MEASUREMENT Reverse_Switch "Display output in engineering units" UBYTE CompuMethod_239 1 0 0 1 ECU_ADDRESS 0x400006B5 /end MEASUREMENT
/begin MEASUREMENT Reverse_Switch_Raw "Display output in engineering units" FLOAT32_IEEE CompuMethod_8 1 0 -1E+17 1E+17 ECU_ADDRESS 0x400006B6 /end MEASUREMENT
/begin MEASUREMENT RevOut_ "Display output in engineering units" UBYTE CompuMethod_216 1 0 0 1 ECU_ADDRESS 0x400006BA /end MEASUREMENT
/begin MEASUREMENT scrollIndex "" UBYTE CompuMethod_1 1 0 0 255 ECU_ADDRESS 0x400006C7 /end MEASUREMENT
/begin MEASUREMENT scrollTimer "" UWORD CompuMethod_227 1 0 0 327.675 ECU_ADDRESS 0x400006C8 /end MEASUREMENT
/begin MEASUREMENT Vehicle_Odometer "" FLOAT32_IEEE CompuMethod_2 1 0 -1E+17 1E+17 ECU_ADDRESS 0x4000071E /end MEASUREMENT
/begin MEASUREMENT Vehicle_Speed "" FLOAT32_IEEE CompuMethod_33 1 0 -1E+17 1E+17 ECU_ADDRESS 0x40000722 /end MEASUREMENT
/begin MEASUREMENT WhPerMileKeyCycle "" FLOAT32_IEEE CompuMethod_2 1 0 -1E+17 1E+17 ECU_ADDRESS 0x40000732 /end MEASUREMENT
/begin MEASUREMENT WhPerMileKeyCycle_without_12v_dcdc_current "" FLOAT32_IEEE CompuMethod_2 1 0 -1E+17 1E+17 ECU_ADDRESS 0x40000736 /end MEASUREMENT
/begin CHARACTERISTIC Current_Limit_Override_new "" VALUE 0x80000237 RecordLayout_4 0 CompuMethod_2 -1E+17 1E+17 /end CHARACTERISTIC
/begin CHARACTERISTIC Current_Limit_Override_ovr "" VALUE 0x8000023B RecordLayout_1 0 CompuMethod_9 0 1 /end CHARACTERISTIC
/begin CHARACTERISTIC DisplayFaults "Enable displaying faults when they are active." VALUE 0x8000023E RecordLayout_1 0 CompuMethod_196 0 1 /end CHARACTERISTIC
/begin CHARACTERISTIC dispLength "Number of characters to display when scrolling fault name." VALUE 0x8000023F RecordLayout_1 0 CompuMethod_1 0 9 /end CHARACTERISTIC
/begin CHARACTERISTIC Downsample "" VALUE 0x80000240 RecordLayout_4 0 CompuMethod_197 -500000000000000 500000000000000 /end CHARACTERISTIC
/begin CHARACTERISTIC dualIndex "" VAL_BLK 0x80000248 RecordLayout_1 0 CompuMethod_1 0 255 MATRIX_DIM 1 2 1 /end CHARACTERISTIC
/begin CHARACTERISTIC E_Stop_Invert "" VALUE 0x8000024A RecordLayout_1 0 CompuMethod_27 0 1 /end CHARACTERISTIC
/begin CHARACTERISTIC Eaton_HV_Charger_Temperature_new "" VALUE 0x8000024B RecordLayout_4 0 CompuMethod_2 -1E+17 1E+17 /end CHARACTERISTIC
/begin CHARACTERISTIC Eaton_HV_Charger_Temperature_ovr "" VALUE 0x8000024F RecordLayout_1 0 CompuMethod_9 0 1 /end CHARACTERISTIC
/begin CHARACTERISTIC ECUP_Threshold "ADC voltage threshold above which ECU is considered powered" VALUE 0x80000250 RecordLayout_8 0 CompuMethod_198 0 1023 /end CHARACTERISTIC
/begin CHARACTERISTIC EHPAS_Fault_new "" VALUE 0x8000025E RecordLayout_4 0 CompuMethod_2 -1E+17 1E+17 /end CHARACTERISTIC
/begin CHARACTERISTIC EHPAS_Fault_ovr "" VALUE 0x80000262 RecordLayout_1 0 CompuMethod_9 0 1 /end CHARACTERISTIC
/begin CHARACTERISTIC EHPAS_Input_Current_NA_new "" VALUE 0x80000267 RecordLayout_4 0 CompuMethod_2 -1E+17 1E+17 /end CHARACTERISTIC
/begin CHARACTERISTIC EHPAS_Input_Current_NA_ovr "" VALUE 0x8000026B RecordLayout_1 0 CompuMethod_9 0 1 /end CHARACTERISTIC
/begin CHARACTERISTIC EHPAS_Input_Voltage_new "" VALUE 0x8000026C RecordLayout_4 0 CompuMethod_2 -1E+17 1E+17 /end CHARACTERISTIC
/begin CHARACTERISTIC EHPAS_Input_Voltage_ovr "" VALUE 0x80000270 RecordLayout_1 0 CompuMethod_9 0 1 /end CHARACTERISTIC
/begin CHARACTERISTIC EHPAS_Op_State_new "" VALUE 0x80000279 RecordLayout_4 0 CompuMethod_2 -1E+17 1E+17 /end CHARACTERISTIC
/begin CHARACTERISTIC EHPAS_Op_State_ovr "" VALUE 0x8000027D RecordLayout_1 0 CompuMethod_9 0 1 /end CHARACTERISTIC
/begin CHARACTERISTIC EHPAS_Operating_Mode_Cmd_new "" VALUE 0x8000027E RecordLayout_1 0 CompuMethod_1 0 255 /end CHARACTERISTIC
/begin CHARACTERISTIC EHPAS_Operating_Mode_Cmd_ovr "" VALUE 0x8000027F RecordLayout_1 0 CompuMethod_9 0 1 /end CHARACTERISTIC
/begin CHARACTERISTIC EHPAS_Performance_Limit "" VALUE 0x80000280 RecordLayout_4 0 CompuMethod_2 -1E+17 1E+17 /end CHARACTERISTIC
/begin CHARACTERISTIC EHPAS_Pump_Speed_new "" VALUE 0x80000284 RecordLayout_4 0 CompuMethod_2 -1E+17 1E+17 /end CHARACTERISTIC
/begin CHARACTERISTIC EHPAS_Pump_Speed_ovr "" VALUE 0x80000288 RecordLayout_1 0 CompuMethod_9 0 1 /end CHARACTERISTIC
/begin CHARACTERISTIC EHPAS_PumpStateEnable_ovr_new "" VALUE 0x80000289 RecordLayout_1 0 CompuMethod_199 0 255 /end CHARACTERISTIC
/begin CHARACTERISTIC EHPAS_PumpStateEnable_ovr_ovr "" VALUE 0x8000028A RecordLayout_1 0 CompuMethod_9 0 1 /end CHARACTERISTIC
/begin CHARACTERISTIC EHPAS_TempCur_new "" VALUE 0x80000293 RecordLayout_4 0 CompuMethod_2 -1E+17 1E+17 /end CHARACTERISTIC
/begin CHARACTERISTIC EHPAS_TempCur_ovr "" VALUE 0x80000297 RecordLayout_1 0 CompuMethod_9 0 1 /end CHARACTERISTIC
/begin CHARACTERISTIC EHPAS_TempMax_new "" VALUE 0x80000298 RecordLayout_4 0 CompuMethod_2 -1E+17 1E+17 /end CHARACTERISTIC
/begin CHARACTERISTIC EHPAS_TempMax_ovr "" VALUE 0x8000029C RecordLayout_1 0 CompuMethod_9 0 1 /end CHARACTERISTIC
/begin CHARACTERISTIC EMP_Board_Temp_new "" VALUE 0x8000029D RecordLayout_4 0 CompuMethod_2 -1E+17 1E+17 /end CHARACTERISTIC
/begin CHARACTERISTIC EMP_Board_Temp_ovr "" VALUE 0x800002A1 RecordLayout_1 0 CompuMethod_9 0 1 /end CHARACTERISTIC
/begin CHARACTERISTIC EMP_CAN_MaxAge "counts before EMP Coolant Pump faults out" VALUE 0x800002A2 RecordLayout_4 0 CompuMethod_200 0 100000 /end CHARACTERISTIC
/begin CHARACTERISTIC EMP_Cooling_Fan_Board_Temp_new "" VALUE 0x800002A6 RecordLayout_4 0 CompuMethod_2 -1E+17 1E+17 /end CHARACTERISTIC
/begin CHARACTERISTIC EMP_Cooling_Fan_Board_Temp_ovr "" VALUE 0x800002AA RecordLayout_1 0 CompuMethod_9 0 1 /end CHARACTERISTIC
/begin CHARACTERISTIC EMP_Cooling_Fan_Mode_new "" VALUE 0x800002AB RecordLayout_4 0 CompuMethod_2 -1E+17 1E+17 /end CHARACTERISTIC
/begin CHARACTERISTIC EMP_Cooling_Fan_Mode_ovr "" VALUE 0x800002AF RecordLayout_1 0 CompuMethod_9 0 1 /end CHARACTERISTIC
/begin CHARACTERISTIC EMP_Cooling_Fan_Power_new "" VALUE 0x800002B0 RecordLayout_4 0 CompuMethod_2 -1E+17 1E+17 /end CHARACTERISTIC
/begin CHARACTERISTIC EMP_Cooling_Fan_Power_ovr "" VALUE 0x800002B4 RecordLayout_1 0 CompuMethod_9 0 1 /end CHARACTERISTIC
/begin CHARACTERISTIC EMP_Cooling_Fan_Speed_new "" VALUE 0x800002B5 RecordLayout_4 0 CompuMethod_2 -1E+17 1E+17 /end CHARACTERISTIC
/begin CHARACTERISTIC EMP_Cooling_Fan_Speed_ovr "" VALUE 0x800002B9 RecordLayout_1 0 CompuMethod_9 0 1 /end CHARACTERISTIC
/begin CHARACTERISTIC EMP_Cooling_Fan_Speed_Percent_new "" VALUE 0x800002BA RecordLayout_4 0 CompuMethod_2 -1E+17 1E+17 /end CHARACTERISTIC
/begin CHARACTERISTIC EMP_Cooling_Fan_Speed_Percent_ovr "" VALUE 0x800002BE RecordLayout_1 0 CompuMethod_9 0 1 /end CHARACTERISTIC
/begin CHARACTERISTIC EMP_Cooling_Fan_Status_new "" VALUE 0x800002BF RecordLayout_4 0 CompuMethod_2 -1E+17 1E+17 /end CHARACTERISTIC
/begin CHARACTERISTIC EMP_Cooling_Fan_Status_ovr "" VALUE 0x800002C3 RecordLayout_1 0 CompuMethod_9 0 1 /end CHARACTERISTIC
/begin CHARACTERISTIC EMP_Fan_Speed_new "" VALUE 0x800002C4 RecordLayout_4 0 CompuMethod_2 -1E+17 1E+17 /end CHARACTERISTIC
/begin CHARACTERISTIC EMP_Fan_Speed_ovr "" VALUE 0x800002C8 RecordLayout_1 0 CompuMethod_9 0 1 /end CHARACTERISTIC
/begin CHARACTERISTIC EMP_Mode_new "" VALUE 0x800002C9 RecordLayout_1 0 CompuMethod_1 0 255 /end CHARACTERISTIC
/begin CHARACTERISTIC EMP_Mode_ovr "" VALUE 0x800002CA RecordLayout_1 0 CompuMethod_9 0 1 /end CHARACTERISTIC
/begin CHARACTERISTIC EMP_Pump_Mode_new "" VALUE 0x800002CB RecordLayout_4 0 CompuMethod_2 -1E+17 1E+17 /end CHARACTERISTIC
/begin CHARACTERISTIC EMP_Pump_Mode_ovr "" VALUE 0x800002CF RecordLayout_1 0 CompuMethod_9 0 1 /end CHARACTERISTIC
/begin CHARACTERISTIC EMP_Pump_Power_new "" VALUE 0x800002D0 RecordLayout_4 0 CompuMethod_2 -1E+17 1E+17 /end CHARACTERISTIC
/begin CHARACTERISTIC EMP_Pump_Power_ovr "" VALUE 0x800002D4 RecordLayout_1 0 CompuMethod_9 0 1 /end CHARACTERISTIC
/begin CHARACTERISTIC EMP_Pump_Speed_new "" VALUE 0x800002D5 RecordLayout_4 0 CompuMethod_2 -1E+17 1E+17 /end CHARACTERISTIC
/begin CHARACTERISTIC EMP_Pump_Speed_ovr "" VALUE 0x800002D9 RecordLayout_1 0 CompuMethod_9 0 1 /end CHARACTERISTIC
/begin CHARACTERISTIC EMP_Pump_Status_new "" VALUE 0x800002DA RecordLayout_4 0 CompuMethod_2 -1E+17 1E+17 /end CHARACTERISTIC
/begin CHARACTERISTIC EMP_Pump_Status_ovr "" VALUE 0x800002DE RecordLayout_1 0 CompuMethod_9 0 1 /end CHARACTERISTIC
/begin CHARACTERISTIC EMP_Speed_new "" VALUE 0x800002DF RecordLayout_4 0 CompuMethod_2 -1E+17 1E+17 /end CHARACTERISTIC
/begin CHARACTERISTIC EMP_Speed_ovr "" VALUE 0x800002E3 RecordLayout_1 0 CompuMethod_9 0 1 /end CHARACTERISTIC
/begin CHARACTERISTIC EMP_Speed_Percent_new "" VALUE 0x800002E4 RecordLayout_4 0 CompuMethod_2 -1E+17 1E+17 /end CHARACTERISTIC
/begin CHARACTERISTIC EMP_Speed_Percent_ovr "" VALUE 0x800002E8 RecordLayout_1 0 CompuMethod_9 0 1 /end CHARACTERISTIC
/begin CHARACTERISTIC EMPFan_CAN_MaxAge "counts before EMP Cooling fan faults out" VALUE 0x800002E9 RecordLayout_4 0 CompuMethod_200 0 100000 /end CHARACTERISTIC
/begin CHARACTERISTIC Estop_switch_ovr_new "" VALUE 0x800002F1 RecordLayout_1 0 CompuMethod_27 0 1 /end CHARACTERISTIC
/begin CHARACTERISTIC Estop_switch_ovr_ovr "" VALUE 0x800002F2 RecordLayout_1 0 CompuMethod_9 0 1 /end CHARACTERISTIC
/begin CHARACTERISTIC Fan_Hold_Mode "" VALUE 0x800002F5 RecordLayout_1 0 CompuMethod_202 0 255 /end CHARACTERISTIC
/begin CHARACTERISTIC Fan_Mode "" VALUE 0x800002F6 RecordLayout_1 0 CompuMethod_203 0 255 /end CHARACTERISTIC
/begin CHARACTERISTIC FanOut_Frequency "Frequency of PWM output" VALUE 0x800002F9 RecordLayout_4 0 CompuMethod_205 -1E+17 1E+17 /end CHARACTERISTIC
/begin CHARACTERISTIC FanOut_Gain "Scaling from engineering units to PWM duty cycle" VALUE 0x800002FD RecordLayout_4 0 CompuMethod_206 -1E+17 1E+17 /end CHARACTERISTIC
/begin CHARACTERISTIC FanOut_MaxLimit "Maximum limit of PWM signal." VALUE 0x80000301 RecordLayout_4 0 CompuMethod_6 -1E+17 1E+17 /end CHARACTERISTIC
/begin CHARACTERISTIC FanOut_MinLimit "Minimum limit of PWM signal." VALUE 0x80000305 RecordLayout_4 0 CompuMethod_6 -1E+17 1E+17 /end CHARACTERISTIC
/begin CHARACTERISTIC FanOut_new "Override result of linear sensor characterization, in engineering units" VALUE 0x80000309 RecordLayout_4 0 CompuMethod_6 -1E+17 1E+17 /end CHARACTERISTIC
/begin CHARACTERISTIC FanOut_Offset "Offset from engineering units to PWM duty cycle" VALUE 0x8000030D RecordLayout_4 0 CompuMethod_6 -1E+17 1E+17 /end CHARACTERISTIC
/begin CHARACTERISTIC FanOut_ovr "" VALUE 0x80000311 RecordLayout_1 0 CompuMethod_9 0 1 /end CHARACTERISTIC
/begin CHARACTERISTIC FaultCommand "Select a command to control the fault manager." VALUE 0x80000312 RecordLayout_1 0 CompuMethod_208 0 255 /end CHARACTERISTIC
/begin CHARACTERISTIC FaultManager.Accel_NeverZeroed.Mode "Fault manager configuration.  Select up to 4 actions for each fault." VALUE 0x80000313 RecordLayout_8 0 CompuMethod_209 0 65535 /end CHARACTERISTIC
/begin CHARACTERISTIC FaultManager.Accel_NeverZeroed.ID "Fault manager configuration.  Select up to 4 actions for each fault." VALUE 0x80000315 RecordLayout_8 0 CompuMethod_1 0 65535 /end CHARACTERISTIC
/begin CHARACTERISTIC FaultManager.Accel_NeverZeroed.Test "Fault manager configuration.  Select up to 4 actions for each fault." VALUE 0x80000317 RecordLayout_8 0 CompuMethod_210 0 65535 /end CHARACTERISTIC
/begin CHARACTERISTIC FaultManager.Accel_NeverZeroed.Faulty_Samples__X_ "Fault manager configuration.  Select up to 4 actions for each fault." VALUE 0x80000319 RecordLayout_8 0 CompuMethod_1 0 65535 /end CHARACTERISTIC
/begin CHARACTERISTIC FaultManager.Accel_NeverZeroed.Total_Samples__Y_ "Fault manager configuration.  Select up to 4 actions for each fault." VALUE 0x8000031B RecordLayout_8 0 CompuMethod_1 0 65535 /end CHARACTERISTIC
/begin CHARACTERISTIC FaultManager.Accel_NeverZeroed.Action_1 "Fault manager configuration.  Select up to 4 actions for each fault." VALUE 0x8000031D RecordLayout_8 0 CompuMethod_211 0 65535 /end CHARACTERISTIC
/begin CHARACTERISTIC FaultManager.Accel_NeverZeroed.Action_1_Condition "Fault manager configuration.  Select up to 4 actions for each fault." VALUE 0x8000031F RecordLayout_8 0 CompuMethod_212 0 65535 /end CHARACTERISTIC
/begin CHARACTERISTIC FaultManager.Accel_NeverZeroed.Action_2 "Fault manager configuration.  Select up to 4 actions for each fault." VALUE 0x80000321 RecordLayout_8 0 CompuMethod_211 0 65535 /end CHARACTERISTIC
/begin CHARACTERISTIC FaultManager.Accel_NeverZeroed.Action_2_Condition "Fault manager configuration.  Select up to 4 actions for each fault." VALUE 0x80000323 RecordLayout_8 0 CompuMethod_212 0 65535 /end CHARACTERISTIC
/begin CHARACTERISTIC FaultManager.Accel_NeverZeroed.Action_3 "Fault manager configuration.  Select up to 4 actions for each fault." VALUE 0x80000325 RecordLayout_8 0 CompuMethod_211 0 65535 /end CHARACTERISTIC
/begin CHARACTERISTIC FaultManager.Accel_NeverZeroed.Action_3_Condition "Fault manager configuration.  Select up to 4 actions for each fault." VALUE 0x80000327 RecordLayout_8 0 CompuMethod_212 0 65535 /end CHARACTERISTIC
/begin CHARACTERISTIC FaultManager.Accel_NeverZeroed.Action_4 "Fault manager configuration.  Select up to 4 actions for each fault." VALUE 0x80000329 RecordLayout_8 0 CompuMethod_211 0 65535 /end CHARACTERISTIC
/begin CHARACTERISTIC FaultManager.Accel_NeverZeroed.Action_4_Condition "Fault manager configuration.  Select up to 4 actions for each fault." VALUE 0x8000032B RecordLayout_8 0 CompuMethod_212 0 65535 /end CHARACTERISTIC
/begin CHARACTERISTIC FaultManager.Accel_RangeHigh.Mode "Fault manager configuration.  Select up to 4 actions for each fault." VALUE 0x8000032D RecordLayout_8 0 CompuMethod_209 0 65535 /end CHARACTERISTIC
/begin CHARACTERISTIC FaultManager.Accel_RangeHigh.ID "Fault manager configuration.  Select up to 4 actions for each fault." VALUE 0x8000032F RecordLayout_8 0 CompuMethod_1 0 65535 /end CHARACTERISTIC
/begin CHARACTERISTIC FaultManager.Accel_RangeHigh.Test "Fault manager configuration.  Select up to 4 actions for each fault." VALUE 0x80000331 RecordLayout_8 0 CompuMethod_210 0 65535 /end CHARACTERISTIC
/begin CHARACTERISTIC FaultManager.Accel_RangeHigh.Faulty_Samples__X_ "Fault manager configuration.  Select up to 4 actions for each fault." VALUE 0x80000333 RecordLayout_8 0 CompuMethod_1 0 65535 /end CHARACTERISTIC
/begin CHARACTERISTIC FaultManager.Accel_RangeHigh.Total_Samples__Y_ "Fault manager configuration.  Select up to 4 actions for each fault." VALUE 0x80000335 RecordLayout_8 0 CompuMethod_1 0 65535 /end CHARACTERISTIC
/begin CHARACTERISTIC FaultManager.Accel_RangeHigh.Action_1 "Fault manager configuration.  Select up to 4 actions for each fault." VALUE 0x80000337 RecordLayout_8 0 CompuMethod_211 0 65535 /end CHARACTERISTIC
/begin CHARACTERISTIC FaultManager.Accel_RangeHigh.Action_1_Condition "Fault manager configuration.  Select up to 4 actions for each fault." VALUE 0x80000339 RecordLayout_8 0 CompuMethod_212 0 65535 /end CHARACTERISTIC
/begin CHARACTERISTIC FaultManager.Accel_RangeHigh.Action_2 "Fault manager configuration.  Select up to 4 actions for each fault." VALUE 0x8000033B RecordLayout_8 0 CompuMethod_211 0 65535 /end CHARACTERISTIC
/begin CHARACTERISTIC FaultManager.Accel_RangeHigh.Action_2_Condition "Fault manager configuration.  Select up to 4 actions for each fault." VALUE 0x8000033D RecordLayout_8 0 CompuMethod_212 0 65535 /end CHARACTERISTIC
/begin CHARACTERISTIC FaultManager.Accel_RangeHigh.Action_3 "Fault manager configuration.  Select up to 4 actions for each fault." VALUE 0x8000033F RecordLayout_8 0 CompuMethod_211 0 65535 /end CHARACTERISTIC
/begin CHARACTERISTIC FaultManager.Accel_RangeHigh.Action_3_Condition "Fault manager configuration.  Select up to 4 actions for each fault." VALUE 0x80000341 RecordLayout_8 0 CompuMethod_212 0 65535 /end CHARACTERISTIC
/begin CHARACTERISTIC FaultManager.Accel_RangeHigh.Action_4 "Fault manager configuration.  Select up to 4 actions for each fault." VALUE 0x80000343 RecordLayout_8 0 CompuMethod_211 0 65535 /end CHARACTERISTIC
/begin CHARACTERISTIC FaultManager.Accel_RangeHigh.Action_4_Condition "Fault manager configuration.  Select up to 4 actions for each fault." VALUE 0x80000345 RecordLayout_8 0 CompuMethod_212 0 65535 /end CHARACTERISTIC
/begin CHARACTERISTIC FaultManager.Accel_RangeLow.Mode "Fault manager configuration.  Select up to 4 actions for each fault." VALUE 0x80000347 RecordLayout_8 0 CompuMethod_209 0 65535 /end CHARACTERISTIC
/begin CHARACTERISTIC FaultManager.Accel_RangeLow.ID "Fault manager configuration.  Select up to 4 actions for each fault." VALUE 0x80000349 RecordLayout_8 0 CompuMethod_1 0 65535 /end CHARACTERISTIC
/begin CHARACTERISTIC FaultManager.Accel_RangeLow.Test "Fault manager configuration.  Select up to 4 actions for each fault." VALUE 0x8000034B RecordLayout_8 0 CompuMethod_210 0 65535 /end CHARACTERISTIC
/begin CHARACTERISTIC FaultManager.Accel_RangeLow.Faulty_Samples__X_ "Fault manager configuration.  Select up to 4 actions for each fault." VALUE 0x8000034D RecordLayout_8 0 CompuMethod_1 0 65535 /end CHARACTERISTIC
/begin CHARACTERISTIC FaultManager.Accel_RangeLow.Total_Samples__Y_ "Fault manager configuration.  Select up to 4 actions for each fault." VALUE 0x8000034F RecordLayout_8 0 CompuMethod_1 0 65535 /end CHARACTERISTIC
/begin CHARACTERISTIC FaultManager.Accel_RangeLow.Action_1 "Fault manager configuration.  Select up to 4 actions for each fault." VALUE 0x80000351 RecordLayout_8 0 CompuMethod_211 0 65535 /end CHARACTERISTIC
/begin CHARACTERISTIC FaultManager.Accel_RangeLow.Action_1_Condition "Fault manager configuration.  Select up to 4 actions for each fault." VALUE 0x80000353 RecordLayout_8 0 CompuMethod_212 0 65535 /end CHARACTERISTIC
/begin CHARACTERISTIC FaultManager.Accel_RangeLow.Action_2 "Fault manager configuration.  Select up to 4 actions for each fault." VALUE 0x80000355 RecordLayout_8 0 CompuMethod_211 0 65535 /end CHARACTERISTIC
/begin CHARACTERISTIC FaultManager.Accel_RangeLow.Action_2_Condition "Fault manager configuration.  Select up to 4 actions for each fault." VALUE 0x80000357 RecordLayout_8 0 CompuMethod_212 0 65535 /end CHARACTERISTIC
/begin CHARACTERISTIC FaultManager.Accel_RangeLow.Action_3 "Fault manager configuration.  Select up to 4 actions for each fault." VALUE 0x80000359 RecordLayout_8 0 CompuMethod_211 0 65535 /end CHARACTERISTIC
/begin CHARACTERISTIC FaultManager.Accel_RangeLow.Action_3_Condition "Fault manager configuration.  Select up to 4 actions for each fault." VALUE 0x8000035B RecordLayout_8 0 CompuMethod_212 0 65535 /end CHARACTERISTIC
/begin CHARACTERISTIC FaultManager.Accel_RangeLow.Action_4 "Fault manager configuration.  Select up to 4 actions for each fault." VALUE 0x8000035D RecordLayout_8 0 CompuMethod_211 0 65535 /end CHARACTERISTIC
/begin CHARACTERISTIC FaultManager.Accel_RangeLow.Action_4_Condition "Fault manager configuration.  Select up to 4 actions for each fault." VALUE 0x8000035F RecordLayout_8 0 CompuMethod_212 0 65535 /end CHARACTERISTIC
/begin CHARACTERISTIC FaultManager.Battery_OverTemp.Mode "Fault manager configuration.  Select up to 4 actions for each fault." VALUE 0x80000361 RecordLayout_8 0 CompuMethod_209 0 65535 /end CHARACTERISTIC
/begin CHARACTERISTIC FaultManager.Battery_OverTemp.ID "Fault manager configuration.  Select up to 4 actions for each fault." VALUE 0x80000363 RecordLayout_8 0 CompuMethod_1 0 65535 /end CHARACTERISTIC
/begin CHARACTERISTIC FaultManager.Battery_OverTemp.Test "Fault manager configuration.  Select up to 4 actions for each fault." VALUE 0x80000365 RecordLayout_8 0 CompuMethod_210 0 65535 /end CHARACTERISTIC
/begin CHARACTERISTIC FaultManager.Battery_OverTemp.Faulty_Samples__X_ "Fault manager configuration.  Select up to 4 actions for each fault." VALUE 0x80000367 RecordLayout_8 0 CompuMethod_1 0 65535 /end CHARACTERISTIC
/begin CHARACTERISTIC FaultManager.Battery_OverTemp.Total_Samples__Y_ "Fault manager configuration.  Select up to 4 actions for each fault." VALUE 0x80000369 RecordLayout_8 0 CompuMethod_1 0 65535 /end CHARACTERISTIC
/begin CHARACTERISTIC FaultManager.Battery_OverTemp.Action_1 "Fault manager configuration.  Select up to 4 actions for each fault." VALUE 0x8000036B RecordLayout_8 0 CompuMethod_211 0 65535 /end CHARACTERISTIC
/begin CHARACTERISTIC FaultManager.Battery_OverTemp.Action_1_Condition "Fault manager configuration.  Select up to 4 actions for each fault." VALUE 0x8000036D RecordLayout_8 0 CompuMethod_212 0 65535 /end CHARACTERISTIC
/begin CHARACTERISTIC FaultManager.Battery_OverTemp.Action_2 "Fault manager configuration.  Select up to 4 actions for each fault." VALUE 0x8000036F RecordLayout_8 0 CompuMethod_211 0 65535 /end CHARACTERISTIC
/begin CHARACTERISTIC FaultManager.Battery_OverTemp.Action_2_Condition "Fault manager configuration.  Select up to 4 actions for each fault." VALUE 0x80000371 RecordLayout_8 0 CompuMethod_212 0 65535 /end CHARACTERISTIC
/begin CHARACTERISTIC FaultManager.Battery_OverTemp.Action_3 "Fault manager configuration.  Select up to 4 actions for each fault." VALUE 0x80000373 RecordLayout_8 0 CompuMethod_211 0 65535 /end CHARACTERISTIC
/begin CHARACTERISTIC FaultManager.Battery_OverTemp.Action_3_Condition "Fault manager configuration.  Select up to 4 actions for each fault." VALUE 0x80000375 RecordLayout_8 0 CompuMethod_212 0 65535 /end CHARACTERISTIC
/begin CHARACTERISTIC FaultManager.Battery_OverTemp.Action_4 "Fault manager configuration.  Select up to 4 actions for each fault." VALUE 0x80000377 RecordLayout_8 0 CompuMethod_211 0 65535 /end CHARACTERISTIC
/begin CHARACTERISTIC FaultManager.Battery_OverTemp.Action_4_Condition "Fault manager configuration.  Select up to 4 actions for each fault." VALUE 0x80000379 RecordLayout_8 0 CompuMethod_212 0 65535 /end CHARACTERISTIC
/begin CHARACTERISTIC FaultManager.Battery_UnderTemp.Mode "Fault manager configuration.  Select up to 4 actions for each fault." VALUE 0x8000037B RecordLayout_8 0 CompuMethod_209 0 65535 /end CHARACTERISTIC
/begin CHARACTERISTIC FaultManager.Battery_UnderTemp.ID "Fault manager configuration.  Select up to 4 actions for each fault." VALUE 0x8000037D RecordLayout_8 0 CompuMethod_1 0 65535 /end CHARACTERISTIC
/begin CHARACTERISTIC FaultManager.Battery_UnderTemp.Test "Fault manager configuration.  Select up to 4 actions for each fault." VALUE 0x8000037F RecordLayout_8 0 CompuMethod_210 0 65535 /end CHARACTERISTIC
/begin CHARACTERISTIC FaultManager.Battery_UnderTemp.Faulty_Samples__X_ "Fault manager configuration.  Select up to 4 actions for each fault." VALUE 0x80000381 RecordLayout_8 0 CompuMethod_1 0 65535 /end CHARACTERISTIC
/begin CHARACTERISTIC FaultManager.Battery_UnderTemp.Total_Samples__Y_ "Fault manager configuration.  Select up to 4 actions for each fault." VALUE 0x80000383 RecordLayout_8 0 CompuMethod_1 0 65535 /end CHARACTERISTIC
/begin CHARACTERISTIC FaultManager.Battery_UnderTemp.Action_1 "Fault manager configuration.  Select up to 4 actions for each fault." VALUE 0x80000385 RecordLayout_8 0 CompuMethod_211 0 65535 /end CHARACTERISTIC
/begin CHARACTERISTIC FaultManager.Battery_UnderTemp.Action_1_Condition "Fault manager configuration.  Select up to 4 actions for each fault." VALUE 0x80000387 RecordLayout_8 0 CompuMethod_212 0 65535 /end CHARACTERISTIC
/begin CHARACTERISTIC FaultManager.Battery_UnderTemp.Action_2 "Fault manager configuration.  Select up to 4 actions for each fault." VALUE 0x80000389 RecordLayout_8 0 CompuMethod_211 0 65535 /end CHARACTERISTIC
/begin CHARACTERISTIC FaultManager.Battery_UnderTemp.Action_2_Condition "Fault manager configuration.  Select up to 4 actions for each fault." VALUE 0x8000038B RecordLayout_8 0 CompuMethod_212 0 65535 /end CHARACTERISTIC
/begin CHARACTERISTIC FaultManager.Battery_UnderTemp.Action_3 "Fault manager configuration.  Select up to 4 actions for each fault." VALUE 0x8000038D RecordLayout_8 0 CompuMethod_211 0 65535 /end CHARACTERISTIC
/begin CHARACTERISTIC FaultManager.Battery_UnderTemp.Action_3_Condition "Fault manager configuration.  Select up to 4 actions for each fault." VALUE 0x8000038F RecordLayout_8 0 CompuMethod_212 0 65535 /end CHARACTERISTIC
/begin CHARACTERISTIC FaultManager.Battery_UnderTemp.Action_4 "Fault manager configuration.  Select up to 4 actions for each fault." VALUE 0x80000391 RecordLayout_8 0 CompuMethod_211 0 65535 /end CHARACTERISTIC
/begin CHARACTERISTIC FaultManager.Battery_UnderTemp.Action_4_Condition "Fault manager configuration.  Select up to 4 actions for each fault." VALUE 0x80000393 RecordLayout_8 0 CompuMethod_212 0 65535 /end CHARACTERISTIC
/begin CHARACTERISTIC FaultManager.Brake_RangeHigh.Mode "Fault manager configuration.  Select up to 4 actions for each fault." VALUE 0x80000395 RecordLayout_8 0 CompuMethod_209 0 65535 /end CHARACTERISTIC
/begin CHARACTERISTIC FaultManager.Brake_RangeHigh.ID "Fault manager configuration.  Select up to 4 actions for each fault." VALUE 0x80000397 RecordLayout_8 0 CompuMethod_1 0 65535 /end CHARACTERISTIC
/begin CHARACTERISTIC FaultManager.Brake_RangeHigh.Test "Fault manager configuration.  Select up to 4 actions for each fault." VALUE 0x80000399 RecordLayout_8 0 CompuMethod_210 0 65535 /end CHARACTERISTIC
/begin CHARACTERISTIC FaultManager.Brake_RangeHigh.Faulty_Samples__X_ "Fault manager configuration.  Select up to 4 actions for each fault." VALUE 0x8000039B RecordLayout_8 0 CompuMethod_1 0 65535 /end CHARACTERISTIC
/begin CHARACTERISTIC FaultManager.Brake_RangeHigh.Total_Samples__Y_ "Fault manager configuration.  Select up to 4 actions for each fault." VALUE 0x8000039D RecordLayout_8 0 CompuMethod_1 0 65535 /end CHARACTERISTIC
/begin CHARACTERISTIC FaultManager.Brake_RangeHigh.Action_1 "Fault manager configuration.  Select up to 4 actions for each fault." VALUE 0x8000039F RecordLayout_8 0 CompuMethod_211 0 65535 /end CHARACTERISTIC
/begin CHARACTERISTIC FaultManager.Brake_RangeHigh.Action_1_Condition "Fault manager configuration.  Select up to 4 actions for each fault." VALUE 0x800003A1 RecordLayout_8 0 CompuMethod_212 0 65535 /end CHARACTERISTIC
/begin CHARACTERISTIC FaultManager.Brake_RangeHigh.Action_2 "Fault manager configuration.  Select up to 4 actions for each fault." VALUE 0x800003A3 RecordLayout_8 0 CompuMethod_211 0 65535 /end CHARACTERISTIC
/begin CHARACTERISTIC FaultManager.Brake_RangeHigh.Action_2_Condition "Fault manager configuration.  Select up to 4 actions for each fault." VALUE 0x800003A5 RecordLayout_8 0 CompuMethod_212 0 65535 /end CHARACTERISTIC
/begin CHARACTERISTIC FaultManager.Brake_RangeHigh.Action_3 "Fault manager configuration.  Select up to 4 actions for each fault." VALUE 0x800003A7 RecordLayout_8 0 CompuMethod_211 0 65535 /end CHARACTERISTIC
/begin CHARACTERISTIC FaultManager.Brake_RangeHigh.Action_3_Condition "Fault manager configuration.  Select up to 4 actions for each fault." VALUE 0x800003A9 RecordLayout_8 0 CompuMethod_212 0 65535 /end CHARACTERISTIC
/begin CHARACTERISTIC FaultManager.Brake_RangeHigh.Action_4 "Fault manager configuration.  Select up to 4 actions for each fault." VALUE 0x800003AB RecordLayout_8 0 CompuMethod_211 0 65535 /end CHARACTERISTIC
/begin CHARACTERISTIC FaultManager.Brake_RangeHigh.Action_4_Condition "Fault manager configuration.  Select up to 4 actions for each fault." VALUE 0x800003AD RecordLayout_8 0 CompuMethod_212 0 65535 /end CHARACTERISTIC
/begin CHARACTERISTIC FaultManager.Brake_RangeLow.Mode "Fault manager configuration.  Select up to 4 actions for each fault." VALUE 0x800003AF RecordLayout_8 0 CompuMethod_209 0 65535 /end CHARACTERISTIC
/begin CHARACTERISTIC FaultManager.Brake_RangeLow.ID "Fault manager configuration.  Select up to 4 actions for each fault." VALUE 0x800003B1 RecordLayout_8 0 CompuMethod_1 0 65535 /end CHARACTERISTIC
/begin CHARACTERISTIC FaultManager.Brake_RangeLow.Test "Fault manager configuration.  Select up to 4 actions for each fault." VALUE 0x800003B3 RecordLayout_8 0 CompuMethod_210 0 65535 /end CHARACTERISTIC
/begin CHARACTERISTIC FaultManager.Brake_RangeLow.Faulty_Samples__X_ "Fault manager configuration.  Select up to 4 actions for each fault." VALUE 0x800003B5 RecordLayout_8 0 CompuMethod_1 0 65535 /end CHARACTERISTIC
/begin CHARACTERISTIC FaultManager.Brake_RangeLow.Total_Samples__Y_ "Fault manager configuration.  Select up to 4 actions for each fault." VALUE 0x800003B7 RecordLayout_8 0 CompuMethod_1 0 65535 /end CHARACTERISTIC
/begin CHARACTERISTIC FaultManager.Brake_RangeLow.Action_1 "Fault manager configuration.  Select up to 4 actions for each fault." VALUE 0x800003B9 RecordLayout_8 0 CompuMethod_211 0 65535 /end CHARACTERISTIC
/begin CHARACTERISTIC FaultManager.Brake_RangeLow.Action_1_Condition "Fault manager configuration.  Select up to 4 actions for each fault." VALUE 0x800003BB RecordLayout_8 0 CompuMethod_212 0 65535 /end CHARACTERISTIC
/begin CHARACTERISTIC FaultManager.Brake_RangeLow.Action_2 "Fault manager configuration.  Select up to 4 actions for each fault." VALUE 0x800003BD RecordLayout_8 0 CompuMethod_211 0 65535 /end CHARACTERISTIC
/begin CHARACTERISTIC FaultManager.Brake_RangeLow.Action_2_Condition "Fault manager configuration.  Select up to 4 actions for each fault." VALUE 0x800003BF RecordLayout_8 0 CompuMethod_212 0 65535 /end CHARACTERISTIC
/begin CHARACTERISTIC FaultManager.Brake_RangeLow.Action_3 "Fault manager configuration.  Select up to 4 actions for each fault." VALUE 0x800003C1 RecordLayout_8 0 CompuMethod_211 0 65535 /end CHARACTERISTIC
/begin CHARACTERISTIC FaultManager.Brake_RangeLow.Action_3_Condition "Fault manager configuration.  Select up to 4 actions for each fault." VALUE 0x800003C3 RecordLayout_8 0 CompuMethod_212 0 65535 /end CHARACTERISTIC
/begin CHARACTERISTIC FaultManager.Brake_RangeLow.Action_4 "Fault manager configuration.  Select up to 4 actions for each fault." VALUE 0x800003C5 RecordLayout_8 0 CompuMethod_211 0 65535 /end CHARACTERISTIC
/begin CHARACTERISTIC FaultManager.Brake_RangeLow.Action_4_Condition "Fault manager configuration.  Select up to 4 actions for each fault." VALUE 0x800003C7 RecordLayout_8 0 CompuMethod_212 0 65535 /end CHARACTERISTIC
/begin CHARACTERISTIC FaultManager.ChargeComplete.Mode "Fault manager configuration.  Select up to 4 actions for each fault." VALUE 0x800003C9 RecordLayout_8 0 CompuMethod_209 0 65535 /end CHARACTERISTIC
/begin CHARACTERISTIC FaultManager.ChargeComplete.ID "Fault manager configuration.  Select up to 4 actions for each fault." VALUE 0x800003CB RecordLayout_8 0 CompuMethod_1 0 65535 /end CHARACTERISTIC
/begin CHARACTERISTIC FaultManager.ChargeComplete.Test "Fault manager configuration.  Select up to 4 actions for each fault." VALUE 0x800003CD RecordLayout_8 0 CompuMethod_210 0 65535 /end CHARACTERISTIC
/begin CHARACTERISTIC FaultManager.ChargeComplete.Faulty_Samples__X_ "Fault manager configuration.  Select up to 4 actions for each fault." VALUE 0x800003CF RecordLayout_8 0 CompuMethod_1 0 65535 /end CHARACTERISTIC
/begin CHARACTERISTIC FaultManager.ChargeComplete.Total_Samples__Y_ "Fault manager configuration.  Select up to 4 actions for each fault." VALUE 0x800003D1 RecordLayout_8 0 CompuMethod_1 0 65535 /end CHARACTERISTIC
/begin CHARACTERISTIC FaultManager.ChargeComplete.Action_1 "Fault manager configuration.  Select up to 4 actions for each fault." VALUE 0x800003D3 RecordLayout_8 0 CompuMethod_211 0 65535 /end CHARACTERISTIC
/begin CHARACTERISTIC FaultManager.ChargeComplete.Action_1_Condition "Fault manager configuration.  Select up to 4 actions for each fault." VALUE 0x800003D5 RecordLayout_8 0 CompuMethod_212 0 65535 /end CHARACTERISTIC
/begin CHARACTERISTIC FaultManager.ChargeComplete.Action_2 "Fault manager configuration.  Select up to 4 actions for each fault." VALUE 0x800003D7 RecordLayout_8 0 CompuMethod_211 0 65535 /end CHARACTERISTIC
/begin CHARACTERISTIC FaultManager.ChargeComplete.Action_2_Condition "Fault manager configuration.  Select up to 4 actions for each fault." VALUE 0x800003D9 RecordLayout_8 0 CompuMethod_212 0 65535 /end CHARACTERISTIC
/begin CHARACTERISTIC FaultManager.ChargeComplete.Action_3 "Fault manager configuration.  Select up to 4 actions for each fault." VALUE 0x800003DB RecordLayout_8 0 CompuMethod_211 0 65535 /end CHARACTERISTIC
/begin CHARACTERISTIC FaultManager.ChargeComplete.Action_3_Condition "Fault manager configuration.  Select up to 4 actions for each fault." VALUE 0x800003DD RecordLayout_8 0 CompuMethod_212 0 65535 /end CHARACTERISTIC
/begin CHARACTERISTIC FaultManager.ChargeComplete.Action_4 "Fault manager configuration.  Select up to 4 actions for each fault." VALUE 0x800003DF RecordLayout_8 0 CompuMethod_211 0 65535 /end CHARACTERISTIC
/begin CHARACTERISTIC FaultManager.ChargeComplete.Action_4_Condition "Fault manager configuration.  Select up to 4 actions for each fault." VALUE 0x800003E1 RecordLayout_8 0 CompuMethod_212 0 65535 /end CHARACTERISTIC
/begin CHARACTERISTIC FaultManager.CoolingOverheat.Mode "Fault manager configuration.  Select up to 4 actions for each fault." VALUE 0x800003E3 RecordLayout_8 0 CompuMethod_209 0 65535 /end CHARACTERISTIC
/begin CHARACTERISTIC FaultManager.CoolingOverheat.ID "Fault manager configuration.  Select up to 4 actions for each fault." VALUE 0x800003E5 RecordLayout_8 0 CompuMethod_1 0 65535 /end CHARACTERISTIC
/begin CHARACTERISTIC FaultManager.CoolingOverheat.Test "Fault manager configuration.  Select up to 4 actions for each fault." VALUE 0x800003E7 RecordLayout_8 0 CompuMethod_210 0 65535 /end CHARACTERISTIC
/begin CHARACTERISTIC FaultManager.CoolingOverheat.Faulty_Samples__X_ "Fault manager configuration.  Select up to 4 actions for each fault." VALUE 0x800003E9 RecordLayout_8 0 CompuMethod_1 0 65535 /end CHARACTERISTIC
/begin CHARACTERISTIC FaultManager.CoolingOverheat.Total_Samples__Y_ "Fault manager configuration.  Select up to 4 actions for each fault." VALUE 0x800003EB RecordLayout_8 0 CompuMethod_1 0 65535 /end CHARACTERISTIC
/begin CHARACTERISTIC FaultManager.CoolingOverheat.Action_1 "Fault manager configuration.  Select up to 4 actions for each fault." VALUE 0x800003ED RecordLayout_8 0 CompuMethod_211 0 65535 /end CHARACTERISTIC
/begin CHARACTERISTIC FaultManager.CoolingOverheat.Action_1_Condition "Fault manager configuration.  Select up to 4 actions for each fault." VALUE 0x800003EF RecordLayout_8 0 CompuMethod_212 0 65535 /end CHARACTERISTIC
/begin CHARACTERISTIC FaultManager.CoolingOverheat.Action_2 "Fault manager configuration.  Select up to 4 actions for each fault." VALUE 0x800003F1 RecordLayout_8 0 CompuMethod_211 0 65535 /end CHARACTERISTIC
/begin CHARACTERISTIC FaultManager.CoolingOverheat.Action_2_Condition "Fault manager configuration.  Select up to 4 actions for each fault." VALUE 0x800003F3 RecordLayout_8 0 CompuMethod_212 0 65535 /end CHARACTERISTIC
/begin CHARACTERISTIC FaultManager.CoolingOverheat.Action_3 "Fault manager configuration.  Select up to 4 actions for each fault." VALUE 0x800003F5 RecordLayout_8 0 CompuMethod_211 0 65535 /end CHARACTERISTIC
/begin CHARACTERISTIC FaultManager.CoolingOverheat.Action_3_Condition "Fault manager configuration.  Select up to 4 actions for each fault." VALUE 0x800003F7 RecordLayout_8 0 CompuMethod_212 0 65535 /end CHARACTERISTIC
/begin CHARACTERISTIC FaultManager.CoolingOverheat.Action_4 "Fault manager configuration.  Select up to 4 actions for each fault." VALUE 0x800003F9 RecordLayout_8 0 CompuMethod_211 0 65535 /end CHARACTERISTIC
/begin CHARACTERISTIC FaultManager.CoolingOverheat.Action_4_Condition "Fault manager configuration.  Select up to 4 actions for each fault." VALUE 0x800003FB RecordLayout_8 0 CompuMethod_212 0 65535 /end CHARACTERISTIC
/begin CHARACTERISTIC FaultManager.ESTOPped.Mode "Fault manager configuration.  Select up to 4 actions for each fault." VALUE 0x800003FD RecordLayout_8 0 CompuMethod_209 0 65535 /end CHARACTERISTIC
/begin CHARACTERISTIC FaultManager.ESTOPped.ID "Fault manager configuration.  Select up to 4 actions for each fault." VALUE 0x800003FF RecordLayout_8 0 CompuMethod_1 0 65535 /end CHARACTERISTIC
/begin CHARACTERISTIC FaultManager.ESTOPped.Test "Fault manager configuration.  Select up to 4 actions for each fault." VALUE 0x80000401 RecordLayout_8 0 CompuMethod_210 0 65535 /end CHARACTERISTIC
/begin CHARACTERISTIC FaultManager.ESTOPped.Faulty_Samples__X_ "Fault manager configuration.  Select up to 4 actions for each fault." VALUE 0x80000403 RecordLayout_8 0 CompuMethod_1 0 65535 /end CHARACTERISTIC
/begin CHARACTERISTIC FaultManager.ESTOPped.Total_Samples__Y_ "Fault manager configuration.  Select up to 4 actions for each fault." VALUE 0x80000405 RecordLayout_8 0 CompuMethod_1 0 65535 /end CHARACTERISTIC
/begin CHARACTERISTIC FaultManager.ESTOPped.Action_1 "Fault manager configuration.  Select up to 4 actions for each fault." VALUE 0x80000407 RecordLayout_8 0 CompuMethod_211 0 65535 /end CHARACTERISTIC
/begin CHARACTERISTIC FaultManager.ESTOPped.Action_1_Condition "Fault manager configuration.  Select up to 4 actions for each fault." VALUE 0x80000409 RecordLayout_8 0 CompuMethod_212 0 65535 /end CHARACTERISTIC
/begin CHARACTERISTIC FaultManager.ESTOPped.Action_2 "Fault manager configuration.  Select up to 4 actions for each fault." VALUE 0x8000040B RecordLayout_8 0 CompuMethod_211 0 65535 /end CHARACTERISTIC
/begin CHARACTERISTIC FaultManager.ESTOPped.Action_2_Condition "Fault manager configuration.  Select up to 4 actions for each fault." VALUE 0x8000040D RecordLayout_8 0 CompuMethod_212 0 65535 /end CHARACTERISTIC
/begin CHARACTERISTIC FaultManager.ESTOPped.Action_3 "Fault manager configuration.  Select up to 4 actions for each fault." VALUE 0x8000040F RecordLayout_8 0 CompuMethod_211 0 65535 /end CHARACTERISTIC
/begin CHARACTERISTIC FaultManager.ESTOPped.Action_3_Condition "Fault manager configuration.  Select up to 4 actions for each fault." VALUE 0x80000411 RecordLayout_8 0 CompuMethod_212 0 65535 /end CHARACTERISTIC
/begin CHARACTERISTIC FaultManager.ESTOPped.Action_4 "Fault manager configuration.  Select up to 4 actions for each fault." VALUE 0x80000413 RecordLayout_8 0 CompuMethod_211 0 65535 /end CHARACTERISTIC
/begin CHARACTERISTIC FaultManager.ESTOPped.Action_4_Condition "Fault manager configuration.  Select up to 4 actions for each fault." VALUE 0x80000415 RecordLayout_8 0 CompuMethod_212 0 65535 /end CHARACTERISTIC
/begin CHARACTERISTIC FaultManager.Eaton_CAN_Timeout.Mode "Fault manager configuration.  Select up to 4 actions for each fault." VALUE 0x80000417 RecordLayout_8 0 CompuMethod_209 0 65535 /end CHARACTERISTIC
/begin CHARACTERISTIC FaultManager.Eaton_CAN_Timeout.ID "Fault manager configuration.  Select up to 4 actions for each fault." VALUE 0x80000419 RecordLayout_8 0 CompuMethod_1 0 65535 /end CHARACTERISTIC
/begin CHARACTERISTIC FaultManager.Eaton_CAN_Timeout.Test "Fault manager configuration.  Select up to 4 actions for each fault." VALUE 0x8000041B RecordLayout_8 0 CompuMethod_210 0 65535 /end CHARACTERISTIC
/begin CHARACTERISTIC FaultManager.Eaton_CAN_Timeout.Faulty_Samples__X_ "Fault manager configuration.  Select up to 4 actions for each fault." VALUE 0x8000041D RecordLayout_8 0 CompuMethod_1 0 65535 /end CHARACTERISTIC
/begin CHARACTERISTIC FaultManager.Eaton_CAN_Timeout.Total_Samples__Y_ "Fault manager configuration.  Select up to 4 actions for each fault." VALUE 0x8000041F RecordLayout_8 0 CompuMethod_1 0 65535 /end CHARACTERISTIC
/begin CHARACTERISTIC FaultManager.Eaton_CAN_Timeout.Action_1 "Fault manager configuration.  Select up to 4 actions for each fault." VALUE 0x80000421 RecordLayout_8 0 CompuMethod_211 0 65535 /end CHARACTERISTIC
/begin CHARACTERISTIC FaultManager.Eaton_CAN_Timeout.Action_1_Condition "Fault manager configuration.  Select up to 4 actions for each fault." VALUE 0x80000423 RecordLayout_8 0 CompuMethod_212 0 65535 /end CHARACTERISTIC
/begin CHARACTERISTIC FaultManager.Eaton_CAN_Timeout.Action_2 "Fault manager configuration.  Select up to 4 actions for each fault." VALUE 0x80000425 RecordLayout_8 0 CompuMethod_211 0 65535 /end CHARACTERISTIC
/begin CHARACTERISTIC FaultManager.Eaton_CAN_Timeout.Action_2_Condition "Fault manager configuration.  Select up to 4 actions for each fault." VALUE 0x80000427 RecordLayout_8 0 CompuMethod_212 0 65535 /end CHARACTERISTIC
/begin CHARACTERISTIC FaultManager.Eaton_CAN_Timeout.Action_3 "Fault manager configuration.  Select up to 4 actions for each fault." VALUE 0x80000429 RecordLayout_8 0 CompuMethod_211 0 65535 /end CHARACTERISTIC
/begin CHARACTERISTIC FaultManager.Eaton_CAN_Timeout.Action_3_Condition "Fault manager configuration.  Select up to 4 actions for each fault." VALUE 0x8000042B RecordLayout_8 0 CompuMethod_212 0 65535 /end CHARACTERISTIC
/begin CHARACTERISTIC FaultManager.Eaton_CAN_Timeout.Action_4 "Fault manager configuration.  Select up to 4 actions for each fault." VALUE 0x8000042D RecordLayout_8 0 CompuMethod_211 0 65535 /end CHARACTERISTIC
/begin CHARACTERISTIC FaultManager.Eaton_CAN_Timeout.Action_4_Condition "Fault manager configuration.  Select up to 4 actions for each fault." VALUE 0x8000042F RecordLayout_8 0 CompuMethod_212 0 65535 /end CHARACTERISTIC
/begin CHARACTERISTIC FaultManager.GroundFault.Mode "Fault manager configuration.  Select up to 4 actions for each fault." VALUE 0x80000431 RecordLayout_8 0 CompuMethod_209 0 65535 /end CHARACTERISTIC
/begin CHARACTERISTIC FaultManager.GroundFault.ID "Fault manager configuration.  Select up to 4 actions for each fault." VALUE 0x80000433 RecordLayout_8 0 CompuMethod_1 0 65535 /end CHARACTERISTIC
/begin CHARACTERISTIC FaultManager.GroundFault.Test "Fault manager configuration.  Select up to 4 actions for each fault." VALUE 0x80000435 RecordLayout_8 0 CompuMethod_210 0 65535 /end CHARACTERISTIC
/begin CHARACTERISTIC FaultManager.GroundFault.Faulty_Samples__X_ "Fault manager configuration.  Select up to 4 actions for each fault." VALUE 0x80000437 RecordLayout_8 0 CompuMethod_1 0 65535 /end CHARACTERISTIC
/begin CHARACTERISTIC FaultManager.GroundFault.Total_Samples__Y_ "Fault manager configuration.  Select up to 4 actions for each fault." VALUE 0x80000439 RecordLayout_8 0 CompuMethod_1 0 65535 /end CHARACTERISTIC
/begin CHARACTERISTIC FaultManager.GroundFault.Action_1 "Fault manager configuration.  Select up to 4 actions for each fault." VALUE 0x8000043B RecordLayout_8 0 CompuMethod_211 0 65535 /end CHARACTERISTIC
/begin CHARACTERISTIC FaultManager.GroundFault.Action_1_Condition "Fault manager configuration.  Select up to 4 actions for each fault." VALUE 0x8000043D RecordLayout_8 0 CompuMethod_212 0 65535 /end CHARACTERISTIC
/begin CHARACTERISTIC FaultManager.GroundFault.Action_2 "Fault manager configuration.  Select up to 4 actions for each fault." VALUE 0x8000043F RecordLayout_8 0 CompuMethod_211 0 65535 /end CHARACTERISTIC
/begin CHARACTERISTIC FaultManager.GroundFault.Action_2_Condition "Fault manager configuration.  Select up to 4 actions for each fault." VALUE 0x80000441 RecordLayout_8 0 CompuMethod_212 0 65535 /end CHARACTERISTIC
/begin CHARACTERISTIC FaultManager.GroundFault.Action_3 "Fault manager configuration.  Select up to 4 actions for each fault." VALUE 0x80000443 RecordLayout_8 0 CompuMethod_211 0 65535 /end CHARACTERISTIC
/begin CHARACTERISTIC FaultManager.GroundFault.Action_3_Condition "Fault manager configuration.  Select up to 4 actions for each fault." VALUE 0x80000445 RecordLayout_8 0 CompuMethod_212 0 65535 /end CHARACTERISTIC
/begin CHARACTERISTIC FaultManager.GroundFault.Action_4 "Fault manager configuration.  Select up to 4 actions for each fault." VALUE 0x80000447 RecordLayout_8 0 CompuMethod_211 0 65535 /end CHARACTERISTIC
/begin CHARACTERISTIC FaultManager.GroundFault.Action_4_Condition "Fault manager configuration.  Select up to 4 actions for each fault." VALUE 0x80000449 RecordLayout_8 0 CompuMethod_212 0 65535 /end CHARACTERISTIC
/begin CHARACTERISTIC FaultManager.HV_BUS_OFFLINE_check_fuse.Mode "Fault manager configuration.  Select up to 4 actions for each fault." VALUE 0x8000044B RecordLayout_8 0 CompuMethod_209 0 65535 /end CHARACTERISTIC
/begin CHARACTERISTIC FaultManager.HV_BUS_OFFLINE_check_fuse.ID "Fault manager configuration.  Select up to 4 actions for each fault." VALUE 0x8000044D RecordLayout_8 0 CompuMethod_1 0 65535 /end CHARACTERISTIC
/begin CHARACTERISTIC FaultManager.HV_BUS_OFFLINE_check_fuse.Test "Fault manager configuration.  Select up to 4 actions for each fault." VALUE 0x8000044F RecordLayout_8 0 CompuMethod_210 0 65535 /end CHARACTERISTIC
/begin CHARACTERISTIC FaultManager.HV_BUS_OFFLINE_check_fuse.Faulty_Samples__X_ "Fault manager configuration.  Select up to 4 actions for each fault." VALUE 0x80000451 RecordLayout_8 0 CompuMethod_1 0 65535 /end CHARACTERISTIC
/begin CHARACTERISTIC FaultManager.HV_BUS_OFFLINE_check_fuse.Total_Samples__Y_ "Fault manager configuration.  Select up to 4 actions for each fault." VALUE 0x80000453 RecordLayout_8 0 CompuMethod_1 0 65535 /end CHARACTERISTIC
/begin CHARACTERISTIC FaultManager.HV_BUS_OFFLINE_check_fuse.Action_1 "Fault manager configuration.  Select up to 4 actions for each fault." VALUE 0x80000455 RecordLayout_8 0 CompuMethod_211 0 65535 /end CHARACTERISTIC
/begin CHARACTERISTIC FaultManager.HV_BUS_OFFLINE_check_fuse.Action_1_Condition "Fault manager configuration.  Select up to 4 actions for each fault." VALUE 0x80000457 RecordLayout_8 0 CompuMethod_212 0 65535 /end CHARACTERISTIC
/begin CHARACTERISTIC FaultManager.HV_BUS_OFFLINE_check_fuse.Action_2 "Fault manager configuration.  Select up to 4 actions for each fault." VALUE 0x80000459 RecordLayout_8 0 CompuMethod_211 0 65535 /end CHARACTERISTIC
/begin CHARACTERISTIC FaultManager.HV_BUS_OFFLINE_check_fuse.Action_2_Condition "Fault manager configuration.  Select up to 4 actions for each fault." VALUE 0x8000045B RecordLayout_8 0 CompuMethod_212 0 65535 /end CHARACTERISTIC
/begin CHARACTERISTIC FaultManager.HV_BUS_OFFLINE_check_fuse.Action_3 "Fault manager configuration.  Select up to 4 actions for each fault." VALUE 0x8000045D RecordLayout_8 0 CompuMethod_211 0 65535 /end CHARACTERISTIC
/begin CHARACTERISTIC FaultManager.HV_BUS_OFFLINE_check_fuse.Action_3_Condition "Fault manager configuration.  Select up to 4 actions for each fault." VALUE 0x8000045F RecordLayout_8 0 CompuMethod_212 0 65535 /end CHARACTERISTIC
/begin CHARACTERISTIC FaultManager.HV_BUS_OFFLINE_check_fuse.Action_4 "Fault manager configuration.  Select up to 4 actions for each fault." VALUE 0x80000461 RecordLayout_8 0 CompuMethod_211 0 65535 /end CHARACTERISTIC
/begin CHARACTERISTIC FaultManager.HV_BUS_OFFLINE_check_fuse.Action_4_Condition "Fault manager configuration.  Select up to 4 actions for each fault." VALUE 0x80000463 RecordLayout_8 0 CompuMethod_212 0 65535 /end CHARACTERISTIC
/begin CHARACTERISTIC FaultManager.High_Cell_Voltage_Shutdown.Mode "Fault manager configuration.  Select up to 4 actions for each fault." VALUE 0x80000465 RecordLayout_8 0 CompuMethod_209 0 65535 /end CHARACTERISTIC
/begin CHARACTERISTIC FaultManager.High_Cell_Voltage_Shutdown.ID "Fault manager configuration.  Select up to 4 actions for each fault." VALUE 0x80000467 RecordLayout_8 0 CompuMethod_1 0 65535 /end CHARACTERISTIC
/begin CHARACTERISTIC FaultManager.High_Cell_Voltage_Shutdown.Test "Fault manager configuration.  Select up to 4 actions for each fault." VALUE 0x80000469 RecordLayout_8 0 CompuMethod_210 0 65535 /end CHARACTERISTIC
/begin CHARACTERISTIC FaultManager.High_Cell_Voltage_Shutdown.Faulty_Samples__X_ "Fault manager configuration.  Select up to 4 actions for each fault." VALUE 0x8000046B RecordLayout_8 0 CompuMethod_1 0 65535 /end CHARACTERISTIC
/begin CHARACTERISTIC FaultManager.High_Cell_Voltage_Shutdown.Total_Samples__Y_ "Fault manager configuration.  Select up to 4 actions for each fault." VALUE 0x8000046D RecordLayout_8 0 CompuMethod_1 0 65535 /end CHARACTERISTIC
/begin CHARACTERISTIC FaultManager.High_Cell_Voltage_Shutdown.Action_1 "Fault manager configuration.  Select up to 4 actions for each fault." VALUE 0x8000046F RecordLayout_8 0 CompuMethod_211 0 65535 /end CHARACTERISTIC
/begin CHARACTERISTIC FaultManager.High_Cell_Voltage_Shutdown.Action_1_Condition "Fault manager configuration.  Select up to 4 actions for each fault." VALUE 0x80000471 RecordLayout_8 0 CompuMethod_212 0 65535 /end CHARACTERISTIC
/begin CHARACTERISTIC FaultManager.High_Cell_Voltage_Shutdown.Action_2 "Fault manager configuration.  Select up to 4 actions for each fault." VALUE 0x80000473 RecordLayout_8 0 CompuMethod_211 0 65535 /end CHARACTERISTIC
/begin CHARACTERISTIC FaultManager.High_Cell_Voltage_Shutdown.Action_2_Condition "Fault manager configuration.  Select up to 4 actions for each fault." VALUE 0x80000475 RecordLayout_8 0 CompuMethod_212 0 65535 /end CHARACTERISTIC
/begin CHARACTERISTIC FaultManager.High_Cell_Voltage_Shutdown.Action_3 "Fault manager configuration.  Select up to 4 actions for each fault." VALUE 0x80000477 RecordLayout_8 0 CompuMethod_211 0 65535 /end CHARACTERISTIC
/begin CHARACTERISTIC FaultManager.High_Cell_Voltage_Shutdown.Action_3_Condition "Fault manager configuration.  Select up to 4 actions for each fault." VALUE 0x80000479 RecordLayout_8 0 CompuMethod_212 0 65535 /end CHARACTERISTIC
/begin CHARACTERISTIC FaultManager.High_Cell_Voltage_Shutdown.Action_4 "Fault manager configuration.  Select up to 4 actions for each fault." VALUE 0x8000047B RecordLayout_8 0 CompuMethod_211 0 65535 /end CHARACTERISTIC
/begin CHARACTERISTIC FaultManager.High_Cell_Voltage_Shutdown.Action_4_Condition "Fault manager configuration.  Select up to 4 actions for each fault." VALUE 0x8000047D RecordLayout_8 0 CompuMethod_212 0 65535 /end CHARACTERISTIC
/begin CHARACTERISTIC FaultManager.High_SOC_Alert.Mode "Fault manager configuration.  Select up to 4 actions for each fault." VALUE 0x8000047F RecordLayout_8 0 CompuMethod_209 0 65535 /end CHARACTERISTIC
/begin CHARACTERISTIC FaultManager.High_SOC_Alert.ID "Fault manager configuration.  Select up to 4 actions for each fault." VALUE 0x80000481 RecordLayout_8 0 CompuMethod_1 0 65535 /end CHARACTERISTIC
/begin CHARACTERISTIC FaultManager.High_SOC_Alert.Test "Fault manager configuration.  Select up to 4 actions for each fault." VALUE 0x80000483 RecordLayout_8 0 CompuMethod_210 0 65535 /end CHARACTERISTIC
/begin CHARACTERISTIC FaultManager.High_SOC_Alert.Faulty_Samples__X_ "Fault manager configuration.  Select up to 4 actions for each fault." VALUE 0x80000485 RecordLayout_8 0 CompuMethod_1 0 65535 /end CHARACTERISTIC
/begin CHARACTERISTIC FaultManager.High_SOC_Alert.Total_Samples__Y_ "Fault manager configuration.  Select up to 4 actions for each fault." VALUE 0x80000487 RecordLayout_8 0 CompuMethod_1 0 65535 /end CHARACTERISTIC
/begin CHARACTERISTIC FaultManager.High_SOC_Alert.Action_1 "Fault manager configuration.  Select up to 4 actions for each fault." VALUE 0x80000489 RecordLayout_8 0 CompuMethod_211 0 65535 /end CHARACTERISTIC
/begin CHARACTERISTIC FaultManager.High_SOC_Alert.Action_1_Condition "Fault manager configuration.  Select up to 4 actions for each fault." VALUE 0x8000048B RecordLayout_8 0 CompuMethod_212 0 65535 /end CHARACTERISTIC
/begin CHARACTERISTIC FaultManager.High_SOC_Alert.Action_2 "Fault manager configuration.  Select up to 4 actions for each fault." VALUE 0x8000048D RecordLayout_8 0 CompuMethod_211 0 65535 /end CHARACTERISTIC
/begin CHARACTERISTIC FaultManager.High_SOC_Alert.Action_2_Condition "Fault manager configuration.  Select up to 4 actions for each fault." VALUE 0x8000048F RecordLayout_8 0 CompuMethod_212 0 65535 /end CHARACTERISTIC
/begin CHARACTERISTIC FaultManager.High_SOC_Alert.Action_3 "Fault manager configuration.  Select up to 4 actions for each fault." VALUE 0x80000491 RecordLayout_8 0 CompuMethod_211 0 65535 /end CHARACTERISTIC
/begin CHARACTERISTIC FaultManager.High_SOC_Alert.Action_3_Condition "Fault manager configuration.  Select up to 4 actions for each fault." VALUE 0x80000493 RecordLayout_8 0 CompuMethod_212 0 65535 /end CHARACTERISTIC
/begin CHARACTERISTIC FaultManager.High_SOC_Alert.Action_4 "Fault manager configuration.  Select up to 4 actions for each fault." VALUE 0x80000495 RecordLayout_8 0 CompuMethod_211 0 65535 /end CHARACTERISTIC
/begin CHARACTERISTIC FaultManager.High_SOC_Alert.Action_4_Condition "Fault manager configuration.  Select up to 4 actions for each fault." VALUE 0x80000497 RecordLayout_8 0 CompuMethod_212 0 65535 /end CHARACTERISTIC
/begin CHARACTERISTIC FaultManager.High_SOC_Shutdown.Mode "Fault manager configuration.  Select up to 4 actions for each fault." VALUE 0x80000499 RecordLayout_8 0 CompuMethod_209 0 65535 /end CHARACTERISTIC
/begin CHARACTERISTIC FaultManager.High_SOC_Shutdown.ID "Fault manager configuration.  Select up to 4 actions for each fault." VALUE 0x8000049B RecordLayout_8 0 CompuMethod_1 0 65535 /end CHARACTERISTIC
/begin CHARACTERISTIC FaultManager.High_SOC_Shutdown.Test "Fault manager configuration.  Select up to 4 actions for each fault." VALUE 0x8000049D RecordLayout_8 0 CompuMethod_210 0 65535 /end CHARACTERISTIC
/begin CHARACTERISTIC FaultManager.High_SOC_Shutdown.Faulty_Samples__X_ "Fault manager configuration.  Select up to 4 actions for each fault." VALUE 0x8000049F RecordLayout_8 0 CompuMethod_1 0 65535 /end CHARACTERISTIC
/begin CHARACTERISTIC FaultManager.High_SOC_Shutdown.Total_Samples__Y_ "Fault manager configuration.  Select up to 4 actions for each fault." VALUE 0x800004A1 RecordLayout_8 0 CompuMethod_1 0 65535 /end CHARACTERISTIC
/begin CHARACTERISTIC FaultManager.High_SOC_Shutdown.Action_1 "Fault manager configuration.  Select up to 4 actions for each fault." VALUE 0x800004A3 RecordLayout_8 0 CompuMethod_211 0 65535 /end CHARACTERISTIC
/begin CHARACTERISTIC FaultManager.High_SOC_Shutdown.Action_1_Condition "Fault manager configuration.  Select up to 4 actions for each fault." VALUE 0x800004A5 RecordLayout_8 0 CompuMethod_212 0 65535 /end CHARACTERISTIC
/begin CHARACTERISTIC FaultManager.High_SOC_Shutdown.Action_2 "Fault manager configuration.  Select up to 4 actions for each fault." VALUE 0x800004A7 RecordLayout_8 0 CompuMethod_211 0 65535 /end CHARACTERISTIC
/begin CHARACTERISTIC FaultManager.High_SOC_Shutdown.Action_2_Condition "Fault manager configuration.  Select up to 4 actions for each fault." VALUE 0x800004A9 RecordLayout_8 0 CompuMethod_212 0 65535 /end CHARACTERISTIC
/begin CHARACTERISTIC FaultManager.High_SOC_Shutdown.Action_3 "Fault manager configuration.  Select up to 4 actions for each fault." VALUE 0x800004AB RecordLayout_8 0 CompuMethod_211 0 65535 /end CHARACTERISTIC
/begin CHARACTERISTIC FaultManager.High_SOC_Shutdown.Action_3_Condition "Fault manager configuration.  Select up to 4 actions for each fault." VALUE 0x800004AD RecordLayout_8 0 CompuMethod_212 0 65535 /end CHARACTERISTIC
/begin CHARACTERISTIC FaultManager.High_SOC_Shutdown.Action_4 "Fault manager configuration.  Select up to 4 actions for each fault." VALUE 0x800004AF RecordLayout_8 0 CompuMethod_211 0 65535 /end CHARACTERISTIC
/begin CHARACTERISTIC FaultManager.High_SOC_Shutdown.Action_4_Condition "Fault manager configuration.  Select up to 4 actions for each fault." VALUE 0x800004B1 RecordLayout_8 0 CompuMethod_212 0 65535 /end CHARACTERISTIC
/begin CHARACTERISTIC FaultManager.Inverter_OverTemp.Mode "Fault manager configuration.  Select up to 4 actions for each fault." VALUE 0x800004B3 RecordLayout_8 0 CompuMethod_209 0 65535 /end CHARACTERISTIC
/begin CHARACTERISTIC FaultManager.Inverter_OverTemp.ID "Fault manager configuration.  Select up to 4 actions for each fault." VALUE 0x800004B5 RecordLayout_8 0 CompuMethod_1 0 65535 /end CHARACTERISTIC
/begin CHARACTERISTIC FaultManager.Inverter_OverTemp.Test "Fault manager configuration.  Select up to 4 actions for each fault." VALUE 0x800004B7 RecordLayout_8 0 CompuMethod_210 0 65535 /end CHARACTERISTIC
/begin CHARACTERISTIC FaultManager.Inverter_OverTemp.Faulty_Samples__X_ "Fault manager configuration.  Select up to 4 actions for each fault." VALUE 0x800004B9 RecordLayout_8 0 CompuMethod_1 0 65535 /end CHARACTERISTIC
/begin CHARACTERISTIC FaultManager.Inverter_OverTemp.Total_Samples__Y_ "Fault manager configuration.  Select up to 4 actions for each fault." VALUE 0x800004BB RecordLayout_8 0 CompuMethod_1 0 65535 /end CHARACTERISTIC
/begin CHARACTERISTIC FaultManager.Inverter_OverTemp.Action_1 "Fault manager configuration.  Select up to 4 actions for each fault." VALUE 0x800004BD RecordLayout_8 0 CompuMethod_211 0 65535 /end CHARACTERISTIC
/begin CHARACTERISTIC FaultManager.Inverter_OverTemp.Action_1_Condition "Fault manager configuration.  Select up to 4 actions for each fault." VALUE 0x800004BF RecordLayout_8 0 CompuMethod_212 0 65535 /end CHARACTERISTIC
/begin CHARACTERISTIC FaultManager.Inverter_OverTemp.Action_2 "Fault manager configuration.  Select up to 4 actions for each fault." VALUE 0x800004C1 RecordLayout_8 0 CompuMethod_211 0 65535 /end CHARACTERISTIC
/begin CHARACTERISTIC FaultManager.Inverter_OverTemp.Action_2_Condition "Fault manager configuration.  Select up to 4 actions for each fault." VALUE 0x800004C3 RecordLayout_8 0 CompuMethod_212 0 65535 /end CHARACTERISTIC
/begin CHARACTERISTIC FaultManager.Inverter_OverTemp.Action_3 "Fault manager configuration.  Select up to 4 actions for each fault." VALUE 0x800004C5 RecordLayout_8 0 CompuMethod_211 0 65535 /end CHARACTERISTIC
/begin CHARACTERISTIC FaultManager.Inverter_OverTemp.Action_3_Condition "Fault manager configuration.  Select up to 4 actions for each fault." VALUE 0x800004C7 RecordLayout_8 0 CompuMethod_212 0 65535 /end CHARACTERISTIC
/begin CHARACTERISTIC FaultManager.Inverter_OverTemp.Action_4 "Fault manager configuration.  Select up to 4 actions for each fault." VALUE 0x800004C9 RecordLayout_8 0 CompuMethod_211 0 65535 /end CHARACTERISTIC
/begin CHARACTERISTIC FaultManager.Inverter_OverTemp.Action_4_Condition "Fault manager configuration.  Select up to 4 actions for each fault." VALUE 0x800004CB RecordLayout_8 0 CompuMethod_212 0 65535 /end CHARACTERISTIC
/begin CHARACTERISTIC FaultManager.LVVoltHigh.Mode "Fault manager configuration.  Select up to 4 actions for each fault." VALUE 0x800004CD RecordLayout_8 0 CompuMethod_209 0 65535 /end CHARACTERISTIC
/begin CHARACTERISTIC FaultManager.LVVoltHigh.ID "Fault manager configuration.  Select up to 4 actions for each fault." VALUE 0x800004CF RecordLayout_8 0 CompuMethod_1 0 65535 /end CHARACTERISTIC
/begin CHARACTERISTIC FaultManager.LVVoltHigh.Test "Fault manager configuration.  Select up to 4 actions for each fault." VALUE 0x800004D1 RecordLayout_8 0 CompuMethod_210 0 65535 /end CHARACTERISTIC
/begin CHARACTERISTIC FaultManager.LVVoltHigh.Faulty_Samples__X_ "Fault manager configuration.  Select up to 4 actions for each fault." VALUE 0x800004D3 RecordLayout_8 0 CompuMethod_1 0 65535 /end CHARACTERISTIC
/begin CHARACTERISTIC FaultManager.LVVoltHigh.Total_Samples__Y_ "Fault manager configuration.  Select up to 4 actions for each fault." VALUE 0x800004D5 RecordLayout_8 0 CompuMethod_1 0 65535 /end CHARACTERISTIC
/begin CHARACTERISTIC FaultManager.LVVoltHigh.Action_1 "Fault manager configuration.  Select up to 4 actions for each fault." VALUE 0x800004D7 RecordLayout_8 0 CompuMethod_211 0 65535 /end CHARACTERISTIC
/begin CHARACTERISTIC FaultManager.LVVoltHigh.Action_1_Condition "Fault manager configuration.  Select up to 4 actions for each fault." VALUE 0x800004D9 RecordLayout_8 0 CompuMethod_212 0 65535 /end CHARACTERISTIC
/begin CHARACTERISTIC FaultManager.LVVoltHigh.Action_2 "Fault manager configuration.  Select up to 4 actions for each fault." VALUE 0x800004DB RecordLayout_8 0 CompuMethod_211 0 65535 /end CHARACTERISTIC
/begin CHARACTERISTIC FaultManager.LVVoltHigh.Action_2_Condition "Fault manager configuration.  Select up to 4 actions for each fault." VALUE 0x800004DD RecordLayout_8 0 CompuMethod_212 0 65535 /end CHARACTERISTIC
/begin CHARACTERISTIC FaultManager.LVVoltHigh.Action_3 "Fault manager configuration.  Select up to 4 actions for each fault." VALUE 0x800004DF RecordLayout_8 0 CompuMethod_211 0 65535 /end CHARACTERISTIC
/begin CHARACTERISTIC FaultManager.LVVoltHigh.Action_3_Condition "Fault manager configuration.  Select up to 4 actions for each fault." VALUE 0x800004E1 RecordLayout_8 0 CompuMethod_212 0 65535 /end CHARACTERISTIC
/begin CHARACTERISTIC FaultManager.LVVoltHigh.Action_4 "Fault manager configuration.  Select up to 4 actions for each fault." VALUE 0x800004E3 RecordLayout_8 0 CompuMethod_211 0 65535 /end CHARACTERISTIC
/begin CHARACTERISTIC FaultManager.LVVoltHigh.Action_4_Condition "Fault manager configuration.  Select up to 4 actions for each fault." VALUE 0x800004E5 RecordLayout_8 0 CompuMethod_212 0 65535 /end CHARACTERISTIC
/begin CHARACTERISTIC FaultManager.LVVoltLow.Mode "Fault manager configuration.  Select up to 4 actions for each fault." VALUE 0x800004E7 RecordLayout_8 0 CompuMethod_209 0 65535 /end CHARACTERISTIC
/begin CHARACTERISTIC FaultManager.LVVoltLow.ID "Fault manager configuration.  Select up to 4 actions for each fault." VALUE 0x800004E9 RecordLayout_8 0 CompuMethod_1 0 65535 /end CHARACTERISTIC
/begin CHARACTERISTIC FaultManager.LVVoltLow.Test "Fault manager configuration.  Select up to 4 actions for each fault." VALUE 0x800004EB RecordLayout_8 0 CompuMethod_210 0 65535 /end CHARACTERISTIC
/begin CHARACTERISTIC FaultManager.LVVoltLow.Faulty_Samples__X_ "Fault manager configuration.  Select up to 4 actions for each fault." VALUE 0x800004ED RecordLayout_8 0 CompuMethod_1 0 65535 /end CHARACTERISTIC
/begin CHARACTERISTIC FaultManager.LVVoltLow.Total_Samples__Y_ "Fault manager configuration.  Select up to 4 actions for each fault." VALUE 0x800004EF RecordLayout_8 0 CompuMethod_1 0 65535 /end CHARACTERISTIC
/begin CHARACTERISTIC FaultManager.LVVoltLow.Action_1 "Fault manager configuration.  Select up to 4 actions for each fault." VALUE 0x800004F1 RecordLayout_8 0 CompuMethod_211 0 65535 /end CHARACTERISTIC
/begin CHARACTERISTIC FaultManager.LVVoltLow.Action_1_Condition "Fault manager configuration.  Select up to 4 actions for each fault." VALUE 0x800004F3 RecordLayout_8 0 CompuMethod_212 0 65535 /end CHARACTERISTIC
/begin CHARACTERISTIC FaultManager.LVVoltLow.Action_2 "Fault manager configuration.  Select up to 4 actions for each fault." VALUE 0x800004F5 RecordLayout_8 0 CompuMethod_211 0 65535 /end CHARACTERISTIC
/begin CHARACTERISTIC FaultManager.LVVoltLow.Action_2_Condition "Fault manager configuration.  Select up to 4 actions for each fault." VALUE 0x800004F7 RecordLayout_8 0 CompuMethod_212 0 65535 /end CHARACTERISTIC
/begin CHARACTERISTIC FaultManager.LVVoltLow.Action_3 "Fault manager configuration.  Select up to 4 actions for each fault." VALUE 0x800004F9 RecordLayout_8 0 CompuMethod_211 0 65535 /end CHARACTERISTIC
/begin CHARACTERISTIC FaultManager.LVVoltLow.Action_3_Condition "Fault manager configuration.  Select up to 4 actions for each fault." VALUE 0x800004FB RecordLayout_8 0 CompuMethod_212 0 65535 /end CHARACTERISTIC
/begin CHARACTERISTIC FaultManager.LVVoltLow.Action_4 "Fault manager configuration.  Select up to 4 actions for each fault." VALUE 0x800004FD RecordLayout_8 0 CompuMethod_211 0 65535 /end CHARACTERISTIC
/begin CHARACTERISTIC FaultManager.LVVoltLow.Action_4_Condition "Fault manager configuration.  Select up to 4 actions for each fault." VALUE 0x800004FF RecordLayout_8 0 CompuMethod_212 0 65535 /end CHARACTERISTIC
/begin CHARACTERISTIC FaultManager.LVVolt_RangeHigh.Mode "Fault manager configuration.  Select up to 4 actions for each fault." VALUE 0x80000501 RecordLayout_8 0 CompuMethod_209 0 65535 /end CHARACTERISTIC
/begin CHARACTERISTIC FaultManager.LVVolt_RangeHigh.ID "Fault manager configuration.  Select up to 4 actions for each fault." VALUE 0x80000503 RecordLayout_8 0 CompuMethod_1 0 65535 /end CHARACTERISTIC
/begin CHARACTERISTIC FaultManager.LVVolt_RangeHigh.Test "Fault manager configuration.  Select up to 4 actions for each fault." VALUE 0x80000505 RecordLayout_8 0 CompuMethod_210 0 65535 /end CHARACTERISTIC
/begin CHARACTERISTIC FaultManager.LVVolt_RangeHigh.Faulty_Samples__X_ "Fault manager configuration.  Select up to 4 actions for each fault." VALUE 0x80000507 RecordLayout_8 0 CompuMethod_1 0 65535 /end CHARACTERISTIC
/begin CHARACTERISTIC FaultManager.LVVolt_RangeHigh.Total_Samples__Y_ "Fault manager configuration.  Select up to 4 actions for each fault." VALUE 0x80000509 RecordLayout_8 0 CompuMethod_1 0 65535 /end CHARACTERISTIC
/begin CHARACTERISTIC FaultManager.LVVolt_RangeHigh.Action_1 "Fault manager configuration.  Select up to 4 actions for each fault." VALUE 0x8000050B RecordLayout_8 0 CompuMethod_211 0 65535 /end CHARACTERISTIC
/begin CHARACTERISTIC FaultManager.LVVolt_RangeHigh.Action_1_Condition "Fault manager configuration.  Select up to 4 actions for each fault." VALUE 0x8000050D RecordLayout_8 0 CompuMethod_212 0 65535 /end CHARACTERISTIC
/begin CHARACTERISTIC FaultManager.LVVolt_RangeHigh.Action_2 "Fault manager configuration.  Select up to 4 actions for each fault." VALUE 0x8000050F RecordLayout_8 0 CompuMethod_211 0 65535 /end CHARACTERISTIC
/begin CHARACTERISTIC FaultManager.LVVolt_RangeHigh.Action_2_Condition "Fault manager configuration.  Select up to 4 actions for each fault." VALUE 0x80000511 RecordLayout_8 0 CompuMethod_212 0 65535 /end CHARACTERISTIC
/begin CHARACTERISTIC FaultManager.LVVolt_RangeHigh.Action_3 "Fault manager configuration.  Select up to 4 actions for each fault." VALUE 0x80000513 RecordLayout_8 0 CompuMethod_211 0 65535 /end CHARACTERISTIC
/begin CHARACTERISTIC FaultManager.LVVolt_RangeHigh.Action_3_Condition "Fault manager configuration.  Select up to 4 actions for each fault." VALUE 0x80000515 RecordLayout_8 0 CompuMethod_212 0 65535 /end CHARACTERISTIC
/begin CHARACTERISTIC FaultManager.LVVolt_RangeHigh.Action_4 "Fault manager configuration.  Select up to 4 actions for each fault." VALUE 0x80000517 RecordLayout_8 0 CompuMethod_211 0 65535 /end CHARACTERISTIC
/begin CHARACTERISTIC FaultManager.LVVolt_RangeHigh.Action_4_Condition "Fault manager configuration.  Select up to 4 actions for each fault." VALUE 0x80000519 RecordLayout_8 0 CompuMethod_212 0 65535 /end CHARACTERISTIC
/begin CHARACTERISTIC FaultManager.LVVolt_RangeLow.Mode "Fault manager configuration.  Select up to 4 actions for each fault." VALUE 0x8000051B RecordLayout_8 0 CompuMethod_209 0 65535 /end CHARACTERISTIC
/begin CHARACTERISTIC FaultManager.LVVolt_RangeLow.ID "Fault manager configuration.  Select up to 4 actions for each fault." VALUE 0x8000051D RecordLayout_8 0 CompuMethod_1 0 65535 /end CHARACTERISTIC
/begin CHARACTERISTIC FaultManager.LVVolt_RangeLow.Test "Fault manager configuration.  Select up to 4 actions for each fault." VALUE 0x8000051F RecordLayout_8 0 CompuMethod_210 0 65535 /end CHARACTERISTIC
/begin CHARACTERISTIC FaultManager.LVVolt_RangeLow.Faulty_Samples__X_ "Fault manager configuration.  Select up to 4 actions for each fault." VALUE 0x80000521 RecordLayout_8 0 CompuMethod_1 0 65535 /end CHARACTERISTIC
/begin CHARACTERISTIC FaultManager.LVVolt_RangeLow.Total_Samples__Y_ "Fault manager configuration.  Select up to 4 actions for each fault." VALUE 0x80000523 RecordLayout_8 0 CompuMethod_1 0 65535 /end CHARACTERISTIC
/begin CHARACTERISTIC FaultManager.LVVolt_RangeLow.Action_1 "Fault manager configuration.  Select up to 4 actions for each fault." VALUE 0x80000525 RecordLayout_8 0 CompuMethod_211 0 65535 /end CHARACTERISTIC
/begin CHARACTERISTIC FaultManager.LVVolt_RangeLow.Action_1_Condition "Fault manager configuration.  Select up to 4 actions for each fault." VALUE 0x80000527 RecordLayout_8 0 CompuMethod_212 0 65535 /end CHARACTERISTIC
/begin CHARACTERISTIC FaultManager.LVVolt_RangeLow.Action_2 "Fault manager configuration.  Select up to 4 actions for each fault." VALUE 0x80000529 RecordLayout_8 0 CompuMethod_211 0 65535 /end CHARACTERISTIC
/begin CHARACTERISTIC FaultManager.LVVolt_RangeLow.Action_2_Condition "Fault manager configuration.  Select up to 4 actions for each fault." VALUE 0x8000052B RecordLayout_8 0 CompuMethod_212 0 65535 /end CHARACTERISTIC
/begin CHARACTERISTIC FaultManager.LVVolt_RangeLow.Action_3 "Fault manager configuration.  Select up to 4 actions for each fault." VALUE 0x8000052D RecordLayout_8 0 CompuMethod_211 0 65535 /end CHARACTERISTIC
/begin CHARACTERISTIC FaultManager.LVVolt_RangeLow.Action_3_Condition "Fault manager configuration.  Select up to 4 actions for each fault." VALUE 0x8000052F RecordLayout_8 0 CompuMethod_212 0 65535 /end CHARACTERISTIC
/begin CHARACTERISTIC FaultManager.LVVolt_RangeLow.Action_4 "Fault manager configuration.  Select up to 4 actions for each fault." VALUE 0x80000531 RecordLayout_8 0 CompuMethod_211 0 65535 /end CHARACTERISTIC
/begin CHARACTERISTIC FaultManager.LVVolt_RangeLow.Action_4_Condition "Fault manager configuration.  Select up to 4 actions for each fault." VALUE 0x80000533 RecordLayout_8 0 CompuMethod_212 0 65535 /end CHARACTERISTIC
/begin CHARACTERISTIC FaultManager.LockedRotor.Mode "Fault manager configuration.  Select up to 4 actions for each fault." VALUE 0x80000535 RecordLayout_8 0 CompuMethod_209 0 65535 /end CHARACTERISTIC
/begin CHARACTERISTIC FaultManager.LockedRotor.ID "Fault manager configuration.  Select up to 4 actions for each fault." VALUE 0x80000537 RecordLayout_8 0 CompuMethod_1 0 65535 /end CHARACTERISTIC
/begin CHARACTERISTIC FaultManager.LockedRotor.Test "Fault manager configuration.  Select up to 4 actions for each fault." VALUE 0x80000539 RecordLayout_8 0 CompuMethod_210 0 65535 /end CHARACTERISTIC
/begin CHARACTERISTIC FaultManager.LockedRotor.Faulty_Samples__X_ "Fault manager configuration.  Select up to 4 actions for each fault." VALUE 0x8000053B RecordLayout_8 0 CompuMethod_1 0 65535 /end CHARACTERISTIC
/begin CHARACTERISTIC FaultManager.LockedRotor.Total_Samples__Y_ "Fault manager configuration.  Select up to 4 actions for each fault." VALUE 0x8000053D RecordLayout_8 0 CompuMethod_1 0 65535 /end CHARACTERISTIC
/begin CHARACTERISTIC FaultManager.LockedRotor.Action_1 "Fault manager configuration.  Select up to 4 actions for each fault." VALUE 0x8000053F RecordLayout_8 0 CompuMethod_211 0 65535 /end CHARACTERISTIC
/begin CHARACTERISTIC FaultManager.LockedRotor.Action_1_Condition "Fault manager configuration.  Select up to 4 actions for each fault." VALUE 0x80000541 RecordLayout_8 0 CompuMethod_212 0 65535 /end CHARACTERISTIC
/begin CHARACTERISTIC FaultManager.LockedRotor.Action_2 "Fault manager configuration.  Select up to 4 actions for each fault." VALUE 0x80000543 RecordLayout_8 0 CompuMethod_211 0 65535 /end CHARACTERISTIC
/begin CHARACTERISTIC FaultManager.LockedRotor.Action_2_Condition "Fault manager configuration.  Select up to 4 actions for each fault." VALUE 0x80000545 RecordLayout_8 0 CompuMethod_212 0 65535 /end CHARACTERISTIC
/begin CHARACTERISTIC FaultManager.LockedRotor.Action_3 "Fault manager configuration.  Select up to 4 actions for each fault." VALUE 0x80000547 RecordLayout_8 0 CompuMethod_211 0 65535 /end CHARACTERISTIC
/begin CHARACTERISTIC FaultManager.LockedRotor.Action_3_Condition "Fault manager configuration.  Select up to 4 actions for each fault." VALUE 0x80000549 RecordLayout_8 0 CompuMethod_212 0 65535 /end CHARACTERISTIC
/begin CHARACTERISTIC FaultManager.LockedRotor.Action_4 "Fault manager configuration.  Select up to 4 actions for each fault." VALUE 0x8000054B RecordLayout_8 0 CompuMethod_211 0 65535 /end CHARACTERISTIC
/begin CHARACTERISTIC FaultManager.LockedRotor.Action_4_Condition "Fault manager configuration.  Select up to 4 actions for each fault." VALUE 0x8000054D RecordLayout_8 0 CompuMethod_212 0 65535 /end CHARACTERISTIC
/begin CHARACTERISTIC FaultManager.Low_SOC_Alert.Mode "Fault manager configuration.  Select up to 4 actions for each fault." VALUE 0x8000054F RecordLayout_8 0 CompuMethod_209 0 65535 /end CHARACTERISTIC
/begin CHARACTERISTIC FaultManager.Low_SOC_Alert.ID "Fault manager configuration.  Select up to 4 actions for each fault." VALUE 0x80000551 RecordLayout_8 0 CompuMethod_1 0 65535 /end CHARACTERISTIC
/begin CHARACTERISTIC FaultManager.Low_SOC_Alert.Test "Fault manager configuration.  Select up to 4 actions for each fault." VALUE 0x80000553 RecordLayout_8 0 CompuMethod_210 0 65535 /end CHARACTERISTIC
/begin CHARACTERISTIC FaultManager.Low_SOC_Alert.Faulty_Samples__X_ "Fault manager configuration.  Select up to 4 actions for each fault." VALUE 0x80000555 RecordLayout_8 0 CompuMethod_1 0 65535 /end CHARACTERISTIC
/begin CHARACTERISTIC FaultManager.Low_SOC_Alert.Total_Samples__Y_ "Fault manager configuration.  Select up to 4 actions for each fault." VALUE 0x80000557 RecordLayout_8 0 CompuMethod_1 0 65535 /end CHARACTERISTIC
/begin CHARACTERISTIC FaultManager.Low_SOC_Alert.Action_1 "Fault manager configuration.  Select up to 4 actions for each fault." VALUE 0x80000559 RecordLayout_8 0 CompuMethod_211 0 65535 /end CHARACTERISTIC
/begin CHARACTERISTIC FaultManager.Low_SOC_Alert.Action_1_Condition "Fault manager configuration.  Select up to 4 actions for each fault." VALUE 0x8000055B RecordLayout_8 0 CompuMethod_212 0 65535 /end CHARACTERISTIC
/begin CHARACTERISTIC FaultManager.Low_SOC_Alert.Action_2 "Fault manager configuration.  Select up to 4 actions for each fault." VALUE 0x8000055D RecordLayout_8 0 CompuMethod_211 0 65535 /end CHARACTERISTIC
/begin CHARACTERISTIC FaultManager.Low_SOC_Alert.Action_2_Condition "Fault manager configuration.  Select up to 4 actions for each fault." VALUE 0x8000055F RecordLayout_8 0 CompuMethod_212 0 65535 /end CHARACTERISTIC
/begin CHARACTERISTIC FaultManager.Low_SOC_Alert.Action_3 "Fault manager configuration.  Select up to 4 actions for each fault." VALUE 0x80000561 RecordLayout_8 0 CompuMethod_211 0 65535 /end CHARACTERISTIC
/begin CHARACTERISTIC FaultManager.Low_SOC_Alert.Action_3_Condition "Fault manager configuration.  Select up to 4 actions for each fault." VALUE 0x80000563 RecordLayout_8 0 CompuMethod_212 0 65535 /end CHARACTERISTIC
/begin CHARACTERISTIC FaultManager.Low_SOC_Alert.Action_4 "Fault manager configuration.  Select up to 4 actions for each fault." VALUE 0x80000565 RecordLayout_8 0 CompuMethod_211 0 65535 /end CHARACTERISTIC
/begin CHARACTERISTIC FaultManager.Low_SOC_Alert.Action_4_Condition "Fault manager configuration.  Select up to 4 actions for each fault." VALUE 0x80000567 RecordLayout_8 0 CompuMethod_212 0 65535 /end CHARACTERISTIC
/begin CHARACTERISTIC FaultManager.Low_SOC_Shutdown.Mode "Fault manager configuration.  Select up to 4 actions for each fault." VALUE 0x80000569 RecordLayout_8 0 CompuMethod_209 0 65535 /end CHARACTERISTIC
/begin CHARACTERISTIC FaultManager.Low_SOC_Shutdown.ID "Fault manager configuration.  Select up to 4 actions for each fault." VALUE 0x8000056B RecordLayout_8 0 CompuMethod_1 0 65535 /end CHARACTERISTIC
/begin CHARACTERISTIC FaultManager.Low_SOC_Shutdown.Test "Fault manager configuration.  Select up to 4 actions for each fault." VALUE 0x8000056D RecordLayout_8 0 CompuMethod_210 0 65535 /end CHARACTERISTIC
/begin CHARACTERISTIC FaultManager.Low_SOC_Shutdown.Faulty_Samples__X_ "Fault manager configuration.  Select up to 4 actions for each fault." VALUE 0x8000056F RecordLayout_8 0 CompuMethod_1 0 65535 /end CHARACTERISTIC
/begin CHARACTERISTIC FaultManager.Low_SOC_Shutdown.Total_Samples__Y_ "Fault manager configuration.  Select up to 4 actions for each fault." VALUE 0x80000571 RecordLayout_8 0 CompuMethod_1 0 65535 /end CHARACTERISTIC
/begin CHARACTERISTIC FaultManager.Low_SOC_Shutdown.Action_1 "Fault manager configuration.  Select up to 4 actions for each fault." VALUE 0x80000573 RecordLayout_8 0 CompuMethod_211 0 65535 /end CHARACTERISTIC
/begin CHARACTERISTIC FaultManager.Low_SOC_Shutdown.Action_1_Condition "Fault manager configuration.  Select up to 4 actions for each fault." VALUE 0x80000575 RecordLayout_8 0 CompuMethod_212 0 65535 /end CHARACTERISTIC
/begin CHARACTERISTIC FaultManager.Low_SOC_Shutdown.Action_2 "Fault manager configuration.  Select up to 4 actions for each fault." VALUE 0x80000577 RecordLayout_8 0 CompuMethod_211 0 65535 /end CHARACTERISTIC
/begin CHARACTERISTIC FaultManager.Low_SOC_Shutdown.Action_2_Condition "Fault manager configuration.  Select up to 4 actions for each fault." VALUE 0x80000579 RecordLayout_8 0 CompuMethod_212 0 65535 /end CHARACTERISTIC
/begin CHARACTERISTIC FaultManager.Low_SOC_Shutdown.Action_3 "Fault manager configuration.  Select up to 4 actions for each fault." VALUE 0x8000057B RecordLayout_8 0 CompuMethod_211 0 65535 /end CHARACTERISTIC
/begin CHARACTERISTIC FaultManager.Low_SOC_Shutdown.Action_3_Condition "Fault manager configuration.  Select up to 4 actions for each fault." VALUE 0x8000057D RecordLayout_8 0 CompuMethod_212 0 65535 /end CHARACTERISTIC
/begin CHARACTERISTIC FaultManager.Low_SOC_Shutdown.Action_4 "Fault manager configuration.  Select up to 4 actions for each fault." VALUE 0x8000057F RecordLayout_8 0 CompuMethod_211 0 65535 /end CHARACTERISTIC
/begin CHARACTERISTIC FaultManager.Low_SOC_Shutdown.Action_4_Condition "Fault manager configuration.  Select up to 4 actions for each fault." VALUE 0x80000581 RecordLayout_8 0 CompuMethod_212 0 65535 /end CHARACTERISTIC
/begin CHARACTERISTIC FaultManager.NoCAN_BCM_410.Mode "Fault manager configuration.  Select up to 4 actions for each fault." VALUE 0x80000583 RecordLayout_8 0 CompuMethod_209 0 65535 /end CHARACTERISTIC
/begin CHARACTERISTIC FaultManager.NoCAN_BCM_410.ID "Fault manager configuration.  Select up to 4 actions for each fault." VALUE 0x80000585 RecordLayout_8 0 CompuMethod_1 0 65535 /end CHARACTERISTIC
/begin CHARACTERISTIC FaultManager.NoCAN_BCM_410.Test "Fault manager configuration.  Select up to 4 actions for each fault." VALUE 0x80000587 RecordLayout_8 0 CompuMethod_210 0 65535 /end CHARACTERISTIC
/begin CHARACTERISTIC FaultManager.NoCAN_BCM_410.Faulty_Samples__X_ "Fault manager configuration.  Select up to 4 actions for each fault." VALUE 0x80000589 RecordLayout_8 0 CompuMethod_1 0 65535 /end CHARACTERISTIC
/begin CHARACTERISTIC FaultManager.NoCAN_BCM_410.Total_Samples__Y_ "Fault manager configuration.  Select up to 4 actions for each fault." VALUE 0x8000058B RecordLayout_8 0 CompuMethod_1 0 65535 /end CHARACTERISTIC
/begin CHARACTERISTIC FaultManager.NoCAN_BCM_410.Action_1 "Fault manager configuration.  Select up to 4 actions for each fault." VALUE 0x8000058D RecordLayout_8 0 CompuMethod_211 0 65535 /end CHARACTERISTIC
/begin CHARACTERISTIC FaultManager.NoCAN_BCM_410.Action_1_Condition "Fault manager configuration.  Select up to 4 actions for each fault." VALUE 0x8000058F RecordLayout_8 0 CompuMethod_212 0 65535 /end CHARACTERISTIC
/begin CHARACTERISTIC FaultManager.NoCAN_BCM_410.Action_2 "Fault manager configuration.  Select up to 4 actions for each fault." VALUE 0x80000591 RecordLayout_8 0 CompuMethod_211 0 65535 /end CHARACTERISTIC
/begin CHARACTERISTIC FaultManager.NoCAN_BCM_410.Action_2_Condition "Fault manager configuration.  Select up to 4 actions for each fault." VALUE 0x80000593 RecordLayout_8 0 CompuMethod_212 0 65535 /end CHARACTERISTIC
/begin CHARACTERISTIC FaultManager.NoCAN_BCM_410.Action_3 "Fault manager configuration.  Select up to 4 actions for each fault." VALUE 0x80000595 RecordLayout_8 0 CompuMethod_211 0 65535 /end CHARACTERISTIC
/begin CHARACTERISTIC FaultManager.NoCAN_BCM_410.Action_3_Condition "Fault manager configuration.  Select up to 4 actions for each fault." VALUE 0x80000597 RecordLayout_8 0 CompuMethod_212 0 65535 /end CHARACTERISTIC
/begin CHARACTERISTIC FaultManager.NoCAN_BCM_410.Action_4 "Fault manager configuration.  Select up to 4 actions for each fault." VALUE 0x80000599 RecordLayout_8 0 CompuMethod_211 0 65535 /end CHARACTERISTIC
/begin CHARACTERISTIC FaultManager.NoCAN_BCM_410.Action_4_Condition "Fault manager configuration.  Select up to 4 actions for each fault." VALUE 0x8000059B RecordLayout_8 0 CompuMethod_212 0 65535 /end CHARACTERISTIC
/begin CHARACTERISTIC FaultManager.NoCAN_BCM_420.Mode "Fault manager configuration.  Select up to 4 actions for each fault." VALUE 0x8000059D RecordLayout_8 0 CompuMethod_209 0 65535 /end CHARACTERISTIC
/begin CHARACTERISTIC FaultManager.NoCAN_BCM_420.ID "Fault manager configuration.  Select up to 4 actions for each fault." VALUE 0x8000059F RecordLayout_8 0 CompuMethod_1 0 65535 /end CHARACTERISTIC
/begin CHARACTERISTIC FaultManager.NoCAN_BCM_420.Test "Fault manager configuration.  Select up to 4 actions for each fault." VALUE 0x800005A1 RecordLayout_8 0 CompuMethod_210 0 65535 /end CHARACTERISTIC
/begin CHARACTERISTIC FaultManager.NoCAN_BCM_420.Faulty_Samples__X_ "Fault manager configuration.  Select up to 4 actions for each fault." VALUE 0x800005A3 RecordLayout_8 0 CompuMethod_1 0 65535 /end CHARACTERISTIC
/begin CHARACTERISTIC FaultManager.NoCAN_BCM_420.Total_Samples__Y_ "Fault manager configuration.  Select up to 4 actions for each fault." VALUE 0x800005A5 RecordLayout_8 0 CompuMethod_1 0 65535 /end CHARACTERISTIC
/begin CHARACTERISTIC FaultManager.NoCAN_BCM_420.Action_1 "Fault manager configuration.  Select up to 4 actions for each fault." VALUE 0x800005A7 RecordLayout_8 0 CompuMethod_211 0 65535 /end CHARACTERISTIC
/begin CHARACTERISTIC FaultManager.NoCAN_BCM_420.Action_1_Condition "Fault manager configuration.  Select up to 4 actions for each fault." VALUE 0x800005A9 RecordLayout_8 0 CompuMethod_212 0 65535 /end CHARACTERISTIC
/begin CHARACTERISTIC FaultManager.NoCAN_BCM_420.Action_2 "Fault manager configuration.  Select up to 4 actions for each fault." VALUE 0x800005AB RecordLayout_8 0 CompuMethod_211 0 65535 /end CHARACTERISTIC
/begin CHARACTERISTIC FaultManager.NoCAN_BCM_420.Action_2_Condition "Fault manager configuration.  Select up to 4 actions for each fault." VALUE 0x800005AD RecordLayout_8 0 CompuMethod_212 0 65535 /end CHARACTERISTIC
/begin CHARACTERISTIC FaultManager.NoCAN_BCM_420.Action_3 "Fault manager configuration.  Select up to 4 actions for each fault." VALUE 0x800005AF RecordLayout_8 0 CompuMethod_211 0 65535 /end CHARACTERISTIC
/begin CHARACTERISTIC FaultManager.NoCAN_BCM_420.Action_3_Condition "Fault manager configuration.  Select up to 4 actions for each fault." VALUE 0x800005B1 RecordLayout_8 0 CompuMethod_212 0 65535 /end CHARACTERISTIC
/begin CHARACTERISTIC FaultManager.NoCAN_BCM_420.Action_4 "Fault manager configuration.  Select up to 4 actions for each fault." VALUE 0x800005B3 RecordLayout_8 0 CompuMethod_211 0 65535 /end CHARACTERISTIC
/begin CHARACTERISTIC FaultManager.NoCAN_BCM_420.Action_4_Condition "Fault manager configuration.  Select up to 4 actions for each fault." VALUE 0x800005B5 RecordLayout_8 0 CompuMethod_212 0 65535 /end CHARACTERISTIC
/begin CHARACTERISTIC FaultManager.NoCAN_BCM_430.Mode "Fault manager configuration.  Select up to 4 actions for each fault." VALUE 0x800005B7 RecordLayout_8 0 CompuMethod_209 0 65535 /end CHARACTERISTIC
/begin CHARACTERISTIC FaultManager.NoCAN_BCM_430.ID "Fault manager configuration.  Select up to 4 actions for each fault." VALUE 0x800005B9 RecordLayout_8 0 CompuMethod_1 0 65535 /end CHARACTERISTIC
/begin CHARACTERISTIC FaultManager.NoCAN_BCM_430.Test "Fault manager configuration.  Select up to 4 actions for each fault." VALUE 0x800005BB RecordLayout_8 0 CompuMethod_210 0 65535 /end CHARACTERISTIC
/begin CHARACTERISTIC FaultManager.NoCAN_BCM_430.Faulty_Samples__X_ "Fault manager configuration.  Select up to 4 actions for each fault." VALUE 0x800005BD RecordLayout_8 0 CompuMethod_1 0 65535 /end CHARACTERISTIC
/begin CHARACTERISTIC FaultManager.NoCAN_BCM_430.Total_Samples__Y_ "Fault manager configuration.  Select up to 4 actions for each fault." VALUE 0x800005BF RecordLayout_8 0 CompuMethod_1 0 65535 /end CHARACTERISTIC
/begin CHARACTERISTIC FaultManager.NoCAN_BCM_430.Action_1 "Fault manager configuration.  Select up to 4 actions for each fault." VALUE 0x800005C1 RecordLayout_8 0 CompuMethod_211 0 65535 /end CHARACTERISTIC
/begin CHARACTERISTIC FaultManager.NoCAN_BCM_430.Action_1_Condition "Fault manager configuration.  Select up to 4 actions for each fault." VALUE 0x800005C3 RecordLayout_8 0 CompuMethod_212 0 65535 /end CHARACTERISTIC
/begin CHARACTERISTIC FaultManager.NoCAN_BCM_430.Action_2 "Fault manager configuration.  Select up to 4 actions for each fault." VALUE 0x800005C5 RecordLayout_8 0 CompuMethod_211 0 65535 /end CHARACTERISTIC
/begin CHARACTERISTIC FaultManager.NoCAN_BCM_430.Action_2_Condition "Fault manager configuration.  Select up to 4 actions for each fault." VALUE 0x800005C7 RecordLayout_8 0 CompuMethod_212 0 65535 /end CHARACTERISTIC
/begin CHARACTERISTIC FaultManager.NoCAN_BCM_430.Action_3 "Fault manager configuration.  Select up to 4 actions for each fault." VALUE 0x800005C9 RecordLayout_8 0 CompuMethod_211 0 65535 /end CHARACTERISTIC
/begin CHARACTERISTIC FaultManager.NoCAN_BCM_430.Action_3_Condition "Fault manager configuration.  Select up to 4 actions for each fault." VALUE 0x800005CB RecordLayout_8 0 CompuMethod_212 0 65535 /end CHARACTERISTIC
/begin CHARACTERISTIC FaultManager.NoCAN_BCM_430.Action_4 "Fault manager configuration.  Select up to 4 actions for each fault." VALUE 0x800005CD RecordLayout_8 0 CompuMethod_211 0 65535 /end CHARACTERISTIC
/begin CHARACTERISTIC FaultManager.NoCAN_BCM_430.Action_4_Condition "Fault manager configuration.  Select up to 4 actions for each fault." VALUE 0x800005CF RecordLayout_8 0 CompuMethod_212 0 65535 /end CHARACTERISTIC
/begin CHARACTERISTIC FaultManager.NoCAN_CoolantPump.Mode "Fault manager configuration.  Select up to 4 actions for each fault." VALUE 0x800005D1 RecordLayout_8 0 CompuMethod_209 0 65535 /end CHARACTERISTIC
/begin CHARACTERISTIC FaultManager.NoCAN_CoolantPump.ID "Fault manager configuration.  Select up to 4 actions for each fault." VALUE 0x800005D3 RecordLayout_8 0 CompuMethod_1 0 65535 /end CHARACTERISTIC
/begin CHARACTERISTIC FaultManager.NoCAN_CoolantPump.Test "Fault manager configuration.  Select up to 4 actions for each fault." VALUE 0x800005D5 RecordLayout_8 0 CompuMethod_210 0 65535 /end CHARACTERISTIC
/begin CHARACTERISTIC FaultManager.NoCAN_CoolantPump.Faulty_Samples__X_ "Fault manager configuration.  Select up to 4 actions for each fault." VALUE 0x800005D7 RecordLayout_8 0 CompuMethod_1 0 65535 /end CHARACTERISTIC
/begin CHARACTERISTIC FaultManager.NoCAN_CoolantPump.Total_Samples__Y_ "Fault manager configuration.  Select up to 4 actions for each fault." VALUE 0x800005D9 RecordLayout_8 0 CompuMethod_1 0 65535 /end CHARACTERISTIC
/begin CHARACTERISTIC FaultManager.NoCAN_CoolantPump.Action_1 "Fault manager configuration.  Select up to 4 actions for each fault." VALUE 0x800005DB RecordLayout_8 0 CompuMethod_211 0 65535 /end CHARACTERISTIC
/begin CHARACTERISTIC FaultManager.NoCAN_CoolantPump.Action_1_Condition "Fault manager configuration.  Select up to 4 actions for each fault." VALUE 0x800005DD RecordLayout_8 0 CompuMethod_212 0 65535 /end CHARACTERISTIC
/begin CHARACTERISTIC FaultManager.NoCAN_CoolantPump.Action_2 "Fault manager configuration.  Select up to 4 actions for each fault." VALUE 0x800005DF RecordLayout_8 0 CompuMethod_211 0 65535 /end CHARACTERISTIC
/begin CHARACTERISTIC FaultManager.NoCAN_CoolantPump.Action_2_Condition "Fault manager configuration.  Select up to 4 actions for each fault." VALUE 0x800005E1 RecordLayout_8 0 CompuMethod_212 0 65535 /end CHARACTERISTIC
/begin CHARACTERISTIC FaultManager.NoCAN_CoolantPump.Action_3 "Fault manager configuration.  Select up to 4 actions for each fault." VALUE 0x800005E3 RecordLayout_8 0 CompuMethod_211 0 65535 /end CHARACTERISTIC
/begin CHARACTERISTIC FaultManager.NoCAN_CoolantPump.Action_3_Condition "Fault manager configuration.  Select up to 4 actions for each fault." VALUE 0x800005E5 RecordLayout_8 0 CompuMethod_212 0 65535 /end CHARACTERISTIC
/begin CHARACTERISTIC FaultManager.NoCAN_CoolantPump.Action_4 "Fault manager configuration.  Select up to 4 actions for each fault." VALUE 0x800005E7 RecordLayout_8 0 CompuMethod_211 0 65535 /end CHARACTERISTIC
/begin CHARACTERISTIC FaultManager.NoCAN_CoolantPump.Action_4_Condition "Fault manager configuration.  Select up to 4 actions for each fault." VALUE 0x800005E9 RecordLayout_8 0 CompuMethod_212 0 65535 /end CHARACTERISTIC
/begin CHARACTERISTIC FaultManager.NoCAN_CoolingFan.Mode "Fault manager configuration.  Select up to 4 actions for each fault." VALUE 0x800005EB RecordLayout_8 0 CompuMethod_209 0 65535 /end CHARACTERISTIC
/begin CHARACTERISTIC FaultManager.NoCAN_CoolingFan.ID "Fault manager configuration.  Select up to 4 actions for each fault." VALUE 0x800005ED RecordLayout_8 0 CompuMethod_1 0 65535 /end CHARACTERISTIC
/begin CHARACTERISTIC FaultManager.NoCAN_CoolingFan.Test "Fault manager configuration.  Select up to 4 actions for each fault." VALUE 0x800005EF RecordLayout_8 0 CompuMethod_210 0 65535 /end CHARACTERISTIC
/begin CHARACTERISTIC FaultManager.NoCAN_CoolingFan.Faulty_Samples__X_ "Fault manager configuration.  Select up to 4 actions for each fault." VALUE 0x800005F1 RecordLayout_8 0 CompuMethod_1 0 65535 /end CHARACTERISTIC
/begin CHARACTERISTIC FaultManager.NoCAN_CoolingFan.Total_Samples__Y_ "Fault manager configuration.  Select up to 4 actions for each fault." VALUE 0x800005F3 RecordLayout_8 0 CompuMethod_1 0 65535 /end CHARACTERISTIC
/begin CHARACTERISTIC FaultManager.NoCAN_CoolingFan.Action_1 "Fault manager configuration.  Select up to 4 actions for each fault." VALUE 0x800005F5 RecordLayout_8 0 CompuMethod_211 0 65535 /end CHARACTERISTIC
/begin CHARACTERISTIC FaultManager.NoCAN_CoolingFan.Action_1_Condition "Fault manager configuration.  Select up to 4 actions for each fault." VALUE 0x800005F7 RecordLayout_8 0 CompuMethod_212 0 65535 /end CHARACTERISTIC
/begin CHARACTERISTIC FaultManager.NoCAN_CoolingFan.Action_2 "Fault manager configuration.  Select up to 4 actions for each fault." VALUE 0x800005F9 RecordLayout_8 0 CompuMethod_211 0 65535 /end CHARACTERISTIC
/begin CHARACTERISTIC FaultManager.NoCAN_CoolingFan.Action_2_Condition "Fault manager configuration.  Select up to 4 actions for each fault." VALUE 0x800005FB RecordLayout_8 0 CompuMethod_212 0 65535 /end CHARACTERISTIC
/begin CHARACTERISTIC FaultManager.NoCAN_CoolingFan.Action_3 "Fault manager configuration.  Select up to 4 actions for each fault." VALUE 0x800005FD RecordLayout_8 0 CompuMethod_211 0 65535 /end CHARACTERISTIC
/begin CHARACTERISTIC FaultManager.NoCAN_CoolingFan.Action_3_Condition "Fault manager configuration.  Select up to 4 actions for each fault." VALUE 0x800005FF RecordLayout_8 0 CompuMethod_212 0 65535 /end CHARACTERISTIC
/begin CHARACTERISTIC FaultManager.NoCAN_CoolingFan.Action_4 "Fault manager configuration.  Select up to 4 actions for each fault." VALUE 0x80000601 RecordLayout_8 0 CompuMethod_211 0 65535 /end CHARACTERISTIC
/begin CHARACTERISTIC FaultManager.NoCAN_CoolingFan.Action_4_Condition "Fault manager configuration.  Select up to 4 actions for each fault." VALUE 0x80000603 RecordLayout_8 0 CompuMethod_212 0 65535 /end CHARACTERISTIC
/begin CHARACTERISTIC FaultManager.NoCAN_PowerSteering.Mode "Fault manager configuration.  Select up to 4 actions for each fault." VALUE 0x80000605 RecordLayout_8 0 CompuMethod_209 0 65535 /end CHARACTERISTIC
/begin CHARACTERISTIC FaultManager.NoCAN_PowerSteering.ID "Fault manager configuration.  Select up to 4 actions for each fault." VALUE 0x80000607 RecordLayout_8 0 CompuMethod_1 0 65535 /end CHARACTERISTIC
/begin CHARACTERISTIC FaultManager.NoCAN_PowerSteering.Test "Fault manager configuration.  Select up to 4 actions for each fault." VALUE 0x80000609 RecordLayout_8 0 CompuMethod_210 0 65535 /end CHARACTERISTIC
/begin CHARACTERISTIC FaultManager.NoCAN_PowerSteering.Faulty_Samples__X_ "Fault manager configuration.  Select up to 4 actions for each fault." VALUE 0x8000060B RecordLayout_8 0 CompuMethod_1 0 65535 /end CHARACTERISTIC
/begin CHARACTERISTIC FaultManager.NoCAN_PowerSteering.Total_Samples__Y_ "Fault manager configuration.  Select up to 4 actions for each fault." VALUE 0x8000060D RecordLayout_8 0 CompuMethod_1 0 65535 /end CHARACTERISTIC
/begin CHARACTERISTIC FaultManager.NoCAN_PowerSteering.Action_1 "Fault manager configuration.  Select up to 4 actions for each fault." VALUE 0x8000060F RecordLayout_8 0 CompuMethod_211 0 65535 /end CHARACTERISTIC
/begin CHARACTERISTIC FaultManager.NoCAN_PowerSteering.Action_1_Condition "Fault manager configuration.  Select up to 4 actions for each fault." VALUE 0x80000611 RecordLayout_8 0 CompuMethod_212 0 65535 /end CHARACTERISTIC
/begin CHARACTERISTIC FaultManager.NoCAN_PowerSteering.Action_2 "Fault manager configuration.  Select up to 4 actions for each fault." VALUE 0x80000613 RecordLayout_8 0 CompuMethod_211 0 65535 /end CHARACTERISTIC
/begin CHARACTERISTIC FaultManager.NoCAN_PowerSteering.Action_2_Condition "Fault manager configuration.  Select up to 4 actions for each fault." VALUE 0x80000615 RecordLayout_8 0 CompuMethod_212 0 65535 /end CHARACTERISTIC
/begin CHARACTERISTIC FaultManager.NoCAN_PowerSteering.Action_3 "Fault manager configuration.  Select up to 4 actions for each fault." VALUE 0x80000617 RecordLayout_8 0 CompuMethod_211 0 65535 /end CHARACTERISTIC
/begin CHARACTERISTIC FaultManager.NoCAN_PowerSteering.Action_3_Condition "Fault manager configuration.  Select up to 4 actions for each fault." VALUE 0x80000619 RecordLayout_8 0 CompuMethod_212 0 65535 /end CHARACTERISTIC
/begin CHARACTERISTIC FaultManager.NoCAN_PowerSteering.Action_4 "Fault manager configuration.  Select up to 4 actions for each fault." VALUE 0x8000061B RecordLayout_8 0 CompuMethod_211 0 65535 /end CHARACTERISTIC
/begin CHARACTERISTIC FaultManager.NoCAN_PowerSteering.Action_4_Condition "Fault manager configuration.  Select up to 4 actions for each fault." VALUE 0x8000061D RecordLayout_8 0 CompuMethod_212 0 65535 /end CHARACTERISTIC
/begin CHARACTERISTIC FaultManager.NoCAN_UQM_04EF.Mode "Fault manager configuration.  Select up to 4 actions for each fault." VALUE 0x8000061F RecordLayout_8 0 CompuMethod_209 0 65535 /end CHARACTERISTIC
/begin CHARACTERISTIC FaultManager.NoCAN_UQM_04EF.ID "Fault manager configuration.  Select up to 4 actions for each fault." VALUE 0x80000621 RecordLayout_8 0 CompuMethod_1 0 65535 /end CHARACTERISTIC
/begin CHARACTERISTIC FaultManager.NoCAN_UQM_04EF.Test "Fault manager configuration.  Select up to 4 actions for each fault." VALUE 0x80000623 RecordLayout_8 0 CompuMethod_210 0 65535 /end CHARACTERISTIC
/begin CHARACTERISTIC FaultManager.NoCAN_UQM_04EF.Faulty_Samples__X_ "Fault manager configuration.  Select up to 4 actions for each fault." VALUE 0x80000625 RecordLayout_8 0 CompuMethod_1 0 65535 /end CHARACTERISTIC
/begin CHARACTERISTIC FaultManager.NoCAN_UQM_04EF.Total_Samples__Y_ "Fault manager configuration.  Select up to 4 actions for each fault." VALUE 0x80000627 RecordLayout_8 0 CompuMethod_1 0 65535 /end CHARACTERISTIC
/begin CHARACTERISTIC FaultManager.NoCAN_UQM_04EF.Action_1 "Fault manager configuration.  Select up to 4 actions for each fault." VALUE 0x80000629 RecordLayout_8 0 CompuMethod_211 0 65535 /end CHARACTERISTIC
/begin CHARACTERISTIC FaultManager.NoCAN_UQM_04EF.Action_1_Condition "Fault manager configuration.  Select up to 4 actions for each fault." VALUE 0x8000062B RecordLayout_8 0 CompuMethod_212 0 65535 /end CHARACTERISTIC
/begin CHARACTERISTIC FaultManager.NoCAN_UQM_04EF.Action_2 "Fault manager configuration.  Select up to 4 actions for each fault." VALUE 0x8000062D RecordLayout_8 0 CompuMethod_211 0 65535 /end CHARACTERISTIC
/begin CHARACTERISTIC FaultManager.NoCAN_UQM_04EF.Action_2_Condition "Fault manager configuration.  Select up to 4 actions for each fault." VALUE 0x8000062F RecordLayout_8 0 CompuMethod_212 0 65535 /end CHARACTERISTIC
/begin CHARACTERISTIC FaultManager.NoCAN_UQM_04EF.Action_3 "Fault manager configuration.  Select up to 4 actions for each fault." VALUE 0x80000631 RecordLayout_8 0 CompuMethod_211 0 65535 /end CHARACTERISTIC
/begin CHARACTERISTIC FaultManager.NoCAN_UQM_04EF.Action_3_Condition "Fault manager configuration.  Select up to 4 actions for each fault." VALUE 0x80000633 RecordLayout_8 0 CompuMethod_212 0 65535 /end CHARACTERISTIC
/begin CHARACTERISTIC FaultManager.NoCAN_UQM_04EF.Action_4 "Fault manager configuration.  Select up to 4 actions for each fault." VALUE 0x80000635 RecordLayout_8 0 CompuMethod_211 0 65535 /end CHARACTERISTIC
/begin CHARACTERISTIC FaultManager.NoCAN_UQM_04EF.Action_4_Condition "Fault manager configuration.  Select up to 4 actions for each fault." VALUE 0x80000637 RecordLayout_8 0 CompuMethod_212 0 65535 /end CHARACTERISTIC
/begin CHARACTERISTIC FaultManager.NoCAN_UQM_14EF.Mode "Fault manager configuration.  Select up to 4 actions for each fault." VALUE 0x80000639 RecordLayout_8 0 CompuMethod_209 0 65535 /end CHARACTERISTIC
/begin CHARACTERISTIC FaultManager.NoCAN_UQM_14EF.ID "Fault manager configuration.  Select up to 4 actions for each fault." VALUE 0x8000063B RecordLayout_8 0 CompuMethod_1 0 65535 /end CHARACTERISTIC
/begin CHARACTERISTIC FaultManager.NoCAN_UQM_14EF.Test "Fault manager configuration.  Select up to 4 actions for each fault." VALUE 0x8000063D RecordLayout_8 0 CompuMethod_210 0 65535 /end CHARACTERISTIC
/begin CHARACTERISTIC FaultManager.NoCAN_UQM_14EF.Faulty_Samples__X_ "Fault manager configuration.  Select up to 4 actions for each fault." VALUE 0x8000063F RecordLayout_8 0 CompuMethod_1 0 65535 /end CHARACTERISTIC
/begin CHARACTERISTIC FaultManager.NoCAN_UQM_14EF.Total_Samples__Y_ "Fault manager configuration.  Select up to 4 actions for each fault." VALUE 0x80000641 RecordLayout_8 0 CompuMethod_1 0 65535 /end CHARACTERISTIC
/begin CHARACTERISTIC FaultManager.NoCAN_UQM_14EF.Action_1 "Fault manager configuration.  Select up to 4 actions for each fault." VALUE 0x80000643 RecordLayout_8 0 CompuMethod_211 0 65535 /end CHARACTERISTIC
/begin CHARACTERISTIC FaultManager.NoCAN_UQM_14EF.Action_1_Condition "Fault manager configuration.  Select up to 4 actions for each fault." VALUE 0x80000645 RecordLayout_8 0 CompuMethod_212 0 65535 /end CHARACTERISTIC
/begin CHARACTERISTIC FaultManager.NoCAN_UQM_14EF.Action_2 "Fault manager configuration.  Select up to 4 actions for each fault." VALUE 0x80000647 RecordLayout_8 0 CompuMethod_211 0 65535 /end CHARACTERISTIC
/begin CHARACTERISTIC FaultManager.NoCAN_UQM_14EF.Action_2_Condition "Fault manager configuration.  Select up to 4 actions for each fault." VALUE 0x80000649 RecordLayout_8 0 CompuMethod_212 0 65535 /end CHARACTERISTIC
/begin CHARACTERISTIC FaultManager.NoCAN_UQM_14EF.Action_3 "Fault manager configuration.  Select up to 4 actions for each fault." VALUE 0x8000064B RecordLayout_8 0 CompuMethod_211 0 65535 /end CHARACTERISTIC
/begin CHARACTERISTIC FaultManager.NoCAN_UQM_14EF.Action_3_Condition "Fault manager configuration.  Select up to 4 actions for each fault." VALUE 0x8000064D RecordLayout_8 0 CompuMethod_212 0 65535 /end CHARACTERISTIC
/begin CHARACTERISTIC FaultManager.NoCAN_UQM_14EF.Action_4 "Fault manager configuration.  Select up to 4 actions for each fault." VALUE 0x8000064F RecordLayout_8 0 CompuMethod_211 0 65535 /end CHARACTERISTIC
/begin CHARACTERISTIC FaultManager.NoCAN_UQM_14EF.Action_4_Condition "Fault manager configuration.  Select up to 4 actions for each fault." VALUE 0x80000651 RecordLayout_8 0 CompuMethod_212 0 65535 /end CHARACTERISTIC
/begin CHARACTERISTIC FaultManager.NoCAN_UQM_18EF.Mode "Fault manager configuration.  Select up to 4 actions for each fault." VALUE 0x80000653 RecordLayout_8 0 CompuMethod_209 0 65535 /end CHARACTERISTIC
/begin CHARACTERISTIC FaultManager.NoCAN_UQM_18EF.ID "Fault manager configuration.  Select up to 4 actions for each fault." VALUE 0x80000655 RecordLayout_8 0 CompuMethod_1 0 65535 /end CHARACTERISTIC
/begin CHARACTERISTIC FaultManager.NoCAN_UQM_18EF.Test "Fault manager configuration.  Select up to 4 actions for each fault." VALUE 0x80000657 RecordLayout_8 0 CompuMethod_210 0 65535 /end CHARACTERISTIC
/begin CHARACTERISTIC FaultManager.NoCAN_UQM_18EF.Faulty_Samples__X_ "Fault manager configuration.  Select up to 4 actions for each fault." VALUE 0x80000659 RecordLayout_8 0 CompuMethod_1 0 65535 /end CHARACTERISTIC
/begin CHARACTERISTIC FaultManager.NoCAN_UQM_18EF.Total_Samples__Y_ "Fault manager configuration.  Select up to 4 actions for each fault." VALUE 0x8000065B RecordLayout_8 0 CompuMethod_1 0 65535 /end CHARACTERISTIC
/begin CHARACTERISTIC FaultManager.NoCAN_UQM_18EF.Action_1 "Fault manager configuration.  Select up to 4 actions for each fault." VALUE 0x8000065D RecordLayout_8 0 CompuMethod_211 0 65535 /end CHARACTERISTIC
/begin CHARACTERISTIC FaultManager.NoCAN_UQM_18EF.Action_1_Condition "Fault manager configuration.  Select up to 4 actions for each fault." VALUE 0x8000065F RecordLayout_8 0 CompuMethod_212 0 65535 /end CHARACTERISTIC
/begin CHARACTERISTIC FaultManager.NoCAN_UQM_18EF.Action_2 "Fault manager configuration.  Select up to 4 actions for each fault." VALUE 0x80000661 RecordLayout_8 0 CompuMethod_211 0 65535 /end CHARACTERISTIC
/begin CHARACTERISTIC FaultManager.NoCAN_UQM_18EF.Action_2_Condition "Fault manager configuration.  Select up to 4 actions for each fault." VALUE 0x80000663 RecordLayout_8 0 CompuMethod_212 0 65535 /end CHARACTERISTIC
/begin CHARACTERISTIC FaultManager.NoCAN_UQM_18EF.Action_3 "Fault manager configuration.  Select up to 4 actions for each fault." VALUE 0x80000665 RecordLayout_8 0 CompuMethod_211 0 65535 /end CHARACTERISTIC
/begin CHARACTERISTIC FaultManager.NoCAN_UQM_18EF.Action_3_Condition "Fault manager configuration.  Select up to 4 actions for each fault." VALUE 0x80000667 RecordLayout_8 0 CompuMethod_212 0 65535 /end CHARACTERISTIC
/begin CHARACTERISTIC FaultManager.NoCAN_UQM_18EF.Action_4 "Fault manager configuration.  Select up to 4 actions for each fault." VALUE 0x80000669 RecordLayout_8 0 CompuMethod_211 0 65535 /end CHARACTERISTIC
/begin CHARACTERISTIC FaultManager.NoCAN_UQM_18EF.Action_4_Condition "Fault manager configuration.  Select up to 4 actions for each fault." VALUE 0x8000066B RecordLayout_8 0 CompuMethod_212 0 65535 /end CHARACTERISTIC
/begin CHARACTERISTIC FaultSeverityIndicator_new "" VALUE 0x8000066D RecordLayout_4 0 CompuMethod_2 -1E+17 1E+17 /end CHARACTERISTIC
/begin CHARACTERISTIC FaultSeverityIndicator_ovr "" VALUE 0x80000671 RecordLayout_1 0 CompuMethod_9 0 1 /end CHARACTERISTIC
/begin CHARACTERISTIC firstScrollTime "Time to spend on first view of the scroll" VALUE 0x80000684 RecordLayout_8 0 CompuMethod_35 0 5 /end CHARACTERISTIC
/begin CHARACTERISTIC Flash_Reverse_Lights_Ovr_new "" VALUE 0x80000686 RecordLayout_4 0 CompuMethod_2 -1E+17 1E+17 /end CHARACTERISTIC
/begin CHARACTERISTIC Flash_Reverse_Lights_Ovr_ovr "" VALUE 0x8000068A RecordLayout_1 0 CompuMethod_9 0 1 /end CHARACTERISTIC
/begin CHARACTERISTIC fwdAccThres "Accelerator must be below this to switch Rev->Fwd" VALUE 0x8000068F RecordLayout_4 0 CompuMethod_6 0 1 /end CHARACTERISTIC
/begin CHARACTERISTIC fwdSpdThres "Must be below this speed to switch Rev->Fwd" VALUE 0x80000693 RecordLayout_4 0 CompuMethod_195 0 1E+17 /end CHARACTERISTIC
/begin CHARACTERISTIC GFD_Enable "" VALUE 0x80000697 RecordLayout_4 0 CompuMethod_2 -1E+17 1E+17 /end CHARACTERISTIC
/begin CHARACTERISTIC GFD_Torque_Off "" VALUE 0x8000069B RecordLayout_4 0 CompuMethod_2 -1E+17 1E+17 /end CHARACTERISTIC
/begin CHARACTERISTIC hsc_bcm_enable_new "" VALUE 0x800006B1 RecordLayout_1 0 CompuMethod_1 0 255 /end CHARACTERISTIC
/begin CHARACTERISTIC hsc_bcm_enable_ovr "" VALUE 0x800006B2 RecordLayout_1 0 CompuMethod_9 0 1 /end CHARACTERISTIC
/begin CHARACTERISTIC hsc_bcm_epo_new "" VALUE 0x800006B3 RecordLayout_1 0 CompuMethod_1 0 255 /end CHARACTERISTIC
/begin CHARACTERISTIC hsc_bcm_epo_ovr "" VALUE 0x800006B4 RecordLayout_1 0 CompuMethod_9 0 1 /end CHARACTERISTIC
/begin CHARACTERISTIC hsc_bcm_leakage_enable_new "" VALUE 0x800006B5 RecordLayout_1 0 CompuMethod_27 0 1 /end CHARACTERISTIC
/begin CHARACTERISTIC hsc_bcm_leakage_enable_ovr "" VALUE 0x800006B6 RecordLayout_1 0 CompuMethod_9 0 1 /end CHARACTERISTIC
/begin CHARACTERISTIC hsc_bcm_mainc_enable_new "" VALUE 0x800006B7 RecordLayout_1 0 CompuMethod_27 0 1 /end CHARACTERISTIC
/begin CHARACTERISTIC hsc_bcm_mainc_enable_ovr "" VALUE 0x800006B8 RecordLayout_1 0 CompuMethod_9 0 1 /end CHARACTERISTIC
/begin CHARACTERISTIC HV_Bus_allowed_mismatch "this is the max difference allowed before battery shutdown" VALUE 0x800006B9 RecordLayout_4 0 CompuMethod_2 -1E+17 1E+17 /end CHARACTERISTIC
/begin CHARACTERISTIC HV_Bus_offline_delay "This leads to hv buss ofline fault" VALUE 0x800006BD RecordLayout_4 0 CompuMethod_215 -1E+17 1E+17 /end CHARACTERISTIC
/begin CHARACTERISTIC HV_GFI_Check "This leads to hv buss ofline fault" VALUE 0x800006C1 RecordLayout_4 0 CompuMethod_215 -1E+17 1E+17 /end CHARACTERISTIC
/begin CHARACTERISTIC IgnitionStatus_new "" VALUE 0x800006CB RecordLayout_4 0 CompuMethod_2 -1E+17 1E+17 /end CHARACTERISTIC
/begin CHARACTERISTIC IgnitionStatus_ovr "" VALUE 0x800006CF RecordLayout_1 0 CompuMethod_9 0 1 /end CHARACTERISTIC
/begin CHARACTERISTIC In_Reverse_new "" VALUE 0x800006D4 RecordLayout_4 0 CompuMethod_2 -1E+17 1E+17 /end CHARACTERISTIC
/begin CHARACTERISTIC In_Reverse_ovr "" VALUE 0x800006D8 RecordLayout_1 0 CompuMethod_9 0 1 /end CHARACTERISTIC
/begin CHARACTERISTIC InhibitDCDC_Out__new "Override actuator, in engineering units" VALUE 0x800006D9 RecordLayout_1 0 CompuMethod_216 0 1 /end CHARACTERISTIC
/begin CHARACTERISTIC InhibitDCDC_Out__ovr "" VALUE 0x800006DA RecordLayout_1 0 CompuMethod_9 0 1 /end CHARACTERISTIC
/begin CHARACTERISTIC InhibitDCDC_Out__Polarity "Inverts the output of the actuator relative to the desired command - 0 = High True    1 = Low True" VALUE 0x800006DB RecordLayout_1 0 CompuMethod_216 0 1 /end CHARACTERISTIC
/begin CHARACTERISTIC InputCurrent_new "" VALUE 0x800006DC RecordLayout_4 0 CompuMethod_2 -1E+17 1E+17 /end CHARACTERISTIC
/begin CHARACTERISTIC InputCurrent_ovr "" VALUE 0x800006E0 RecordLayout_1 0 CompuMethod_9 0 1 /end CHARACTERISTIC
/begin CHARACTERISTIC InputCurrentLimitMax_new "" VALUE 0x800006E1 RecordLayout_4 0 CompuMethod_2 -1E+17 1E+17 /end CHARACTERISTIC
/begin CHARACTERISTIC InputCurrentLimitMax_ovr "" VALUE 0x800006E5 RecordLayout_1 0 CompuMethod_9 0 1 /end CHARACTERISTIC
/begin CHARACTERISTIC InputVoltage_new "" VALUE 0x800006E6 RecordLayout_4 0 CompuMethod_2 -1E+17 1E+17 /end CHARACTERISTIC
/begin CHARACTERISTIC InputVoltage_ovr "" VALUE 0x800006EA RecordLayout_1 0 CompuMethod_9 0 1 /end CHARACTERISTIC
/begin CHARACTERISTIC IntermediaryGearRatio "Used to calculate vehicle speed from motor speed" VALUE 0x800006EB RecordLayout_4 0 CompuMethod_14 -1E+17 1E+17 /end CHARACTERISTIC
/begin CHARACTERISTIC InvertMode "Sets the background color for the text." VALUE 0x800006FA RecordLayout_1 0 CompuMethod_219 0 1 /end CHARACTERISTIC
/begin CHARACTERISTIC lastScrollTime "Time to spend on the last view of the scroll" VALUE 0x800006FD RecordLayout_8 0 CompuMethod_35 0 5 /end CHARACTERISTIC
/begin CHARACTERISTIC listIndex "" VALUE 0x80000700 RecordLayout_1 0 CompuMethod_1 0 255 /end CHARACTERISTIC
/begin CHARACTERISTIC LVVolt_DfltValue "This is the initial default value should the sensor be in fault on key-up.  Otherwise the sensors outputs the last value prior to faulting" VALUE 0x8000070E RecordLayout_4 0 CompuMethod_214 -1E+17 1E+17 /end CHARACTERISTIC
/begin CHARACTERISTIC LVVolt_FilterConst "Filter time constant" VALUE 0x80000712 RecordLayout_4 0 CompuMethod_7 -1E+17 1E+17 /end CHARACTERISTIC
/begin CHARACTERISTIC LVVolt_Gain "Scaling from A/D counts to engineering units" VALUE 0x80000716 RecordLayout_4 0 CompuMethod_223 -1E+17 1E+17 /end CHARACTERISTIC
/begin CHARACTERISTIC LVVolt_InputHiFltPos "Maximum allowable input, indicating short or open circuit" VALUE 0x8000071A RecordLayout_4 0 CompuMethod_8 -1E+17 1E+17 /end CHARACTERISTIC
/begin CHARACTERISTIC LVVolt_InputLoFltPos "Minimum allowable input, indicating short or open circuit" VALUE 0x8000071E RecordLayout_4 0 CompuMethod_8 -1E+17 1E+17 /end CHARACTERISTIC
/begin CHARACTERISTIC LVVolt_new "Override result of linear sensor characterization, in engineering units" VALUE 0x80000722 RecordLayout_4 0 CompuMethod_214 -1E+17 1E+17 /end CHARACTERISTIC
/begin CHARACTERISTIC LVVolt_Ofst "Offset after gain in engineering units" VALUE 0x80000726 RecordLayout_4 0 CompuMethod_214 -1E+17 1E+17 /end CHARACTERISTIC
/begin CHARACTERISTIC LVVolt_ovr "" VALUE 0x8000072A RecordLayout_1 0 CompuMethod_9 0 1 /end CHARACTERISTIC
/begin CHARACTERISTIC minTime "Minimum time to display each fault name." VALUE 0x80000743 RecordLayout_8 0 CompuMethod_35 0 5 /end CHARACTERISTIC
/begin CHARACTERISTIC motor_torque_Ovr_new "" VALUE 0x80000745 RecordLayout_4 0 CompuMethod_2 -1E+17 1E+17 /end CHARACTERISTIC
/begin CHARACTERISTIC motor_torque_Ovr_ovr "" VALUE 0x80000749 RecordLayout_1 0 CompuMethod_9 0 1 /end CHARACTERISTIC
/begin CHARACTERISTIC MPRD_KeepAlive "When enabled, keeps the MPRD output on and keeps the processor alive" VALUE 0x8000076A RecordLayout_1 0 CompuMethod_230 0 1 /end CHARACTERISTIC
/begin CHARACTERISTIC MPRD_new "Directly Override Main Power Relay" VALUE 0x8000076B RecordLayout_1 0 CompuMethod_231 0 1 /end CHARACTERISTIC
/begin CHARACTERISTIC MPRD_ovr "" VALUE 0x8000076C RecordLayout_1 0 CompuMethod_9 0 1 /end CHARACTERISTIC
/begin CHARACTERISTIC noErrText "Text to display if there are no faults." ASCII 0x8000076D RecordLayout_2 0 CompuMethod_2 0 255 NUMBER 10 MATRIX_DIM 10 1 1 /end CHARACTERISTIC
/begin CHARACTERISTIC NonVolatileRestoreOnFirstStartup "Selects whether to restore from factory defaults the first time an application boots" VALUE 0x80000777 RecordLayout_1 0 CompuMethod_232 0 1 /end CHARACTERISTIC
/begin CHARACTERISTIC NonVolatileRestoreOnStartup "Selects whether to restore from factory defaults on next startup" VALUE 0x80000778 RecordLayout_1 0 CompuMethod_232 0 1 /end CHARACTERISTIC
/begin CHARACTERISTIC offTime "Switch must be released this long to press again." VALUE 0x80000779 RecordLayout_4 0 CompuMethod_234 0 500000000000000 /end CHARACTERISTIC
/begin CHARACTERISTIC onTime "Switch must be pressed this long." VALUE 0x80000781 RecordLayout_4 0 CompuMethod_234 0 500000000000000 /end CHARACTERISTIC
/begin CHARACTERISTIC OutputCurrent_new "" VALUE 0x80000785 RecordLayout_4 0 CompuMethod_2 -1E+17 1E+17 /end CHARACTERISTIC
/begin CHARACTERISTIC OutputCurrent_ovr "" VALUE 0x80000789 RecordLayout_1 0 CompuMethod_9 0 1 /end CHARACTERISTIC
/begin CHARACTERISTIC OutputVoltage_new "" VALUE 0x8000078A RecordLayout_4 0 CompuMethod_2 -1E+17 1E+17 /end CHARACTERISTIC
/begin CHARACTERISTIC OutputVoltage_ovr "" VALUE 0x8000078E RecordLayout_1 0 CompuMethod_9 0 1 /end CHARACTERISTIC
/begin CHARACTERISTIC Over_SOC_Shutdown_Thresh "" VALUE 0x8000078F RecordLayout_4 0 CompuMethod_2 -1E+17 1E+17 /end CHARACTERISTIC
/begin CHARACTERISTIC Over_SOCAlertThresh "" VALUE 0x80000793 RecordLayout_4 0 CompuMethod_2 -1E+17 1E+17 /end CHARACTERISTIC
/begin CHARACTERISTIC ProcessorReboot "Reboots the processor when set." VALUE 0x800007C8 RecordLayout_1 0 CompuMethod_237 0 1 /end CHARACTERISTIC
/begin CHARACTERISTIC quadIndex "" VAL_BLK 0x800007C9 RecordLayout_1 0 CompuMethod_1 0 255 MATRIX_DIM 1 4 1 /end CHARACTERISTIC
/begin CHARACTERISTIC RearDiffRatio "Used to calculate vehicle speed from motor speed" VALUE 0x800007CD RecordLayout_4 0 CompuMethod_14 -1E+17 1E+17 /end CHARACTERISTIC
/begin CHARACTERISTIC Regen_SOC_Speed_Ramp_ovr_new "" VALUE 0x800007D5 RecordLayout_4 0 CompuMethod_2 -1E+17 1E+17 /end CHARACTERISTIC
/begin CHARACTERISTIC Regen_SOC_Speed_Ramp_ovr_ovr "" VALUE 0x800007D9 RecordLayout_1 0 CompuMethod_9 0 1 /end CHARACTERISTIC
/begin CHARACTERISTIC RestoreNVFactoryDefaults "Restores NonVolatile Memory to Factory Defaults" VALUE 0x8000085E RecordLayout_1 0 CompuMethod_238 0 1 /end CHARACTERISTIC
/begin CHARACTERISTIC revAccThres "Accelerator must be below this to switch Fwd->Rev" VALUE 0x8000085F RecordLayout_4 0 CompuMethod_6 0 1 /end CHARACTERISTIC
/begin CHARACTERISTIC Reverse_Polarity "0 = High True    1 = Low True" VALUE 0x80000863 RecordLayout_1 0 CompuMethod_216 0 1 /end CHARACTERISTIC
/begin CHARACTERISTIC Reverse_Switch_new "Override actuator, in engineering units" VALUE 0x80000868 RecordLayout_1 0 CompuMethod_239 0 1 /end CHARACTERISTIC
/begin CHARACTERISTIC Reverse_Switch_ovr "" VALUE 0x80000869 RecordLayout_1 0 CompuMethod_9 0 1 /end CHARACTERISTIC
/begin CHARACTERISTIC Reverse_SwitchPt "Defines switch point in ADC units boolean conversion" VALUE 0x8000086D RecordLayout_4 0 CompuMethod_8 -1E+17 1E+17 /end CHARACTERISTIC
/begin CHARACTERISTIC ReverseIndFlash_Period "Period for the flashing reverse indicator." VALUE 0x80000872 RecordLayout_5 0 CompuMethod_35 0 100 /end CHARACTERISTIC
/begin CHARACTERISTIC RevIndType "Mode for Reverse Indicator" VALUE 0x80000876 RecordLayout_1 0 CompuMethod_241 0 100 /end CHARACTERISTIC
/begin CHARACTERISTIC RevOut__new "Override actuator, in engineering units" VALUE 0x80000877 RecordLayout_1 0 CompuMethod_216 0 1 /end CHARACTERISTIC
/begin CHARACTERISTIC RevOut__ovr "" VALUE 0x80000878 RecordLayout_1 0 CompuMethod_9 0 1 /end CHARACTERISTIC
/begin CHARACTERISTIC RevOut__Polarity "Inverts the output of the actuator relative to the desired command - 0 = High True    1 = Low True" VALUE 0x80000879 RecordLayout_1 0 CompuMethod_216 0 1 /end CHARACTERISTIC
/begin CHARACTERISTIC revSpdThres "Must be below this speed to switch Fwd->Rev." VALUE 0x8000087A RecordLayout_4 0 CompuMethod_195 0 1E+17 /end CHARACTERISTIC
/begin CHARACTERISTIC screen "" VALUE 0x80000883 RecordLayout_1 0 CompuMethod_1 0 255 /end CHARACTERISTIC
/begin CHARACTERISTIC scrollTime "Time to spend on each view of the scroll" VALUE 0x80000884 RecordLayout_8 0 CompuMethod_35 0 5 /end CHARACTERISTIC
/begin CHARACTERISTIC Shutdown_Req "" VALUE 0x8000088A RecordLayout_1 0 CompuMethod_27 0 1 /end CHARACTERISTIC
/begin CHARACTERISTIC singleIndex "" VALUE 0x8000088B RecordLayout_1 0 CompuMethod_1 0 255 /end CHARACTERISTIC
/begin CHARACTERISTIC SOC_new "" VALUE 0x8000088C RecordLayout_4 0 CompuMethod_2 0 1 /end CHARACTERISTIC
/begin CHARACTERISTIC SOC_ovr "" VALUE 0x80000890 RecordLayout_1 0 CompuMethod_9 0 1 /end CHARACTERISTIC
/begin CHARACTERISTIC startupCount "" VALUE 0x8000089D RecordLayout_3 0 CompuMethod_18 0 4294970000 /end CHARACTERISTIC
/begin CHARACTERISTIC startupDelay "Time to wait before drawing on the miniview." VALUE 0x800008A1 RecordLayout_8 0 CompuMethod_35 0 10 /end CHARACTERISTIC
/begin CHARACTERISTIC StoreNV "Stores RAM-Shadowed memory to serial EEPROM" VALUE 0x800008BC RecordLayout_1 0 CompuMethod_243 0 1 /end CHARACTERISTIC
/begin CHARACTERISTIC TireSize "Used to calculate vehicle speed from motor speed" VALUE 0x800008C5 RecordLayout_4 0 CompuMethod_246 -1E+17 1E+17 /end CHARACTERISTIC
/begin CHARACTERISTIC totalOnTime "" VALUE 0x800008CD RecordLayout_3 0 CompuMethod_18 0 4294970000 /end CHARACTERISTIC
/begin CHARACTERISTIC Under_SOC_Shutdown_Thresh "" VALUE 0x800008D1 RecordLayout_4 0 CompuMethod_2 -1E+17 1E+17 /end CHARACTERISTIC
/begin CHARACTERISTIC Under_SOCAlertThresh "" VALUE 0x800008D5 RecordLayout_4 0 CompuMethod_248 -1E+17 1E+17 /end CHARACTERISTIC
/begin CHARACTERISTIC UQM_Direction_new "" VALUE 0x800008D9 RecordLayout_1 0 CompuMethod_249 0 1 /end CHARACTERISTIC
/begin CHARACTERISTIC UQM_Direction_ovr "" VALUE 0x800008DA RecordLayout_1 0 CompuMethod_9 0 1 /end CHARACTERISTIC
/begin CHARACTERISTIC UQM_Enable_new "" VALUE 0x800008DB RecordLayout_1 0 CompuMethod_27 0 1 /end CHARACTERISTIC
/begin CHARACTERISTIC UQM_Enable_ovr "" VALUE 0x800008DC RecordLayout_1 0 CompuMethod_9 0 1 /end CHARACTERISTIC
/begin CHARACTERISTIC UQM_Torque_new "" VALUE 0x800008DD RecordLayout_4 0 CompuMethod_2 -1E+17 1E+17 /end CHARACTERISTIC
/begin CHARACTERISTIC UQM_Torque_ovr "" VALUE 0x800008E1 RecordLayout_1 0 CompuMethod_9 0 1 /end CHARACTERISTIC
/begin CHARACTERISTIC VDO_Gauge_Brightness "" VALUE 0x800008E7 RecordLayout_8 0 CompuMethod_29 0 7 /end CHARACTERISTIC
/begin CHARACTERISTIC VDO_Gauge_StartupDelay "" VALUE 0x800008E9 RecordLayout_4 0 CompuMethod_2 0 7 /end CHARACTERISTIC
/begin CHARACTERISTIC Vehicle_Speed_new "" VALUE 0x800008F1 RecordLayout_4 0 CompuMethod_2 -1E+17 1E+17 /end CHARACTERISTIC
/begin CHARACTERISTIC Vehicle_Speed_ovr "" VALUE 0x800008F5 RecordLayout_1 0 CompuMethod_9 0 1 /end CHARACTERISTIC
/begin CHARACTERISTIC Voltage_Limit_Override_new "" VALUE 0x800008FA RecordLayout_4 0 CompuMethod_2 -1E+17 1E+17 /end CHARACTERISTIC
/begin CHARACTERISTIC Voltage_Limit_Override_ovr "" VALUE 0x800008FE RecordLayout_1 0 CompuMethod_9 0 1 /end CHARACTERISTIC
/*~~~~~~~~~ 6.3.106 RECORD_LAYOUTs ~~~~~~~~~*/
/begin RECORD_LAYOUT RecordLayout_1 FNC_VALUES 1 UBYTE ROW_DIR DIRECT /end RECORD_LAYOUT
/begin RECORD_LAYOUT RecordLayout_2 FNC_VALUES 1 UBYTE ROW_DIR DIRECT /end RECORD_LAYOUT
/begin RECORD_LAYOUT RecordLayout_3 FNC_VALUES 1 ULONG ROW_DIR DIRECT /end RECORD_LAYOUT
/begin RECORD_LAYOUT RecordLayout_4 FNC_VALUES 1 FLOAT32_IEEE ROW_DIR DIRECT /end RECORD_LAYOUT
/begin RECORD_LAYOUT RecordLayout_5 FNC_VALUES 1 SWORD ROW_DIR DIRECT /end RECORD_LAYOUT
/begin RECORD_LAYOUT RecordLayout_8 FNC_VALUES 1 UWORD ROW_DIR DIRECT /end RECORD_LAYOUT
/*~~~~~~~~~ 6.3.31 COMPU_METHODs ~~~~~~~~~*/
/begin COMPU_METHOD CompuMethod_1 "" RAT_FUNC "%3.0" "" COEFFS 0 1 0 0 0 1 /end COMPU_METHOD
/begin COMPU_METHOD CompuMethod_2 "" RAT_FUNC "%6.2" "" COEFFS 0 1 0 0 0 1 /end COMPU_METHOD
/begin COMPU_METHOD CompuMethod_5 "" RAT_FUNC "%5.0" "ADC" COEFFS 0 1 0 0 0 1 /end COMPU_METHOD
/begin COMPU_METHOD CompuMethod_6 "" RAT_FUNC "%6.2" "%" COEFFS 0 1 0 0 0 1 /end COMPU_METHOD
/begin COMPU_METHOD CompuMethod_7 "" RAT_FUNC "%6.2" "sec" COEFFS 0 1 0 0 0 1 /end COMPU_METHOD
/begin COMPU_METHOD CompuMethod_8 "" RAT_FUNC "%6.2" "ADC" COEFFS 0 1 0 0 0 1 /end COMPU_METHOD
/begin COMPU_METHOD CompuMethod_9 "" TAB_VERB "%1.0" "" COMPU_TAB_REF CompuVtab_1 /end COMPU_METHOD
/begin COMPU_METHOD CompuMethod_14 "" RAT_FUNC "%5.4" "" COEFFS 0 1 0 0 0 1 /end COMPU_METHOD
/begin COMPU_METHOD CompuMethod_18 "" RAT_FUNC "%8.0" "" COEFFS 0 1 0 0 0 1 /end COMPU_METHOD
/begin COMPU_METHOD CompuMethod_19 "" TAB_VERB "%6.2" "" COMPU_TAB_REF CompuVtab_4 /end COMPU_METHOD
/begin COMPU_METHOD CompuMethod_27 "" RAT_FUNC "%1.0" "" COEFFS 0 1 0 0 0 1 /end COMPU_METHOD
/begin COMPU_METHOD CompuMethod_29 "" RAT_FUNC "%5.0" "" COEFFS 0 1 0 0 0 1 /end COMPU_METHOD
/begin COMPU_METHOD CompuMethod_33 "" RAT_FUNC "%4.3" "" COEFFS 0 1 0 0 0 1 /end COMPU_METHOD
/begin COMPU_METHOD CompuMethod_35 "" RAT_FUNC "%4.3" "s" COEFFS 0 1 0 0 0 0.005 /end COMPU_METHOD
/begin COMPU_METHOD CompuMethod_195 "" RAT_FUNC "%6.2" "mph" COEFFS 0 1 0 0 0 1 /end COMPU_METHOD
/begin COMPU_METHOD CompuMethod_196 "" TAB_VERB "%1.0" "" COMPU_TAB_REF CompuVtab_6 /end COMPU_METHOD
/begin COMPU_METHOD CompuMethod_197 "" RAT_FUNC "%6.2" "Sec" COEFFS 0 1 0 0 0 0.005 /end COMPU_METHOD
/begin COMPU_METHOD CompuMethod_198 "" RAT_FUNC "%5.0" "ADC_counts" COEFFS 0 1 0 0 0 1 /end COMPU_METHOD
/begin COMPU_METHOD CompuMethod_199 "" TAB_VERB "%3.0" "" COMPU_TAB_REF CompuVtab_167 /end COMPU_METHOD
/begin COMPU_METHOD CompuMethod_200 "" RAT_FUNC "%3.1" "" COEFFS 0 1 0 0 0 1 /end COMPU_METHOD
/begin COMPU_METHOD CompuMethod_202 "" TAB_VERB "%3.0" "" COMPU_TAB_REF CompuVtab_169 /end COMPU_METHOD
/begin COMPU_METHOD CompuMethod_203 "" TAB_VERB "%3.0" "" COMPU_TAB_REF CompuVtab_170 /end COMPU_METHOD
/begin COMPU_METHOD CompuMethod_205 "" RAT_FUNC "%6.2" "Hz" COEFFS 0 1 0 0 0 1 /end COMPU_METHOD
/begin COMPU_METHOD CompuMethod_206 "" RAT_FUNC "%6.2" "%/%" COEFFS 0 1 0 0 0 1 /end COMPU_METHOD
/begin COMPU_METHOD CompuMethod_207 "" TAB_VERB "%3.0" "" COMPU_TAB_REF CompuVtab_172 /end COMPU_METHOD
/begin COMPU_METHOD CompuMethod_208 "" TAB_VERB "%3.0" "" COMPU_TAB_REF CompuVtab_173 /end COMPU_METHOD
/begin COMPU_METHOD CompuMethod_209 "" TAB_VERB "%3.0" "" COMPU_TAB_REF CompuVtab_174 /end COMPU_METHOD
/begin COMPU_METHOD CompuMethod_210 "" TAB_VERB "%3.0" "" COMPU_TAB_REF CompuVtab_175 /end COMPU_METHOD
/begin COMPU_METHOD CompuMethod_211 "" TAB_VERB "%3.0" "" COMPU_TAB_REF CompuVtab_176 /end COMPU_METHOD
/begin COMPU_METHOD CompuMethod_212 "" TAB_VERB "%3.0" "" COMPU_TAB_REF CompuVtab_177 /end COMPU_METHOD
/begin COMPU_METHOD CompuMethod_213 "" TAB_VERB "%3.0" "" COMPU_TAB_REF CompuVtab_4 /end COMPU_METHOD
/begin COMPU_METHOD CompuMethod_214 "" RAT_FUNC "%6.2" "V" COEFFS 0 1 0 0 0 1 /end COMPU_METHOD
/begin COMPU_METHOD CompuMethod_215 "" RAT_FUNC "%6.2" "time (seconds), since vehicle enable" COEFFS 0 1 0 0 0 1 /end COMPU_METHOD
/begin COMPU_METHOD CompuMethod_216 "" RAT_FUNC "%1.0" "bool" COEFFS 0 1 0 0 0 1 /end COMPU_METHOD
/begin COMPU_METHOD CompuMethod_219 "" TAB_VERB "%1.0" "" COMPU_TAB_REF CompuVtab_178 /end COMPU_METHOD
/begin COMPU_METHOD CompuMethod_223 "" RAT_FUNC "%9.4" "V/ADC" COEFFS 0 1 0 0 0 1 /end COMPU_METHOD
/begin COMPU_METHOD CompuMethod_227 "" RAT_FUNC "%4.3" "" COEFFS 0 1 0 0 0 0.005 /end COMPU_METHOD
/begin COMPU_METHOD CompuMethod_230 "" TAB_VERB "%1.0" "" COMPU_TAB_REF CompuVtab_182 /end COMPU_METHOD
/begin COMPU_METHOD CompuMethod_231 "" TAB_VERB "%1.0" "boolean" COMPU_TAB_REF CompuVtab_183 /end COMPU_METHOD
/begin COMPU_METHOD CompuMethod_232 "" TAB_VERB "%1.0" "" COMPU_TAB_REF CompuVtab_184 /end COMPU_METHOD
/begin COMPU_METHOD CompuMethod_233 "" TAB_VERB "%1.0" "" COMPU_TAB_REF CompuVtab_185 /end COMPU_METHOD
/begin COMPU_METHOD CompuMethod_234 "" RAT_FUNC "%4.3" "%" COEFFS 0 1 0 0 0 0.005 /end COMPU_METHOD
/begin COMPU_METHOD CompuMethod_237 "" TAB_VERB "%1.0" "" COMPU_TAB_REF CompuVtab_187 /end COMPU_METHOD
/begin COMPU_METHOD CompuMethod_238 "" TAB_VERB "%1.0" "" COMPU_TAB_REF CompuVtab_188 /end COMPU_METHOD
/begin COMPU_METHOD CompuMethod_239 "" RAT_FUNC "%1.0" "Boolean" COEFFS 0 1 0 0 0 1 /end COMPU_METHOD
/begin COMPU_METHOD CompuMethod_241 "" TAB_VERB "%3.0" "" COMPU_TAB_REF CompuVtab_190 /end COMPU_METHOD
/begin COMPU_METHOD CompuMethod_243 "" TAB_VERB "%1.0" "" COMPU_TAB_REF CompuVtab_191 /end COMPU_METHOD
/begin COMPU_METHOD CompuMethod_246 "" RAT_FUNC "%5.4" "in" COEFFS 0 1 0 0 0 1 /end COMPU_METHOD
/begin COMPU_METHOD CompuMethod_248 "" RAT_FUNC "%6.2" "Percent above or below the JCS specified limits that a warning will be issued" COEFFS 0 1 0 0 0 1 /end COMPU_METHOD
/begin COMPU_METHOD CompuMethod_249 "" TAB_VERB "%1.0" "" COMPU_TAB_REF CompuVtab_193 /end COMPU_METHOD
/*~~~~~~~~~ 6.3.34 COMPU_VTABs ~~~~~~~~~*/
/begin COMPU_VTAB CompuVtab_1 "" TAB_VERB 2 0 "Pass-Through" 1 "Override" /end COMPU_VTAB
/begin COMPU_VTAB CompuVtab_4 "" TAB_VERB 90 0 "Normal Operation" 1 "Bad Resource ID" 2 "Hardware Not Supported" 3 "Behaviour Not Supported" 4 "Bad Attribute Data" 5 "Fail On Create" 6 "Fail On Set Attributes" 7 "Resource Not Created" 8 "Missing Attribute" 9 "Behaviour Method Not Supported" 10 "A Service Failed" 11 "Failed to destroy a resource" 12 "Resource Was Created" 13 "Resource Conflict" 14 "Invalid Encoder Type" 15 "2-Strike Not Supported" 16 "720degCA Pattern Not Supported" 17 "CAM Pattern Not Supported" 18 "Unknown CAM Pattern Supplied" 19 "Engine Speed Present" 20 "Hardware Interface Not Supported" 21 "Service Already Started" 22 "Register Write Failed to verify" 23 "Register access was denied" 24 "Out of free store memory" 25 "Software Q Overrun" 26 "Hardware Q Overrun" 27 "Feature unsupported in archive" 28 "Insufficient FW resource" 29 "OS Resource conflict" 30 "Driver Mode conflict" 31 "RTC time is illegal" 32 "FFS unmounted" 33 "Access from an ISR" 34 "FFS internal" 35 "Operation timed out" 36 "Task Kernel API Usage" 37 "Operation aborted" 38 "File not Found" 39 "Invalid characters in filename" 40 "Duplicate filename" 41 "Filename is too long" 42 "Dir not empty on remove" 43 "Dir not found" 44 "Dir name invalid" 45 "Dir exists" 46 "Dir too deep" 47 "Illegal Handle" 48 "End of File" 49 "Media Full" 50 "Media Write" 51 "Media Read" 52 "Media Write Protected" 53 "File Read Only" 54 "FS Media Changed" 55 "Internal USB" 56 "Voltage too high for USB IC" 57 "Encoder not created" 64 "TPU Chan Conflict" 65 "TPU Func Unavailable" 66 "TPU Config" 67 "TPU Primative Usage" 68 "TPU Primitive Count" 69 "TPU Restricted TPU channel" 70 "TPU Not Created" 71 "TPU Self Modify constant write err" 72 "TPU Error 0x48" 73 "TPU Error 0x49" 74 "TPU Error 0x4A" 75 "TPU Error 0x4B" 76 "TPU Error 0x4C" 77 "TPU Error 0x4D" 78 "TPU Error 0x4E" 79 "TPU Error 0x4F" 80 "TPU Error 0x50" 81 "TPU Error 0x51" 82 "TPU Error 0x52" 83 "TPU Error 0x53" 84 "TPU Error 0x54" 85 "TPU Error 0x55" 86 "TPU Error 0x56" 87 "TPU Error 0x57" 88 "TPU Error 0x58" 89 "TPU Error 0x59" 90 "TPU Error 0x5A" 91 "TPU Error 0x5B" 92 "TPU Error 0x5C" 93 "TPU Error 0x5D" 94 "TPU Error 0x5E" 95 "TPU Error 0x5F" /end COMPU_VTAB
/begin COMPU_VTAB CompuVtab_6 "" TAB_VERB 2 0 "Disabled" 1 "Enabled" /end COMPU_VTAB
/begin COMPU_VTAB CompuVtab_167 "" TAB_VERB 6 0 "Off" 1 "Low_Speed_Maneuvering" 2 "Normal_Driving" 3 "Normal_DrivingWithBrake" 4 "KeyUpActive" 5 "ZeroSpeedBraking" /end COMPU_VTAB
/begin COMPU_VTAB CompuVtab_169 "" TAB_VERB 2 0 "Power_Off" 1 "Power_On" /end COMPU_VTAB
/begin COMPU_VTAB CompuVtab_170 "" TAB_VERB 3 0 "Off" 1 "Normal" 2 "Reverse" /end COMPU_VTAB
/begin COMPU_VTAB CompuVtab_172 "" TAB_VERB 34 0 "Accel_NeverZeroed" 1 "Accel_RangeHigh" 2 "Accel_RangeLow" 3 "Battery_OverTemp" 4 "Battery_UnderTemp" 5 "Brake_RangeHigh" 6 "Brake_RangeLow" 7 "ChargeComplete" 8 "CoolingOverheat" 9 "ESTOPped" 10 "Eaton_CAN_Timeout" 11 "GroundFault" 12 "HV_BUS_OFFLINE_check_fuse" 13 "High_Cell_Voltage_Shutdown" 14 "High_SOC_Alert" 15 "High_SOC_Shutdown" 16 "Inverter_OverTemp" 17 "LVVoltHigh" 18 "LVVoltLow" 19 "LVVolt_RangeHigh" 20 "LVVolt_RangeLow" 21 "LockedRotor" 22 "Low_SOC_Alert" 23 "Low_SOC_Shutdown" 24 "NoCAN_BCM_410" 25 "NoCAN_BCM_420" 26 "NoCAN_BCM_430" 27 "NoCAN_CoolantPump" 28 "NoCAN_CoolingFan" 29 "NoCAN_PowerSteering" 30 "NoCAN_UQM_04EF" 31 "NoCAN_UQM_14EF" 32 "NoCAN_UQM_18EF" 33 "(None)" /end COMPU_VTAB
/begin COMPU_VTAB CompuVtab_173 "" TAB_VERB 2 0 "-" 1 "Clear All Faults" /end COMPU_VTAB
/begin COMPU_VTAB CompuVtab_174 "" TAB_VERB 6 0 "Disabled" 1 "Enabled" 2 "Sticky" 3 "Enabled - Persistent" 4 "Sticky - Persistent" 5 "Save Occurred" /end COMPU_VTAB
/begin COMPU_VTAB CompuVtab_175 "" TAB_VERB 2 0 "-" 1 "Test" /end COMPU_VTAB
/begin COMPU_VTAB CompuVtab_176 "" TAB_VERB 8 0 "Bat_limit_high" 1 "Bat_limit_low" 2 "Battery_Warning" 3 "DisableDrive" 4 "EmergencyPowerOff" 5 "OpenContactors" 6 "PumpFan_Full" 7 "(None)" /end COMPU_VTAB
/begin COMPU_VTAB CompuVtab_177 "" TAB_VERB 8 0 "(None)" 1 "Suspected" 2 "Active" 3 "Suspected or Active" 4 "Occurred" 5 "Suspected or Occurred" 6 "Active or Occurred" 7 "Suspected or Active or Occurred" /end COMPU_VTAB
/begin COMPU_VTAB CompuVtab_178 "" TAB_VERB 2 0 "Normal" 1 "Inverted" /end COMPU_VTAB
/begin COMPU_VTAB CompuVtab_182 "" TAB_VERB 2 0 "Disable on low ECUP" 1 "Keep alive" /end COMPU_VTAB
/begin COMPU_VTAB CompuVtab_183 "" TAB_VERB 2 0 "Off" 1 "On" /end COMPU_VTAB
/begin COMPU_VTAB CompuVtab_184 "" TAB_VERB 2 0 "Load saved application values on next startup" 1 "Load factory defaults on next startup" /end COMPU_VTAB
/begin COMPU_VTAB CompuVtab_185 "" TAB_VERB 7 0 "Currently loading NV from Factory FLASH to RAM" 1 "Currently loading NV from EEPROM to RAM" 2 "Currently storing NV from RAM to EEPROM" 3 "Detected new program.  Loaded Factory Defaults from FLASH" 4 "CRC failure.  Loaded Factory Defaults from FLASH" 5 "User requested refresh from Factory Defaults in FLASH." 6 "Successful refresh of EEPROM values from last shutdown" /end COMPU_VTAB
/begin COMPU_VTAB CompuVtab_187 "" TAB_VERB 2 0 "Run" 1 "Reboot" /end COMPU_VTAB
/begin COMPU_VTAB CompuVtab_188 "" TAB_VERB 2 0 "Run" 1 "Restore To Defaults" /end COMPU_VTAB
/begin COMPU_VTAB CompuVtab_190 "" TAB_VERB 2 0 "Flash" 1 "Solid" /end COMPU_VTAB
/begin COMPU_VTAB CompuVtab_191 "" TAB_VERB 2 0 "Run" 1 "Store To EEPROM" /end COMPU_VTAB
/begin COMPU_VTAB CompuVtab_193 "" TAB_VERB 2 0 "Reverse" 1 "Forward" /end COMPU_VTAB
/begin FUNCTION Current_Limit_Override_Override "" /begin DEF_CHARACTERISTIC Current_Limit_Override_new Current_Limit_Override_ovr /end DEF_CHARACTERISTIC /end FUNCTION
/begin FUNCTION DigitalInput "" /begin OUT_MEASUREMENT din_create_EStop_Switch_Pin din_read_EStop_Switch_Pin /end OUT_MEASUREMENT /end FUNCTION
/begin FUNCTION GetFaultName ""
 /begin DEF_CHARACTERISTIC DisplayFaults dispLength firstScrollTime InvertMode lastScrollTime minTime noErrText scrollTime /end DEF_CHARACTERISTIC
 /begin OUT_MEASUREMENT minTimer scrollIndex scrollTimer /end OUT_MEASUREMENT
/end FUNCTION
/begin FUNCTION MiniViewDisplay ""
 /begin DEF_CHARACTERISTIC dualIndex listIndex quadIndex screen singleIndex startupDelay /end DEF_CHARACTERISTIC
 /begin SUB_FUNCTION GetFaultName /end SUB_FUNCTION
/end FUNCTION
/begin FUNCTION DiscreteOut ""
 /begin OUT_MEASUREMENT dout_create_DOut178p0011 dout_create_DOut179p0011 dout_create_DOut180p0011 dout_create_DOut3445p0009 /end OUT_MEASUREMENT
/end FUNCTION
/begin FUNCTION kW_calculation1 "" /begin DEF_CHARACTERISTIC Downsample /end DEF_CHARACTERISTIC /end FUNCTION
/begin FUNCTION Calculations ""
 /begin OUT_MEASUREMENT InstBattKW InstDCDCWatts InstPhxCurrent InstPhxKW InstUQMKW InstVehicleKWUsed InstWhperMile KeyCycleKWh KeyCycleKWh_without_12v_dcdc_current WhPerMileKeyCycle WhPerMileKeyCycle_without_12v_dcdc_current /end OUT_MEASUREMENT
 /begin SUB_FUNCTION kW_calculation1 Odometer /end SUB_FUNCTION
/end FUNCTION
/begin FUNCTION Sensors_1 "" /begin DEF_CHARACTERISTIC E_Stop_Invert HV_GFI_Check /end DEF_CHARACTERISTIC /begin OUT_MEASUREMENT Estop_switch_probe /end OUT_MEASUREMENT /begin SUB_FUNCTION EHPAS_Power_Steering_Pump_Inputs Estop_switch_ovr_Override /end SUB_FUNCTION /end FUNCTION
/begin FUNCTION Eaton_HV_Charger_Temperature_Override ""
 /begin DEF_CHARACTERISTIC Eaton_HV_Charger_Temperature_new Eaton_HV_Charger_Temperature_ovr /end DEF_CHARACTERISTIC
/end FUNCTION
/begin FUNCTION Main_Power_Relay_Config "" /begin DEF_CHARACTERISTIC ECUP_Threshold /end DEF_CHARACTERISTIC /end FUNCTION
/begin FUNCTION Main_Power_Relay "" /begin DEF_CHARACTERISTIC MPRD_KeepAlive ProcessorReboot Shutdown_Req /end DEF_CHARACTERISTIC /begin OUT_MEASUREMENT MPRD /end OUT_MEASUREMENT /begin SUB_FUNCTION Main_Power_Relay_Config MPRD_Override /end SUB_FUNCTION /end FUNCTION
/begin FUNCTION EHPAS_Fault_Override "" /begin DEF_CHARACTERISTIC EHPAS_Fault_new EHPAS_Fault_ovr /end DEF_CHARACTERISTIC /end FUNCTION
/begin FUNCTION EHPAS_Power_Steering_Pump_Inputs ""
 /begin SUB_FUNCTION EHPAS_Fault_Override EHPAS_Input_Current_NA_Override EHPAS_Input_Voltage_Override EHPAS_Op_State_Override EHPAS_Pump_Speed_Override EHPAS_TempCur_Override EHPAS_TempMax_Override /end SUB_FUNCTION
/end FUNCTION
/begin FUNCTION EHPAS_Input_Current_NA_Override "" /begin DEF_CHARACTERISTIC EHPAS_Input_Current_NA_new EHPAS_Input_Current_NA_ovr /end DEF_CHARACTERISTIC /end FUNCTION
/begin FUNCTION EHPAS_Input_Voltage_Override "" /begin DEF_CHARACTERISTIC EHPAS_Input_Voltage_new EHPAS_Input_Voltage_ovr /end DEF_CHARACTERISTIC /end FUNCTION
/begin FUNCTION EHPAS_Op_State_Override "" /begin DEF_CHARACTERISTIC EHPAS_Op_State_new EHPAS_Op_State_ovr /end DEF_CHARACTERISTIC /end FUNCTION
/begin FUNCTION EHPAS_Operating_Mode_Cmd_Override "" /begin DEF_CHARACTERISTIC EHPAS_Operating_Mode_Cmd_new EHPAS_Operating_Mode_Cmd_ovr /end DEF_CHARACTERISTIC /end FUNCTION
/begin FUNCTION EHPAS_1 "" /begin DEF_CHARACTERISTIC EHPAS_Performance_Limit /end DEF_CHARACTERISTIC /begin OUT_MEASUREMENT EHPAS_Operating_Mode_Command /end OUT_MEASUREMENT /begin SUB_FUNCTION EHPAS_Operating_Mode_Cmd_Override /end SUB_FUNCTION /end FUNCTION
/begin FUNCTION EHPAS_Pump_Speed_Override "" /begin DEF_CHARACTERISTIC EHPAS_Pump_Speed_new EHPAS_Pump_Speed_ovr /end DEF_CHARACTERISTIC /end FUNCTION
/begin FUNCTION EHPAS_PumpStateEnable_ovr_Override ""
 /begin DEF_CHARACTERISTIC EHPAS_PumpStateEnable_ovr_new EHPAS_PumpStateEnable_ovr_ovr /end DEF_CHARACTERISTIC
/end FUNCTION
/begin FUNCTION EHPAS_TempCur_Override "" /begin DEF_CHARACTERISTIC EHPAS_TempCur_new EHPAS_TempCur_ovr /end DEF_CHARACTERISTIC /end FUNCTION
/begin FUNCTION EHPAS_TempMax_Override "" /begin DEF_CHARACTERISTIC EHPAS_TempMax_new EHPAS_TempMax_ovr /end DEF_CHARACTERISTIC /end FUNCTION
/begin FUNCTION EMP_Coolant_Pump "" /begin DEF_CHARACTERISTIC EMP_CAN_MaxAge /end DEF_CHARACTERISTIC
 /begin OUT_MEASUREMENT EMP_Board_Temp EMP_Pump_Mode EMP_Pump_Power EMP_Pump_Speed EMP_Pump_Status EMP_Speed_Percent /end OUT_MEASUREMENT
 /begin SUB_FUNCTION EMP_Board_Temp_Override EMP_Pump_Mode_Override EMP_Pump_Power_Override EMP_Pump_Speed_Override EMP_Pump_Status_Override EMP_Speed_Percent_Override /end SUB_FUNCTION
/end FUNCTION
/begin FUNCTION EMP_Board_Temp_Override "" /begin DEF_CHARACTERISTIC EMP_Board_Temp_new EMP_Board_Temp_ovr /end DEF_CHARACTERISTIC /end FUNCTION
/begin FUNCTION EMP_Cooling_Fan "" /begin DEF_CHARACTERISTIC EMPFan_CAN_MaxAge /end DEF_CHARACTERISTIC
 /begin OUT_MEASUREMENT EMP_Cooling_Fan_Board_Temp EMP_Cooling_Fan_Mode EMP_Cooling_Fan_Power EMP_Cooling_Fan_Speed EMP_Cooling_Fan_Speed_Percent EMP_Cooling_Fan_Status /end OUT_MEASUREMENT
 /begin SUB_FUNCTION EMP_Cooling_Fan_Board_Temp_Override EMP_Cooling_Fan_Mode_Override EMP_Cooling_Fan_Power_Override EMP_Cooling_Fan_Speed_Override EMP_Cooling_Fan_Speed_Percent_Override EMP_Cooling_Fan_Status_Override /end SUB_FUNCTION
/end FUNCTION
/begin FUNCTION EMP_Cooling_Fan_Board_Temp_Override ""
 /begin DEF_CHARACTERISTIC EMP_Cooling_Fan_Board_Temp_new EMP_Cooling_Fan_Board_Temp_ovr /end DEF_CHARACTERISTIC
/end FUNCTION
/begin FUNCTION EMP_Cooling_Fan_Mode_Override "" /begin DEF_CHARACTERISTIC EMP_Cooling_Fan_Mode_new EMP_Cooling_Fan_Mode_ovr /end DEF_CHARACTERISTIC /end FUNCTION
/begin FUNCTION EMP_Cooling_Fan_Power_Override "" /begin DEF_CHARACTERISTIC EMP_Cooling_Fan_Power_new EMP_Cooling_Fan_Power_ovr /end DEF_CHARACTERISTIC /end FUNCTION
/begin FUNCTION EMP_Cooling_Fan_Speed_Override "" /begin DEF_CHARACTERISTIC EMP_Cooling_Fan_Speed_new EMP_Cooling_Fan_Speed_ovr /end DEF_CHARACTERISTIC /end FUNCTION
/begin FUNCTION EMP_Cooling_Fan_Speed_Percent_Override ""
 /begin DEF_CHARACTERISTIC EMP_Cooling_Fan_Speed_Percent_new EMP_Cooling_Fan_Speed_Percent_ovr /end DEF_CHARACTERISTIC
/end FUNCTION
/begin FUNCTION EMP_Cooling_Fan_Status_Override "" /begin DEF_CHARACTERISTIC EMP_Cooling_Fan_Status_new EMP_Cooling_Fan_Status_ovr /end DEF_CHARACTERISTIC /end FUNCTION
/begin FUNCTION EMP_Cooling_Fan_1 "" /begin DEF_CHARACTERISTIC Fan_Hold_Mode Fan_Mode /end DEF_CHARACTERISTIC /begin OUT_MEASUREMENT EMP_Fan_Speed /end OUT_MEASUREMENT /begin SUB_FUNCTION EMP_Fan_Speed_Override /end SUB_FUNCTION /end FUNCTION
/begin FUNCTION EMP_Fan_Speed_Override "" /begin DEF_CHARACTERISTIC EMP_Fan_Speed_new EMP_Fan_Speed_ovr /end DEF_CHARACTERISTIC /end FUNCTION
/begin FUNCTION EMP_Mode_Override "" /begin DEF_CHARACTERISTIC EMP_Mode_new EMP_Mode_ovr /end DEF_CHARACTERISTIC /end FUNCTION
/begin FUNCTION EMP_Coolant_Pump_1 "" /begin OUT_MEASUREMENT EMP_Speed /end OUT_MEASUREMENT /begin SUB_FUNCTION EMP_Mode_Override EMP_Speed_Override /end SUB_FUNCTION /end FUNCTION
/begin FUNCTION EMP_Pump_Mode_Override "" /begin DEF_CHARACTERISTIC EMP_Pump_Mode_new EMP_Pump_Mode_ovr /end DEF_CHARACTERISTIC /end FUNCTION
/begin FUNCTION EMP_Pump_Power_Override "" /begin DEF_CHARACTERISTIC EMP_Pump_Power_new EMP_Pump_Power_ovr /end DEF_CHARACTERISTIC /end FUNCTION
/begin FUNCTION EMP_Pump_Speed_Override "" /begin DEF_CHARACTERISTIC EMP_Pump_Speed_new EMP_Pump_Speed_ovr /end DEF_CHARACTERISTIC /end FUNCTION
/begin FUNCTION EMP_Pump_Status_Override "" /begin DEF_CHARACTERISTIC EMP_Pump_Status_new EMP_Pump_Status_ovr /end DEF_CHARACTERISTIC /end FUNCTION
/begin FUNCTION EMP_Speed_Override "" /begin DEF_CHARACTERISTIC EMP_Speed_new EMP_Speed_ovr /end DEF_CHARACTERISTIC /end FUNCTION
/begin FUNCTION EMP_Speed_Percent_Override "" /begin DEF_CHARACTERISTIC EMP_Speed_Percent_new EMP_Speed_Percent_ovr /end DEF_CHARACTERISTIC /end FUNCTION
/begin FUNCTION Estop_switch_ovr_Override "" /begin DEF_CHARACTERISTIC Estop_switch_ovr_new Estop_switch_ovr_ovr /end DEF_CHARACTERISTIC /end FUNCTION
/begin FUNCTION FanOut "" /begin OUT_MEASUREMENT FanOut_DutyCycle /end OUT_MEASUREMENT /begin SUB_FUNCTION FanOut_Config FanOut_Override /end SUB_FUNCTION /end FUNCTION
/begin FUNCTION Fan "" /begin SUB_FUNCTION FanOut /end SUB_FUNCTION /end FUNCTION
/begin FUNCTION FanOut_Config ""
 /begin DEF_CHARACTERISTIC FanOut_Frequency FanOut_Gain FanOut_MaxLimit FanOut_MinLimit FanOut_Offset /end DEF_CHARACTERISTIC
/end FUNCTION
/begin FUNCTION FanOut_Override "" /begin DEF_CHARACTERISTIC FanOut_new FanOut_ovr /end DEF_CHARACTERISTIC /end FUNCTION
/begin FUNCTION Action_Reasons ""
 /begin OUT_MEASUREMENT FaultActionReason._.Bat_limit_high FaultActionReason._.Bat_limit_low FaultActionReason._.Battery_Warning FaultActionReason._.DisableDrive FaultActionReason._.EmergencyPowerOff FaultActionReason._.OpenContactors FaultActionReason._.PumpFan_Full /end OUT_MEASUREMENT
/end FUNCTION
/begin FUNCTION Faults ""
 /begin DEF_CHARACTERISTIC FaultCommand FaultManager.Accel_NeverZeroed.Mode FaultManager.Accel_NeverZeroed.ID FaultManager.Accel_NeverZeroed.Test FaultManager.Accel_NeverZeroed.Faulty_Samples__X_ FaultManager.Accel_NeverZeroed.Total_Samples__Y_ FaultManager.Accel_NeverZeroed.Action_1 FaultManager.Accel_NeverZeroed.Action_1_Condition FaultManager.Accel_NeverZeroed.Action_2 FaultManager.Accel_NeverZeroed.Action_2_Condition FaultManager.Accel_NeverZeroed.Action_3 FaultManager.Accel_NeverZeroed.Action_3_Condition FaultManager.Accel_NeverZeroed.Action_4 FaultManager.Accel_NeverZeroed.Action_4_Condition FaultManager.Accel_RangeHigh.Mode FaultManager.Accel_RangeHigh.ID FaultManager.Accel_RangeHigh.Test FaultManager.Accel_RangeHigh.Faulty_Samples__X_ FaultManager.Accel_RangeHigh.Total_Samples__Y_ FaultManager.Accel_RangeHigh.Action_1 FaultManager.Accel_RangeHigh.Action_1_Condition FaultManager.Accel_RangeHigh.Action_2 FaultManager.Accel_RangeHigh.Action_2_Condition FaultManager.Accel_RangeHigh.Action_3 FaultManager.Accel_RangeHigh.Action_3_Condition FaultManager.Accel_RangeHigh.Action_4 FaultManager.Accel_RangeHigh.Action_4_Condition FaultManager.Accel_RangeLow.Mode FaultManager.Accel_RangeLow.ID FaultManager.Accel_RangeLow.Test FaultManager.Accel_RangeLow.Faulty_Samples__X_ FaultManager.Accel_RangeLow.Total_Samples__Y_ FaultManager.Accel_RangeLow.Action_1 FaultManager.Accel_RangeLow.Action_1_Condition FaultManager.Accel_RangeLow.Action_2 FaultManager.Accel_RangeLow.Action_2_Condition FaultManager.Accel_RangeLow.Action_3 FaultManager.Accel_RangeLow.Action_3_Condition FaultManager.Accel_RangeLow.Action_4 FaultManager.Accel_RangeLow.Action_4_Condition FaultManager.Battery_OverTemp.Mode FaultManager.Battery_OverTemp.ID FaultManager.Battery_OverTemp.Test FaultManager.Battery_OverTemp.Faulty_Samples__X_ FaultManager.Battery_OverTemp.Total_Samples__Y_ FaultManager.Battery_OverTemp.Action_1 FaultManager.Battery_OverTemp.Action_1_Condition FaultManager.Battery_OverTemp.Action_2 FaultManager.Battery_OverTemp.Action_2_Condition FaultManager.Battery_OverTemp.Action_3 FaultManager.Battery_OverTemp.Action_3_Condition FaultManager.Battery_OverTemp.Action_4 FaultManager.Battery_OverTemp.Action_4_Condition FaultManager.Battery_UnderTemp.Mode FaultManager.Battery_UnderTemp.ID FaultManager.Battery_UnderTemp.Test FaultManager.Battery_UnderTemp.Faulty_Samples__X_ FaultManager.Battery_UnderTemp.Total_Samples__Y_ FaultManager.Battery_UnderTemp.Action_1 FaultManager.Battery_UnderTemp.Action_1_Condition FaultManager.Battery_UnderTemp.Action_2 FaultManager.Battery_UnderTemp.Action_2_Condition FaultManager.Battery_UnderTemp.Action_3 FaultManager.Battery_UnderTemp.Action_3_Condition FaultManager.Battery_UnderTemp.Action_4 FaultManager.Battery_UnderTemp.Action_4_Condition FaultManager.Brake_RangeHigh.Mode FaultManager.Brake_RangeHigh.ID FaultManager.Brake_RangeHigh.Test FaultManager.Brake_RangeHigh.Faulty_Samples__X_ FaultManager.Brake_RangeHigh.Total_Samples__Y_ FaultManager.Brake_RangeHigh.Action_1 FaultManager.Brake_RangeHigh.Action_1_Condition FaultManager.Brake_RangeHigh.Action_2 FaultManager.Brake_RangeHigh.Action_2_Condition FaultManager.Brake_RangeHigh.Action_3 FaultManager.Brake_RangeHigh.Action_3_Condition FaultManager.Brake_RangeHigh.Action_4 FaultManager.Brake_RangeHigh.Action_4_Condition FaultManager.Brake_RangeLow.Mode FaultManager.Brake_RangeLow.ID FaultManager.Brake_RangeLow.Test FaultManager.Brake_RangeLow.Faulty_Samples__X_ FaultManager.Brake_RangeLow.Total_Samples__Y_ FaultManager.Brake_RangeLow.Action_1 FaultManager.Brake_RangeLow.Action_1_Condition FaultManager.Brake_RangeLow.Action_2 FaultManager.Brake_RangeLow.Action_2_Condition FaultManager.Brake_RangeLow.Action_3 FaultManager.Brake_RangeLow.Action_3_Condition FaultManager.Brake_RangeLow.Action_4 FaultManager.Brake_RangeLow.Action_4_Condition FaultManager.ChargeComplete.Mode FaultManager.ChargeComplete.ID FaultManager.ChargeComplete.Test FaultManager.ChargeComplete.Faulty_Samples__X_ FaultManager.ChargeComplete.Total_Samples__Y_ FaultManager.ChargeComplete.Action_1 FaultManager.ChargeComplete.Action_1_Condition FaultManager.ChargeComplete.Action_2 FaultManager.ChargeComplete.Action_2_Condition FaultManager.ChargeComplete.Action_3 FaultManager.ChargeComplete.Action_3_Condition FaultManager.ChargeComplete.Action_4 FaultManager.ChargeComplete.Action_4_Condition FaultManager.CoolingOverheat.Mode FaultManager.CoolingOverheat.ID FaultManager.CoolingOverheat.Test FaultManager.CoolingOverheat.Faulty_Samples__X_ FaultManager.CoolingOverheat.Total_Samples__Y_ FaultManager.CoolingOverheat.Action_1 FaultManager.CoolingOverheat.Action_1_Condition FaultManager.CoolingOverheat.Action_2 FaultManager.CoolingOverheat.Action_2_Condition FaultManager.CoolingOverheat.Action_3 FaultManager.CoolingOverheat.Action_3_Condition FaultManager.CoolingOverheat.Action_4 FaultManager.CoolingOverheat.Action_4_Condition FaultManager.ESTOPped.Mode FaultManager.ESTOPped.ID FaultManager.ESTOPped.Test FaultManager.ESTOPped.Faulty_Samples__X_ FaultManager.ESTOPped.Total_Samples__Y_ FaultManager.ESTOPped.Action_1 FaultManager.ESTOPped.Action_1_Condition FaultManager.ESTOPped.Action_2 FaultManager.ESTOPped.Action_2_Condition FaultManager.ESTOPped.Action_3 FaultManager.ESTOPped.Action_3_Condition FaultManager.ESTOPped.Action_4 FaultManager.ESTOPped.Action_4_Condition FaultManager.Eaton_CAN_Timeout.Mode FaultManager.Eaton_CAN_Timeout.ID FaultManager.Eaton_CAN_Timeout.Test FaultManager.Eaton_CAN_Timeout.Faulty_Samples__X_ FaultManager.Eaton_CAN_Timeout.Total_Samples__Y_ FaultManager.Eaton_CAN_Timeout.Action_1 FaultManager.Eaton_CAN_Timeout.Action_1_Condition FaultManager.Eaton_CAN_Timeout.Action_2 FaultManager.Eaton_CAN_Timeout.Action_2_Condition FaultManager.Eaton_CAN_Timeout.Action_3 FaultManager.Eaton_CAN_Timeout.Action_3_Condition FaultManager.Eaton_CAN_Timeout.Action_4 FaultManager.Eaton_CAN_Timeout.Action_4_Condition FaultManager.GroundFault.Mode FaultManager.GroundFault.ID FaultManager.GroundFault.Test FaultManager.GroundFault.Faulty_Samples__X_ FaultManager.GroundFault.Total_Samples__Y_ FaultManager.GroundFault.Action_1 FaultManager.GroundFault.Action_1_Condition FaultManager.GroundFault.Action_2 FaultManager.GroundFault.Action_2_Condition FaultManager.GroundFault.Action_3 FaultManager.GroundFault.Action_3_Condition FaultManager.GroundFault.Action_4 FaultManager.GroundFault.Action_4_Condition FaultManager.HV_BUS_OFFLINE_check_fuse.Mode FaultManager.HV_BUS_OFFLINE_check_fuse.ID FaultManager.HV_BUS_OFFLINE_check_fuse.Test FaultManager.HV_BUS_OFFLINE_check_fuse.Faulty_Samples__X_ FaultManager.HV_BUS_OFFLINE_check_fuse.Total_Samples__Y_ FaultManager.HV_BUS_OFFLINE_check_fuse.Action_1 FaultManager.HV_BUS_OFFLINE_check_fuse.Action_1_Condition FaultManager.HV_BUS_OFFLINE_check_fuse.Action_2 FaultManager.HV_BUS_OFFLINE_check_fuse.Action_2_Condition FaultManager.HV_BUS_OFFLINE_check_fuse.Action_3 FaultManager.HV_BUS_OFFLINE_check_fuse.Action_3_Condition FaultManager.HV_BUS_OFFLINE_check_fuse.Action_4 FaultManager.HV_BUS_OFFLINE_check_fuse.Action_4_Condition FaultManager.High_Cell_Voltage_Shutdown.Mode FaultManager.High_Cell_Voltage_Shutdown.ID FaultManager.High_Cell_Voltage_Shutdown.Test FaultManager.High_Cell_Voltage_Shutdown.Faulty_Samples__X_ FaultManager.High_Cell_Voltage_Shutdown.Total_Samples__Y_ FaultManager.High_Cell_Voltage_Shutdown.Action_1 FaultManager.High_Cell_Voltage_Shutdown.Action_1_Condition FaultManager.High_Cell_Voltage_Shutdown.Action_2 FaultManager.High_Cell_Voltage_Shutdown.Action_2_Condition FaultManager.High_Cell_Voltage_Shutdown.Action_3 FaultManager.High_Cell_Voltage_Shutdown.Action_3_Condition FaultManager.High_Cell_Voltage_Shutdown.Action_4 FaultManager.High_Cell_Voltage_Shutdown.Action_4_Condition FaultManager.High_SOC_Alert.Mode FaultManager.High_SOC_Alert.ID FaultManager.High_SOC_Alert.Test FaultManager.High_SOC_Alert.Faulty_Samples__X_ FaultManager.High_SOC_Alert.Total_Samples__Y_ FaultManager.High_SOC_Alert.Action_1 FaultManager.High_SOC_Alert.Action_1_Condition FaultManager.High_SOC_Alert.Action_2 FaultManager.High_SOC_Alert.Action_2_Condition FaultManager.High_SOC_Alert.Action_3 FaultManager.High_SOC_Alert.Action_3_Condition FaultManager.High_SOC_Alert.Action_4 FaultManager.High_SOC_Alert.Action_4_Condition FaultManager.High_SOC_Shutdown.Mode FaultManager.High_SOC_Shutdown.ID FaultManager.High_SOC_Shutdown.Test FaultManager.High_SOC_Shutdown.Faulty_Samples__X_ FaultManager.High_SOC_Shutdown.Total_Samples__Y_ FaultManager.High_SOC_Shutdown.Action_1 FaultManager.High_SOC_Shutdown.Action_1_Condition FaultManager.High_SOC_Shutdown.Action_2 FaultManager.High_SOC_Shutdown.Action_2_Condition FaultManager.High_SOC_Shutdown.Action_3 FaultManager.High_SOC_Shutdown.Action_3_Condition FaultManager.High_SOC_Shutdown.Action_4 FaultManager.High_SOC_Shutdown.Action_4_Condition FaultManager.Inverter_OverTemp.Mode FaultManager.Inverter_OverTemp.ID FaultManager.Inverter_OverTemp.Test FaultManager.Inverter_OverTemp.Faulty_Samples__X_ FaultManager.Inverter_OverTemp.Total_Samples__Y_ FaultManager.Inverter_OverTemp.Action_1 FaultManager.Inverter_OverTemp.Action_1_Condition FaultManager.Inverter_OverTemp.Action_2 FaultManager.Inverter_OverTemp.Action_2_Condition FaultManager.Inverter_OverTemp.Action_3 FaultManager.Inverter_OverTemp.Action_3_Condition FaultManager.Inverter_OverTemp.Action_4 FaultManager.Inverter_OverTemp.Action_4_Condition FaultManager.LVVoltHigh.Mode FaultManager.LVVoltHigh.ID FaultManager.LVVoltHigh.Test FaultManager.LVVoltHigh.Faulty_Samples__X_ FaultManager.LVVoltHigh.Total_Samples__Y_ FaultManager.LVVoltHigh.Action_1 FaultManager.LVVoltHigh.Action_1_Condition FaultManager.LVVoltHigh.Action_2 FaultManager.LVVoltHigh.Action_2_Condition FaultManager.LVVoltHigh.Action_3 FaultManager.LVVoltHigh.Action_3_Condition FaultManager.LVVoltHigh.Action_4 FaultManager.LVVoltHigh.Action_4_Condition FaultManager.LVVoltLow.Mode FaultManager.LVVoltLow.ID FaultManager.LVVoltLow.Test FaultManager.LVVoltLow.Faulty_Samples__X_ FaultManager.LVVoltLow.Total_Samples__Y_ FaultManager.LVVoltLow.Action_1 FaultManager.LVVoltLow.Action_1_Condition FaultManager.LVVoltLow.Action_2 FaultManager.LVVoltLow.Action_2_Condition FaultManager.LVVoltLow.Action_3 FaultManager.LVVoltLow.Action_3_Condition FaultManager.LVVoltLow.Action_4 FaultManager.LVVoltLow.Action_4_Condition FaultManager.LVVolt_RangeHigh.Mode FaultManager.LVVolt_RangeHigh.ID FaultManager.LVVolt_RangeHigh.Test FaultManager.LVVolt_RangeHigh.Faulty_Samples__X_ FaultManager.LVVolt_RangeHigh.Total_Samples__Y_ FaultManager.LVVolt_RangeHigh.Action_1 FaultManager.LVVolt_RangeHigh.Action_1_Condition FaultManager.LVVolt_RangeHigh.Action_2 FaultManager.LVVolt_RangeHigh.Action_2_Condition FaultManager.LVVolt_RangeHigh.Action_3 FaultManager.LVVolt_RangeHigh.Action_3_Condition FaultManager.LVVolt_RangeHigh.Action_4 FaultManager.LVVolt_RangeHigh.Action_4_Condition FaultManager.LVVolt_RangeLow.Mode FaultManager.LVVolt_RangeLow.ID FaultManager.LVVolt_RangeLow.Test FaultManager.LVVolt_RangeLow.Faulty_Samples__X_ FaultManager.LVVolt_RangeLow.Total_Samples__Y_ FaultManager.LVVolt_RangeLow.Action_1 FaultManager.LVVolt_RangeLow.Action_1_Condition FaultManager.LVVolt_RangeLow.Action_2 FaultManager.LVVolt_RangeLow.Action_2_Condition FaultManager.LVVolt_RangeLow.Action_3 FaultManager.LVVolt_RangeLow.Action_3_Condition FaultManager.LVVolt_RangeLow.Action_4 FaultManager.LVVolt_RangeLow.Action_4_Condition FaultManager.LockedRotor.Mode FaultManager.LockedRotor.ID FaultManager.LockedRotor.Test FaultManager.LockedRotor.Faulty_Samples__X_ FaultManager.LockedRotor.Total_Samples__Y_ FaultManager.LockedRotor.Action_1 FaultManager.LockedRotor.Action_1_Condition FaultManager.LockedRotor.Action_2 FaultManager.LockedRotor.Action_2_Condition FaultManager.LockedRotor.Action_3 FaultManager.LockedRotor.Action_3_Condition FaultManager.LockedRotor.Action_4 FaultManager.LockedRotor.Action_4_Condition FaultManager.Low_SOC_Alert.Mode FaultManager.Low_SOC_Alert.ID FaultManager.Low_SOC_Alert.Test FaultManager.Low_SOC_Alert.Faulty_Samples__X_ FaultManager.Low_SOC_Alert.Total_Samples__Y_ FaultManager.Low_SOC_Alert.Action_1 FaultManager.Low_SOC_Alert.Action_1_Condition FaultManager.Low_SOC_Alert.Action_2 FaultManager.Low_SOC_Alert.Action_2_Condition FaultManager.Low_SOC_Alert.Action_3 FaultManager.Low_SOC_Alert.Action_3_Condition FaultManager.Low_SOC_Alert.Action_4 FaultManager.Low_SOC_Alert.Action_4_Condition FaultManager.Low_SOC_Shutdown.Mode FaultManager.Low_SOC_Shutdown.ID FaultManager.Low_SOC_Shutdown.Test FaultManager.Low_SOC_Shutdown.Faulty_Samples__X_ FaultManager.Low_SOC_Shutdown.Total_Samples__Y_ FaultManager.Low_SOC_Shutdown.Action_1 FaultManager.Low_SOC_Shutdown.Action_1_Condition FaultManager.Low_SOC_Shutdown.Action_2 FaultManager.Low_SOC_Shutdown.Action_2_Condition FaultManager.Low_SOC_Shutdown.Action_3 FaultManager.Low_SOC_Shutdown.Action_3_Condition FaultManager.Low_SOC_Shutdown.Action_4 FaultManager.Low_SOC_Shutdown.Action_4_Condition FaultManager.NoCAN_BCM_410.Mode FaultManager.NoCAN_BCM_410.ID FaultManager.NoCAN_BCM_410.Test FaultManager.NoCAN_BCM_410.Faulty_Samples__X_ FaultManager.NoCAN_BCM_410.Total_Samples__Y_ FaultManager.NoCAN_BCM_410.Action_1 FaultManager.NoCAN_BCM_410.Action_1_Condition FaultManager.NoCAN_BCM_410.Action_2 FaultManager.NoCAN_BCM_410.Action_2_Condition FaultManager.NoCAN_BCM_410.Action_3 FaultManager.NoCAN_BCM_410.Action_3_Condition FaultManager.NoCAN_BCM_410.Action_4 FaultManager.NoCAN_BCM_410.Action_4_Condition FaultManager.NoCAN_BCM_420.Mode FaultManager.NoCAN_BCM_420.ID FaultManager.NoCAN_BCM_420.Test FaultManager.NoCAN_BCM_420.Faulty_Samples__X_ FaultManager.NoCAN_BCM_420.Total_Samples__Y_ FaultManager.NoCAN_BCM_420.Action_1 FaultManager.NoCAN_BCM_420.Action_1_Condition FaultManager.NoCAN_BCM_420.Action_2 FaultManager.NoCAN_BCM_420.Action_2_Condition FaultManager.NoCAN_BCM_420.Action_3 FaultManager.NoCAN_BCM_420.Action_3_Condition FaultManager.NoCAN_BCM_420.Action_4 FaultManager.NoCAN_BCM_420.Action_4_Condition FaultManager.NoCAN_BCM_430.Mode FaultManager.NoCAN_BCM_430.ID FaultManager.NoCAN_BCM_430.Test FaultManager.NoCAN_BCM_430.Faulty_Samples__X_ FaultManager.NoCAN_BCM_430.Total_Samples__Y_ FaultManager.NoCAN_BCM_430.Action_1 FaultManager.NoCAN_BCM_430.Action_1_Condition FaultManager.NoCAN_BCM_430.Action_2 FaultManager.NoCAN_BCM_430.Action_2_Condition FaultManager.NoCAN_BCM_430.Action_3 FaultManager.NoCAN_BCM_430.Action_3_Condition FaultManager.NoCAN_BCM_430.Action_4 FaultManager.NoCAN_BCM_430.Action_4_Condition FaultManager.NoCAN_CoolantPump.Mode FaultManager.NoCAN_CoolantPump.ID FaultManager.NoCAN_CoolantPump.Test FaultManager.NoCAN_CoolantPump.Faulty_Samples__X_ FaultManager.NoCAN_CoolantPump.Total_Samples__Y_ FaultManager.NoCAN_CoolantPump.Action_1 FaultManager.NoCAN_CoolantPump.Action_1_Condition FaultManager.NoCAN_CoolantPump.Action_2 FaultManager.NoCAN_CoolantPump.Action_2_Condition FaultManager.NoCAN_CoolantPump.Action_3 FaultManager.NoCAN_CoolantPump.Action_3_Condition FaultManager.NoCAN_CoolantPump.Action_4 FaultManager.NoCAN_CoolantPump.Action_4_Condition FaultManager.NoCAN_CoolingFan.Mode FaultManager.NoCAN_CoolingFan.ID FaultManager.NoCAN_CoolingFan.Test FaultManager.NoCAN_CoolingFan.Faulty_Samples__X_ FaultManager.NoCAN_CoolingFan.Total_Samples__Y_ FaultManager.NoCAN_CoolingFan.Action_1 FaultManager.NoCAN_CoolingFan.Action_1_Condition FaultManager.NoCAN_CoolingFan.Action_2 FaultManager.NoCAN_CoolingFan.Action_2_Condition FaultManager.NoCAN_CoolingFan.Action_3 FaultManager.NoCAN_CoolingFan.Action_3_Condition FaultManager.NoCAN_CoolingFan.Action_4 FaultManager.NoCAN_CoolingFan.Action_4_Condition FaultManager.NoCAN_PowerSteering.Mode FaultManager.NoCAN_PowerSteering.ID FaultManager.NoCAN_PowerSteering.Test FaultManager.NoCAN_PowerSteering.Faulty_Samples__X_ FaultManager.NoCAN_PowerSteering.Total_Samples__Y_ FaultManager.NoCAN_PowerSteering.Action_1 FaultManager.NoCAN_PowerSteering.Action_1_Condition FaultManager.NoCAN_PowerSteering.Action_2 FaultManager.NoCAN_PowerSteering.Action_2_Condition FaultManager.NoCAN_PowerSteering.Action_3 FaultManager.NoCAN_PowerSteering.Action_3_Condition FaultManager.NoCAN_PowerSteering.Action_4 FaultManager.NoCAN_PowerSteering.Action_4_Condition FaultManager.NoCAN_UQM_04EF.Mode FaultManager.NoCAN_UQM_04EF.ID FaultManager.NoCAN_UQM_04EF.Test FaultManager.NoCAN_UQM_04EF.Faulty_Samples__X_ FaultManager.NoCAN_UQM_04EF.Total_Samples__Y_ FaultManager.NoCAN_UQM_04EF.Action_1 FaultManager.NoCAN_UQM_04EF.Action_1_Condition FaultManager.NoCAN_UQM_04EF.Action_2 FaultManager.NoCAN_UQM_04EF.Action_2_Condition FaultManager.NoCAN_UQM_04EF.Action_3 FaultManager.NoCAN_UQM_04EF.Action_3_Condition FaultManager.NoCAN_UQM_04EF.Action_4 FaultManager.NoCAN_UQM_04EF.Action_4_Condition FaultManager.NoCAN_UQM_14EF.Mode FaultManager.NoCAN_UQM_14EF.ID FaultManager.NoCAN_UQM_14EF.Test FaultManager.NoCAN_UQM_14EF.Faulty_Samples__X_ FaultManager.NoCAN_UQM_14EF.Total_Samples__Y_ FaultManager.NoCAN_UQM_14EF.Action_1 FaultManager.NoCAN_UQM_14EF.Action_1_Condition FaultManager.NoCAN_UQM_14EF.Action_2 FaultManager.NoCAN_UQM_14EF.Action_2_Condition FaultManager.NoCAN_UQM_14EF.Action_3 FaultManager.NoCAN_UQM_14EF.Action_3_Condition FaultManager.NoCAN_UQM_14EF.Action_4 FaultManager.NoCAN_UQM_14EF.Action_4_Condition FaultManager.NoCAN_UQM_18EF.Mode FaultManager.NoCAN_UQM_18EF.ID FaultManager.NoCAN_UQM_18EF.Test FaultManager.NoCAN_UQM_18EF.Faulty_Samples__X_ FaultManager.NoCAN_UQM_18EF.Total_Samples__Y_ FaultManager.NoCAN_UQM_18EF.Action_1 FaultManager.NoCAN_UQM_18EF.Action_1_Condition FaultManager.NoCAN_UQM_18EF.Action_2 FaultManager.NoCAN_UQM_18EF.Action_2_Condition FaultManager.NoCAN_UQM_18EF.Action_3 FaultManager.NoCAN_UQM_18EF.Action_3_Condition FaultManager.NoCAN_UQM_18EF.Action_4 FaultManager.NoCAN_UQM_18EF.Action_4_Condition /end DEF_CHARACTERISTIC
 /begin OUT_MEASUREMENT FaultMarquees.FaultMarquees.Current_Suspected FaultMarquees.FaultMarquees.Current_Active FaultMarquees.FaultMarquees.Current_Occurred /end OUT_MEASUREMENT
 /begin SUB_FUNCTION Action_Reasons /end SUB_FUNCTION
/end FUNCTION
/begin FUNCTION FaultSeverityIndicator_Override "" /begin DEF_CHARACTERISTIC FaultSeverityIndicator_new FaultSeverityIndicator_ovr /end DEF_CHARACTERISTIC /end FUNCTION
/begin FUNCTION Flash_Reverse_Lights_Ovr_Override "" /begin DEF_CHARACTERISTIC Flash_Reverse_Lights_Ovr_new Flash_Reverse_Lights_Ovr_ovr /end DEF_CHARACTERISTIC /end FUNCTION
/begin FUNCTION Framework "" /begin OUT_MEASUREMENT FrameworkGlueErrors /end OUT_MEASUREMENT /end FUNCTION
/begin FUNCTION Reverse_1 ""
 /begin DEF_CHARACTERISTIC fwdAccThres fwdSpdThres offTime onTime revAccThres revSpdThres /end DEF_CHARACTERISTIC
 /begin OUT_MEASUREMENT In_Reverse /end OUT_MEASUREMENT
 /begin SUB_FUNCTION In_Reverse_Override /end SUB_FUNCTION
/end FUNCTION
/begin FUNCTION EZLink ""
 /begin OUT_MEASUREMENT GaugeChain_EZLinkCallbackCounter GaugeChain_EZLinkNoPendingTxCounter MaxQueueDepth /end OUT_MEASUREMENT
/end FUNCTION
/begin FUNCTION General "" /begin SUB_FUNCTION EZLink /end SUB_FUNCTION /end FUNCTION
/begin FUNCTION EZLink_1 "" /begin OUT_MEASUREMENT GaugeChain_EZlinkTx mh_EZlink /end OUT_MEASUREMENT /end FUNCTION
/begin FUNCTION GFD_Logic "" /begin DEF_CHARACTERISTIC GFD_Enable GFD_Torque_Off /end DEF_CHARACTERISTIC /end FUNCTION
/begin FUNCTION A123_Battery_Controller "" /begin SUB_FUNCTION GFD_Logic /end SUB_FUNCTION /end FUNCTION
/begin FUNCTION hsc_bcm_enable_Override "" /begin DEF_CHARACTERISTIC hsc_bcm_enable_new hsc_bcm_enable_ovr /end DEF_CHARACTERISTIC /end FUNCTION
/begin FUNCTION hsc_bcm_epo_Override "" /begin DEF_CHARACTERISTIC hsc_bcm_epo_new hsc_bcm_epo_ovr /end DEF_CHARACTERISTIC /end FUNCTION
/begin FUNCTION hsc_bcm_leakage_enable_Override "" /begin DEF_CHARACTERISTIC hsc_bcm_leakage_enable_new hsc_bcm_leakage_enable_ovr /end DEF_CHARACTERISTIC /end FUNCTION
/begin FUNCTION hsc_bcm_mainc_enable_Override "" /begin DEF_CHARACTERISTIC hsc_bcm_mainc_enable_new hsc_bcm_mainc_enable_ovr /end DEF_CHARACTERISTIC /end FUNCTION
/begin FUNCTION Battery "" /begin DEF_CHARACTERISTIC HV_Bus_allowed_mismatch HV_Bus_offline_delay /end DEF_CHARACTERISTIC /begin SUB_FUNCTION Over_Under_SOC_Management /end SUB_FUNCTION /end FUNCTION
/begin FUNCTION Addl_Fault_Detection "" /begin SUB_FUNCTION Battery /end SUB_FUNCTION /end FUNCTION
/begin FUNCTION IgnitionStatus_Override "" /begin DEF_CHARACTERISTIC IgnitionStatus_new IgnitionStatus_ovr /end DEF_CHARACTERISTIC /end FUNCTION
/begin FUNCTION In_Reverse_Override "" /begin DEF_CHARACTERISTIC In_Reverse_new In_Reverse_ovr /end DEF_CHARACTERISTIC /end FUNCTION
/begin FUNCTION InhibitDCDC_Out "" /begin OUT_MEASUREMENT InhibitDCDC_Out_ /end OUT_MEASUREMENT /begin SUB_FUNCTION InhibitDCDC_Out__Override InhibitDCDC_Out_Config /end SUB_FUNCTION /end FUNCTION
/begin FUNCTION DC_DC "" /begin SUB_FUNCTION InhibitDCDC_Out /end SUB_FUNCTION /end FUNCTION
/begin FUNCTION InhibitDCDC_Out__Override "" /begin DEF_CHARACTERISTIC InhibitDCDC_Out__new InhibitDCDC_Out__ovr /end DEF_CHARACTERISTIC /end FUNCTION
/begin FUNCTION InhibitDCDC_Out_Config "" /begin DEF_CHARACTERISTIC InhibitDCDC_Out__Polarity /end DEF_CHARACTERISTIC /end FUNCTION
/begin FUNCTION InputCurrent_Override "" /begin DEF_CHARACTERISTIC InputCurrent_new InputCurrent_ovr /end DEF_CHARACTERISTIC /end FUNCTION
/begin FUNCTION InputCurrentLimitMax_Override "" /begin DEF_CHARACTERISTIC InputCurrentLimitMax_new InputCurrentLimitMax_ovr /end DEF_CHARACTERISTIC /end FUNCTION
/begin FUNCTION InputVoltage_Override "" /begin DEF_CHARACTERISTIC InputVoltage_new InputVoltage_ovr /end DEF_CHARACTERISTIC /end FUNCTION
/begin FUNCTION Vehicle_Speed "" /begin DEF_CHARACTERISTIC IntermediaryGearRatio RearDiffRatio TireSize /end DEF_CHARACTERISTIC /begin OUT_MEASUREMENT Vehicle_Speed /end OUT_MEASUREMENT /begin SUB_FUNCTION Vehicle_Speed_Override /end SUB_FUNCTION /end FUNCTION
/begin FUNCTION LVVolt_1 "" /begin OUT_MEASUREMENT LVVolt LVVolt_ADC LVVolt_Raw /end OUT_MEASUREMENT /begin SUB_FUNCTION LVVolt_Config LVVolt_Override /end SUB_FUNCTION /end FUNCTION
/begin FUNCTION LVVolt "" /begin SUB_FUNCTION LVVolt_1 /end SUB_FUNCTION /end FUNCTION
/begin FUNCTION LVVolt_Config ""
 /begin DEF_CHARACTERISTIC LVVolt_DfltValue LVVolt_FilterConst LVVolt_Gain LVVolt_InputHiFltPos LVVolt_InputLoFltPos LVVolt_Ofst /end DEF_CHARACTERISTIC
/end FUNCTION
/begin FUNCTION LVVolt_Override "" /begin DEF_CHARACTERISTIC LVVolt_new LVVolt_ovr /end DEF_CHARACTERISTIC /end FUNCTION
/begin FUNCTION Odometer "" /begin OUT_MEASUREMENT MilesSinceKeyed Vehicle_Odometer /end OUT_MEASUREMENT /end FUNCTION
/begin FUNCTION motor_torque_Ovr_Override "" /begin DEF_CHARACTERISTIC motor_torque_Ovr_new motor_torque_Ovr_ovr /end DEF_CHARACTERISTIC /end FUNCTION
/begin FUNCTION MPRD_Override "" /begin DEF_CHARACTERISTIC MPRD_new MPRD_ovr /end DEF_CHARACTERISTIC /end FUNCTION
/begin FUNCTION NonVolatile_Storage "" /begin DEF_CHARACTERISTIC RestoreNVFactoryDefaults StoreNV /end DEF_CHARACTERISTIC /begin OUT_MEASUREMENT NonVolatileCRC NonVolatileFormatID NonVolatileStatus /end OUT_MEASUREMENT /begin SUB_FUNCTION NonVolatile_Storage_Config /end SUB_FUNCTION /end FUNCTION
/begin FUNCTION NonVolatile_Storage_Config ""
 /begin DEF_CHARACTERISTIC NonVolatileRestoreOnFirstStartup NonVolatileRestoreOnStartup /end DEF_CHARACTERISTIC
/end FUNCTION
/begin FUNCTION OutputCurrent_Override "" /begin DEF_CHARACTERISTIC OutputCurrent_new OutputCurrent_ovr /end DEF_CHARACTERISTIC /end FUNCTION
/begin FUNCTION OutputVoltage_Override "" /begin DEF_CHARACTERISTIC OutputVoltage_new OutputVoltage_ovr /end DEF_CHARACTERISTIC /end FUNCTION
/begin FUNCTION SOCShutdown "" /begin DEF_CHARACTERISTIC Over_SOC_Shutdown_Thresh Under_SOC_Shutdown_Thresh /end DEF_CHARACTERISTIC /end FUNCTION
/begin FUNCTION Over_Under_SOC_Management "" /begin SUB_FUNCTION SOCShutdown SOCAlert /end SUB_FUNCTION /end FUNCTION
/begin FUNCTION SOCAlert "" /begin DEF_CHARACTERISTIC Over_SOCAlertThresh Under_SOCAlertThresh /end DEF_CHARACTERISTIC /end FUNCTION
/begin FUNCTION PWM "" /begin OUT_MEASUREMENT pwm_create_Fan_Pin_PWMOutput pwm_set_Fan_Pin_PWMOutput /end OUT_MEASUREMENT /end FUNCTION
/begin FUNCTION Regen_SOC_Speed_Ramp_ovr_Override "" /begin DEF_CHARACTERISTIC Regen_SOC_Speed_Ramp_ovr_new Regen_SOC_Speed_Ramp_ovr_ovr /end DEF_CHARACTERISTIC /end FUNCTION
/begin FUNCTION Other "" /begin OUT_MEASUREMENT resource_allocation /end OUT_MEASUREMENT /end FUNCTION
/begin FUNCTION Reverse_Switch_Config "" /begin DEF_CHARACTERISTIC Reverse_Polarity Reverse_SwitchPt /end DEF_CHARACTERISTIC /end FUNCTION
/begin FUNCTION Reverse_Switch "" /begin OUT_MEASUREMENT Reverse_Switch Reverse_Switch_Raw /end OUT_MEASUREMENT /begin SUB_FUNCTION Reverse_Switch_Config Reverse_Switch_Override /end SUB_FUNCTION /end FUNCTION
/begin FUNCTION Reverse_2 "" /begin SUB_FUNCTION Reverse_Switch /end SUB_FUNCTION /end FUNCTION
/begin FUNCTION Reverse_Switch_Override "" /begin DEF_CHARACTERISTIC Reverse_Switch_new Reverse_Switch_ovr /end DEF_CHARACTERISTIC /end FUNCTION
/begin FUNCTION ReverseInd "" /begin DEF_CHARACTERISTIC ReverseIndFlash_Period RevIndType /end DEF_CHARACTERISTIC /end FUNCTION
/begin FUNCTION ReverseOut "" /begin OUT_MEASUREMENT RevOut_ /end OUT_MEASUREMENT /begin SUB_FUNCTION RevOut__Override ReverseOut_Config /end SUB_FUNCTION /end FUNCTION
/begin FUNCTION RevOut__Override "" /begin DEF_CHARACTERISTIC RevOut__new RevOut__ovr /end DEF_CHARACTERISTIC /end FUNCTION
/begin FUNCTION ReverseOut_Config "" /begin DEF_CHARACTERISTIC RevOut__Polarity /end DEF_CHARACTERISTIC /end FUNCTION
/begin FUNCTION SOC_Override "" /begin DEF_CHARACTERISTIC SOC_new SOC_ovr /end DEF_CHARACTERISTIC /end FUNCTION
/begin FUNCTION startup "" /begin DEF_CHARACTERISTIC startupCount /end DEF_CHARACTERISTIC /end FUNCTION
/begin FUNCTION onTimeCount "" /begin DEF_CHARACTERISTIC totalOnTime /end DEF_CHARACTERISTIC /end FUNCTION
/begin FUNCTION UQM_Direction_Override "" /begin DEF_CHARACTERISTIC UQM_Direction_new UQM_Direction_ovr /end DEF_CHARACTERISTIC /end FUNCTION
/begin FUNCTION UQM_Enable_Override "" /begin DEF_CHARACTERISTIC UQM_Enable_new UQM_Enable_ovr /end DEF_CHARACTERISTIC /end FUNCTION
/begin FUNCTION UQM_Torque_Override "" /begin DEF_CHARACTERISTIC UQM_Torque_new UQM_Torque_ovr /end DEF_CHARACTERISTIC /end FUNCTION
/begin FUNCTION Gauges "" /begin DEF_CHARACTERISTIC VDO_Gauge_Brightness VDO_Gauge_StartupDelay /end DEF_CHARACTERISTIC /end FUNCTION
/begin FUNCTION Vehicle_Speed_Override "" /begin DEF_CHARACTERISTIC Vehicle_Speed_new Vehicle_Speed_ovr /end DEF_CHARACTERISTIC /end FUNCTION
/begin FUNCTION Voltage_Limit_Override_Override "" /begin DEF_CHARACTERISTIC Voltage_Limit_Override_new Voltage_Limit_Override_ovr /end DEF_CHARACTERISTIC /end FUNCTION
/end MODULE
/end PROJECT
