/******************************************************************************
* ASAP2 descrition file /
* Generated by Woodward ASAP2 Generator /
* This file was auto-generated on: Monday, April 29, 2019 7:23 PM /
******************************************************************************/
ASAP2_VERSION 1 51
/begin PROJECT Project ""
/begin MODULE BuckyWago_187 ""
/begin IF_DATA VISION DEVICE_SETTING "CCP=2.1_ASAP1b" DEVICE_SETTING "DefaultCRCType=5" /end IF_DATA
/begin IF_DATA ASAP1B_CCP
 /begin SOURCE "List 1" 0 0 DISPLAY_IDENTIFIER "DAQ1"
  /begin QP_BLOB 0 LENGTH 8 CAN_ID_FIXED 0x98EF3102 RASTER 0 REDUCTION_ALLOWED FIRST_PID 0 /end QP_BLOB
 /end SOURCE
 /begin SOURCE "List 2" 0 0 DISPLAY_IDENTIFIER "DAQ2"
  /begin QP_BLOB 1 LENGTH 8 CAN_ID_FIXED 0x98EF3102 RASTER 1 REDUCTION_ALLOWED FIRST_PID 8 /end QP_BLOB
 /end SOURCE
 /begin SOURCE "List 3" 0 0 DISPLAY_IDENTIFIER "DAQ3"
  /begin QP_BLOB 2 LENGTH 8 CAN_ID_FIXED 0x98EF3102 RASTER 2 REDUCTION_ALLOWED FIRST_PID 16 /end QP_BLOB
 /end SOURCE
 /begin SOURCE "List 4" 0 0 DISPLAY_IDENTIFIER "DAQ4"
  /begin QP_BLOB 3 LENGTH 8 CAN_ID_FIXED 0x98EF3102 RASTER 3 REDUCTION_ALLOWED FIRST_PID 24 /end QP_BLOB
 /end SOURCE
 /begin RASTER "FGND_RTI_PERIODIC" "FGND_RTI_PERIODIC" 0 3 5 /end RASTER
 /begin RASTER "FGND_2XRTI_PERIODIC" "FGND_2XRTI_PERIODIC" 1 3 10 /end RASTER
 /begin RASTER "FGND_10XRTI_PERIODIC" "FGND_10XRTI_PERIODIC" 2 3 50 /end RASTER
 /begin RASTER "FGND_20XRTI_PERIODIC" "FGND_20XRTI_PERIODIC" 3 3 100 /end RASTER
 /begin RASTER "BGND_BASE_PERIODIC" "BGND_BASE_PERIODIC" 4 3 50 /end RASTER
 /begin RASTER "BGND_BASEx2_PERIODIC" "BGND_BASEx2_PERIODIC" 5 3 100 /end RASTER
 /begin RASTER "BGND_BASEx10_PERIODIC" "BGND_BASEx10_PERIODIC" 6 3 500 /end RASTER
 /begin RASTER "ONE_SECOND_EVENT" "ONE_SECOND_EVENT" 7 3 1000 /end RASTER
 /* /begin SEED_KEY */ /* DLL for CAL */ /* Uncomment and supply a value "SecurityCAL.dll" */ /* DLL for DAQ */ /* Uncomment and supply a value "SecurityDAQ.dll" */ /* DLL for PGM */ /* Uncomment and supply a value "SecurityPGM.dll" */ /* /end SEED_KEY */
 /begin TP_BLOB /* CCP version */ 0x201 /* Blob version */ 0x204 /* CAN msg ID - send */ 0x98EF0231 /* CAN msg ID - recv */ 0x98EF3102 /* Station address */ 0x31 /* byte order */ 1 BAUDRATE 250000 SAMPLE_RATE 1 SAMPLE_POINT 70 BTL_CYCLES 10 SJW 2 SYNC_EDGE SINGLE DAQ_MODE BURST CONSISTENCY ODT ADDRESS_EXTENSION DAQ
  /begin CHECKSUM_PARAM /* algorithm */ 0x8009 /* limit */ 0x1000 CHECKSUM_CALCULATION ACTIVE_PAGE /end CHECKSUM_PARAM
  /begin DEFINED_PAGES /* Memory page num */ 1 /* Page Name */ "working page" /* address ext. */ 0x00 /* base address */ 0x80000000 /* page length */ 0x00000901 RAM /* memory page in RAM */ RAM_INIT_BY_ECU /* memory page is initialised by ECU start-up */ /end DEFINED_PAGES
  OPTIONAL_CMD 0x5 /* TEST */ OPTIONAL_CMD 0x8 /* START_STOP_ALL */ OPTIONAL_CMD 0xC /* SET_S_STATUS */ OPTIONAL_CMD 0xD /* GET_S_STATUS */ OPTIONAL_CMD 0xE /* BUILD_CHECKSUM */ OPTIONAL_CMD 0xF /* SHORT_UP */ OPTIONAL_CMD 0x12 /* GET_SEED */ OPTIONAL_CMD 0x13 /* UNLOCK */ OPTIONAL_CMD 0x23 /* DNLOAD_6 */ /end TP_BLOB
/end IF_DATA
/*~~~~~~~~~ 6.3.91 MOD_PAR ~~~~~~~~~*/
/begin MOD_PAR /* MOD_PAR Comment*/ "" ECU_CALIBRATION_OFFSET 0x00000000
 /begin MEMORY_SEGMENT CAL "" DATA FLASH INTERN 0x80000000 /* Size */ 0x00000901 /* Offset */ -1 -1 -1 -1 -1 /end MEMORY_SEGMENT
 /begin MEMORY_SEGMENT MeasRAM "" VARIABLES RAM INTERN 0x40000000 /* Size */ 0x0000073A /* Offset */ -1 -1 -1 -1 -1 /end MEMORY_SEGMENT
/end MOD_PAR
/begin MOD_COMMON /* MOD_COMMON Comment */ "" BYTE_ORDER MSB_FIRST ALIGNMENT_BYTE 1 ALIGNMENT_FLOAT32_IEEE 1 ALIGNMENT_FLOAT64_IEEE 1 ALIGNMENT_LONG 1 ALIGNMENT_WORD 1 /end MOD_COMMON
/*~~~~~~~~~ 6.3.86 MEASUREMENTs ~~~~~~~~~*/
/begin MEASUREMENT table_0_rev "VarDec Table0 Revision Number" UBYTE CompuMethod_1 1 0 0 255 ECU_ADDRESS 0x40000000 /end MEASUREMENT
/begin MEASUREMENT table_1_rev "VarDec Table1 Revision Number" UBYTE CompuMethod_1 1 0 0 255 ECU_ADDRESS 0x40000001 /end MEASUREMENT
/begin MEASUREMENT table_2_rev "VarDec Table2 Revision Number" UBYTE CompuMethod_1 1 0 0 255 ECU_ADDRESS 0x40000002 /end MEASUREMENT
/begin MEASUREMENT KeyRev "This is the revision for the key protocol." UBYTE CompuMethod_1 1 0 0 255 ECU_ADDRESS 0x40000003 /end MEASUREMENT
/begin MEASUREMENT EriRev "This is the revision for the ERI protocol." UBYTE CompuMethod_1 1 0 0 255 ECU_ADDRESS 0x40000004 /end MEASUREMENT
/begin MEASUREMENT table_3_rev "VarDec Table3 Revision Number" UBYTE CompuMethod_1 1 0 0 255 ECU_ADDRESS 0x40000005 /end MEASUREMENT
/begin MEASUREMENT table_4_rev "VarDec Table4 Revision Number" UBYTE CompuMethod_1 1 0 0 255 ECU_ADDRESS 0x40000006 /end MEASUREMENT
/begin MEASUREMENT table_5_rev "VarDec Table5 Revision Number" UBYTE CompuMethod_1 1 0 0 255 ECU_ADDRESS 0x40000007 /end MEASUREMENT
/begin MEASUREMENT table_6_rev "VarDec Table6 Revision Number" UBYTE CompuMethod_1 1 0 0 255 ECU_ADDRESS 0x40000008 /end MEASUREMENT
/begin MEASUREMENT table_7_rev "VarDec Table7 Revision Number" UBYTE CompuMethod_1 1 0 0 255 ECU_ADDRESS 0x40000009 /end MEASUREMENT
/begin MEASUREMENT MotProgRev "This is the revision for the MOTPROG protocol." UBYTE CompuMethod_1 1 0 0 255 ECU_ADDRESS 0x40000049 /end MEASUREMENT
/begin MEASUREMENT BootVerMaj "" UBYTE CompuMethod_1 1 0 0 255 ECU_ADDRESS 0x4000004A /end MEASUREMENT
/begin MEASUREMENT BootVerMin "" UBYTE CompuMethod_1 1 0 0 255 ECU_ADDRESS 0x4000004B /end MEASUREMENT
/begin MEASUREMENT EcuHwMaj "" UBYTE CompuMethod_1 1 0 0 255 ECU_ADDRESS 0x4000004C /end MEASUREMENT
/begin MEASUREMENT EcuHwMin "" UBYTE CompuMethod_1 1 0 0 255 ECU_ADDRESS 0x4000004D /end MEASUREMENT
/begin MEASUREMENT ApplicationCompatibilityArr "Software Format ID" UWORD CompuMethod_2 1 0 0 65535 ECU_ADDRESS 0x4000004E MATRIX_DIM 1 50 1 /end MEASUREMENT
/begin MEASUREMENT ABC_Phase_Order "" FLOAT32_IEEE CompuMethod_2 1 0 -1E+17 1E+17 ECU_ADDRESS 0x40000116 /end MEASUREMENT
/begin MEASUREMENT Accel_ADC "Singal measured directly from sensor" UWORD CompuMethod_5 1 0 0 65535 ECU_ADDRESS 0x4000011A /end MEASUREMENT
/begin MEASUREMENT Accel_Pedal "Final value after Linear Sensor Characterization" FLOAT32_IEEE CompuMethod_6 1 0 -1E+17 1E+17 ECU_ADDRESS 0x4000011C /end MEASUREMENT
/begin MEASUREMENT Accel_Raw "After conversion to engineering units, before range checking" FLOAT32_IEEE CompuMethod_6 1 0 -1E+17 1E+17 ECU_ADDRESS 0x40000120 /end MEASUREMENT
/begin MEASUREMENT Accel_Zeroed_Since_KeyUp "Accel pedal has been at zero position since key-up" UBYTE CompuMethod_13 1 0 0 1 ECU_ADDRESS 0x40000124 /end MEASUREMENT
/begin MEASUREMENT Acceleration_Limited "" FLOAT32_IEEE CompuMethod_2 1 0 -1E+17 1E+17 ECU_ADDRESS 0x40000125 /end MEASUREMENT
/begin MEASUREMENT AccelPedalMap_v2 "" FLOAT32_IEEE CompuMethod_14 1 0 -1E+17 1E+17 ECU_ADDRESS 0x40000129 /end MEASUREMENT
/begin MEASUREMENT AccelPedalMap_v2Idx "" UWORD CompuMethod_15 1 0 0 127.998 ECU_ADDRESS 0x4000012D /end MEASUREMENT
/begin MEASUREMENT AccelPedalMap_v2In "" FLOAT32_IEEE CompuMethod_2 1 0 -1E+17 1E+17 ECU_ADDRESS 0x4000012F /end MEASUREMENT
/begin MEASUREMENT Accurate_Current "" FLOAT32_IEEE CompuMethod_2 1 0 -1E+17 1E+17 ECU_ADDRESS 0x40000133 /end MEASUREMENT
/begin MEASUREMENT Accurate_Speed "" FLOAT32_IEEE CompuMethod_2 1 0 -1E+17 1E+17 ECU_ADDRESS 0x40000137 /end MEASUREMENT
/begin MEASUREMENT Accurate_Torque "" FLOAT32_IEEE CompuMethod_2 1 0 -1E+17 1E+17 ECU_ADDRESS 0x4000013B /end MEASUREMENT
/begin MEASUREMENT Accurate_Voltage "" FLOAT32_IEEE CompuMethod_2 1 0 -1E+17 1E+17 ECU_ADDRESS 0x4000013F /end MEASUREMENT
/begin MEASUREMENT ADC_Calibration_Problem "" FLOAT32_IEEE CompuMethod_2 1 0 -1E+17 1E+17 ECU_ADDRESS 0x40000143 /end MEASUREMENT
/begin MEASUREMENT ADC_Calibration_Problem_History "" FLOAT32_IEEE CompuMethod_2 1 0 -1E+17 1E+17 ECU_ADDRESS 0x40000147 /end MEASUREMENT
/begin MEASUREMENT AgeCount "" ULONG CompuMethod_18 1 0 0 4294970000 ECU_ADDRESS 0x4000014B /end MEASUREMENT
/begin MEASUREMENT ain_create_Accel_Pedal_Pin "Debug Variable" UBYTE CompuMethod_19 1 0 0 0 ECU_ADDRESS 0x4000014F /end MEASUREMENT
/begin MEASUREMENT ain_create_Brake_Pedal_Pin "Debug Variable" UBYTE CompuMethod_19 1 0 0 0 ECU_ADDRESS 0x40000150 /end MEASUREMENT
/begin MEASUREMENT ain_create_ECUP "Debug Variable" UBYTE CompuMethod_19 1 0 0 0 ECU_ADDRESS 0x40000151 /end MEASUREMENT
/begin MEASUREMENT ain_create_LV_Voltage_Pin "Debug Variable" UBYTE CompuMethod_19 1 0 0 0 ECU_ADDRESS 0x40000152 /end MEASUREMENT
/begin MEASUREMENT ain_create_Reverse_Switch_Pin "Debug Variable" UBYTE CompuMethod_19 1 0 0 0 ECU_ADDRESS 0x40000153 /end MEASUREMENT
/begin MEASUREMENT ain_read_Accel_Pedal_Pin "Debug Variable" UBYTE CompuMethod_19 1 0 0 0 ECU_ADDRESS 0x40000154 /end MEASUREMENT
/begin MEASUREMENT ain_read_Brake_Pedal_Pin "Debug Variable" UBYTE CompuMethod_19 1 0 0 0 ECU_ADDRESS 0x40000155 /end MEASUREMENT
/begin MEASUREMENT ain_read_ECUP "Debug Variable" UBYTE CompuMethod_19 1 0 0 0 ECU_ADDRESS 0x40000156 /end MEASUREMENT
/begin MEASUREMENT ain_read_LV_Voltage_Pin "Debug Variable" UBYTE CompuMethod_19 1 0 0 0 ECU_ADDRESS 0x40000157 /end MEASUREMENT
/begin MEASUREMENT ain_read_Reverse_Switch_Pin "Debug Variable" UBYTE CompuMethod_19 1 0 0 0 ECU_ADDRESS 0x40000158 /end MEASUREMENT
/begin MEASUREMENT Angular_Distance "" FLOAT32_IEEE CompuMethod_2 1 0 -1E+17 1E+17 ECU_ADDRESS 0x40000159 /end MEASUREMENT
/begin MEASUREMENT ApplicationInitStatus "Shows how far the module initialization has progressed" UBYTE CompuMethod_21 1 0 3 5 ECU_ADDRESS 0x4000015D /end MEASUREMENT
/begin MEASUREMENT ApplicationStopReason "Indicates the reason for an application stop" ULONG CompuMethod_25 1 0 0 5 ECU_ADDRESS 0x4000015E /end MEASUREMENT
/begin MEASUREMENT ApplicationStopReasonBlock "Indicates the block that caused the application stop" ULONG CompuMethod_26 1 0 0 5 ECU_ADDRESS 0x40000162 /end MEASUREMENT
/begin MEASUREMENT Bad_Position_Signal "" FLOAT32_IEEE CompuMethod_2 1 0 -1E+17 1E+17 ECU_ADDRESS 0x40000166 /end MEASUREMENT
/begin MEASUREMENT Bad_Switch "" FLOAT32_IEEE CompuMethod_2 1 0 -1E+17 1E+17 ECU_ADDRESS 0x4000016A /end MEASUREMENT
/begin MEASUREMENT bcm_alarm "" FLOAT32_IEEE CompuMethod_2 1 0 -1E+17 1E+17 ECU_ADDRESS 0x4000016E /end MEASUREMENT
/begin MEASUREMENT bcm_cell_overvolt_probe "" FLOAT32_IEEE CompuMethod_2 1 0 -1E+17 1E+17 ECU_ADDRESS 0x40000172 /end MEASUREMENT
/begin MEASUREMENT bcm_cell_tmax "" FLOAT32_IEEE CompuMethod_2 1 0 -1E+17 1E+17 ECU_ADDRESS 0x40000176 /end MEASUREMENT
/begin MEASUREMENT bcm_cell_tmin "" FLOAT32_IEEE CompuMethod_2 1 0 -1E+17 1E+17 ECU_ADDRESS 0x4000017A /end MEASUREMENT
/begin MEASUREMENT bcm_cell_undervolt "" UBYTE CompuMethod_27 1 0 0 1 ECU_ADDRESS 0x4000017E /end MEASUREMENT
/begin MEASUREMENT bcm_cell_vmax "" FLOAT32_IEEE CompuMethod_2 1 0 -1E+17 1E+17 ECU_ADDRESS 0x4000017F /end MEASUREMENT
/begin MEASUREMENT bcm_cell_vmin "" FLOAT32_IEEE CompuMethod_2 1 0 -1E+17 1E+17 ECU_ADDRESS 0x40000183 /end MEASUREMENT
/begin MEASUREMENT bcm_chg_buf "" FLOAT32_IEEE CompuMethod_2 1 0 -1E+17 1E+17 ECU_ADDRESS 0x40000187 /end MEASUREMENT
/begin MEASUREMENT bcm_chg_done "" FLOAT32_IEEE CompuMethod_2 1 0 -1E+17 1E+17 ECU_ADDRESS 0x4000018B /end MEASUREMENT
/begin MEASUREMENT bcm_chg_max "" FLOAT32_IEEE CompuMethod_2 1 0 -1E+17 1E+17 ECU_ADDRESS 0x4000018F /end MEASUREMENT
/begin MEASUREMENT bcm_chga_ena "" FLOAT32_IEEE CompuMethod_2 1 0 -1E+17 1E+17 ECU_ADDRESS 0x40000193 /end MEASUREMENT
/begin MEASUREMENT bcm_chga_mon "" FLOAT32_IEEE CompuMethod_2 1 0 -1E+17 1E+17 ECU_ADDRESS 0x40000197 /end MEASUREMENT
/begin MEASUREMENT bcm_chgc_stat "" UBYTE CompuMethod_27 1 0 0 1 ECU_ADDRESS 0x4000019B /end MEASUREMENT
/begin MEASUREMENT bcm_cool_req "" FLOAT32_IEEE CompuMethod_2 1 0 -1E+17 1E+17 ECU_ADDRESS 0x4000019C /end MEASUREMENT
/begin MEASUREMENT bcm_cpwr_cmd "" FLOAT32_IEEE CompuMethod_2 1 0 -1E+17 1E+17 ECU_ADDRESS 0x400001A0 /end MEASUREMENT
/begin MEASUREMENT bcm_cpwr_mon "" FLOAT32_IEEE CompuMethod_2 1 0 -1E+17 1E+17 ECU_ADDRESS 0x400001A4 /end MEASUREMENT
/begin MEASUREMENT bcm_dis_buf "" FLOAT32_IEEE CompuMethod_2 1 0 -1E+17 1E+17 ECU_ADDRESS 0x400001A8 /end MEASUREMENT
/begin MEASUREMENT bcm_dis_max "" FLOAT32_IEEE CompuMethod_2 1 0 -1E+17 1E+17 ECU_ADDRESS 0x400001AC /end MEASUREMENT
/begin MEASUREMENT bcm_epo "" FLOAT32_IEEE CompuMethod_2 1 0 -1E+17 1E+17 ECU_ADDRESS 0x400001B0 /end MEASUREMENT
/begin MEASUREMENT bcm_gfd "" FLOAT32_IEEE CompuMethod_2 1 0 -1E+17 1E+17 ECU_ADDRESS 0x400001B4 /end MEASUREMENT
/begin MEASUREMENT bcm_hvil_mon "" FLOAT32_IEEE CompuMethod_2 1 0 -1E+17 1E+17 ECU_ADDRESS 0x400001B8 /end MEASUREMENT
/begin MEASUREMENT bcm_ibat "" FLOAT32_IEEE CompuMethod_2 1 0 -1E+17 1E+17 ECU_ADDRESS 0x400001BC /end MEASUREMENT
/begin MEASUREMENT bcm_lvbat "" FLOAT32_IEEE CompuMethod_2 1 0 -1E+17 1E+17 ECU_ADDRESS 0x400001C0 /end MEASUREMENT
/begin MEASUREMENT bcm_mainc_stat "" UBYTE CompuMethod_27 1 0 0 1 ECU_ADDRESS 0x400001C4 /end MEASUREMENT
/begin MEASUREMENT bcm_mod_ena "" FLOAT32_IEEE CompuMethod_2 1 0 -1E+17 1E+17 ECU_ADDRESS 0x400001C5 /end MEASUREMENT
/begin MEASUREMENT bcm_ready "" FLOAT32_IEEE CompuMethod_2 1 0 -1E+17 1E+17 ECU_ADDRESS 0x400001C9 /end MEASUREMENT
/begin MEASUREMENT bcm_soc "" FLOAT32_IEEE CompuMethod_2 1 0 -1E+17 1E+17 ECU_ADDRESS 0x400001CD /end MEASUREMENT
/begin MEASUREMENT bcm_t_coolant "" FLOAT32_IEEE CompuMethod_2 1 0 -1E+17 1E+17 ECU_ADDRESS 0x400001D1 /end MEASUREMENT
/begin MEASUREMENT bcm_vbat "" FLOAT32_IEEE CompuMethod_2 1 0 -1E+17 1E+17 ECU_ADDRESS 0x400001D5 /end MEASUREMENT
/begin MEASUREMENT bcm_veh_mon "" FLOAT32_IEEE CompuMethod_2 1 0 -1E+17 1E+17 ECU_ADDRESS 0x400001D9 /end MEASUREMENT
/begin MEASUREMENT BgndAngTaskStatus "Background Time Scheduler Status" UBYTE CompuMethod_30 1 0 0 0 ECU_ADDRESS 0x400001DD /end MEASUREMENT
/begin MEASUREMENT BgndStackMinBytesFree "Min bytes observed on the Background Stack" ULONG CompuMethod_31 1 0 0 0 ECU_ADDRESS 0x400001DE /end MEASUREMENT
/begin MEASUREMENT BgndTimeTaskStatus "Background Time Scheduler Status" UBYTE CompuMethod_32 1 0 0 0 ECU_ADDRESS 0x400001E2 /end MEASUREMENT
/begin MEASUREMENT Brake_ADC "Singal measured directly from sensor" UWORD CompuMethod_5 1 0 0 65535 ECU_ADDRESS 0x400001E3 /end MEASUREMENT
/begin MEASUREMENT Brake_Pedal "Final value after Linear Sensor Characterization" FLOAT32_IEEE CompuMethod_6 1 0 -1E+17 1E+17 ECU_ADDRESS 0x400001E5 /end MEASUREMENT
/begin MEASUREMENT Brake_Raw "After conversion to engineering units, before range checking" FLOAT32_IEEE CompuMethod_6 1 0 -1E+17 1E+17 ECU_ADDRESS 0x400001E9 /end MEASUREMENT
/begin MEASUREMENT CAN_1_ext_handled_count "Total number of handled ext CAN messages on bus CAN_1" ULONG CompuMethod_18 1 0 0 4294970000 ECU_ADDRESS 0x400001ED /end MEASUREMENT
/begin MEASUREMENT CAN_1_ext_last_unhandled_id "Last received ext CAN message on bus CAN_1, which was unhandled" ULONG CompuMethod_18 1 0 0 4294970000 ECU_ADDRESS 0x400001F1 /end MEASUREMENT
/begin MEASUREMENT CAN_1_ext_receive_count "Total number of received ext CAN messages on bus CAN_1" ULONG CompuMethod_18 1 0 0 4294970000 ECU_ADDRESS 0x400001F5 /end MEASUREMENT
/begin MEASUREMENT CAN_1_std_handled_count "Total number of handled std CAN messages on bus CAN_1" ULONG CompuMethod_18 1 0 0 4294970000 ECU_ADDRESS 0x400001F9 /end MEASUREMENT
/begin MEASUREMENT CAN_1_std_last_unhandled_id "Last received std CAN message on bus CAN_1, which was unhandled" ULONG CompuMethod_18 1 0 0 4294970000 ECU_ADDRESS 0x400001FD /end MEASUREMENT
/begin MEASUREMENT CAN_1_std_receive_count "Total number of received std CAN messages on bus CAN_1" ULONG CompuMethod_18 1 0 0 4294970000 ECU_ADDRESS 0x40000201 /end MEASUREMENT
/begin MEASUREMENT CAN_2_ext_handled_count "Total number of handled ext CAN messages on bus CAN_2" ULONG CompuMethod_18 1 0 0 4294970000 ECU_ADDRESS 0x40000205 /end MEASUREMENT
/begin MEASUREMENT CAN_2_ext_last_unhandled_id "Last received ext CAN message on bus CAN_2, which was unhandled" ULONG CompuMethod_18 1 0 0 4294970000 ECU_ADDRESS 0x40000209 /end MEASUREMENT
/begin MEASUREMENT CAN_2_ext_receive_count "Total number of received ext CAN messages on bus CAN_2" ULONG CompuMethod_18 1 0 0 4294970000 ECU_ADDRESS 0x4000020D /end MEASUREMENT
/begin MEASUREMENT CAN_2_std_handled_count "Total number of handled std CAN messages on bus CAN_2" ULONG CompuMethod_18 1 0 0 4294970000 ECU_ADDRESS 0x40000211 /end MEASUREMENT
/begin MEASUREMENT CAN_2_std_last_unhandled_id "Last received std CAN message on bus CAN_2, which was unhandled" ULONG CompuMethod_18 1 0 0 4294970000 ECU_ADDRESS 0x40000215 /end MEASUREMENT
/begin MEASUREMENT CAN_2_std_receive_count "Total number of received std CAN messages on bus CAN_2" ULONG CompuMethod_18 1 0 0 4294970000 ECU_ADDRESS 0x40000219 /end MEASUREMENT
/begin MEASUREMENT can_create_CAN_1 "Debug Variable" UBYTE CompuMethod_19 1 0 0 0 ECU_ADDRESS 0x4000021D /end MEASUREMENT
/begin MEASUREMENT can_create_CAN_2 "Debug Variable" UBYTE CompuMethod_19 1 0 0 0 ECU_ADDRESS 0x4000021E /end MEASUREMENT
/begin MEASUREMENT CAN_Limits_In_Effect "" FLOAT32_IEEE CompuMethod_2 1 0 -1E+17 1E+17 ECU_ADDRESS 0x4000021F /end MEASUREMENT
/begin MEASUREMENT can_tx_err_CAN_1_0 "Debug Variable" UBYTE CompuMethod_19 1 0 0 0 ECU_ADDRESS 0x40000223 /end MEASUREMENT
/begin MEASUREMENT can_tx_err_CAN_1_0_27 "Debug Variable" UBYTE CompuMethod_19 1 0 0 0 ECU_ADDRESS 0x40000224 /end MEASUREMENT
/begin MEASUREMENT can_tx_err_CAN_2_0 "Debug Variable" UBYTE CompuMethod_19 1 0 0 0 ECU_ADDRESS 0x40000225 /end MEASUREMENT
/begin MEASUREMENT can_tx_err_CAN_2_0_28 "Debug Variable" UBYTE CompuMethod_19 1 0 0 0 ECU_ADDRESS 0x40000226 /end MEASUREMENT
/begin MEASUREMENT CCP_CCP1_Access.CCP_CCP1_CAL "Calibration Authentication Status for CCP Handler CCP1" UBYTE CompuMethod_36 1 0 0 1 ECU_ADDRESS 0x40000227 BIT_MASK 0x00000001 /end MEASUREMENT
/begin MEASUREMENT CCP_CCP1_Access.CCP_CCP1_DAQ "Data Acquisition Authentication Status for CCP Handler CCP1" UBYTE CompuMethod_37 1 0 0 1 ECU_ADDRESS 0x40000227 BIT_MASK 0x00000002 /end MEASUREMENT
/begin MEASUREMENT CCP_CCP1_Access.CCP_CCP1_PGM "Programming Authentication Status for CCP Handler CCP1" UBYTE CompuMethod_38 1 0 0 1 ECU_ADDRESS 0x40000227 BIT_MASK 0x00000040 /end MEASUREMENT
/begin MEASUREMENT CCP_CCP1_Access "Current Access Code for CCP Handler CCP1" UBYTE CompuMethod_2 1 0 0 255 ECU_ADDRESS 0x40000227 /end MEASUREMENT
/begin MEASUREMENT CCP_CCP1_ConnectionStatus "CCP Handler CCP1 connection status" UBYTE CompuMethod_39 1 0 0 255 ECU_ADDRESS 0x40000228 /end MEASUREMENT
/begin MEASUREMENT Charge_Complete_Probe "" UBYTE CompuMethod_27 1 0 0 1 ECU_ADDRESS 0x40000229 /end MEASUREMENT
/begin MEASUREMENT Charge_Enable_Probe "" UBYTE CompuMethod_27 1 0 0 1 ECU_ADDRESS 0x4000022A /end MEASUREMENT
/begin MEASUREMENT Charge_Falt_Probe "" UBYTE CompuMethod_40 1 0 0 255 ECU_ADDRESS 0x4000022B /end MEASUREMENT
/begin MEASUREMENT ChargerState "" FLOAT32_IEEE CompuMethod_2 1 0 -1E+17 1E+17 ECU_ADDRESS 0x4000022C /end MEASUREMENT
/begin MEASUREMENT Coast_Down_Tq_Probe "" FLOAT32_IEEE CompuMethod_2 1 0 -1E+17 1E+17 ECU_ADDRESS 0x40000230 /end MEASUREMENT
/begin MEASUREMENT CodeCoverParent000.CodeCover000029 "Determines if this subsystem has run" ULONG CompuMethod_42 1 0 0 1 ECU_ADDRESS 0x40000234 BIT_MASK 0x20000000 /end MEASUREMENT
/begin MEASUREMENT CodeCoverParent000.CodeCover000018 "Determines if this subsystem has run" ULONG CompuMethod_43 1 0 0 1 ECU_ADDRESS 0x40000234 BIT_MASK 0x00040000 /end MEASUREMENT
/begin MEASUREMENT CodeCoverParent000.CodeCover000007 "Determines if this subsystem has run" ULONG CompuMethod_44 1 0 0 1 ECU_ADDRESS 0x40000234 BIT_MASK 0x00000080 /end MEASUREMENT
/begin MEASUREMENT CodeCoverParent000.CodeCover000019 "Determines if this subsystem has run" ULONG CompuMethod_45 1 0 0 1 ECU_ADDRESS 0x40000234 BIT_MASK 0x00080000 /end MEASUREMENT
/begin MEASUREMENT CodeCoverParent000.CodeCover000008 "Determines if this subsystem has run" ULONG CompuMethod_46 1 0 0 1 ECU_ADDRESS 0x40000234 BIT_MASK 0x00000100 /end MEASUREMENT
/begin MEASUREMENT CodeCoverParent000.CodeCover000009 "Determines if this subsystem has run" ULONG CompuMethod_47 1 0 0 1 ECU_ADDRESS 0x40000234 BIT_MASK 0x00000200 /end MEASUREMENT
/begin MEASUREMENT CodeCoverParent000.CodeCover000030 "Determines if this subsystem has run" ULONG CompuMethod_48 1 0 0 1 ECU_ADDRESS 0x40000234 BIT_MASK 0x40000000 /end MEASUREMENT
/begin MEASUREMENT CodeCoverParent000.CodeCover000031 "Determines if this subsystem has run" ULONG CompuMethod_49 1 0 0 1 ECU_ADDRESS 0x40000234 BIT_MASK 0x80000000 /end MEASUREMENT
/begin MEASUREMENT CodeCoverParent000.CodeCover000020 "Determines if this subsystem has run" ULONG CompuMethod_50 1 0 0 1 ECU_ADDRESS 0x40000234 BIT_MASK 0x00100000 /end MEASUREMENT
/begin MEASUREMENT CodeCoverParent000.CodeCover000021 "Determines if this subsystem has run" ULONG CompuMethod_51 1 0 0 1 ECU_ADDRESS 0x40000234 BIT_MASK 0x00200000 /end MEASUREMENT
/begin MEASUREMENT CodeCoverParent000.CodeCover000010 "Determines if this subsystem has run" ULONG CompuMethod_52 1 0 0 1 ECU_ADDRESS 0x40000234 BIT_MASK 0x00000400 /end MEASUREMENT
/begin MEASUREMENT CodeCoverParent000.CodeCover000022 "Determines if this subsystem has run" ULONG CompuMethod_53 1 0 0 1 ECU_ADDRESS 0x40000234 BIT_MASK 0x00400000 /end MEASUREMENT
/begin MEASUREMENT CodeCoverParent000.CodeCover000011 "Determines if this subsystem has run" ULONG CompuMethod_54 1 0 0 1 ECU_ADDRESS 0x40000234 BIT_MASK 0x00000800 /end MEASUREMENT
/begin MEASUREMENT CodeCoverParent000.CodeCover000000 "Determines if this subsystem has run" ULONG CompuMethod_55 1 0 0 1 ECU_ADDRESS 0x40000234 BIT_MASK 0x00000001 /end MEASUREMENT
/begin MEASUREMENT CodeCoverParent000.CodeCover000023 "Determines if this subsystem has run" ULONG CompuMethod_56 1 0 0 1 ECU_ADDRESS 0x40000234 BIT_MASK 0x00800000 /end MEASUREMENT
/begin MEASUREMENT CodeCoverParent000.CodeCover000012 "Determines if this subsystem has run" ULONG CompuMethod_57 1 0 0 1 ECU_ADDRESS 0x40000234 BIT_MASK 0x00001000 /end MEASUREMENT
/begin MEASUREMENT CodeCoverParent000.CodeCover000001 "Determines if this subsystem has run" ULONG CompuMethod_58 1 0 0 1 ECU_ADDRESS 0x40000234 BIT_MASK 0x00000002 /end MEASUREMENT
/begin MEASUREMENT CodeCoverParent000.CodeCover000024 "Determines if this subsystem has run" ULONG CompuMethod_59 1 0 0 1 ECU_ADDRESS 0x40000234 BIT_MASK 0x01000000 /end MEASUREMENT
/begin MEASUREMENT CodeCoverParent000.CodeCover000013 "Determines if this subsystem has run" ULONG CompuMethod_60 1 0 0 1 ECU_ADDRESS 0x40000234 BIT_MASK 0x00002000 /end MEASUREMENT
/begin MEASUREMENT CodeCoverParent000.CodeCover000002 "Determines if this subsystem has run" ULONG CompuMethod_61 1 0 0 1 ECU_ADDRESS 0x40000234 BIT_MASK 0x00000004 /end MEASUREMENT
/begin MEASUREMENT CodeCoverParent000.CodeCover000025 "Determines if this subsystem has run" ULONG CompuMethod_62 1 0 0 1 ECU_ADDRESS 0x40000234 BIT_MASK 0x02000000 /end MEASUREMENT
/begin MEASUREMENT CodeCoverParent000.CodeCover000014 "Determines if this subsystem has run" ULONG CompuMethod_63 1 0 0 1 ECU_ADDRESS 0x40000234 BIT_MASK 0x00004000 /end MEASUREMENT
/begin MEASUREMENT CodeCoverParent000.CodeCover000003 "Determines if this subsystem has run" ULONG CompuMethod_64 1 0 0 1 ECU_ADDRESS 0x40000234 BIT_MASK 0x00000008 /end MEASUREMENT
/begin MEASUREMENT CodeCoverParent000.CodeCover000026 "Determines if this subsystem has run" ULONG CompuMethod_65 1 0 0 1 ECU_ADDRESS 0x40000234 BIT_MASK 0x04000000 /end MEASUREMENT
/begin MEASUREMENT CodeCoverParent000.CodeCover000015 "Determines if this subsystem has run" ULONG CompuMethod_66 1 0 0 1 ECU_ADDRESS 0x40000234 BIT_MASK 0x00008000 /end MEASUREMENT
/begin MEASUREMENT CodeCoverParent000.CodeCover000004 "Determines if this subsystem has run" ULONG CompuMethod_67 1 0 0 1 ECU_ADDRESS 0x40000234 BIT_MASK 0x00000010 /end MEASUREMENT
/begin MEASUREMENT CodeCoverParent000.CodeCover000027 "Determines if this subsystem has run" ULONG CompuMethod_68 1 0 0 1 ECU_ADDRESS 0x40000234 BIT_MASK 0x08000000 /end MEASUREMENT
/begin MEASUREMENT CodeCoverParent000.CodeCover000016 "Determines if this subsystem has run" ULONG CompuMethod_69 1 0 0 1 ECU_ADDRESS 0x40000234 BIT_MASK 0x00010000 /end MEASUREMENT
/begin MEASUREMENT CodeCoverParent000.CodeCover000005 "Determines if this subsystem has run" ULONG CompuMethod_70 1 0 0 1 ECU_ADDRESS 0x40000234 BIT_MASK 0x00000020 /end MEASUREMENT
/begin MEASUREMENT CodeCoverParent000.CodeCover000028 "Determines if this subsystem has run" ULONG CompuMethod_71 1 0 0 1 ECU_ADDRESS 0x40000234 BIT_MASK 0x10000000 /end MEASUREMENT
/begin MEASUREMENT CodeCoverParent000.CodeCover000017 "Determines if this subsystem has run" ULONG CompuMethod_72 1 0 0 1 ECU_ADDRESS 0x40000234 BIT_MASK 0x00020000 /end MEASUREMENT
/begin MEASUREMENT CodeCoverParent000.CodeCover000006 "Determines if this subsystem has run" ULONG CompuMethod_73 1 0 0 1 ECU_ADDRESS 0x40000234 BIT_MASK 0x00000040 /end MEASUREMENT
/begin MEASUREMENT CodeCoverParent000 "Run Status of Subsystems" ULONG CompuMethod_2 1 0 0 4294967295 ECU_ADDRESS 0x40000234 /end MEASUREMENT
/begin MEASUREMENT CodeCoverParent001.CodeCover000060 "Determines if this subsystem has run" ULONG CompuMethod_74 1 0 0 1 ECU_ADDRESS 0x40000238 BIT_MASK 0x10000000 /end MEASUREMENT
/begin MEASUREMENT CodeCoverParent001.CodeCover000061 "Determines if this subsystem has run" ULONG CompuMethod_75 1 0 0 1 ECU_ADDRESS 0x40000238 BIT_MASK 0x20000000 /end MEASUREMENT
/begin MEASUREMENT CodeCoverParent001.CodeCover000050 "Determines if this subsystem has run" ULONG CompuMethod_76 1 0 0 1 ECU_ADDRESS 0x40000238 BIT_MASK 0x00040000 /end MEASUREMENT
/begin MEASUREMENT CodeCoverParent001.CodeCover000062 "Determines if this subsystem has run" ULONG CompuMethod_77 1 0 0 1 ECU_ADDRESS 0x40000238 BIT_MASK 0x40000000 /end MEASUREMENT
/begin MEASUREMENT CodeCoverParent001.CodeCover000051 "Determines if this subsystem has run" ULONG CompuMethod_78 1 0 0 1 ECU_ADDRESS 0x40000238 BIT_MASK 0x00080000 /end MEASUREMENT
/begin MEASUREMENT CodeCoverParent001.CodeCover000040 "Determines if this subsystem has run" ULONG CompuMethod_79 1 0 0 1 ECU_ADDRESS 0x40000238 BIT_MASK 0x00000100 /end MEASUREMENT
/begin MEASUREMENT CodeCoverParent001.CodeCover000063 "Determines if this subsystem has run" ULONG CompuMethod_80 1 0 0 1 ECU_ADDRESS 0x40000238 BIT_MASK 0x80000000 /end MEASUREMENT
/begin MEASUREMENT CodeCoverParent001.CodeCover000052 "Determines if this subsystem has run" ULONG CompuMethod_81 1 0 0 1 ECU_ADDRESS 0x40000238 BIT_MASK 0x00100000 /end MEASUREMENT
/begin MEASUREMENT CodeCoverParent001.CodeCover000041 "Determines if this subsystem has run" ULONG CompuMethod_82 1 0 0 1 ECU_ADDRESS 0x40000238 BIT_MASK 0x00000200 /end MEASUREMENT
/begin MEASUREMENT CodeCoverParent001.CodeCover000053 "Determines if this subsystem has run" ULONG CompuMethod_83 1 0 0 1 ECU_ADDRESS 0x40000238 BIT_MASK 0x00200000 /end MEASUREMENT
/begin MEASUREMENT CodeCoverParent001.CodeCover000042 "Determines if this subsystem has run" ULONG CompuMethod_84 1 0 0 1 ECU_ADDRESS 0x40000238 BIT_MASK 0x00000400 /end MEASUREMENT
/begin MEASUREMENT CodeCoverParent001.CodeCover000054 "Determines if this subsystem has run" ULONG CompuMethod_85 1 0 0 1 ECU_ADDRESS 0x40000238 BIT_MASK 0x00400000 /end MEASUREMENT
/begin MEASUREMENT CodeCoverParent001.CodeCover000043 "Determines if this subsystem has run" ULONG CompuMethod_86 1 0 0 1 ECU_ADDRESS 0x40000238 BIT_MASK 0x00000800 /end MEASUREMENT
/begin MEASUREMENT CodeCoverParent001.CodeCover000032 "Determines if this subsystem has run" ULONG CompuMethod_87 1 0 0 1 ECU_ADDRESS 0x40000238 BIT_MASK 0x00000001 /end MEASUREMENT
/begin MEASUREMENT CodeCoverParent001.CodeCover000055 "Determines if this subsystem has run" ULONG CompuMethod_88 1 0 0 1 ECU_ADDRESS 0x40000238 BIT_MASK 0x00800000 /end MEASUREMENT
/begin MEASUREMENT CodeCoverParent001.CodeCover000044 "Determines if this subsystem has run" ULONG CompuMethod_89 1 0 0 1 ECU_ADDRESS 0x40000238 BIT_MASK 0x00001000 /end MEASUREMENT
/begin MEASUREMENT CodeCoverParent001.CodeCover000033 "Determines if this subsystem has run" ULONG CompuMethod_90 1 0 0 1 ECU_ADDRESS 0x40000238 BIT_MASK 0x00000002 /end MEASUREMENT
/begin MEASUREMENT CodeCoverParent001.CodeCover000056 "Determines if this subsystem has run" ULONG CompuMethod_91 1 0 0 1 ECU_ADDRESS 0x40000238 BIT_MASK 0x01000000 /end MEASUREMENT
/begin MEASUREMENT CodeCoverParent001.CodeCover000045 "Determines if this subsystem has run" ULONG CompuMethod_92 1 0 0 1 ECU_ADDRESS 0x40000238 BIT_MASK 0x00002000 /end MEASUREMENT
/begin MEASUREMENT CodeCoverParent001.CodeCover000034 "Determines if this subsystem has run" ULONG CompuMethod_93 1 0 0 1 ECU_ADDRESS 0x40000238 BIT_MASK 0x00000004 /end MEASUREMENT
/begin MEASUREMENT CodeCoverParent001.CodeCover000057 "Determines if this subsystem has run" ULONG CompuMethod_94 1 0 0 1 ECU_ADDRESS 0x40000238 BIT_MASK 0x02000000 /end MEASUREMENT
/begin MEASUREMENT CodeCoverParent001.CodeCover000046 "Determines if this subsystem has run" ULONG CompuMethod_95 1 0 0 1 ECU_ADDRESS 0x40000238 BIT_MASK 0x00004000 /end MEASUREMENT
/begin MEASUREMENT CodeCoverParent001.CodeCover000035 "Determines if this subsystem has run" ULONG CompuMethod_96 1 0 0 1 ECU_ADDRESS 0x40000238 BIT_MASK 0x00000008 /end MEASUREMENT
/begin MEASUREMENT CodeCoverParent001.CodeCover000058 "Determines if this subsystem has run" ULONG CompuMethod_97 1 0 0 1 ECU_ADDRESS 0x40000238 BIT_MASK 0x04000000 /end MEASUREMENT
/begin MEASUREMENT CodeCoverParent001.CodeCover000047 "Determines if this subsystem has run" ULONG CompuMethod_98 1 0 0 1 ECU_ADDRESS 0x40000238 BIT_MASK 0x00008000 /end MEASUREMENT
/begin MEASUREMENT CodeCoverParent001.CodeCover000036 "Determines if this subsystem has run" ULONG CompuMethod_99 1 0 0 1 ECU_ADDRESS 0x40000238 BIT_MASK 0x00000010 /end MEASUREMENT
/begin MEASUREMENT CodeCoverParent001.CodeCover000059 "Determines if this subsystem has run" ULONG CompuMethod_100 1 0 0 1 ECU_ADDRESS 0x40000238 BIT_MASK 0x08000000 /end MEASUREMENT
/begin MEASUREMENT CodeCoverParent001.CodeCover000048 "Determines if this subsystem has run" ULONG CompuMethod_101 1 0 0 1 ECU_ADDRESS 0x40000238 BIT_MASK 0x00010000 /end MEASUREMENT
/begin MEASUREMENT CodeCoverParent001.CodeCover000037 "Determines if this subsystem has run" ULONG CompuMethod_102 1 0 0 1 ECU_ADDRESS 0x40000238 BIT_MASK 0x00000020 /end MEASUREMENT
/begin MEASUREMENT CodeCoverParent001.CodeCover000049 "Determines if this subsystem has run" ULONG CompuMethod_103 1 0 0 1 ECU_ADDRESS 0x40000238 BIT_MASK 0x00020000 /end MEASUREMENT
/begin MEASUREMENT CodeCoverParent001.CodeCover000038 "Determines if this subsystem has run" ULONG CompuMethod_104 1 0 0 1 ECU_ADDRESS 0x40000238 BIT_MASK 0x00000040 /end MEASUREMENT
/begin MEASUREMENT CodeCoverParent001.CodeCover000039 "Determines if this subsystem has run" ULONG CompuMethod_105 1 0 0 1 ECU_ADDRESS 0x40000238 BIT_MASK 0x00000080 /end MEASUREMENT
/begin MEASUREMENT CodeCoverParent001 "Run Status of Subsystems" ULONG CompuMethod_2 1 0 0 4294967295 ECU_ADDRESS 0x40000238 /end MEASUREMENT
/begin MEASUREMENT CodeCoverParent002.CodeCover000090 "Determines if this subsystem has run" ULONG CompuMethod_106 1 0 0 1 ECU_ADDRESS 0x4000023C BIT_MASK 0x04000000 /end MEASUREMENT
/begin MEASUREMENT CodeCoverParent002.CodeCover000091 "Determines if this subsystem has run" ULONG CompuMethod_107 1 0 0 1 ECU_ADDRESS 0x4000023C BIT_MASK 0x08000000 /end MEASUREMENT
/begin MEASUREMENT CodeCoverParent002.CodeCover000080 "Determines if this subsystem has run" ULONG CompuMethod_108 1 0 0 1 ECU_ADDRESS 0x4000023C BIT_MASK 0x00010000 /end MEASUREMENT
/begin MEASUREMENT CodeCoverParent002.CodeCover000092 "Determines if this subsystem has run" ULONG CompuMethod_109 1 0 0 1 ECU_ADDRESS 0x4000023C BIT_MASK 0x10000000 /end MEASUREMENT
/begin MEASUREMENT CodeCoverParent002.CodeCover000081 "Determines if this subsystem has run" ULONG CompuMethod_110 1 0 0 1 ECU_ADDRESS 0x4000023C BIT_MASK 0x00020000 /end MEASUREMENT
/begin MEASUREMENT CodeCoverParent002.CodeCover000070 "Determines if this subsystem has run" ULONG CompuMethod_111 1 0 0 1 ECU_ADDRESS 0x4000023C BIT_MASK 0x00000040 /end MEASUREMENT
/begin MEASUREMENT CodeCoverParent002.CodeCover000093 "Determines if this subsystem has run" ULONG CompuMethod_112 1 0 0 1 ECU_ADDRESS 0x4000023C BIT_MASK 0x20000000 /end MEASUREMENT
/begin MEASUREMENT CodeCoverParent002.CodeCover000082 "Determines if this subsystem has run" ULONG CompuMethod_113 1 0 0 1 ECU_ADDRESS 0x4000023C BIT_MASK 0x00040000 /end MEASUREMENT
/begin MEASUREMENT CodeCoverParent002.CodeCover000071 "Determines if this subsystem has run" ULONG CompuMethod_114 1 0 0 1 ECU_ADDRESS 0x4000023C BIT_MASK 0x00000080 /end MEASUREMENT
/begin MEASUREMENT CodeCoverParent002.CodeCover000094 "Determines if this subsystem has run" ULONG CompuMethod_115 1 0 0 1 ECU_ADDRESS 0x4000023C BIT_MASK 0x40000000 /end MEASUREMENT
/begin MEASUREMENT CodeCoverParent002.CodeCover000083 "Determines if this subsystem has run" ULONG CompuMethod_116 1 0 0 1 ECU_ADDRESS 0x4000023C BIT_MASK 0x00080000 /end MEASUREMENT
/begin MEASUREMENT CodeCoverParent002.CodeCover000072 "Determines if this subsystem has run" ULONG CompuMethod_117 1 0 0 1 ECU_ADDRESS 0x4000023C BIT_MASK 0x00000100 /end MEASUREMENT
/begin MEASUREMENT CodeCoverParent002.CodeCover000095 "Determines if this subsystem has run" ULONG CompuMethod_118 1 0 0 1 ECU_ADDRESS 0x4000023C BIT_MASK 0x80000000 /end MEASUREMENT
/begin MEASUREMENT CodeCoverParent002.CodeCover000084 "Determines if this subsystem has run" ULONG CompuMethod_119 1 0 0 1 ECU_ADDRESS 0x4000023C BIT_MASK 0x00100000 /end MEASUREMENT
/begin MEASUREMENT CodeCoverParent002.CodeCover000073 "Determines if this subsystem has run" ULONG CompuMethod_120 1 0 0 1 ECU_ADDRESS 0x4000023C BIT_MASK 0x00000200 /end MEASUREMENT
/begin MEASUREMENT CodeCoverParent002.CodeCover000085 "Determines if this subsystem has run" ULONG CompuMethod_121 1 0 0 1 ECU_ADDRESS 0x4000023C BIT_MASK 0x00200000 /end MEASUREMENT
/begin MEASUREMENT CodeCoverParent002.CodeCover000074 "Determines if this subsystem has run" ULONG CompuMethod_122 1 0 0 1 ECU_ADDRESS 0x4000023C BIT_MASK 0x00000400 /end MEASUREMENT
/begin MEASUREMENT CodeCoverParent002.CodeCover000086 "Determines if this subsystem has run" ULONG CompuMethod_123 1 0 0 1 ECU_ADDRESS 0x4000023C BIT_MASK 0x00400000 /end MEASUREMENT
/begin MEASUREMENT CodeCoverParent002.CodeCover000075 "Determines if this subsystem has run" ULONG CompuMethod_124 1 0 0 1 ECU_ADDRESS 0x4000023C BIT_MASK 0x00000800 /end MEASUREMENT
/begin MEASUREMENT CodeCoverParent002.CodeCover000064 "Determines if this subsystem has run" ULONG CompuMethod_125 1 0 0 1 ECU_ADDRESS 0x4000023C BIT_MASK 0x00000001 /end MEASUREMENT
/begin MEASUREMENT CodeCoverParent002.CodeCover000087 "Determines if this subsystem has run" ULONG CompuMethod_126 1 0 0 1 ECU_ADDRESS 0x4000023C BIT_MASK 0x00800000 /end MEASUREMENT
/begin MEASUREMENT CodeCoverParent002.CodeCover000076 "Determines if this subsystem has run" ULONG CompuMethod_127 1 0 0 1 ECU_ADDRESS 0x4000023C BIT_MASK 0x00001000 /end MEASUREMENT
/begin MEASUREMENT CodeCoverParent002.CodeCover000065 "Determines if this subsystem has run" ULONG CompuMethod_128 1 0 0 1 ECU_ADDRESS 0x4000023C BIT_MASK 0x00000002 /end MEASUREMENT
/begin MEASUREMENT CodeCoverParent002.CodeCover000088 "Determines if this subsystem has run" ULONG CompuMethod_129 1 0 0 1 ECU_ADDRESS 0x4000023C BIT_MASK 0x01000000 /end MEASUREMENT
/begin MEASUREMENT CodeCoverParent002.CodeCover000077 "Determines if this subsystem has run" ULONG CompuMethod_130 1 0 0 1 ECU_ADDRESS 0x4000023C BIT_MASK 0x00002000 /end MEASUREMENT
/begin MEASUREMENT CodeCoverParent002.CodeCover000066 "Determines if this subsystem has run" ULONG CompuMethod_131 1 0 0 1 ECU_ADDRESS 0x4000023C BIT_MASK 0x00000004 /end MEASUREMENT
/begin MEASUREMENT CodeCoverParent002.CodeCover000089 "Determines if this subsystem has run" ULONG CompuMethod_132 1 0 0 1 ECU_ADDRESS 0x4000023C BIT_MASK 0x02000000 /end MEASUREMENT
/begin MEASUREMENT CodeCoverParent002.CodeCover000078 "Determines if this subsystem has run" ULONG CompuMethod_133 1 0 0 1 ECU_ADDRESS 0x4000023C BIT_MASK 0x00004000 /end MEASUREMENT
/begin MEASUREMENT CodeCoverParent002.CodeCover000067 "Determines if this subsystem has run" ULONG CompuMethod_134 1 0 0 1 ECU_ADDRESS 0x4000023C BIT_MASK 0x00000008 /end MEASUREMENT
/begin MEASUREMENT CodeCoverParent002.CodeCover000079 "Determines if this subsystem has run" ULONG CompuMethod_135 1 0 0 1 ECU_ADDRESS 0x4000023C BIT_MASK 0x00008000 /end MEASUREMENT
/begin MEASUREMENT CodeCoverParent002.CodeCover000068 "Determines if this subsystem has run" ULONG CompuMethod_136 1 0 0 1 ECU_ADDRESS 0x4000023C BIT_MASK 0x00000010 /end MEASUREMENT
/begin MEASUREMENT CodeCoverParent002.CodeCover000069 "Determines if this subsystem has run" ULONG CompuMethod_137 1 0 0 1 ECU_ADDRESS 0x4000023C BIT_MASK 0x00000020 /end MEASUREMENT
/begin MEASUREMENT CodeCoverParent002 "Run Status of Subsystems" ULONG CompuMethod_2 1 0 0 4294967295 ECU_ADDRESS 0x4000023C /end MEASUREMENT
/begin MEASUREMENT CodeCoverParent003.CodeCover000117 "Determines if this subsystem has run" ULONG CompuMethod_138 1 0 0 1 ECU_ADDRESS 0x40000240 BIT_MASK 0x00200000 /end MEASUREMENT
/begin MEASUREMENT CodeCoverParent003.CodeCover000106 "Determines if this subsystem has run" ULONG CompuMethod_139 1 0 0 1 ECU_ADDRESS 0x40000240 BIT_MASK 0x00000400 /end MEASUREMENT
/begin MEASUREMENT CodeCoverParent003.CodeCover000118 "Determines if this subsystem has run" ULONG CompuMethod_140 1 0 0 1 ECU_ADDRESS 0x40000240 BIT_MASK 0x00400000 /end MEASUREMENT
/begin MEASUREMENT CodeCoverParent003.CodeCover000107 "Determines if this subsystem has run" ULONG CompuMethod_141 1 0 0 1 ECU_ADDRESS 0x40000240 BIT_MASK 0x00000800 /end MEASUREMENT
/begin MEASUREMENT CodeCoverParent003.CodeCover000119 "Determines if this subsystem has run" ULONG CompuMethod_142 1 0 0 1 ECU_ADDRESS 0x40000240 BIT_MASK 0x00800000 /end MEASUREMENT
/begin MEASUREMENT CodeCoverParent003.CodeCover000108 "Determines if this subsystem has run" ULONG CompuMethod_143 1 0 0 1 ECU_ADDRESS 0x40000240 BIT_MASK 0x00001000 /end MEASUREMENT
/begin MEASUREMENT CodeCoverParent003.CodeCover000109 "Determines if this subsystem has run" ULONG CompuMethod_144 1 0 0 1 ECU_ADDRESS 0x40000240 BIT_MASK 0x00002000 /end MEASUREMENT
/begin MEASUREMENT CodeCoverParent003.CodeCover000096 "Determines if this subsystem has run" ULONG CompuMethod_145 1 0 0 1 ECU_ADDRESS 0x40000240 BIT_MASK 0x00000001 /end MEASUREMENT
/begin MEASUREMENT CodeCoverParent003.CodeCover000097 "Determines if this subsystem has run" ULONG CompuMethod_146 1 0 0 1 ECU_ADDRESS 0x40000240 BIT_MASK 0x00000002 /end MEASUREMENT
/begin MEASUREMENT CodeCoverParent003.CodeCover000120 "Determines if this subsystem has run" ULONG CompuMethod_147 1 0 0 1 ECU_ADDRESS 0x40000240 BIT_MASK 0x01000000 /end MEASUREMENT
/begin MEASUREMENT CodeCoverParent003.CodeCover000098 "Determines if this subsystem has run" ULONG CompuMethod_148 1 0 0 1 ECU_ADDRESS 0x40000240 BIT_MASK 0x00000004 /end MEASUREMENT
/begin MEASUREMENT CodeCoverParent003.CodeCover000121 "Determines if this subsystem has run" ULONG CompuMethod_149 1 0 0 1 ECU_ADDRESS 0x40000240 BIT_MASK 0x02000000 /end MEASUREMENT
/begin MEASUREMENT CodeCoverParent003.CodeCover000110 "Determines if this subsystem has run" ULONG CompuMethod_150 1 0 0 1 ECU_ADDRESS 0x40000240 BIT_MASK 0x00004000 /end MEASUREMENT
/begin MEASUREMENT CodeCoverParent003.CodeCover000099 "Determines if this subsystem has run" ULONG CompuMethod_151 1 0 0 1 ECU_ADDRESS 0x40000240 BIT_MASK 0x00000008 /end MEASUREMENT
/begin MEASUREMENT CodeCoverParent003.CodeCover000122 "Determines if this subsystem has run" ULONG CompuMethod_152 1 0 0 1 ECU_ADDRESS 0x40000240 BIT_MASK 0x04000000 /end MEASUREMENT
/begin MEASUREMENT CodeCoverParent003.CodeCover000111 "Determines if this subsystem has run" ULONG CompuMethod_153 1 0 0 1 ECU_ADDRESS 0x40000240 BIT_MASK 0x00008000 /end MEASUREMENT
/begin MEASUREMENT CodeCoverParent003.CodeCover000100 "Determines if this subsystem has run" ULONG CompuMethod_154 1 0 0 1 ECU_ADDRESS 0x40000240 BIT_MASK 0x00000010 /end MEASUREMENT
/begin MEASUREMENT CodeCoverParent003.CodeCover000123 "Determines if this subsystem has run" ULONG CompuMethod_155 1 0 0 1 ECU_ADDRESS 0x40000240 BIT_MASK 0x08000000 /end MEASUREMENT
/begin MEASUREMENT CodeCoverParent003.CodeCover000112 "Determines if this subsystem has run" ULONG CompuMethod_156 1 0 0 1 ECU_ADDRESS 0x40000240 BIT_MASK 0x00010000 /end MEASUREMENT
/begin MEASUREMENT CodeCoverParent003.CodeCover000101 "Determines if this subsystem has run" ULONG CompuMethod_157 1 0 0 1 ECU_ADDRESS 0x40000240 BIT_MASK 0x00000020 /end MEASUREMENT
/begin MEASUREMENT CodeCoverParent003.CodeCover000124 "Determines if this subsystem has run" ULONG CompuMethod_158 1 0 0 1 ECU_ADDRESS 0x40000240 BIT_MASK 0x10000000 /end MEASUREMENT
/begin MEASUREMENT CodeCoverParent003.CodeCover000113 "Determines if this subsystem has run" ULONG CompuMethod_159 1 0 0 1 ECU_ADDRESS 0x40000240 BIT_MASK 0x00020000 /end MEASUREMENT
/begin MEASUREMENT CodeCoverParent003.CodeCover000102 "Determines if this subsystem has run" ULONG CompuMethod_160 1 0 0 1 ECU_ADDRESS 0x40000240 BIT_MASK 0x00000040 /end MEASUREMENT
/begin MEASUREMENT CodeCoverParent003.CodeCover000125 "Determines if this subsystem has run" ULONG CompuMethod_161 1 0 0 1 ECU_ADDRESS 0x40000240 BIT_MASK 0x20000000 /end MEASUREMENT
/begin MEASUREMENT CodeCoverParent003.CodeCover000114 "Determines if this subsystem has run" ULONG CompuMethod_162 1 0 0 1 ECU_ADDRESS 0x40000240 BIT_MASK 0x00040000 /end MEASUREMENT
/begin MEASUREMENT CodeCoverParent003.CodeCover000103 "Determines if this subsystem has run" ULONG CompuMethod_163 1 0 0 1 ECU_ADDRESS 0x40000240 BIT_MASK 0x00000080 /end MEASUREMENT
/begin MEASUREMENT CodeCoverParent003.CodeCover000126 "Determines if this subsystem has run" ULONG CompuMethod_164 1 0 0 1 ECU_ADDRESS 0x40000240 BIT_MASK 0x40000000 /end MEASUREMENT
/begin MEASUREMENT CodeCoverParent003.CodeCover000115 "Determines if this subsystem has run" ULONG CompuMethod_165 1 0 0 1 ECU_ADDRESS 0x40000240 BIT_MASK 0x00080000 /end MEASUREMENT
/begin MEASUREMENT CodeCoverParent003.CodeCover000104 "Determines if this subsystem has run" ULONG CompuMethod_166 1 0 0 1 ECU_ADDRESS 0x40000240 BIT_MASK 0x00000100 /end MEASUREMENT
/begin MEASUREMENT CodeCoverParent003.CodeCover000127 "Determines if this subsystem has run" ULONG CompuMethod_167 1 0 0 1 ECU_ADDRESS 0x40000240 BIT_MASK 0x80000000 /end MEASUREMENT
/begin MEASUREMENT CodeCoverParent003.CodeCover000116 "Determines if this subsystem has run" ULONG CompuMethod_168 1 0 0 1 ECU_ADDRESS 0x40000240 BIT_MASK 0x00100000 /end MEASUREMENT
/begin MEASUREMENT CodeCoverParent003.CodeCover000105 "Determines if this subsystem has run" ULONG CompuMethod_169 1 0 0 1 ECU_ADDRESS 0x40000240 BIT_MASK 0x00000200 /end MEASUREMENT
/begin MEASUREMENT CodeCoverParent003 "Run Status of Subsystems" ULONG CompuMethod_2 1 0 0 4294967295 ECU_ADDRESS 0x40000240 /end MEASUREMENT
/begin MEASUREMENT CodeCoverParent004.CodeCover000139 "Determines if this subsystem has run" ULONG CompuMethod_170 1 0 0 1 ECU_ADDRESS 0x40000244 BIT_MASK 0x00000800 /end MEASUREMENT
/begin MEASUREMENT CodeCoverParent004.CodeCover000128 "Determines if this subsystem has run" ULONG CompuMethod_171 1 0 0 1 ECU_ADDRESS 0x40000244 BIT_MASK 0x00000001 /end MEASUREMENT
/begin MEASUREMENT CodeCoverParent004.CodeCover000129 "Determines if this subsystem has run" ULONG CompuMethod_172 1 0 0 1 ECU_ADDRESS 0x40000244 BIT_MASK 0x00000002 /end MEASUREMENT
/begin MEASUREMENT CodeCoverParent004.CodeCover000140 "Determines if this subsystem has run" ULONG CompuMethod_173 1 0 0 1 ECU_ADDRESS 0x40000244 BIT_MASK 0x00001000 /end MEASUREMENT
/begin MEASUREMENT CodeCoverParent004.CodeCover000141 "Determines if this subsystem has run" ULONG CompuMethod_174 1 0 0 1 ECU_ADDRESS 0x40000244 BIT_MASK 0x00002000 /end MEASUREMENT
/begin MEASUREMENT CodeCoverParent004.CodeCover000130 "Determines if this subsystem has run" ULONG CompuMethod_175 1 0 0 1 ECU_ADDRESS 0x40000244 BIT_MASK 0x00000004 /end MEASUREMENT
/begin MEASUREMENT CodeCoverParent004.CodeCover000142 "Determines if this subsystem has run" ULONG CompuMethod_176 1 0 0 1 ECU_ADDRESS 0x40000244 BIT_MASK 0x00004000 /end MEASUREMENT
/begin MEASUREMENT CodeCoverParent004.CodeCover000131 "Determines if this subsystem has run" ULONG CompuMethod_177 1 0 0 1 ECU_ADDRESS 0x40000244 BIT_MASK 0x00000008 /end MEASUREMENT
/begin MEASUREMENT CodeCoverParent004.CodeCover000143 "Determines if this subsystem has run" ULONG CompuMethod_178 1 0 0 1 ECU_ADDRESS 0x40000244 BIT_MASK 0x00008000 /end MEASUREMENT
/begin MEASUREMENT CodeCoverParent004.CodeCover000132 "Determines if this subsystem has run" ULONG CompuMethod_179 1 0 0 1 ECU_ADDRESS 0x40000244 BIT_MASK 0x00000010 /end MEASUREMENT
/begin MEASUREMENT CodeCoverParent004.CodeCover000144 "Determines if this subsystem has run" ULONG CompuMethod_180 1 0 0 1 ECU_ADDRESS 0x40000244 BIT_MASK 0x00010000 /end MEASUREMENT
/begin MEASUREMENT CodeCoverParent004.CodeCover000133 "Determines if this subsystem has run" ULONG CompuMethod_181 1 0 0 1 ECU_ADDRESS 0x40000244 BIT_MASK 0x00000020 /end MEASUREMENT
/begin MEASUREMENT CodeCoverParent004.CodeCover000145 "Determines if this subsystem has run" ULONG CompuMethod_182 1 0 0 1 ECU_ADDRESS 0x40000244 BIT_MASK 0x00020000 /end MEASUREMENT
/begin MEASUREMENT CodeCoverParent004.CodeCover000134 "Determines if this subsystem has run" ULONG CompuMethod_183 1 0 0 1 ECU_ADDRESS 0x40000244 BIT_MASK 0x00000040 /end MEASUREMENT
/begin MEASUREMENT CodeCoverParent004.CodeCover000146 "Determines if this subsystem has run" ULONG CompuMethod_184 1 0 0 1 ECU_ADDRESS 0x40000244 BIT_MASK 0x00040000 /end MEASUREMENT
/begin MEASUREMENT CodeCoverParent004.CodeCover000135 "Determines if this subsystem has run" ULONG CompuMethod_185 1 0 0 1 ECU_ADDRESS 0x40000244 BIT_MASK 0x00000080 /end MEASUREMENT
/begin MEASUREMENT CodeCoverParent004.CodeCover000136 "Determines if this subsystem has run" ULONG CompuMethod_186 1 0 0 1 ECU_ADDRESS 0x40000244 BIT_MASK 0x00000100 /end MEASUREMENT
/begin MEASUREMENT CodeCoverParent004.CodeCover000137 "Determines if this subsystem has run" ULONG CompuMethod_187 1 0 0 1 ECU_ADDRESS 0x40000244 BIT_MASK 0x00000200 /end MEASUREMENT
/begin MEASUREMENT CodeCoverParent004.CodeCover000138 "Determines if this subsystem has run" ULONG CompuMethod_188 1 0 0 1 ECU_ADDRESS 0x40000244 BIT_MASK 0x00000400 /end MEASUREMENT
/begin MEASUREMENT CodeCoverParent004 "Run Status of Subsystems" ULONG CompuMethod_2 1 0 0 4294967295 ECU_ADDRESS 0x40000244 /end MEASUREMENT
/begin MEASUREMENT ConfigVerMaj "" UBYTE CompuMethod_1 1 0 0 255 ECU_ADDRESS 0x40000298 /end MEASUREMENT
/begin MEASUREMENT ConfigVerMin "" UBYTE CompuMethod_1 1 0 0 255 ECU_ADDRESS 0x40000299 /end MEASUREMENT
/begin MEASUREMENT Coolant_Fan "" FLOAT32_IEEE CompuMethod_2 1 0 -1E+17 1E+17 ECU_ADDRESS 0x400002CC /end MEASUREMENT
/begin MEASUREMENT Coolant_FanIdx "" UWORD CompuMethod_15 1 0 0 127.998 ECU_ADDRESS 0x400002D0 /end MEASUREMENT
/begin MEASUREMENT Coolant_FanIn "" FLOAT32_IEEE CompuMethod_2 1 0 -1E+17 1E+17 ECU_ADDRESS 0x400002D2 /end MEASUREMENT
/begin MEASUREMENT Coolant_Pump "" FLOAT32_IEEE CompuMethod_2 1 0 -1E+17 1E+17 ECU_ADDRESS 0x400002D6 /end MEASUREMENT
/begin MEASUREMENT Coolant_PumpIdx "" UWORD CompuMethod_15 1 0 0 127.998 ECU_ADDRESS 0x400002DA /end MEASUREMENT
/begin MEASUREMENT Coolant_PumpIn "" FLOAT32_IEEE CompuMethod_2 1 0 -1E+17 1E+17 ECU_ADDRESS 0x400002DC /end MEASUREMENT
/begin MEASUREMENT CoolantPumpSpeed_out "" FLOAT32_IEEE CompuMethod_2 1 0 -1E+17 1E+17 ECU_ADDRESS 0x400002E0 /end MEASUREMENT
/begin MEASUREMENT Counter_Prb "" FLOAT32_IEEE CompuMethod_2 1 0 -1E+17 1E+17 ECU_ADDRESS 0x400002E4 /end MEASUREMENT
/begin MEASUREMENT CPUIdlePcent "Percentage of the CPU time spent servicing idle priority work." UWORD CompuMethod_193 1 0 0 99.9999 ECU_ADDRESS 0x400002E8 /end MEASUREMENT
/begin MEASUREMENT CPUTime_AppISR "Percentage of the CPU time spent executing the periodic timer interrupt" UWORD CompuMethod_193 1 0 0 99.9999 ECU_ADDRESS 0x400002EA /end MEASUREMENT
/begin MEASUREMENT CPUTime_Bgnd "Percentage of the CPU time spent servicing background priority tasks" UWORD CompuMethod_193 1 0 0 99.9999 ECU_ADDRESS 0x400002EC /end MEASUREMENT
/begin MEASUREMENT CPUTime_CAN "Percentage of the CPU time spent executing CAN interrupts" UWORD CompuMethod_193 1 0 0 99.9999 ECU_ADDRESS 0x400002EE /end MEASUREMENT
/begin MEASUREMENT CPUTime_FgndAngle "Percentage of the CPU time spent executing application callbacks due to framework events" UWORD CompuMethod_193 1 0 0 99.9999 ECU_ADDRESS 0x400002F0 /end MEASUREMENT
/begin MEASUREMENT CPUTime_FgndTime "Percentage of the CPU time spent servicing background priority tasks" UWORD CompuMethod_193 1 0 0 99.9999 ECU_ADDRESS 0x400002F2 /end MEASUREMENT
/begin MEASUREMENT CPUTime_MIOS "Percentage of the CPU time spent executing MIOS interrupts" UWORD CompuMethod_193 1 0 0 99.9999 ECU_ADDRESS 0x400002F4 /end MEASUREMENT
/begin MEASUREMENT CPUTime_Serial "Percentage of the CPU time spent executing serial interrupts" UWORD CompuMethod_193 1 0 0 99.9999 ECU_ADDRESS 0x400002F6 /end MEASUREMENT
/begin MEASUREMENT CPUTime_TimerISR "Percentage of the CPU time spent executing the periodic timer interrupt" UWORD CompuMethod_193 1 0 0 99.9999 ECU_ADDRESS 0x400002F8 /end MEASUREMENT
/begin MEASUREMENT CPUTime_TPU "Percentage of the CPU time spent executing TPU interrupts" UWORD CompuMethod_193 1 0 0 99.9999 ECU_ADDRESS 0x400002FA /end MEASUREMENT
/begin MEASUREMENT Current_Limit_Probe "" FLOAT32_IEEE CompuMethod_2 1 0 -1E+17 1E+17 ECU_ADDRESS 0x400002FC /end MEASUREMENT
/begin MEASUREMENT Current_Transducer_Fault_IbusIleg "" FLOAT32_IEEE CompuMethod_2 1 0 -1E+17 1E+17 ECU_ADDRESS 0x40000300 /end MEASUREMENT
/begin MEASUREMENT DC_Voltage "" FLOAT32_IEEE CompuMethod_2 1 0 -1E+17 1E+17 ECU_ADDRESS 0x40000304 /end MEASUREMENT
/begin MEASUREMENT Drive_Ready_Prb "" UBYTE CompuMethod_27 1 0 0 1 ECU_ADDRESS 0x4000030E /end MEASUREMENT
/begin MEASUREMENT Eaton_HV_Charger_Temperature_probe "" FLOAT32_IEEE CompuMethod_2 1 0 -1E+17 1E+17 ECU_ADDRESS 0x4000030F /end MEASUREMENT
/begin MEASUREMENT EatonpluggedIn "" UBYTE CompuMethod_27 1 0 0 1 ECU_ADDRESS 0x40000313 /end MEASUREMENT
/begin MEASUREMENT EHPAS_Fault "" FLOAT32_IEEE CompuMethod_2 1 0 -1E+17 1E+17 ECU_ADDRESS 0x40000314 /end MEASUREMENT
/begin MEASUREMENT EHPAS_Input_Current_NA "" FLOAT32_IEEE CompuMethod_2 1 0 -1E+17 1E+17 ECU_ADDRESS 0x40000318 /end MEASUREMENT
/begin MEASUREMENT EHPAS_Input_Voltage "" FLOAT32_IEEE CompuMethod_2 1 0 -1E+17 1E+17 ECU_ADDRESS 0x4000031C /end MEASUREMENT
/begin MEASUREMENT EHPAS_Op_State "" FLOAT32_IEEE CompuMethod_2 1 0 -1E+17 1E+17 ECU_ADDRESS 0x40000320 /end MEASUREMENT
/begin MEASUREMENT EHPAS_Pump_Speed "" FLOAT32_IEEE CompuMethod_2 1 0 -1E+17 1E+17 ECU_ADDRESS 0x40000325 /end MEASUREMENT
/begin MEASUREMENT EHPAS_PumpState_probe "" UBYTE CompuMethod_199 1 0 0 255 ECU_ADDRESS 0x40000329 /end MEASUREMENT
/begin MEASUREMENT EHPAS_TempCur "" FLOAT32_IEEE CompuMethod_2 1 0 -1E+17 1E+17 ECU_ADDRESS 0x4000032A /end MEASUREMENT
/begin MEASUREMENT EHPAS_TempMax "" FLOAT32_IEEE CompuMethod_2 1 0 -1E+17 1E+17 ECU_ADDRESS 0x4000032E /end MEASUREMENT
/begin MEASUREMENT FaultSeverityIndicator "" FLOAT32_IEEE CompuMethod_2 1 0 -1E+17 1E+17 ECU_ADDRESS 0x40000379 /end MEASUREMENT
/begin MEASUREMENT FgndAngleStackMinBytesFree "Min bytes observed on the Foreground Angle Stack (may not exist depending onapplication)" ULONG CompuMethod_31 1 0 0 0 ECU_ADDRESS 0x4000037D /end MEASUREMENT
/begin MEASUREMENT FgndAngTaskStatus "Foreground Time Scheduler Status" UBYTE CompuMethod_30 1 0 0 0 ECU_ADDRESS 0x40000381 /end MEASUREMENT
/begin MEASUREMENT FgndTimeStackMinBytesFree "Min bytes observed on the Foreground Time Stack" ULONG CompuMethod_31 1 0 0 0 ECU_ADDRESS 0x40000382 /end MEASUREMENT
/begin MEASUREMENT Flash_Reverse_Lights_Probe "" FLOAT32_IEEE CompuMethod_2 1 0 -1E+17 1E+17 ECU_ADDRESS 0x40000386 /end MEASUREMENT
/begin MEASUREMENT Forced_Open_Loop "" FLOAT32_IEEE CompuMethod_2 1 0 -1E+17 1E+17 ECU_ADDRESS 0x4000038A /end MEASUREMENT
/begin MEASUREMENT Forced_Voltage_Control "" FLOAT32_IEEE CompuMethod_2 1 0 -1E+17 1E+17 ECU_ADDRESS 0x4000038E /end MEASUREMENT
/begin MEASUREMENT High_Bound "" FLOAT32_IEEE CompuMethod_2 1 0 -1E+17 1E+17 ECU_ADDRESS 0x4000039D /end MEASUREMENT
/begin MEASUREMENT hsc_bcm_enable "" UBYTE CompuMethod_1 1 0 0 255 ECU_ADDRESS 0x400003A1 /end MEASUREMENT
/begin MEASUREMENT hsc_bcm_epo "" UBYTE CompuMethod_1 1 0 0 255 ECU_ADDRESS 0x400003A2 /end MEASUREMENT
/begin MEASUREMENT hsc_bcm_leakage_enable "" UBYTE CompuMethod_27 1 0 0 1 ECU_ADDRESS 0x400003A3 /end MEASUREMENT
/begin MEASUREMENT hsc_bcm_mainc_enable "" UBYTE CompuMethod_27 1 0 0 1 ECU_ADDRESS 0x400003A4 /end MEASUREMENT
/begin MEASUREMENT IdleStackMinBytesFree "Min bytes observed on the Idle Stack" ULONG CompuMethod_31 1 0 0 0 ECU_ADDRESS 0x400003A5 /end MEASUREMENT
/begin MEASUREMENT IgnitionStatus "" FLOAT32_IEEE CompuMethod_2 1 0 -1E+17 1E+17 ECU_ADDRESS 0x400003A9 /end MEASUREMENT
/begin MEASUREMENT InputCurrentLimitMax "" FLOAT32_IEEE CompuMethod_2 1 0 -1E+17 1E+17 ECU_ADDRESS 0x400003B2 /end MEASUREMENT
/begin MEASUREMENT InterruptStackMinBytesFree "Minimum observed stack free for use by the interrupts" UWORD CompuMethod_217 1 0 0 65535 ECU_ADDRESS 0x400003D2 /end MEASUREMENT
/begin MEASUREMENT IntStallTorque "" FLOAT32_IEEE CompuMethod_2 1 0 -1E+17 1E+17 ECU_ADDRESS 0x400003D4 /end MEASUREMENT
/begin MEASUREMENT Invalid_Power_Supply "" FLOAT32_IEEE CompuMethod_2 1 0 -1E+17 1E+17 ECU_ADDRESS 0x400003D8 /end MEASUREMENT
/begin MEASUREMENT Inverter_Fault "" FLOAT32_IEEE CompuMethod_2 1 0 -1E+17 1E+17 ECU_ADDRESS 0x400003DC /end MEASUREMENT
/begin MEASUREMENT Inverter_Fault_History "" FLOAT32_IEEE CompuMethod_2 1 0 -1E+17 1E+17 ECU_ADDRESS 0x400003E0 /end MEASUREMENT
/begin MEASUREMENT Inverter_Fault_Occured "" FLOAT32_IEEE CompuMethod_2 1 0 -1E+17 1E+17 ECU_ADDRESS 0x400003E4 /end MEASUREMENT
/begin MEASUREMENT Inverter_Fault_Occured_History "" FLOAT32_IEEE CompuMethod_2 1 0 -1E+17 1E+17 ECU_ADDRESS 0x400003E8 /end MEASUREMENT
/begin MEASUREMENT Inverter_Over_Temperature_History "" FLOAT32_IEEE CompuMethod_2 1 0 -1E+17 1E+17 ECU_ADDRESS 0x400003EC /end MEASUREMENT
/begin MEASUREMENT Inverter_Over_Temperautre "" FLOAT32_IEEE CompuMethod_2 1 0 -1E+17 1E+17 ECU_ADDRESS 0x400003F0 /end MEASUREMENT
/begin MEASUREMENT Inverter_Temperature "" FLOAT32_IEEE CompuMethod_2 1 0 -1E+17 1E+17 ECU_ADDRESS 0x400003F4 /end MEASUREMENT
/begin MEASUREMENT LastOSError "Monitor of Internal OS Errors" UBYTE CompuMethod_221 1 0 0 0 ECU_ADDRESS 0x40000400 /end MEASUREMENT
/begin MEASUREMENT Leg_Current "" FLOAT32_IEEE CompuMethod_2 1 0 -1E+17 1E+17 ECU_ADDRESS 0x40000401 /end MEASUREMENT
/begin MEASUREMENT Limp_Home_Mode "" FLOAT32_IEEE CompuMethod_2 1 0 -1E+17 1E+17 ECU_ADDRESS 0x40000405 /end MEASUREMENT
/begin MEASUREMENT Limp_Home_Mode_History "" FLOAT32_IEEE CompuMethod_2 1 0 -1E+17 1E+17 ECU_ADDRESS 0x40000409 /end MEASUREMENT
/begin MEASUREMENT LinkStatus "This is the Status of the Comms link." UBYTE CompuMethod_1 1 0 0 255 ECU_ADDRESS 0x4000040D /end MEASUREMENT
/begin MEASUREMENT Low_Bound "" FLOAT32_IEEE CompuMethod_2 1 0 -1E+17 1E+17 ECU_ADDRESS 0x4000040E /end MEASUREMENT
/begin MEASUREMENT Mains_Current_Draw_Probe "" FLOAT32_IEEE CompuMethod_2 1 0 -1E+17 1E+17 ECU_ADDRESS 0x4000041C /end MEASUREMENT
/begin MEASUREMENT Mains_Voltage_Probe "" FLOAT32_IEEE CompuMethod_2 1 0 -1E+17 1E+17 ECU_ADDRESS 0x40000420 /end MEASUREMENT
/begin MEASUREMENT MessageChecksum "" FLOAT32_IEEE CompuMethod_2 1 0 -1E+17 1E+17 ECU_ADDRESS 0x40000475 /end MEASUREMENT
/begin MEASUREMENT MessageCounter "" FLOAT32_IEEE CompuMethod_2 1 0 -1E+17 1E+17 ECU_ADDRESS 0x40000479 /end MEASUREMENT
/begin MEASUREMENT ModuleCapability "" UBYTE CompuMethod_228 1 0 0 255 ECU_ADDRESS 0x40000484 /end MEASUREMENT
/begin MEASUREMENT MotoHawkModelSecondsInUse "Total runtime of this MotoHawk software model" ULONG CompuMethod_229 1 0 0 4294970000 ECU_ADDRESS 0x40000575 /end MEASUREMENT
/begin MEASUREMENT Motor_Derate "" FLOAT32_IEEE CompuMethod_2 1 0 -1E+17 1E+17 ECU_ADDRESS 0x400005FB /end MEASUREMENT
/begin MEASUREMENT Motor_Not_Enabled "" FLOAT32_IEEE CompuMethod_2 1 0 -1E+17 1E+17 ECU_ADDRESS 0x400005FF /end MEASUREMENT
/begin MEASUREMENT Motor_Not_Enabled_History "" FLOAT32_IEEE CompuMethod_2 1 0 -1E+17 1E+17 ECU_ADDRESS 0x40000603 /end MEASUREMENT
/begin MEASUREMENT Motor_Shutdown "" FLOAT32_IEEE CompuMethod_2 1 0 -1E+17 1E+17 ECU_ADDRESS 0x40000607 /end MEASUREMENT
/begin MEASUREMENT Motor_Stalled "" FLOAT32_IEEE CompuMethod_2 1 0 -1E+17 1E+17 ECU_ADDRESS 0x4000060B /end MEASUREMENT
/begin MEASUREMENT motor_Torque "" FLOAT32_IEEE CompuMethod_33 1 0 -1E+17 1E+17 ECU_ADDRESS 0x4000060F /end MEASUREMENT
/begin MEASUREMENT MotorSpdIdx "" UWORD CompuMethod_15 1 0 0 127.998 ECU_ADDRESS 0x40000613 /end MEASUREMENT
/begin MEASUREMENT MotorSpdIn "" FLOAT32_IEEE CompuMethod_2 1 0 -1E+17 1E+17 ECU_ADDRESS 0x40000615 /end MEASUREMENT
/begin MEASUREMENT OSErrorCnt "Number of errors observed by the OS" UBYTE CompuMethod_1 1 0 0 255 ECU_ADDRESS 0x40000623 /end MEASUREMENT
/begin MEASUREMENT OSStatus "" UBYTE CompuMethod_235 1 0 0 0 ECU_ADDRESS 0x40000624 /end MEASUREMENT
/begin MEASUREMENT OutputCurrent "" FLOAT32_IEEE CompuMethod_2 1 0 -1E+17 1E+17 ECU_ADDRESS 0x40000625 /end MEASUREMENT
/begin MEASUREMENT OutputVoltage "" FLOAT32_IEEE CompuMethod_2 1 0 -1E+17 1E+17 ECU_ADDRESS 0x40000629 /end MEASUREMENT
/begin MEASUREMENT Over_Bus_Current "" FLOAT32_IEEE CompuMethod_2 1 0 -1E+17 1E+17 ECU_ADDRESS 0x4000062D /end MEASUREMENT
/begin MEASUREMENT Over_Bus_Current_History "" FLOAT32_IEEE CompuMethod_2 1 0 -1E+17 1E+17 ECU_ADDRESS 0x40000631 /end MEASUREMENT
/begin MEASUREMENT Over_Leg_Current "" FLOAT32_IEEE CompuMethod_2 1 0 -1E+17 1E+17 ECU_ADDRESS 0x40000635 /end MEASUREMENT
/begin MEASUREMENT Over_Leg_Current_History "" FLOAT32_IEEE CompuMethod_2 1 0 -1E+17 1E+17 ECU_ADDRESS 0x40000639 /end MEASUREMENT
/begin MEASUREMENT Over_Phase_Advance "" FLOAT32_IEEE CompuMethod_2 1 0 -1E+17 1E+17 ECU_ADDRESS 0x4000063D /end MEASUREMENT
/begin MEASUREMENT Over_Phase_Advance_History "" FLOAT32_IEEE CompuMethod_2 1 0 -1E+17 1E+17 ECU_ADDRESS 0x40000641 /end MEASUREMENT
/begin MEASUREMENT Over_Speed_Alarm "" FLOAT32_IEEE CompuMethod_2 1 0 -1E+17 1E+17 ECU_ADDRESS 0x40000645 /end MEASUREMENT
/begin MEASUREMENT Over_Speed_Alarm_History "" FLOAT32_IEEE CompuMethod_2 1 0 -1E+17 1E+17 ECU_ADDRESS 0x40000649 /end MEASUREMENT
/begin MEASUREMENT Over_Speed_Warning "" FLOAT32_IEEE CompuMethod_2 1 0 -1E+17 1E+17 ECU_ADDRESS 0x4000064D /end MEASUREMENT
/begin MEASUREMENT Over_Speed_Warning_History "" FLOAT32_IEEE CompuMethod_2 1 0 -1E+17 1E+17 ECU_ADDRESS 0x40000651 /end MEASUREMENT
/begin MEASUREMENT Over_Voltage_Alarm "" FLOAT32_IEEE CompuMethod_2 1 0 -1E+17 1E+17 ECU_ADDRESS 0x40000655 /end MEASUREMENT
/begin MEASUREMENT Over_Voltage_Alarm_History "" FLOAT32_IEEE CompuMethod_2 1 0 -1E+17 1E+17 ECU_ADDRESS 0x40000659 /end MEASUREMENT
/begin MEASUREMENT Over_Voltage_Warning "" FLOAT32_IEEE CompuMethod_2 1 0 -1E+17 1E+17 ECU_ADDRESS 0x4000065D /end MEASUREMENT
/begin MEASUREMENT Over_Voltage_Warning_History "" FLOAT32_IEEE CompuMethod_2 1 0 -1E+17 1E+17 ECU_ADDRESS 0x40000661 /end MEASUREMENT
/begin MEASUREMENT PeakHeapBytesUsed "The peak number of bytes seen on the heap." ULONG CompuMethod_29 1 0 0 0 ECU_ADDRESS 0x4000068D /end MEASUREMENT
/begin MEASUREMENT Phase_Current_Sensor_Error "" FLOAT32_IEEE CompuMethod_2 1 0 -1E+17 1E+17 ECU_ADDRESS 0x40000691 /end MEASUREMENT
/begin MEASUREMENT Power_Switches_Off "" FLOAT32_IEEE CompuMethod_2 1 0 -1E+17 1E+17 ECU_ADDRESS 0x40000695 /end MEASUREMENT
/begin MEASUREMENT pre_Filter_Torque_Request "" FLOAT32_IEEE CompuMethod_2 1 0 -1E+17 1E+17 ECU_ADDRESS 0x40000699 /end MEASUREMENT
/begin MEASUREMENT protocol_register_CAN_1 "Debug Variable" UBYTE CompuMethod_19 1 0 0 0 ECU_ADDRESS 0x4000069D /end MEASUREMENT
/begin MEASUREMENT RadiatorFanSpeed_out "" FLOAT32_IEEE CompuMethod_2 1 0 -1E+17 1E+17 ECU_ADDRESS 0x400006A0 /end MEASUREMENT
/begin MEASUREMENT Raw_Regen_Tq_Request "" FLOAT32_IEEE CompuMethod_2 1 0 -1E+17 1E+17 ECU_ADDRESS 0x400006A4 /end MEASUREMENT
/begin MEASUREMENT Regen_SOCSpd_Ramp_probe_preOVR "" FLOAT32_IEEE CompuMethod_2 1 0 -1E+17 1E+17 ECU_ADDRESS 0x400006A8 /end MEASUREMENT
/begin MEASUREMENT Regen_Switch_Open "" FLOAT32_IEEE CompuMethod_2 1 0 -1E+17 1E+17 ECU_ADDRESS 0x400006AC /end MEASUREMENT
/begin MEASUREMENT RegenBatteryLimits "" FLOAT32_IEEE CompuMethod_33 1 0 -1E+17 1E+17 ECU_ADDRESS 0x400006B0 /end MEASUREMENT
/begin MEASUREMENT Rotor_Over_Temperature "" FLOAT32_IEEE CompuMethod_2 1 0 -1E+17 1E+17 ECU_ADDRESS 0x400006BB /end MEASUREMENT
/begin MEASUREMENT Rotor_Over_Temperature_History "" FLOAT32_IEEE CompuMethod_2 1 0 -1E+17 1E+17 ECU_ADDRESS 0x400006BF /end MEASUREMENT
/begin MEASUREMENT Rotor_Temp "" FLOAT32_IEEE CompuMethod_2 1 0 -1E+17 1E+17 ECU_ADDRESS 0x400006C3 /end MEASUREMENT
/begin MEASUREMENT Software_Release_Major_Version "" FLOAT32_IEEE CompuMethod_2 1 0 -1E+17 1E+17 ECU_ADDRESS 0x400006CA /end MEASUREMENT
/begin MEASUREMENT Software_Release_Minor_Version "" FLOAT32_IEEE CompuMethod_2 1 0 -1E+17 1E+17 ECU_ADDRESS 0x400006CE /end MEASUREMENT
/begin MEASUREMENT Software_Release_Sub_Version "" FLOAT32_IEEE CompuMethod_2 1 0 -1E+17 1E+17 ECU_ADDRESS 0x400006D2 /end MEASUREMENT
/begin MEASUREMENT Stall_Safety_Percentage "" FLOAT32_IEEE CompuMethod_2 1 0 -1E+17 1E+17 ECU_ADDRESS 0x400006D6 /end MEASUREMENT
/begin MEASUREMENT StateOfChargePctIdx "" UWORD CompuMethod_15 1 0 0 127.998 ECU_ADDRESS 0x400006DA /end MEASUREMENT
/begin MEASUREMENT StateOfChargePctIn "" FLOAT32_IEEE CompuMethod_2 1 0 -1E+17 1E+17 ECU_ADDRESS 0x400006DC /end MEASUREMENT
/begin MEASUREMENT Stator_Over_Temperature "" FLOAT32_IEEE CompuMethod_2 1 0 -1E+17 1E+17 ECU_ADDRESS 0x400006E0 /end MEASUREMENT
/begin MEASUREMENT Stator_Over_Temperature_History "" FLOAT32_IEEE CompuMethod_2 1 0 -1E+17 1E+17 ECU_ADDRESS 0x400006E4 /end MEASUREMENT
/begin MEASUREMENT Stator_Temp "" FLOAT32_IEEE CompuMethod_2 1 0 -1E+17 1E+17 ECU_ADDRESS 0x400006E8 /end MEASUREMENT
/begin MEASUREMENT Status_A "" FLOAT32_IEEE CompuMethod_2 1 0 -1E+17 1E+17 ECU_ADDRESS 0x400006EC /end MEASUREMENT
/begin MEASUREMENT Status_C "" FLOAT32_IEEE CompuMethod_2 1 0 -1E+17 1E+17 ECU_ADDRESS 0x400006F0 /end MEASUREMENT
/begin MEASUREMENT SWISRCurrQueueSize "Current size of the Software ISR Queue" UBYTE CompuMethod_244 1 0 0 255 ECU_ADDRESS 0x400006F4 /end MEASUREMENT
/begin MEASUREMENT System_Disabled_In_Motrion "" FLOAT32_IEEE CompuMethod_2 1 0 -1E+17 1E+17 ECU_ADDRESS 0x400006F5 /end MEASUREMENT
/begin MEASUREMENT SystemFrequency "The operating CPU frequency." ULONG CompuMethod_245 1 0 0 56 ECU_ADDRESS 0x400006F9 /end MEASUREMENT
/begin MEASUREMENT TimeSinceKeyOn "" FLOAT32_IEEE CompuMethod_2 1 0 -1E+17 1E+17 ECU_ADDRESS 0x400006FD /end MEASUREMENT
/begin MEASUREMENT Torque_Desired "" FLOAT32_IEEE CompuMethod_2 1 0 -1E+17 1E+17 ECU_ADDRESS 0x40000701 /end MEASUREMENT
/begin MEASUREMENT TPUMaskType "Describes the TPU Mask selected for use." UBYTE CompuMethod_247 1 0 0 0 ECU_ADDRESS 0x40000705 /end MEASUREMENT
/begin MEASUREMENT TPUMaskVers "Describes the version of the TPU Mask selected." UBYTE CompuMethod_27 1 0 0 255 ECU_ADDRESS 0x40000706 /end MEASUREMENT
/begin MEASUREMENT Turbo_Mode "" FLOAT32_IEEE CompuMethod_2 1 0 -1E+17 1E+17 ECU_ADDRESS 0x40000707 /end MEASUREMENT
/begin MEASUREMENT Under_Voltage_Warning "" FLOAT32_IEEE CompuMethod_2 1 0 -1E+17 1E+17 ECU_ADDRESS 0x4000070B /end MEASUREMENT
/begin MEASUREMENT Under_Voltage_Warning_History "" FLOAT32_IEEE CompuMethod_2 1 0 -1E+17 1E+17 ECU_ADDRESS 0x4000070F /end MEASUREMENT
/begin MEASUREMENT Unused "Unused Table Entry" UBYTE CompuMethod_1 1 0 0 255 ECU_ADDRESS 0x40000713 /end MEASUREMENT
/begin MEASUREMENT UQM_Direction "" UBYTE CompuMethod_249 1 0 0 1 ECU_ADDRESS 0x40000714 /end MEASUREMENT
/begin MEASUREMENT UQM_Enable "" UBYTE CompuMethod_27 1 0 0 1 ECU_ADDRESS 0x40000715 /end MEASUREMENT
/begin MEASUREMENT UQM_Torque "" FLOAT32_IEEE CompuMethod_2 1 0 -1E+17 1E+17 ECU_ADDRESS 0x40000716 /end MEASUREMENT
/begin MEASUREMENT Using_Raw_Speed "" FLOAT32_IEEE CompuMethod_2 1 0 -1E+17 1E+17 ECU_ADDRESS 0x4000071A /end MEASUREMENT
/begin MEASUREMENT Voltage_Limit_Probe "" FLOAT32_IEEE CompuMethod_2 1 0 -1E+17 1E+17 ECU_ADDRESS 0x40000726 /end MEASUREMENT
/begin MEASUREMENT Watchdog_Error "" FLOAT32_IEEE CompuMethod_2 1 0 -1E+17 1E+17 ECU_ADDRESS 0x4000072A /end MEASUREMENT
/begin MEASUREMENT Watchdog_Status "" FLOAT32_IEEE CompuMethod_2 1 0 -1E+17 1E+17 ECU_ADDRESS 0x4000072E /end MEASUREMENT
/*~~~~~~~~~ 6.3.27 CHARACTERISTICs ~~~~~~~~~*/
/begin CHARACTERISTIC project_id "This is the Platform ID used by the tools." VALUE 0x80000900 RecordLayout_1 0 CompuMethod_1 0 255 /end CHARACTERISTIC
/begin CHARACTERISTIC SwIdTxt "Software Format ID" ASCII 0x4000000A RecordLayout_2 0 CompuMethod_2 0 255 NUMBER 13 MATRIX_DIM 13 1 1 READ_ONLY /end CHARACTERISTIC
/begin CHARACTERISTIC CalIdTxt "Calibration ID" ASCII 0x80000002 RecordLayout_2 0 CompuMethod_2 0 255 NUMBER 33 MATRIX_DIM 33 1 1 /end CHARACTERISTIC
/begin CHARACTERISTIC SwRevisionTxt "Software Revision ID" ASCII 0x40000017 RecordLayout_2 0 CompuMethod_2 0 255 NUMBER 50 MATRIX_DIM 50 1 1 READ_ONLY /end CHARACTERISTIC
/begin CHARACTERISTIC FriendlyName "The device's friendly name." ASCII 0x8000002C RecordLayout_2 0 CompuMethod_2 0 255 NUMBER 33 MATRIX_DIM 33 1 1 /end CHARACTERISTIC
/begin CHARACTERISTIC ProductID "Customer's ID used by the tools." VALUE 0x8000004D RecordLayout_3 0 CompuMethod_3 0 4294970000 /end CHARACTERISTIC
/begin CHARACTERISTIC SerialNumber "" ASCII 0x400000B2 RecordLayout_2 0 CompuMethod_2 0 255 NUMBER 50 MATRIX_DIM 50 1 1 READ_ONLY /end CHARACTERISTIC
/begin CHARACTERISTIC ModelNumber "" ASCII 0x400000E4 RecordLayout_2 0 CompuMethod_2 0 255 NUMBER 50 MATRIX_DIM 50 1 1 READ_ONLY /end CHARACTERISTIC
/begin CHARACTERISTIC A123_Isolation_Monitor_Ground_Fault_Threshold "gfi monitor threshold below which ground fault will be triggered" VALUE 0x80000051 RecordLayout_4 0 CompuMethod_4 -1E+17 1E+17 /end CHARACTERISTIC
/begin CHARACTERISTIC Accel_DfltValue "This is the initial default value should the sensor be in fault on key-up.  Otherwise the sensors outputs the last value prior to faulting" VALUE 0x80000055 RecordLayout_4 0 CompuMethod_6 -1E+17 1E+17 /end CHARACTERISTIC
/begin CHARACTERISTIC Accel_FilterConst "Filter time constant" VALUE 0x80000059 RecordLayout_4 0 CompuMethod_7 -1E+17 1E+17 /end CHARACTERISTIC
/begin CHARACTERISTIC Accel_Full "Offset after gain in engineering units" VALUE 0x8000005D RecordLayout_4 0 CompuMethod_6 -1E+17 1E+17 /end CHARACTERISTIC
/begin CHARACTERISTIC Accel_InputHiFltPos "Maximum allowable input, indicating short or open circuit" VALUE 0x80000061 RecordLayout_4 0 CompuMethod_8 -1E+17 1E+17 /end CHARACTERISTIC
/begin CHARACTERISTIC Accel_InputLoFltPos "Minimum allowable input, indicating short or open circuit" VALUE 0x80000065 RecordLayout_4 0 CompuMethod_8 -1E+17 1E+17 /end CHARACTERISTIC
/begin CHARACTERISTIC Accel_Pedal_new "Override result of linear sensor characterization, in engineering units" VALUE 0x80000069 RecordLayout_4 0 CompuMethod_6 -1E+17 1E+17 /end CHARACTERISTIC
/begin CHARACTERISTIC Accel_Pedal_ovr "" VALUE 0x8000006D RecordLayout_1 0 CompuMethod_9 0 1 /end CHARACTERISTIC
/begin CHARACTERISTIC Accel_Pedal_Pin "Analog input pin selection for Accel_Pedal_Pin" VALUE 0x8000006E RecordLayout_5 0 CompuMethod_10 -32768 32767 /end CHARACTERISTIC
/begin CHARACTERISTIC Accel_Pedal_Pin_ref "Reference Voltage Selection" VALUE 0x80000070 RecordLayout_1 0 CompuMethod_11 0 255 /end CHARACTERISTIC
/begin CHARACTERISTIC Accel_Zero "Scaling from A/D counts to engineering units" VALUE 0x80000071 RecordLayout_4 0 CompuMethod_12 -1E+17 1E+17 /end CHARACTERISTIC
/begin CHARACTERISTIC Acceleration_Limit "" VALUE 0x80000075 RecordLayout_4 0 CompuMethod_2 -1E+17 1E+17 /end CHARACTERISTIC
/begin CHARACTERISTIC AccelPedalMap_v2Tbl "" CURVE 0x800000AD RecordLayout_4 0 CompuMethod_14 -1E+17 1E+17
 /begin AXIS_DESCR COM_AXIS AccelPedalMap_v2In CompuMethod_2 13 -1E+17 1E+17 AXIS_PTS_REF AccelPedalMap_v2IdxArr /end AXIS_DESCR
/end CHARACTERISTIC
/begin CHARACTERISTIC AccelRstSpd "%" VALUE 0x800000E1 RecordLayout_4 0 CompuMethod_16 -1E+17 1E+17 /end CHARACTERISTIC
/begin CHARACTERISTIC AccelRstThres "Below this accel position fault can reset." VALUE 0x800000E5 RecordLayout_4 0 CompuMethod_17 0 1 /end CHARACTERISTIC
/begin CHARACTERISTIC Allow_MainContactor_Close "1=normal mode, 0=prevent main contactors from closing" VALUE 0x800000E9 RecordLayout_1 0 CompuMethod_20 0 1 /end CHARACTERISTIC
/begin CHARACTERISTIC ApplicationMonitorEnable "Enables runtime checking of stack, heap, CPU, and OS errors.  Stops the application on error." VALUE 0x800000EA RecordLayout_1 0 CompuMethod_22 0 1 /end CHARACTERISTIC
/begin CHARACTERISTIC ApplicationPausePoint "Selects the startup pause point, for debugging.  Can be moved forward to step through the initialization" VALUE 0x800000EB RecordLayout_1 0 CompuMethod_23 0 3 /end CHARACTERISTIC
/begin CHARACTERISTIC ApplicationStatus "View and set the application runtime status" VALUE 0x800000EC RecordLayout_1 0 CompuMethod_24 1 3 /end CHARACTERISTIC
/begin CHARACTERISTIC Batt_Load_Enable "" VALUE 0x800000ED RecordLayout_1 0 CompuMethod_27 0 1 /end CHARACTERISTIC
/begin CHARACTERISTIC Battery_OverTemp_Threshold "Temperature at which an overtemp fault occurs" VALUE 0x800000EE RecordLayout_4 0 CompuMethod_28 -1E+17 1E+17 /end CHARACTERISTIC
/begin CHARACTERISTIC Battery_UnderTemp_Threshold "Temperature at which an undertemp fault occurs" VALUE 0x800000F2 RecordLayout_4 0 CompuMethod_28 -1E+17 1E+17 /end CHARACTERISTIC
/begin CHARACTERISTIC bcm_cell_overvolt_ovr_new "" VALUE 0x800000F6 RecordLayout_4 0 CompuMethod_2 -1E+17 1E+17 /end CHARACTERISTIC
/begin CHARACTERISTIC bcm_cell_overvolt_ovr_ovr "" VALUE 0x800000FA RecordLayout_1 0 CompuMethod_9 0 1 /end CHARACTERISTIC
/begin CHARACTERISTIC bcm_chargec_stat_new "" VALUE 0x800000FB RecordLayout_1 0 CompuMethod_27 0 1 /end CHARACTERISTIC
/begin CHARACTERISTIC bcm_chargec_stat_ovr "" VALUE 0x800000FC RecordLayout_1 0 CompuMethod_9 0 1 /end CHARACTERISTIC
/begin CHARACTERISTIC bcm_mainc_stat_new "" VALUE 0x800000FD RecordLayout_1 0 CompuMethod_27 0 1 /end CHARACTERISTIC
/begin CHARACTERISTIC bcm_mainc_stat_ovr "" VALUE 0x800000FE RecordLayout_1 0 CompuMethod_9 0 1 /end CHARACTERISTIC
/begin CHARACTERISTIC bcm_ready_new "" VALUE 0x800000FF RecordLayout_4 0 CompuMethod_2 -1E+17 1E+17 /end CHARACTERISTIC
/begin CHARACTERISTIC bcm_ready_ovr "" VALUE 0x80000103 RecordLayout_1 0 CompuMethod_9 0 1 /end CHARACTERISTIC
/begin CHARACTERISTIC BGND_BASE_PERIODIC_RunCnt "The number of times to execute BGND_BASE_PERIODIC before pausing.  -1 means run forever" VALUE 0x80000104 RecordLayout_7 0 CompuMethod_29 -1 2147480000 /end CHARACTERISTIC
/begin CHARACTERISTIC BGND_BASEx10_PERIODIC_RunCnt "The number of times to execute BGND_BASEx10_PERIODIC before pausing.  -1 means run forever" VALUE 0x80000108 RecordLayout_7 0 CompuMethod_29 -1 2147480000 /end CHARACTERISTIC
/begin CHARACTERISTIC BGND_BASEx2_PERIODIC_RunCnt "The number of times to execute BGND_BASEx2_PERIODIC before pausing.  -1 means run forever" VALUE 0x8000010C RecordLayout_7 0 CompuMethod_29 -1 2147480000 /end CHARACTERISTIC
/begin CHARACTERISTIC BGND_BASEx20_PERIODIC_RunCnt "The number of times to execute BGND_BASEx20_PERIODIC before pausing.  -1 means run forever" VALUE 0x80000110 RecordLayout_7 0 CompuMethod_29 -1 2147480000 /end CHARACTERISTIC
/begin CHARACTERISTIC BgndStackMargin "When the available stack space drops below this threshold, the application performs a safety stop" VALUE 0x80000114 RecordLayout_8 0 CompuMethod_29 0 2048 /end CHARACTERISTIC
/begin CHARACTERISTIC Brake_Active_Threshold "Percent at which the brake is considered triggered for pump activation" VALUE 0x80000116 RecordLayout_4 0 CompuMethod_6 -1E+17 1E+17 /end CHARACTERISTIC
/begin CHARACTERISTIC Brake_DfltValue "This is the initial default value should the sensor be in fault on key-up.  Otherwise the sensors outputs the last value prior to faulting" VALUE 0x8000011A RecordLayout_4 0 CompuMethod_6 -1E+17 1E+17 /end CHARACTERISTIC
/begin CHARACTERISTIC Brake_FilterConst "Filter time constant" VALUE 0x8000011E RecordLayout_4 0 CompuMethod_7 -1E+17 1E+17 /end CHARACTERISTIC
/begin CHARACTERISTIC Brake_Full "Offset after gain in engineering units" VALUE 0x80000122 RecordLayout_4 0 CompuMethod_6 -1E+17 1E+17 /end CHARACTERISTIC
/begin CHARACTERISTIC Brake_InputHiFltPos "Maximum allowable input, indicating short or open circuit" VALUE 0x80000126 RecordLayout_4 0 CompuMethod_8 -1E+17 1E+17 /end CHARACTERISTIC
/begin CHARACTERISTIC Brake_InputLoFltPos "Minimum allowable input, indicating short or open circuit" VALUE 0x8000012A RecordLayout_4 0 CompuMethod_8 -1E+17 1E+17 /end CHARACTERISTIC
/begin CHARACTERISTIC Brake_light_On_Setpoint "This is to change how far down on the peddle you need to push before the brake lights come on" VALUE 0x8000012E RecordLayout_4 0 CompuMethod_33 -1E+17 1E+17 /end CHARACTERISTIC
/begin CHARACTERISTIC Brake_Light_Out "Digital output pin selection for DOut179p001" VALUE 0x80000132 RecordLayout_5 0 CompuMethod_34 -32768 32767 /end CHARACTERISTIC
/begin CHARACTERISTIC Brake_Pedal_new "Override result of linear sensor characterization, in engineering units" VALUE 0x80000134 RecordLayout_4 0 CompuMethod_6 -1E+17 1E+17 /end CHARACTERISTIC
/begin CHARACTERISTIC Brake_Pedal_ovr "" VALUE 0x80000138 RecordLayout_1 0 CompuMethod_9 0 1 /end CHARACTERISTIC
/begin CHARACTERISTIC Brake_Pedal_Pin "Analog input pin selection for Brake_Pedal_Pin" VALUE 0x80000139 RecordLayout_5 0 CompuMethod_10 -32768 32767 /end CHARACTERISTIC
/begin CHARACTERISTIC Brake_Pedal_Pin_ref "Reference Voltage Selection" VALUE 0x8000013B RecordLayout_1 0 CompuMethod_11 0 255 /end CHARACTERISTIC
/begin CHARACTERISTIC Brake_Zero "Scaling from A/D counts to engineering units" VALUE 0x8000013C RecordLayout_4 0 CompuMethod_12 -1E+17 1E+17 /end CHARACTERISTIC
/begin CHARACTERISTIC brakeTime_sec "Time to run brake and power steering pump after switching out of reverse" VALUE 0x80000140 RecordLayout_4 0 CompuMethod_7 -1E+17 1E+17 /end CHARACTERISTIC
/begin CHARACTERISTIC CAN_Watchdog_Reset "" VALUE 0x80000144 RecordLayout_4 0 CompuMethod_2 -1E+17 1E+17 /end CHARACTERISTIC
/begin CHARACTERISTIC cCInd_LongOff "Long Off time in flash sequence." VALUE 0x80000148 RecordLayout_8 0 CompuMethod_35 0 100 /end CHARACTERISTIC
/begin CHARACTERISTIC cCInd_OnTime "On time in flash sequence." VALUE 0x8000014A RecordLayout_8 0 CompuMethod_35 0 100 /end CHARACTERISTIC
/begin CHARACTERISTIC cCInd_ShortTime "Short Off time in sequence." VALUE 0x8000014C RecordLayout_8 0 CompuMethod_35 0 100 /end CHARACTERISTIC
/begin CHARACTERISTIC CCP1_StationAddr "Station ID for CCP handler: CCP1" VALUE 0x8000014E RecordLayout_8 0 CompuMethod_29 0 65535 /end CHARACTERISTIC
/begin CHARACTERISTIC CCP1RxID "Receive CAN ID for CCP handler: CCP1" VALUE 0x80000150 RecordLayout_3 0 CompuMethod_18 0 4294970000 /end CHARACTERISTIC
/begin CHARACTERISTIC CCP1RxIDMask "Receive CAN ID Mask for CCP handler: CCP1" VALUE 0x80000154 RecordLayout_3 0 CompuMethod_18 0 4294970000 /end CHARACTERISTIC
/begin CHARACTERISTIC CCP1TxID "Transmit CAN ID for CCP handler: CCP1" VALUE 0x80000158 RecordLayout_3 0 CompuMethod_18 0 4294970000 /end CHARACTERISTIC
/begin CHARACTERISTIC Charge_Complete_Override_new "" VALUE 0x8000015C RecordLayout_1 0 CompuMethod_27 0 1 /end CHARACTERISTIC
/begin CHARACTERISTIC Charge_Complete_Override_ovr "" VALUE 0x8000015D RecordLayout_1 0 CompuMethod_9 0 1 /end CHARACTERISTIC
/begin CHARACTERISTIC Charge_Enable_Override_new "" VALUE 0x8000015E RecordLayout_1 0 CompuMethod_27 0 1 /end CHARACTERISTIC
/begin CHARACTERISTIC Charge_Enable_Override_ovr "" VALUE 0x8000015F RecordLayout_1 0 CompuMethod_9 0 1 /end CHARACTERISTIC
/begin CHARACTERISTIC Charge_Falt_Override_new "This tells the charger that there is a problem with the vehcile where the charger can not charge the vehicle." VALUE 0x80000160 RecordLayout_1 0 CompuMethod_22 0 255 /end CHARACTERISTIC
/begin CHARACTERISTIC Charge_Falt_Override_ovr "" VALUE 0x80000161 RecordLayout_1 0 CompuMethod_9 0 1 /end CHARACTERISTIC
/begin CHARACTERISTIC ChargeComplete_SOC "Max SOC that causes charger shutdown" VALUE 0x80000162 RecordLayout_4 0 CompuMethod_6 0 100 /end CHARACTERISTIC
/begin CHARACTERISTIC ChargeInterruptor_Voltage "Voltage at which to terminate charging via an EPO" VALUE 0x80000166 RecordLayout_4 0 CompuMethod_41 -1E+17 1E+17 /end CHARACTERISTIC
/begin CHARACTERISTIC Charger_Temp_Enable "" VALUE 0x8000016A RecordLayout_1 0 CompuMethod_22 0 255 /end CHARACTERISTIC
/begin CHARACTERISTIC Charger_Temp_Offset "" VALUE 0x8000016B RecordLayout_4 0 CompuMethod_2 -1E+17 1E+17 /end CHARACTERISTIC
/begin CHARACTERISTIC ChargerState_new "" VALUE 0x8000016F RecordLayout_4 0 CompuMethod_2 -1E+17 1E+17 /end CHARACTERISTIC
/begin CHARACTERISTIC ChargerState_ovr "" VALUE 0x80000173 RecordLayout_1 0 CompuMethod_9 0 1 /end CHARACTERISTIC
/begin CHARACTERISTIC CityID_CAN_1 "City ID for CAN bus CAN_1" VALUE 0x80000174 RecordLayout_1 0 CompuMethod_1 0 255 /end CHARACTERISTIC
/begin CHARACTERISTIC Command_Counter "" VALUE 0x80000175 RecordLayout_4 0 CompuMethod_2 -1E+17 1E+17 /end CHARACTERISTIC
/begin CHARACTERISTIC CompilerVersion "Compiler toolchain version used for the MotoHawk build" ASCII 0x40000248 RecordLayout_2 0 CompuMethod_2 0 255 NUMBER 80 MATRIX_DIM 80 1 1 READ_ONLY /end CHARACTERISTIC
/begin CHARACTERISTIC Contactor_Disable_Delay "" VALUE 0x80000179 RecordLayout_4 0 CompuMethod_189 0 10 /end CHARACTERISTIC
/begin CHARACTERISTIC Contactor_Shutdown_Test_new "" VALUE 0x8000017D RecordLayout_1 0 CompuMethod_27 0 1 /end CHARACTERISTIC
/begin CHARACTERISTIC Contactor_Shutdown_Test_ovr "" VALUE 0x8000017E RecordLayout_1 0 CompuMethod_9 0 1 /end CHARACTERISTIC
/begin CHARACTERISTIC Control_Mode "" VALUE 0x8000017F RecordLayout_1 0 CompuMethod_190 0 255 /end CHARACTERISTIC
/begin CHARACTERISTIC ControlCoreSDKRelease "ControlCoreSDK Build." ASCII 0x4000029A RecordLayout_2 0 CompuMethod_2 0 255 NUMBER 50 MATRIX_DIM 50 1 1 READ_ONLY /end CHARACTERISTIC
/begin CHARACTERISTIC Coolant_FanTbl "" CURVE 0x800001A8 RecordLayout_4 0 CompuMethod_2 -1E+17 1E+17
 /begin AXIS_DESCR COM_AXIS Coolant_FanIn CompuMethod_2 10 -1E+17 1E+17 AXIS_PTS_REF Coolant_FanIdxArr /end AXIS_DESCR
/end CHARACTERISTIC
/begin CHARACTERISTIC Coolant_PumpTbl "" CURVE 0x800001F8 RecordLayout_4 0 CompuMethod_2 -1E+17 1E+17
 /begin AXIS_DESCR COM_AXIS Coolant_PumpIn CompuMethod_2 10 -1E+17 1E+17 AXIS_PTS_REF Coolant_PumpIdxArr /end AXIS_DESCR
/end CHARACTERISTIC
/begin CHARACTERISTIC Counter_Mode_Select "" VALUE 0x80000220 RecordLayout_1 0 CompuMethod_191 0 255 /end CHARACTERISTIC
/begin CHARACTERISTIC Counter_Multiplier "" VALUE 0x80000221 RecordLayout_4 0 CompuMethod_192 -1E+17 1E+17 /end CHARACTERISTIC
/begin CHARACTERISTIC CPUMargin "When the available CPU idle time drops below this threshold, the application performs a safety stop" VALUE 0x80000225 RecordLayout_8 0 CompuMethod_194 0 100 /end CHARACTERISTIC
/begin CHARACTERISTIC creepSpeed "speed below which vehicle is considered in low speed manuevers" VALUE 0x80000227 RecordLayout_4 0 CompuMethod_195 -1E+17 1E+17 /end CHARACTERISTIC
/begin CHARACTERISTIC Current_Limit "" VALUE 0x8000022B RecordLayout_4 0 CompuMethod_2 -1E+17 1E+17 /end CHARACTERISTIC
/begin CHARACTERISTIC Current_Limit_Override_new "" VALUE 0x8000022F RecordLayout_4 0 CompuMethod_2 -1E+17 1E+17 /end CHARACTERISTIC
/begin CHARACTERISTIC Current_Limit_Override_ovr "" VALUE 0x80000233 RecordLayout_1 0 CompuMethod_9 0 1 /end CHARACTERISTIC
/begin CHARACTERISTIC DCDCInhibit_Out_Pin "Digital output pin selection for DOut178p001" VALUE 0x80000234 RecordLayout_5 0 CompuMethod_34 -32768 32767 /end CHARACTERISTIC
/begin CHARACTERISTIC Drive_Enable_Delay "" VALUE 0x8000023C RecordLayout_4 0 CompuMethod_2 -1E+17 1E+17 /end CHARACTERISTIC
/begin CHARACTERISTIC EHPAS_brakeEn "Percent Duty cycle for pump under given condition" VALUE 0x8000024A RecordLayout_4 0 CompuMethod_6 -1E+17 1E+17 /end CHARACTERISTIC
/begin CHARACTERISTIC EHPAS_driveEn "Percent Duty cycle for pump under given condition" VALUE 0x8000024E RecordLayout_4 0 CompuMethod_6 -1E+17 1E+17 /end CHARACTERISTIC
/begin CHARACTERISTIC EHPAS_driveNbrakeEn "Percent Duty cycle for pump under given condition" VALUE 0x80000252 RecordLayout_4 0 CompuMethod_6 -1E+17 1E+17 /end CHARACTERISTIC
/begin CHARACTERISTIC EHPAS_IdleEn "Percent Duty cycle for pump under given condition" VALUE 0x8000025B RecordLayout_4 0 CompuMethod_6 -1E+17 1E+17 /end CHARACTERISTIC
/begin CHARACTERISTIC EHPAS_keyUpEn "Percent Duty cycle for pump under given condition" VALUE 0x80000269 RecordLayout_4 0 CompuMethod_6 -1E+17 1E+17 /end CHARACTERISTIC
/begin CHARACTERISTIC EHPAS_lowSpeedEn "Percent Duty cycle for pump under given condition" VALUE 0x8000026D RecordLayout_4 0 CompuMethod_6 -1E+17 1E+17 /end CHARACTERISTIC
/begin CHARACTERISTIC EHPAS_slowingEn "Percent Duty cycle for pump under given condition" VALUE 0x80000283 RecordLayout_4 0 CompuMethod_6 -1E+17 1E+17 /end CHARACTERISTIC
/begin CHARACTERISTIC EHPAS_stoppingEn "Percent Duty cycle for pump under given condition" VALUE 0x80000287 RecordLayout_4 0 CompuMethod_6 -1E+17 1E+17 /end CHARACTERISTIC
/begin CHARACTERISTIC Enable_Brake_Light_Out "" VALUE 0x800002E5 RecordLayout_1 0 CompuMethod_27 0 1 /end CHARACTERISTIC
/begin CHARACTERISTIC Enable_Coast_Neg_Torque "This allows neg. torque to be applied, depending on vehcild speed, when going from gas to brake" VALUE 0x800002E6 RecordLayout_1 0 CompuMethod_189 0 1 /end CHARACTERISTIC
/begin CHARACTERISTIC Enable_PowerSteering_CAN_Msg "" VALUE 0x800002E7 RecordLayout_1 0 CompuMethod_27 0 1 /end CHARACTERISTIC
/begin CHARACTERISTIC Enable_Regen "Pedal Position where regen is Full" VALUE 0x800002E8 RecordLayout_1 0 CompuMethod_17 0 1 /end CHARACTERISTIC
/begin CHARACTERISTIC EStop_Switch_Pin "Digital input pin selection for EStop_Switch_Pin" VALUE 0x800002EB RecordLayout_5 0 CompuMethod_201 -32768 32767 /end CHARACTERISTIC
/begin CHARACTERISTIC Fan_Pin "PWM output pin selection for Fan_Pin" VALUE 0x800002EF RecordLayout_5 0 CompuMethod_204 -32768 32767 /end CHARACTERISTIC
/begin CHARACTERISTIC FGND_10XRTI_PERIODIC_RunCnt "The number of times to execute FGND_10XRTI_PERIODIC before pausing.  -1 means run forever" VALUE 0x8000066A RecordLayout_7 0 CompuMethod_29 -1 2147480000 /end CHARACTERISTIC
/begin CHARACTERISTIC FGND_20XRTI_PERIODIC_RunCnt "The number of times to execute FGND_20XRTI_PERIODIC before pausing.  -1 means run forever" VALUE 0x8000066E RecordLayout_7 0 CompuMethod_29 -1 2147480000 /end CHARACTERISTIC
/begin CHARACTERISTIC FGND_2XRTI_PERIODIC_RunCnt "The number of times to execute FGND_2XRTI_PERIODIC before pausing.  -1 means run forever" VALUE 0x80000672 RecordLayout_7 0 CompuMethod_29 -1 2147480000 /end CHARACTERISTIC
/begin CHARACTERISTIC FGND_RTI_PERIODIC_RunCnt "The number of times to execute FGND_RTI_PERIODIC before pausing.  -1 means run forever" VALUE 0x80000676 RecordLayout_7 0 CompuMethod_29 -1 2147480000 /end CHARACTERISTIC
/begin CHARACTERISTIC FgndTimeStackMargin "When the available stack space drops below this threshold, the application performs a safety stop" VALUE 0x8000067A RecordLayout_8 0 CompuMethod_29 0 3072 /end CHARACTERISTIC
/begin CHARACTERISTIC Forward_Speed_Limit "" VALUE 0x80000683 RecordLayout_4 0 CompuMethod_2 -1E+17 1E+17 /end CHARACTERISTIC
/begin CHARACTERISTIC hardBrakeLev "brake position considered hard braking event" VALUE 0x80000697 RecordLayout_4 0 CompuMethod_6 -1E+17 1E+17 /end CHARACTERISTIC
/begin CHARACTERISTIC HeapMargin "When the available heap drops below this threshold, the application performs a safety stop" VALUE 0x8000069B RecordLayout_8 0 CompuMethod_29 0 4096 /end CHARACTERISTIC
/begin CHARACTERISTIC Heartbeat_Identifier_1 "" VALUE 0x8000069D RecordLayout_4 0 CompuMethod_2 -1E+17 1E+17 /end CHARACTERISTIC
/begin CHARACTERISTIC Heartbeat_Identifier_2 "" VALUE 0x800006A1 RecordLayout_4 0 CompuMethod_2 -1E+17 1E+17 /end CHARACTERISTIC
/begin CHARACTERISTIC High12VThres "Voltage below with low 12V fault occurs." VALUE 0x800006A5 RecordLayout_4 0 CompuMethod_214 -1E+17 1E+17 /end CHARACTERISTIC
/begin CHARACTERISTIC IDLE_EVENT_RunCnt "The number of times to execute IDLE_EVENT before pausing.  -1 means run forever" VALUE 0x800006BD RecordLayout_7 0 CompuMethod_29 -1 2147480000 /end CHARACTERISTIC
/begin CHARACTERISTIC IdleStackMargin "When the available stack space drops below this threshold, the application performs a safety stop" VALUE 0x800006C1 RecordLayout_8 0 CompuMethod_29 0 1024 /end CHARACTERISTIC
/begin CHARACTERISTIC Ignore_Accel_Limit "" VALUE 0x800006C8 RecordLayout_4 0 CompuMethod_2 -1E+17 1E+17 /end CHARACTERISTIC
/begin CHARACTERISTIC InterruptStackMargin "When the available stack space drops below this threshold, the application performs a safety stop" VALUE 0x800006E7 RecordLayout_8 0 CompuMethod_29 0 1536 /end CHARACTERISTIC
/begin CHARACTERISTIC Inverter_Temp_Enable "" VALUE 0x800006E9 RecordLayout_1 0 CompuMethod_22 0 255 /end CHARACTERISTIC
/begin CHARACTERISTIC Inverter_Temp_Offset "" VALUE 0x800006EA RecordLayout_4 0 CompuMethod_2 -1E+17 1E+17 /end CHARACTERISTIC
/begin CHARACTERISTIC InverterTemp_Overheat "Temperature at which \"Temp\" warning light comes on" VALUE 0x800006EE RecordLayout_4 0 CompuMethod_218 0 100 /end CHARACTERISTIC
/begin CHARACTERISTIC KeyOnRuntime_Sec "Time to run brake and power steering pump on key on" VALUE 0x800006F3 RecordLayout_8 0 CompuMethod_220 0 65535 /end CHARACTERISTIC
/begin CHARACTERISTIC Limits_Control_Mode "" VALUE 0x800006F7 RecordLayout_1 0 CompuMethod_22 0 255 /end CHARACTERISTIC
/begin CHARACTERISTIC Load_Enable_Delay "" VALUE 0x800006F9 RecordLayout_4 0 CompuMethod_189 0 10 /end CHARACTERISTIC
/begin CHARACTERISTIC Low12VThres "Voltage below with low 12V fault occurs." VALUE 0x800006FD RecordLayout_4 0 CompuMethod_214 -1E+17 1E+17 /end CHARACTERISTIC
/begin CHARACTERISTIC LowSpeedManeuverRuntime "run time for pump after leaving reverse if still below creep speed" VALUE 0x80000701 RecordLayout_8 0 CompuMethod_220 0 65535 /end CHARACTERISTIC
/begin CHARACTERISTIC LV_Voltage_Pin "Analog input pin selection for LV_Voltage_Pin" VALUE 0x80000703 RecordLayout_5 0 CompuMethod_222 -32768 32767 /end CHARACTERISTIC
/begin CHARACTERISTIC LV_Voltage_Pin_ref "Reference Voltage Selection" VALUE 0x80000705 RecordLayout_1 0 CompuMethod_11 0 255 /end CHARACTERISTIC
/begin CHARACTERISTIC MatlabVersionTxt "MATLAB version used to build the application." ASCII 0x40000424 RecordLayout_2 0 CompuMethod_2 0 255 NUMBER 80 MATRIX_DIM 80 1 1 READ_ONLY /end CHARACTERISTIC
/begin CHARACTERISTIC Max_Coast_Tq "Changing this will change the amount of drag on the vehile when coasting" VALUE 0x80000723 RecordLayout_4 0 CompuMethod_224 0 1000 /end CHARACTERISTIC
/begin CHARACTERISTIC Max_Regen_Tq "Max tq regen can apply WARNING: CHECK PEDAL AT MAX TQ" VALUE 0x80000727 RecordLayout_4 0 CompuMethod_225 0 1000 /end CHARACTERISTIC
/begin CHARACTERISTIC Max_Slect_Tq_drive "" VALUE 0x8000072B RecordLayout_4 0 CompuMethod_2 -1E+17 1E+17 /end CHARACTERISTIC
/begin CHARACTERISTIC Max_SOC_For_Coast_Tq_EN "Above this SOC, vehcile will not allow negative torque to be applied when coasting" VALUE 0x8000072F RecordLayout_4 0 CompuMethod_17 0 240 /end CHARACTERISTIC
/begin CHARACTERISTIC Min_Speed_Allow_Coast_NegT "Below this speed, negative torque will not be allowed to cause vehicle drag" VALUE 0x80000733 RecordLayout_4 0 CompuMethod_226 0 1 /end CHARACTERISTIC
/begin CHARACTERISTIC minPumpRunTime "min time pump should be on ever" VALUE 0x80000737 RecordLayout_4 0 CompuMethod_7 -1E+17 1E+17 /end CHARACTERISTIC
/begin CHARACTERISTIC MotoHawkBuildGUID "GUID identifying the MotoHawk build session" ASCII 0x40000485 RecordLayout_2 0 CompuMethod_2 0 255 NUMBER 80 MATRIX_DIM 80 1 1 READ_ONLY /end CHARACTERISTIC
/begin CHARACTERISTIC MotoHawkModelGUID "GUID identifying the MotoHawk model" ASCII 0x400004D5 RecordLayout_2 0 CompuMethod_2 0 255 NUMBER 80 MATRIX_DIM 80 1 1 READ_ONLY /end CHARACTERISTIC
/begin CHARACTERISTIC MotoHawkModelName "Simulink model name used for the MotoHawk build" ASCII 0x40000525 RecordLayout_2 0 CompuMethod_2 0 255 NUMBER 80 MATRIX_DIM 80 1 1 READ_ONLY /end CHARACTERISTIC
/begin CHARACTERISTIC MotoHawkTokenGUID "GUID identifying the token inserted during the build.  May be empty if no token was available" ASCII 0x40000579 RecordLayout_2 0 CompuMethod_2 0 255 NUMBER 80 MATRIX_DIM 80 1 1 READ_ONLY /end CHARACTERISTIC
/begin CHARACTERISTIC MotoHawkVersionTxt "MotoHawk version used to build the application." ASCII 0x400005C9 RecordLayout_2 0 CompuMethod_2 0 255 NUMBER 50 MATRIX_DIM 50 1 1 READ_ONLY /end CHARACTERISTIC
/begin CHARACTERISTIC ONE_SECOND_EVENT_RunCnt "The number of times to execute ONE_SECOND_EVENT before pausing.  -1 means run forever" VALUE 0x80000775 RecordLayout_7 0 CompuMethod_29 -1 2147480000 /end CHARACTERISTIC
/begin CHARACTERISTIC Overheat_PumpFan_Speed "" VALUE 0x8000078F RecordLayout_4 0 CompuMethod_2 -1E+17 1E+17 /end CHARACTERISTIC
/begin CHARACTERISTIC Overheat_Threshold "" VALUE 0x80000793 RecordLayout_4 0 CompuMethod_2 -1E+17 1E+17 /end CHARACTERISTIC
/begin CHARACTERISTIC PartNumber "" ASCII 0x40000665 RecordLayout_2 0 CompuMethod_2 0 255 NUMBER 40 MATRIX_DIM 40 1 1 READ_ONLY /end CHARACTERISTIC
/begin CHARACTERISTIC PasswordTxt "Password protection for this calibration" ASCII 0x80000797 RecordLayout_2 0 CompuMethod_2 0 255 NUMBER 33 MATRIX_DIM 33 1 1 /end CHARACTERISTIC
/begin CHARACTERISTIC PluggedInHistTimeeaton "Historesis time for plugged in detection." VALUE 0x800007B8 RecordLayout_4 0 CompuMethod_236 -500000000000000 500000000000000 /end CHARACTERISTIC
/begin CHARACTERISTIC PluggedInMainsThesEaton "Above this mains voltage the charger is plugged in." VALUE 0x800007BC RecordLayout_4 0 CompuMethod_214 -1E+17 1E+17 /end CHARACTERISTIC
/begin CHARACTERISTIC Regen_Full "Pedal Position where regen is Full (WARNING:CHECK WHAT THE MAX REGEN IS)" VALUE 0x800007C9 RecordLayout_4 0 CompuMethod_17 0 1 /end CHARACTERISTIC
/begin CHARACTERISTIC Regen_Start "AKA deadband, Pedal Position where regen is at min" VALUE 0x800007D2 RecordLayout_4 0 CompuMethod_17 0 1 /end CHARACTERISTIC
/begin CHARACTERISTIC RegenBatteryLimitsMap "" MAP 0x800007D6 RecordLayout_4 0 CompuMethod_33 -1E+17 1E+17
 /begin AXIS_DESCR COM_AXIS MotorSpdIn CompuMethod_2 8 -1E+17 1E+17 AXIS_PTS_REF MotorSpdIdxArr /end AXIS_DESCR
 /begin AXIS_DESCR COM_AXIS StateOfChargePctIn CompuMethod_2 4 -1E+17 1E+17 AXIS_PTS_REF StateOfChargePctIdxArr /end AXIS_DESCR
/end CHARACTERISTIC
/begin CHARACTERISTIC Reverse_Speed_Limit "" VALUE 0x8000085C RecordLayout_4 0 CompuMethod_2 -1E+17 1E+17 /end CHARACTERISTIC
/begin CHARACTERISTIC Reverse_Switch_Pin "Analog input pin selection for Reverse_Switch_Pin" VALUE 0x80000862 RecordLayout_5 0 CompuMethod_10 -32768 32767 /end CHARACTERISTIC
/begin CHARACTERISTIC Reverse_Switch_Pin_ref "Reference Voltage Selection" VALUE 0x80000864 RecordLayout_1 0 CompuMethod_11 0 255 /end CHARACTERISTIC
/begin CHARACTERISTIC Reverse_TQ_Negative_Enable "" VALUE 0x80000869 RecordLayout_1 0 CompuMethod_240 0 255 /end CHARACTERISTIC
/begin CHARACTERISTIC ReverseOut_Pin "Digital output pin selection for DOut177p001" VALUE 0x8000086C RecordLayout_5 0 CompuMethod_34 -32768 32767 /end CHARACTERISTIC
/begin CHARACTERISTIC Rotor_Temp_Enable "" VALUE 0x80000876 RecordLayout_1 0 CompuMethod_22 0 255 /end CHARACTERISTIC
/begin CHARACTERISTIC Rotor_Temp_Offset "" VALUE 0x80000877 RecordLayout_4 0 CompuMethod_2 -1E+17 1E+17 /end CHARACTERISTIC
/begin CHARACTERISTIC SHUTDOWN_EVENT_RunCnt "The number of times to execute SHUTDOWN_EVENT before pausing.  -1 means run forever" VALUE 0x8000087E RecordLayout_7 0 CompuMethod_29 -1 2147480000 /end CHARACTERISTIC
/begin CHARACTERISTIC StallSpd "Below this vehicle speed is concidered locked rotor." VALUE 0x80000889 RecordLayout_4 0 CompuMethod_195 0 100 /end CHARACTERISTIC
/begin CHARACTERISTIC StallTrqThres "% seconds of torque allowed while speed is below thres." VALUE 0x8000088D RecordLayout_4 0 CompuMethod_242 -1E+17 1E+17 /end CHARACTERISTIC
/begin CHARACTERISTIC STARTUP_EVENT_RunCnt "The number of times to execute STARTUP_EVENT before pausing.  -1 means run forever" VALUE 0x80000891 RecordLayout_7 0 CompuMethod_29 -1 2147480000 /end CHARACTERISTIC
/begin CHARACTERISTIC Stator_Temp_Enable "" VALUE 0x800008AB RecordLayout_1 0 CompuMethod_22 0 255 /end CHARACTERISTIC
/begin CHARACTERISTIC Stator_Temp_Offset "" VALUE 0x800008AC RecordLayout_4 0 CompuMethod_2 -1E+17 1E+17 /end CHARACTERISTIC
/begin CHARACTERISTIC stopSpeed "speed at which vehicle is considered stopped" VALUE 0x800008B0 RecordLayout_4 0 CompuMethod_195 -1E+17 1E+17 /end CHARACTERISTIC
/begin CHARACTERISTIC Suge_Limit "" VALUE 0x800008B5 RecordLayout_4 0 CompuMethod_2 -1E+17 1E+17 /end CHARACTERISTIC
/begin CHARACTERISTIC Temp_ped_switchOver "" VALUE 0x800008B9 RecordLayout_4 0 CompuMethod_33 -1E+17 1E+17 /end CHARACTERISTIC
/begin CHARACTERISTIC TorqueRequestLP "Filter time constant" VALUE 0x800008C1 RecordLayout_4 0 CompuMethod_7 -1E+17 1E+17 /end CHARACTERISTIC
/begin CHARACTERISTIC UQM_TurboMode "" VALUE 0x800008DA RecordLayout_1 0 CompuMethod_250 0 255 /end CHARACTERISTIC
/begin CHARACTERISTIC Use_Raw_Speed "" VALUE 0x800008DB RecordLayout_4 0 CompuMethod_2 -1E+17 1E+17 /end CHARACTERISTIC
/begin CHARACTERISTIC Veh_Speed_Regen_Filter "Filter time constant" VALUE 0x800008E5 RecordLayout_4 0 CompuMethod_7 -1E+17 1E+17 /end CHARACTERISTIC
/begin CHARACTERISTIC Voltage_Limit "" VALUE 0x800008EE RecordLayout_4 0 CompuMethod_2 -1E+17 1E+17 /end CHARACTERISTIC
/begin CHARACTERISTIC Watchdog_Reset_Num "" VALUE 0x800008F7 RecordLayout_4 0 CompuMethod_2 -1E+17 1E+17 /end CHARACTERISTIC
/*~~~~~~~~~ 6.3.17 AXIS_PTS ~~~~~~~~~*/
/begin AXIS_PTS AccelPedalMap_v2IdxArr "" 0x80000079 AccelPedalMap_v2In RecordLayout_6 0 CompuMethod_2 13 -1E+17 1E+17 DEPOSIT ABSOLUTE /end AXIS_PTS
/begin AXIS_PTS Coolant_FanIdxArr "" 0x80000180 Coolant_FanIn RecordLayout_6 0 CompuMethod_2 10 -1E+17 1E+17 DEPOSIT ABSOLUTE /end AXIS_PTS
/begin AXIS_PTS Coolant_PumpIdxArr "" 0x800001D0 Coolant_PumpIn RecordLayout_6 0 CompuMethod_2 10 -1E+17 1E+17 DEPOSIT ABSOLUTE /end AXIS_PTS
/begin AXIS_PTS MotorSpdIdxArr "" 0x80000742 MotorSpdIn RecordLayout_6 0 CompuMethod_2 8 -1E+17 1E+17 DEPOSIT ABSOLUTE /end AXIS_PTS
/begin AXIS_PTS StateOfChargePctIdxArr "" 0x8000089B StateOfChargePctIn RecordLayout_6 0 CompuMethod_2 4 -1E+17 1E+17 DEPOSIT ABSOLUTE /end AXIS_PTS
/*~~~~~~~~~ 6.3.106 RECORD_LAYOUTs ~~~~~~~~~*/
/begin RECORD_LAYOUT RecordLayout_1 FNC_VALUES 1 UBYTE ROW_DIR DIRECT /end RECORD_LAYOUT
/begin RECORD_LAYOUT RecordLayout_2 FNC_VALUES 1 UBYTE ROW_DIR DIRECT /end RECORD_LAYOUT
/begin RECORD_LAYOUT RecordLayout_3 FNC_VALUES 1 ULONG ROW_DIR DIRECT /end RECORD_LAYOUT
/begin RECORD_LAYOUT RecordLayout_4 FNC_VALUES 1 FLOAT32_IEEE ROW_DIR DIRECT /end RECORD_LAYOUT
/begin RECORD_LAYOUT RecordLayout_5 FNC_VALUES 1 SWORD ROW_DIR DIRECT /end RECORD_LAYOUT
/begin RECORD_LAYOUT RecordLayout_6 AXIS_PTS_X 1 FLOAT32_IEEE /* IndexIncr */ INDEX_INCR /* Addressing */ DIRECT /end RECORD_LAYOUT
/begin RECORD_LAYOUT RecordLayout_7 FNC_VALUES 1 SLONG ROW_DIR DIRECT /end RECORD_LAYOUT
/begin RECORD_LAYOUT RecordLayout_8 FNC_VALUES 1 UWORD ROW_DIR DIRECT /end RECORD_LAYOUT
/*~~~~~~~~~ 6.3.31 COMPU_METHODs ~~~~~~~~~*/
/begin COMPU_METHOD CompuMethod_1 "" RAT_FUNC "%3.0" "" COEFFS 0 1 0 0 0 1 /end COMPU_METHOD
/begin COMPU_METHOD CompuMethod_2 "" RAT_FUNC "%6.2" "" COEFFS 0 1 0 0 0 1 /end COMPU_METHOD
/begin COMPU_METHOD CompuMethod_3 "" RAT_FUNC "%6.2" "ID" COEFFS 0 1 0 0 0 1 /end COMPU_METHOD
/begin COMPU_METHOD CompuMethod_4 "" RAT_FUNC "%6.2" "counts" COEFFS 0 1 0 0 0 1 /end COMPU_METHOD
/begin COMPU_METHOD CompuMethod_5 "" RAT_FUNC "%5.0" "ADC" COEFFS 0 1 0 0 0 1 /end COMPU_METHOD
/begin COMPU_METHOD CompuMethod_6 "" RAT_FUNC "%6.2" "%" COEFFS 0 1 0 0 0 1 /end COMPU_METHOD
/begin COMPU_METHOD CompuMethod_7 "" RAT_FUNC "%6.2" "sec" COEFFS 0 1 0 0 0 1 /end COMPU_METHOD
/begin COMPU_METHOD CompuMethod_8 "" RAT_FUNC "%6.2" "ADC" COEFFS 0 1 0 0 0 1 /end COMPU_METHOD
/begin COMPU_METHOD CompuMethod_9 "" TAB_VERB "%1.0" "" COMPU_TAB_REF CompuVtab_1 /end COMPU_METHOD
/begin COMPU_METHOD CompuMethod_10 "" TAB_VERB "%5.0" "" COMPU_TAB_REF CompuVtab_2 /end COMPU_METHOD
/begin COMPU_METHOD CompuMethod_11 "" TAB_VERB "%3.0" "" COMPU_TAB_REF CompuVtab_3 /end COMPU_METHOD
/begin COMPU_METHOD CompuMethod_12 "" RAT_FUNC "%9.4" "%/ADC" COEFFS 0 1 0 0 0 1 /end COMPU_METHOD
/begin COMPU_METHOD CompuMethod_13 "" RAT_FUNC "%1.0" "boolean" COEFFS 0 1 0 0 0 1 /end COMPU_METHOD
/begin COMPU_METHOD CompuMethod_14 "" RAT_FUNC "%5.4" "" COEFFS 0 1 0 0 0 1 /end COMPU_METHOD
/begin COMPU_METHOD CompuMethod_15 "" RAT_FUNC "%6.2" "idx.frac" COEFFS 0 1 0 0 0 0.00195313 /end COMPU_METHOD
/begin COMPU_METHOD CompuMethod_16 "" RAT_FUNC "%6.2" "Rate at which fault is cleared when accel is below thres." COEFFS 0 1 0 0 0 1 /end COMPU_METHOD
/begin COMPU_METHOD CompuMethod_17 "" RAT_FUNC "%3.2" "%" COEFFS 0 1 0 0 0 1 /end COMPU_METHOD
/begin COMPU_METHOD CompuMethod_18 "" RAT_FUNC "%8.0" "" COEFFS 0 1 0 0 0 1 /end COMPU_METHOD
/begin COMPU_METHOD CompuMethod_19 "" TAB_VERB "%6.2" "" COMPU_TAB_REF CompuVtab_4 /end COMPU_METHOD
/begin COMPU_METHOD CompuMethod_20 "" RAT_FUNC "%1.0" "flag" COEFFS 0 1 0 0 0 1 /end COMPU_METHOD
/begin COMPU_METHOD CompuMethod_21 "" TAB_VERB "%1.0" "" COMPU_TAB_REF CompuVtab_5 /end COMPU_METHOD
/begin COMPU_METHOD CompuMethod_22 "" TAB_VERB "%3.0" "" COMPU_TAB_REF CompuVtab_6 /end COMPU_METHOD
/begin COMPU_METHOD CompuMethod_23 "" TAB_VERB "%3.0" "" COMPU_TAB_REF CompuVtab_5 /end COMPU_METHOD
/begin COMPU_METHOD CompuMethod_24 "" TAB_VERB "%1.0" "" COMPU_TAB_REF CompuVtab_7 /end COMPU_METHOD
/begin COMPU_METHOD CompuMethod_25 "" TAB_VERB "%1.0" "" COMPU_TAB_REF CompuVtab_8 /end COMPU_METHOD
/begin COMPU_METHOD CompuMethod_26 "" TAB_VERB "%1.0" "" COMPU_TAB_REF CompuVtab_9 /end COMPU_METHOD
/begin COMPU_METHOD CompuMethod_27 "" RAT_FUNC "%1.0" "" COEFFS 0 1 0 0 0 1 /end COMPU_METHOD
/begin COMPU_METHOD CompuMethod_28 "" RAT_FUNC "%6.2" "C" COEFFS 0 1 0 0 0 1 /end COMPU_METHOD
/begin COMPU_METHOD CompuMethod_29 "" RAT_FUNC "%5.0" "" COEFFS 0 1 0 0 0 1 /end COMPU_METHOD
/begin COMPU_METHOD CompuMethod_30 "" TAB_VERB "%3.0" "" COMPU_TAB_REF CompuVtab_10 /end COMPU_METHOD
/begin COMPU_METHOD CompuMethod_31 "" RAT_FUNC "%4.0" "" COEFFS 0 1 0 0 0 1 /end COMPU_METHOD
/begin COMPU_METHOD CompuMethod_32 "" TAB_VERB "%3.0" "" COMPU_TAB_REF CompuVtab_11 /end COMPU_METHOD
/begin COMPU_METHOD CompuMethod_33 "" RAT_FUNC "%4.3" "" COEFFS 0 1 0 0 0 1 /end COMPU_METHOD
/begin COMPU_METHOD CompuMethod_34 "" TAB_VERB "%5.0" "" COMPU_TAB_REF CompuVtab_12 /end COMPU_METHOD
/begin COMPU_METHOD CompuMethod_35 "" RAT_FUNC "%4.3" "s" COEFFS 0 1 0 0 0 0.005 /end COMPU_METHOD
/begin COMPU_METHOD CompuMethod_36 "" TAB_VERB "%1.0" "" COMPU_TAB_REF CompuVtab_13 /end COMPU_METHOD
/begin COMPU_METHOD CompuMethod_37 "" TAB_VERB "%1.0" "" COMPU_TAB_REF CompuVtab_14 /end COMPU_METHOD
/begin COMPU_METHOD CompuMethod_38 "" TAB_VERB "%1.0" "" COMPU_TAB_REF CompuVtab_15 /end COMPU_METHOD
/begin COMPU_METHOD CompuMethod_39 "" TAB_VERB "%1.0" "" COMPU_TAB_REF CompuVtab_16 /end COMPU_METHOD
/begin COMPU_METHOD CompuMethod_40 "" TAB_VERB "%3.0" "" COMPU_TAB_REF CompuVtab_17 /end COMPU_METHOD
/begin COMPU_METHOD CompuMethod_41 "" RAT_FUNC "%6.2" "VDC" COEFFS 0 1 0 0 0 1 /end COMPU_METHOD
/begin COMPU_METHOD CompuMethod_42 "" TAB_VERB "%1.0" "" COMPU_TAB_REF CompuVtab_18 /end COMPU_METHOD
/begin COMPU_METHOD CompuMethod_43 "" TAB_VERB "%1.0" "" COMPU_TAB_REF CompuVtab_19 /end COMPU_METHOD
/begin COMPU_METHOD CompuMethod_44 "" TAB_VERB "%1.0" "" COMPU_TAB_REF CompuVtab_20 /end COMPU_METHOD
/begin COMPU_METHOD CompuMethod_45 "" TAB_VERB "%1.0" "" COMPU_TAB_REF CompuVtab_21 /end COMPU_METHOD
/begin COMPU_METHOD CompuMethod_46 "" TAB_VERB "%1.0" "" COMPU_TAB_REF CompuVtab_22 /end COMPU_METHOD
/begin COMPU_METHOD CompuMethod_47 "" TAB_VERB "%1.0" "" COMPU_TAB_REF CompuVtab_23 /end COMPU_METHOD
/begin COMPU_METHOD CompuMethod_48 "" TAB_VERB "%1.0" "" COMPU_TAB_REF CompuVtab_24 /end COMPU_METHOD
/begin COMPU_METHOD CompuMethod_49 "" TAB_VERB "%1.0" "" COMPU_TAB_REF CompuVtab_25 /end COMPU_METHOD
/begin COMPU_METHOD CompuMethod_50 "" TAB_VERB "%1.0" "" COMPU_TAB_REF CompuVtab_26 /end COMPU_METHOD
/begin COMPU_METHOD CompuMethod_51 "" TAB_VERB "%1.0" "" COMPU_TAB_REF CompuVtab_27 /end COMPU_METHOD
/begin COMPU_METHOD CompuMethod_52 "" TAB_VERB "%1.0" "" COMPU_TAB_REF CompuVtab_28 /end COMPU_METHOD
/begin COMPU_METHOD CompuMethod_53 "" TAB_VERB "%1.0" "" COMPU_TAB_REF CompuVtab_29 /end COMPU_METHOD
/begin COMPU_METHOD CompuMethod_54 "" TAB_VERB "%1.0" "" COMPU_TAB_REF CompuVtab_30 /end COMPU_METHOD
/begin COMPU_METHOD CompuMethod_55 "" TAB_VERB "%1.0" "" COMPU_TAB_REF CompuVtab_31 /end COMPU_METHOD
/begin COMPU_METHOD CompuMethod_56 "" TAB_VERB "%1.0" "" COMPU_TAB_REF CompuVtab_32 /end COMPU_METHOD
/begin COMPU_METHOD CompuMethod_57 "" TAB_VERB "%1.0" "" COMPU_TAB_REF CompuVtab_33 /end COMPU_METHOD
/begin COMPU_METHOD CompuMethod_58 "" TAB_VERB "%1.0" "" COMPU_TAB_REF CompuVtab_34 /end COMPU_METHOD
/begin COMPU_METHOD CompuMethod_59 "" TAB_VERB "%1.0" "" COMPU_TAB_REF CompuVtab_35 /end COMPU_METHOD
/begin COMPU_METHOD CompuMethod_60 "" TAB_VERB "%1.0" "" COMPU_TAB_REF CompuVtab_36 /end COMPU_METHOD
/begin COMPU_METHOD CompuMethod_61 "" TAB_VERB "%1.0" "" COMPU_TAB_REF CompuVtab_37 /end COMPU_METHOD
/begin COMPU_METHOD CompuMethod_62 "" TAB_VERB "%1.0" "" COMPU_TAB_REF CompuVtab_38 /end COMPU_METHOD
/begin COMPU_METHOD CompuMethod_63 "" TAB_VERB "%1.0" "" COMPU_TAB_REF CompuVtab_39 /end COMPU_METHOD
/begin COMPU_METHOD CompuMethod_64 "" TAB_VERB "%1.0" "" COMPU_TAB_REF CompuVtab_40 /end COMPU_METHOD
/begin COMPU_METHOD CompuMethod_65 "" TAB_VERB "%1.0" "" COMPU_TAB_REF CompuVtab_41 /end COMPU_METHOD
/begin COMPU_METHOD CompuMethod_66 "" TAB_VERB "%1.0" "" COMPU_TAB_REF CompuVtab_42 /end COMPU_METHOD
/begin COMPU_METHOD CompuMethod_67 "" TAB_VERB "%1.0" "" COMPU_TAB_REF CompuVtab_43 /end COMPU_METHOD
/begin COMPU_METHOD CompuMethod_68 "" TAB_VERB "%1.0" "" COMPU_TAB_REF CompuVtab_44 /end COMPU_METHOD
/begin COMPU_METHOD CompuMethod_69 "" TAB_VERB "%1.0" "" COMPU_TAB_REF CompuVtab_45 /end COMPU_METHOD
/begin COMPU_METHOD CompuMethod_70 "" TAB_VERB "%1.0" "" COMPU_TAB_REF CompuVtab_46 /end COMPU_METHOD
/begin COMPU_METHOD CompuMethod_71 "" TAB_VERB "%1.0" "" COMPU_TAB_REF CompuVtab_47 /end COMPU_METHOD
/begin COMPU_METHOD CompuMethod_72 "" TAB_VERB "%1.0" "" COMPU_TAB_REF CompuVtab_48 /end COMPU_METHOD
/begin COMPU_METHOD CompuMethod_73 "" TAB_VERB "%1.0" "" COMPU_TAB_REF CompuVtab_49 /end COMPU_METHOD
/begin COMPU_METHOD CompuMethod_74 "" TAB_VERB "%1.0" "" COMPU_TAB_REF CompuVtab_50 /end COMPU_METHOD
/begin COMPU_METHOD CompuMethod_75 "" TAB_VERB "%1.0" "" COMPU_TAB_REF CompuVtab_51 /end COMPU_METHOD
/begin COMPU_METHOD CompuMethod_76 "" TAB_VERB "%1.0" "" COMPU_TAB_REF CompuVtab_52 /end COMPU_METHOD
/begin COMPU_METHOD CompuMethod_77 "" TAB_VERB "%1.0" "" COMPU_TAB_REF CompuVtab_53 /end COMPU_METHOD
/begin COMPU_METHOD CompuMethod_78 "" TAB_VERB "%1.0" "" COMPU_TAB_REF CompuVtab_54 /end COMPU_METHOD
/begin COMPU_METHOD CompuMethod_79 "" TAB_VERB "%1.0" "" COMPU_TAB_REF CompuVtab_55 /end COMPU_METHOD
/begin COMPU_METHOD CompuMethod_80 "" TAB_VERB "%1.0" "" COMPU_TAB_REF CompuVtab_56 /end COMPU_METHOD
/begin COMPU_METHOD CompuMethod_81 "" TAB_VERB "%1.0" "" COMPU_TAB_REF CompuVtab_57 /end COMPU_METHOD
/begin COMPU_METHOD CompuMethod_82 "" TAB_VERB "%1.0" "" COMPU_TAB_REF CompuVtab_58 /end COMPU_METHOD
/begin COMPU_METHOD CompuMethod_83 "" TAB_VERB "%1.0" "" COMPU_TAB_REF CompuVtab_59 /end COMPU_METHOD
/begin COMPU_METHOD CompuMethod_84 "" TAB_VERB "%1.0" "" COMPU_TAB_REF CompuVtab_60 /end COMPU_METHOD
/begin COMPU_METHOD CompuMethod_85 "" TAB_VERB "%1.0" "" COMPU_TAB_REF CompuVtab_61 /end COMPU_METHOD
/begin COMPU_METHOD CompuMethod_86 "" TAB_VERB "%1.0" "" COMPU_TAB_REF CompuVtab_62 /end COMPU_METHOD
/begin COMPU_METHOD CompuMethod_87 "" TAB_VERB "%1.0" "" COMPU_TAB_REF CompuVtab_63 /end COMPU_METHOD
/begin COMPU_METHOD CompuMethod_88 "" TAB_VERB "%1.0" "" COMPU_TAB_REF CompuVtab_64 /end COMPU_METHOD
/begin COMPU_METHOD CompuMethod_89 "" TAB_VERB "%1.0" "" COMPU_TAB_REF CompuVtab_65 /end COMPU_METHOD
/begin COMPU_METHOD CompuMethod_90 "" TAB_VERB "%1.0" "" COMPU_TAB_REF CompuVtab_66 /end COMPU_METHOD
/begin COMPU_METHOD CompuMethod_91 "" TAB_VERB "%1.0" "" COMPU_TAB_REF CompuVtab_67 /end COMPU_METHOD
/begin COMPU_METHOD CompuMethod_92 "" TAB_VERB "%1.0" "" COMPU_TAB_REF CompuVtab_68 /end COMPU_METHOD
/begin COMPU_METHOD CompuMethod_93 "" TAB_VERB "%1.0" "" COMPU_TAB_REF CompuVtab_69 /end COMPU_METHOD
/begin COMPU_METHOD CompuMethod_94 "" TAB_VERB "%1.0" "" COMPU_TAB_REF CompuVtab_70 /end COMPU_METHOD
/begin COMPU_METHOD CompuMethod_95 "" TAB_VERB "%1.0" "" COMPU_TAB_REF CompuVtab_71 /end COMPU_METHOD
/begin COMPU_METHOD CompuMethod_96 "" TAB_VERB "%1.0" "" COMPU_TAB_REF CompuVtab_72 /end COMPU_METHOD
/begin COMPU_METHOD CompuMethod_97 "" TAB_VERB "%1.0" "" COMPU_TAB_REF CompuVtab_73 /end COMPU_METHOD
/begin COMPU_METHOD CompuMethod_98 "" TAB_VERB "%1.0" "" COMPU_TAB_REF CompuVtab_74 /end COMPU_METHOD
/begin COMPU_METHOD CompuMethod_99 "" TAB_VERB "%1.0" "" COMPU_TAB_REF CompuVtab_75 /end COMPU_METHOD
/begin COMPU_METHOD CompuMethod_100 "" TAB_VERB "%1.0" "" COMPU_TAB_REF CompuVtab_76 /end COMPU_METHOD
/begin COMPU_METHOD CompuMethod_101 "" TAB_VERB "%1.0" "" COMPU_TAB_REF CompuVtab_77 /end COMPU_METHOD
/begin COMPU_METHOD CompuMethod_102 "" TAB_VERB "%1.0" "" COMPU_TAB_REF CompuVtab_78 /end COMPU_METHOD
/begin COMPU_METHOD CompuMethod_103 "" TAB_VERB "%1.0" "" COMPU_TAB_REF CompuVtab_79 /end COMPU_METHOD
/begin COMPU_METHOD CompuMethod_104 "" TAB_VERB "%1.0" "" COMPU_TAB_REF CompuVtab_80 /end COMPU_METHOD
/begin COMPU_METHOD CompuMethod_105 "" TAB_VERB "%1.0" "" COMPU_TAB_REF CompuVtab_81 /end COMPU_METHOD
/begin COMPU_METHOD CompuMethod_106 "" TAB_VERB "%1.0" "" COMPU_TAB_REF CompuVtab_82 /end COMPU_METHOD
/begin COMPU_METHOD CompuMethod_107 "" TAB_VERB "%1.0" "" COMPU_TAB_REF CompuVtab_83 /end COMPU_METHOD
/begin COMPU_METHOD CompuMethod_108 "" TAB_VERB "%1.0" "" COMPU_TAB_REF CompuVtab_84 /end COMPU_METHOD
/begin COMPU_METHOD CompuMethod_109 "" TAB_VERB "%1.0" "" COMPU_TAB_REF CompuVtab_85 /end COMPU_METHOD
/begin COMPU_METHOD CompuMethod_110 "" TAB_VERB "%1.0" "" COMPU_TAB_REF CompuVtab_86 /end COMPU_METHOD
/begin COMPU_METHOD CompuMethod_111 "" TAB_VERB "%1.0" "" COMPU_TAB_REF CompuVtab_87 /end COMPU_METHOD
/begin COMPU_METHOD CompuMethod_112 "" TAB_VERB "%1.0" "" COMPU_TAB_REF CompuVtab_88 /end COMPU_METHOD
/begin COMPU_METHOD CompuMethod_113 "" TAB_VERB "%1.0" "" COMPU_TAB_REF CompuVtab_89 /end COMPU_METHOD
/begin COMPU_METHOD CompuMethod_114 "" TAB_VERB "%1.0" "" COMPU_TAB_REF CompuVtab_90 /end COMPU_METHOD
/begin COMPU_METHOD CompuMethod_115 "" TAB_VERB "%1.0" "" COMPU_TAB_REF CompuVtab_91 /end COMPU_METHOD
/begin COMPU_METHOD CompuMethod_116 "" TAB_VERB "%1.0" "" COMPU_TAB_REF CompuVtab_92 /end COMPU_METHOD
/begin COMPU_METHOD CompuMethod_117 "" TAB_VERB "%1.0" "" COMPU_TAB_REF CompuVtab_93 /end COMPU_METHOD
/begin COMPU_METHOD CompuMethod_118 "" TAB_VERB "%1.0" "" COMPU_TAB_REF CompuVtab_94 /end COMPU_METHOD
/begin COMPU_METHOD CompuMethod_119 "" TAB_VERB "%1.0" "" COMPU_TAB_REF CompuVtab_95 /end COMPU_METHOD
/begin COMPU_METHOD CompuMethod_120 "" TAB_VERB "%1.0" "" COMPU_TAB_REF CompuVtab_96 /end COMPU_METHOD
/begin COMPU_METHOD CompuMethod_121 "" TAB_VERB "%1.0" "" COMPU_TAB_REF CompuVtab_97 /end COMPU_METHOD
/begin COMPU_METHOD CompuMethod_122 "" TAB_VERB "%1.0" "" COMPU_TAB_REF CompuVtab_98 /end COMPU_METHOD
/begin COMPU_METHOD CompuMethod_123 "" TAB_VERB "%1.0" "" COMPU_TAB_REF CompuVtab_99 /end COMPU_METHOD
/begin COMPU_METHOD CompuMethod_124 "" TAB_VERB "%1.0" "" COMPU_TAB_REF CompuVtab_100 /end COMPU_METHOD
/begin COMPU_METHOD CompuMethod_125 "" TAB_VERB "%1.0" "" COMPU_TAB_REF CompuVtab_101 /end COMPU_METHOD
/begin COMPU_METHOD CompuMethod_126 "" TAB_VERB "%1.0" "" COMPU_TAB_REF CompuVtab_102 /end COMPU_METHOD
/begin COMPU_METHOD CompuMethod_127 "" TAB_VERB "%1.0" "" COMPU_TAB_REF CompuVtab_103 /end COMPU_METHOD
/begin COMPU_METHOD CompuMethod_128 "" TAB_VERB "%1.0" "" COMPU_TAB_REF CompuVtab_104 /end COMPU_METHOD
/begin COMPU_METHOD CompuMethod_129 "" TAB_VERB "%1.0" "" COMPU_TAB_REF CompuVtab_105 /end COMPU_METHOD
/begin COMPU_METHOD CompuMethod_130 "" TAB_VERB "%1.0" "" COMPU_TAB_REF CompuVtab_106 /end COMPU_METHOD
/begin COMPU_METHOD CompuMethod_131 "" TAB_VERB "%1.0" "" COMPU_TAB_REF CompuVtab_107 /end COMPU_METHOD
/begin COMPU_METHOD CompuMethod_132 "" TAB_VERB "%1.0" "" COMPU_TAB_REF CompuVtab_108 /end COMPU_METHOD
/begin COMPU_METHOD CompuMethod_133 "" TAB_VERB "%1.0" "" COMPU_TAB_REF CompuVtab_109 /end COMPU_METHOD
/begin COMPU_METHOD CompuMethod_134 "" TAB_VERB "%1.0" "" COMPU_TAB_REF CompuVtab_110 /end COMPU_METHOD
/begin COMPU_METHOD CompuMethod_135 "" TAB_VERB "%1.0" "" COMPU_TAB_REF CompuVtab_111 /end COMPU_METHOD
/begin COMPU_METHOD CompuMethod_136 "" TAB_VERB "%1.0" "" COMPU_TAB_REF CompuVtab_112 /end COMPU_METHOD
/begin COMPU_METHOD CompuMethod_137 "" TAB_VERB "%1.0" "" COMPU_TAB_REF CompuVtab_113 /end COMPU_METHOD
/begin COMPU_METHOD CompuMethod_138 "" TAB_VERB "%1.0" "" COMPU_TAB_REF CompuVtab_114 /end COMPU_METHOD
/begin COMPU_METHOD CompuMethod_139 "" TAB_VERB "%1.0" "" COMPU_TAB_REF CompuVtab_115 /end COMPU_METHOD
/begin COMPU_METHOD CompuMethod_140 "" TAB_VERB "%1.0" "" COMPU_TAB_REF CompuVtab_116 /end COMPU_METHOD
/begin COMPU_METHOD CompuMethod_141 "" TAB_VERB "%1.0" "" COMPU_TAB_REF CompuVtab_117 /end COMPU_METHOD
/begin COMPU_METHOD CompuMethod_142 "" TAB_VERB "%1.0" "" COMPU_TAB_REF CompuVtab_118 /end COMPU_METHOD
/begin COMPU_METHOD CompuMethod_143 "" TAB_VERB "%1.0" "" COMPU_TAB_REF CompuVtab_119 /end COMPU_METHOD
/begin COMPU_METHOD CompuMethod_144 "" TAB_VERB "%1.0" "" COMPU_TAB_REF CompuVtab_120 /end COMPU_METHOD
/begin COMPU_METHOD CompuMethod_145 "" TAB_VERB "%1.0" "" COMPU_TAB_REF CompuVtab_121 /end COMPU_METHOD
/begin COMPU_METHOD CompuMethod_146 "" TAB_VERB "%1.0" "" COMPU_TAB_REF CompuVtab_122 /end COMPU_METHOD
/begin COMPU_METHOD CompuMethod_147 "" TAB_VERB "%1.0" "" COMPU_TAB_REF CompuVtab_123 /end COMPU_METHOD
/begin COMPU_METHOD CompuMethod_148 "" TAB_VERB "%1.0" "" COMPU_TAB_REF CompuVtab_124 /end COMPU_METHOD
/begin COMPU_METHOD CompuMethod_149 "" TAB_VERB "%1.0" "" COMPU_TAB_REF CompuVtab_125 /end COMPU_METHOD
/begin COMPU_METHOD CompuMethod_150 "" TAB_VERB "%1.0" "" COMPU_TAB_REF CompuVtab_126 /end COMPU_METHOD
/begin COMPU_METHOD CompuMethod_151 "" TAB_VERB "%1.0" "" COMPU_TAB_REF CompuVtab_127 /end COMPU_METHOD
/begin COMPU_METHOD CompuMethod_152 "" TAB_VERB "%1.0" "" COMPU_TAB_REF CompuVtab_128 /end COMPU_METHOD
/begin COMPU_METHOD CompuMethod_153 "" TAB_VERB "%1.0" "" COMPU_TAB_REF CompuVtab_129 /end COMPU_METHOD
/begin COMPU_METHOD CompuMethod_154 "" TAB_VERB "%1.0" "" COMPU_TAB_REF CompuVtab_130 /end COMPU_METHOD
/begin COMPU_METHOD CompuMethod_155 "" TAB_VERB "%1.0" "" COMPU_TAB_REF CompuVtab_131 /end COMPU_METHOD
/begin COMPU_METHOD CompuMethod_156 "" TAB_VERB "%1.0" "" COMPU_TAB_REF CompuVtab_132 /end COMPU_METHOD
/begin COMPU_METHOD CompuMethod_157 "" TAB_VERB "%1.0" "" COMPU_TAB_REF CompuVtab_133 /end COMPU_METHOD
/begin COMPU_METHOD CompuMethod_158 "" TAB_VERB "%1.0" "" COMPU_TAB_REF CompuVtab_134 /end COMPU_METHOD
/begin COMPU_METHOD CompuMethod_159 "" TAB_VERB "%1.0" "" COMPU_TAB_REF CompuVtab_135 /end COMPU_METHOD
/begin COMPU_METHOD CompuMethod_160 "" TAB_VERB "%1.0" "" COMPU_TAB_REF CompuVtab_136 /end COMPU_METHOD
/begin COMPU_METHOD CompuMethod_161 "" TAB_VERB "%1.0" "" COMPU_TAB_REF CompuVtab_137 /end COMPU_METHOD
/begin COMPU_METHOD CompuMethod_162 "" TAB_VERB "%1.0" "" COMPU_TAB_REF CompuVtab_138 /end COMPU_METHOD
/begin COMPU_METHOD CompuMethod_163 "" TAB_VERB "%1.0" "" COMPU_TAB_REF CompuVtab_139 /end COMPU_METHOD
/begin COMPU_METHOD CompuMethod_164 "" TAB_VERB "%1.0" "" COMPU_TAB_REF CompuVtab_140 /end COMPU_METHOD
/begin COMPU_METHOD CompuMethod_165 "" TAB_VERB "%1.0" "" COMPU_TAB_REF CompuVtab_141 /end COMPU_METHOD
/begin COMPU_METHOD CompuMethod_166 "" TAB_VERB "%1.0" "" COMPU_TAB_REF CompuVtab_142 /end COMPU_METHOD
/begin COMPU_METHOD CompuMethod_167 "" TAB_VERB "%1.0" "" COMPU_TAB_REF CompuVtab_143 /end COMPU_METHOD
/begin COMPU_METHOD CompuMethod_168 "" TAB_VERB "%1.0" "" COMPU_TAB_REF CompuVtab_144 /end COMPU_METHOD
/begin COMPU_METHOD CompuMethod_169 "" TAB_VERB "%1.0" "" COMPU_TAB_REF CompuVtab_145 /end COMPU_METHOD
/begin COMPU_METHOD CompuMethod_170 "" TAB_VERB "%1.0" "" COMPU_TAB_REF CompuVtab_146 /end COMPU_METHOD
/begin COMPU_METHOD CompuMethod_171 "" TAB_VERB "%1.0" "" COMPU_TAB_REF CompuVtab_147 /end COMPU_METHOD
/begin COMPU_METHOD CompuMethod_172 "" TAB_VERB "%1.0" "" COMPU_TAB_REF CompuVtab_148 /end COMPU_METHOD
/begin COMPU_METHOD CompuMethod_173 "" TAB_VERB "%1.0" "" COMPU_TAB_REF CompuVtab_149 /end COMPU_METHOD
/begin COMPU_METHOD CompuMethod_174 "" TAB_VERB "%1.0" "" COMPU_TAB_REF CompuVtab_150 /end COMPU_METHOD
/begin COMPU_METHOD CompuMethod_175 "" TAB_VERB "%1.0" "" COMPU_TAB_REF CompuVtab_151 /end COMPU_METHOD
/begin COMPU_METHOD CompuMethod_176 "" TAB_VERB "%1.0" "" COMPU_TAB_REF CompuVtab_152 /end COMPU_METHOD
/begin COMPU_METHOD CompuMethod_177 "" TAB_VERB "%1.0" "" COMPU_TAB_REF CompuVtab_153 /end COMPU_METHOD
/begin COMPU_METHOD CompuMethod_178 "" TAB_VERB "%1.0" "" COMPU_TAB_REF CompuVtab_154 /end COMPU_METHOD
/begin COMPU_METHOD CompuMethod_179 "" TAB_VERB "%1.0" "" COMPU_TAB_REF CompuVtab_155 /end COMPU_METHOD
/begin COMPU_METHOD CompuMethod_180 "" TAB_VERB "%1.0" "" COMPU_TAB_REF CompuVtab_156 /end COMPU_METHOD
/begin COMPU_METHOD CompuMethod_181 "" TAB_VERB "%1.0" "" COMPU_TAB_REF CompuVtab_157 /end COMPU_METHOD
/begin COMPU_METHOD CompuMethod_182 "" TAB_VERB "%1.0" "" COMPU_TAB_REF CompuVtab_158 /end COMPU_METHOD
/begin COMPU_METHOD CompuMethod_183 "" TAB_VERB "%1.0" "" COMPU_TAB_REF CompuVtab_159 /end COMPU_METHOD
/begin COMPU_METHOD CompuMethod_184 "" TAB_VERB "%1.0" "" COMPU_TAB_REF CompuVtab_160 /end COMPU_METHOD
/begin COMPU_METHOD CompuMethod_185 "" TAB_VERB "%1.0" "" COMPU_TAB_REF CompuVtab_161 /end COMPU_METHOD
/begin COMPU_METHOD CompuMethod_186 "" TAB_VERB "%1.0" "" COMPU_TAB_REF CompuVtab_162 /end COMPU_METHOD
/begin COMPU_METHOD CompuMethod_187 "" TAB_VERB "%1.0" "" COMPU_TAB_REF CompuVtab_163 /end COMPU_METHOD
/begin COMPU_METHOD CompuMethod_188 "" TAB_VERB "%1.0" "" COMPU_TAB_REF CompuVtab_164 /end COMPU_METHOD
/begin COMPU_METHOD CompuMethod_189 "" RAT_FUNC "%3.2" "" COEFFS 0 1 0 0 0 1 /end COMPU_METHOD
/begin COMPU_METHOD CompuMethod_190 "" TAB_VERB "%3.0" "" COMPU_TAB_REF CompuVtab_165 /end COMPU_METHOD
/begin COMPU_METHOD CompuMethod_191 "" TAB_VERB "%3.0" "" COMPU_TAB_REF CompuVtab_166 /end COMPU_METHOD
/begin COMPU_METHOD CompuMethod_192 "" RAT_FUNC "%6.5" "" COEFFS 0 1 0 0 0 1 /end COMPU_METHOD
/begin COMPU_METHOD CompuMethod_193 "" RAT_FUNC "%6.2" "%" COEFFS 0 1 0 0 0 0.0015259 /end COMPU_METHOD
/begin COMPU_METHOD CompuMethod_194 "" RAT_FUNC "%3.0" "" COEFFS 0 1 0 0 0 0.0015259 /end COMPU_METHOD
/begin COMPU_METHOD CompuMethod_195 "" RAT_FUNC "%6.2" "mph" COEFFS 0 1 0 0 0 1 /end COMPU_METHOD
/begin COMPU_METHOD CompuMethod_199 "" TAB_VERB "%3.0" "" COMPU_TAB_REF CompuVtab_167 /end COMPU_METHOD
/begin COMPU_METHOD CompuMethod_201 "" TAB_VERB "%5.0" "" COMPU_TAB_REF CompuVtab_168 /end COMPU_METHOD
/begin COMPU_METHOD CompuMethod_204 "" TAB_VERB "%5.0" "" COMPU_TAB_REF CompuVtab_171 /end COMPU_METHOD
/begin COMPU_METHOD CompuMethod_214 "" RAT_FUNC "%6.2" "V" COEFFS 0 1 0 0 0 1 /end COMPU_METHOD
/begin COMPU_METHOD CompuMethod_217 "" RAT_FUNC "%5.0" "bytes" COEFFS 0 1 0 0 0 1 /end COMPU_METHOD
/begin COMPU_METHOD CompuMethod_218 "" RAT_FUNC "%6.1" "degC" COEFFS 0 1 0 0 0 1 /end COMPU_METHOD
/begin COMPU_METHOD CompuMethod_220 "" RAT_FUNC "%5.0" "sec" COEFFS 0 1 0 0 0 1 /end COMPU_METHOD
/begin COMPU_METHOD CompuMethod_221 "" TAB_VERB "%6.2" "" COMPU_TAB_REF CompuVtab_179 /end COMPU_METHOD
/begin COMPU_METHOD CompuMethod_222 "" TAB_VERB "%5.0" "" COMPU_TAB_REF CompuVtab_180 /end COMPU_METHOD
/begin COMPU_METHOD CompuMethod_224 "" RAT_FUNC "%3.2" "NM" COEFFS 0 1 0 0 0 1 /end COMPU_METHOD
/begin COMPU_METHOD CompuMethod_225 "" RAT_FUNC "%3.2" "nM" COEFFS 0 1 0 0 0 1 /end COMPU_METHOD
/begin COMPU_METHOD CompuMethod_226 "" RAT_FUNC "%3.2" "MPH" COEFFS 0 1 0 0 0 1 /end COMPU_METHOD
/begin COMPU_METHOD CompuMethod_228 "" TAB_VERB "%3.0" "" COMPU_TAB_REF CompuVtab_181 /end COMPU_METHOD
/begin COMPU_METHOD CompuMethod_229 "" RAT_FUNC "%8.0" "seconds" COEFFS 0 1 0 0 0 1 /end COMPU_METHOD
/begin COMPU_METHOD CompuMethod_235 "" TAB_VERB "%6.2" "" COMPU_TAB_REF CompuVtab_186 /end COMPU_METHOD
/begin COMPU_METHOD CompuMethod_236 "" RAT_FUNC "%3.2" "s" COEFFS 0 1 0 0 0 0.005 /end COMPU_METHOD
/begin COMPU_METHOD CompuMethod_240 "" TAB_VERB "%3.0" "" COMPU_TAB_REF CompuVtab_189 /end COMPU_METHOD
/begin COMPU_METHOD CompuMethod_242 "" RAT_FUNC "%6.2" "% s" COEFFS 0 1 0 0 0 1 /end COMPU_METHOD
/begin COMPU_METHOD CompuMethod_244 "" RAT_FUNC "%2.0" "ISRs" COEFFS 0 1 0 0 0 1 /end COMPU_METHOD
/begin COMPU_METHOD CompuMethod_245 "" RAT_FUNC "%5.0" "MHz" COEFFS 0 1 0 0 0 1E-06 /end COMPU_METHOD
/begin COMPU_METHOD CompuMethod_247 "" TAB_VERB "%1.0" "" COMPU_TAB_REF CompuVtab_192 /end COMPU_METHOD
/begin COMPU_METHOD CompuMethod_249 "" TAB_VERB "%1.0" "" COMPU_TAB_REF CompuVtab_193 /end COMPU_METHOD
/begin COMPU_METHOD CompuMethod_250 "" TAB_VERB "%3.0" "" COMPU_TAB_REF CompuVtab_194 /end COMPU_METHOD
/*~~~~~~~~~ 6.3.34 COMPU_VTABs ~~~~~~~~~*/
/begin COMPU_VTAB CompuVtab_1 "" TAB_VERB 2 0 "Pass-Through" 1 "Override" /end COMPU_VTAB
/begin COMPU_VTAB CompuVtab_2 "" TAB_VERB 41 -1 "(None)" 53 "ECUP" 54 "DRVP" 55 "XDRP" 56 "AN1M" 57 "AN2M" 58 "AN3M" 59 "AN4M" 60 "AN5M" 61 "AN6M" 62 "AN7M" 63 "AN8M" 64 "AN9M" 65 "AN10M" 66 "AN11M" 67 "AN12M" 68 "AN13M" 69 "AN14M" 70 "AN15M" 71 "AN16M" 72 "AN17M" 73 "AN18M" 74 "AN19M" 75 "AN20M" 76 "AN21M" 77 "AN22M" 78 "AN23M" 79 "AN24M" 80 "AN25M" 81 "AN26M" 82 "AN27M" 83 "AN28M" 84 "AN29M" 85 "AN30M" 86 "AN31M" 87 "AN32M" 88 "AN33M" 89 "AN34M" 90 "O2A" 91 "O2B" 92 "XDRP_B" /end COMPU_VTAB
/begin COMPU_VTAB CompuVtab_3 "" TAB_VERB 2 0 "5V" 1 "2.7V" /end COMPU_VTAB
/begin COMPU_VTAB CompuVtab_4 "" TAB_VERB 90 0 "Normal Operation" 1 "Bad Resource ID" 2 "Hardware Not Supported" 3 "Behaviour Not Supported" 4 "Bad Attribute Data" 5 "Fail On Create" 6 "Fail On Set Attributes" 7 "Resource Not Created" 8 "Missing Attribute" 9 "Behaviour Method Not Supported" 10 "A Service Failed" 11 "Failed to destroy a resource" 12 "Resource Was Created" 13 "Resource Conflict" 14 "Invalid Encoder Type" 15 "2-Strike Not Supported" 16 "720degCA Pattern Not Supported" 17 "CAM Pattern Not Supported" 18 "Unknown CAM Pattern Supplied" 19 "Engine Speed Present" 20 "Hardware Interface Not Supported" 21 "Service Already Started" 22 "Register Write Failed to verify" 23 "Register access was denied" 24 "Out of free store memory" 25 "Software Q Overrun" 26 "Hardware Q Overrun" 27 "Feature unsupported in archive" 28 "Insufficient FW resource" 29 "OS Resource conflict" 30 "Driver Mode conflict" 31 "RTC time is illegal" 32 "FFS unmounted" 33 "Access from an ISR" 34 "FFS internal" 35 "Operation timed out" 36 "Task Kernel API Usage" 37 "Operation aborted" 38 "File not Found" 39 "Invalid characters in filename" 40 "Duplicate filename" 41 "Filename is too long" 42 "Dir not empty on remove" 43 "Dir not found" 44 "Dir name invalid" 45 "Dir exists" 46 "Dir too deep" 47 "Illegal Handle" 48 "End of File" 49 "Media Full" 50 "Media Write" 51 "Media Read" 52 "Media Write Protected" 53 "File Read Only" 54 "FS Media Changed" 55 "Internal USB" 56 "Voltage too high for USB IC" 57 "Encoder not created" 64 "TPU Chan Conflict" 65 "TPU Func Unavailable" 66 "TPU Config" 67 "TPU Primative Usage" 68 "TPU Primitive Count" 69 "TPU Restricted TPU channel" 70 "TPU Not Created" 71 "TPU Self Modify constant write err" 72 "TPU Error 0x48" 73 "TPU Error 0x49" 74 "TPU Error 0x4A" 75 "TPU Error 0x4B" 76 "TPU Error 0x4C" 77 "TPU Error 0x4D" 78 "TPU Error 0x4E" 79 "TPU Error 0x4F" 80 "TPU Error 0x50" 81 "TPU Error 0x51" 82 "TPU Error 0x52" 83 "TPU Error 0x53" 84 "TPU Error 0x54" 85 "TPU Error 0x55" 86 "TPU Error 0x56" 87 "TPU Error 0x57" 88 "TPU Error 0x58" 89 "TPU Error 0x59" 90 "TPU Error 0x5A" 91 "TPU Error 0x5B" 92 "TPU Error 0x5C" 93 "TPU Error 0x5D" 94 "TPU Error 0x5E" 95 "TPU Error 0x5F" /end COMPU_VTAB
/begin COMPU_VTAB CompuVtab_5 "" TAB_VERB 4 0 "Before Model Initialize" 1 "After Model Init - Before STARTUP Event" 2 "After STARTUP Event - Before Run" 3 "Run" /end COMPU_VTAB
/begin COMPU_VTAB CompuVtab_6 "" TAB_VERB 2 0 "Disabled" 1 "Enabled" /end COMPU_VTAB
/begin COMPU_VTAB CompuVtab_7 "" TAB_VERB 4 0 "Initializing" 1 "Run" 2 "Pause" 3 "Stop" /end COMPU_VTAB
/begin COMPU_VTAB CompuVtab_8 "" TAB_VERB 9 0 "Running normally" 1 "Requested by user" 2 "Foreground stack margin violation" 3 "Background stack margin violation" 4 "Idle stack margin violation" 5 "Interrupt stack margin violation" 6 "Heap margin violation" 7 "Idle CPU margin violation" 8 "OS error detected" /end COMPU_VTAB
/begin COMPU_VTAB CompuVtab_9 "" TAB_VERB 9 0 "-" 1 "-" 2 "Application Monitor" 3 "Application Monitor" 4 "Application Monitor" 5 "Application Monitor" 6 "Application Monitor" 7 "Application Monitor" 8 "Application Monitor" /end COMPU_VTAB
/begin COMPU_VTAB CompuVtab_10 "" TAB_VERB 11 0 "None Late" 1 "720 Late" 2 "360 Late" 4 "180 Late" 6 "360, 180 Late" 8 "120 Late" 16 "90 Late" 32 "60 Late" 64 "30 Late" 128 "HIRES Late" 192 "HIRES, 30 Late" /end COMPU_VTAB
/begin COMPU_VTAB CompuVtab_11 "" TAB_VERB 8 0 "None Late" 1 "x1 Late" 2 "x2 Late" 3 "x1, x2 Late" 4 "x10 Late" 5 "x1, x10 Late" 6 "x2, x10 Late" 7 "x1, 2, 10 Late" /end COMPU_VTAB
/begin COMPU_VTAB CompuVtab_12 "" TAB_VERB 41 -1 "(None)" 12 "FINJ1" 13 "FINJ2" 14 "FINJ3" 15 "FINJ4" 16 "FINJ5" 17 "FINJ6" 18 "FINJ7" 19 "FINJ8" 20 "FINJ9" 21 "FINJ10" 22 "FINJ11" 23 "FINJ12" 24 "TACH" 25 "LSD1" 26 "LSD2" 27 "LSD3" 28 "LSD4" 29 "LSD5" 30 "LSD6" 31 "LSD7" 32 "LSD8" 33 "LSD9" 34 "LSD10" 36 "EST 1" 37 "EST 2" 38 "EST 3" 39 "EST 4" 40 "EST 5" 41 "EST 6" 42 "EST 7" 43 "EST 8" 44 "EST 9" 45 "EST 10" 46 "EST 11" 47 "EST 12" 48 "EST 13" 49 "EST 14" 50 "EST 15" 51 "EST 16" 52 "MPRD" /end COMPU_VTAB
/begin COMPU_VTAB CompuVtab_13 "" TAB_VERB 2 0 "Calibration Locked" 1 "Calibration Unlocked" /end COMPU_VTAB
/begin COMPU_VTAB CompuVtab_14 "" TAB_VERB 2 0 "Data Acquisition Locked" 1 "Data Acquisition Unlocked" /end COMPU_VTAB
/begin COMPU_VTAB CompuVtab_15 "" TAB_VERB 2 0 "Programming Locked" 1 "Programming Unlocked" /end COMPU_VTAB
/begin COMPU_VTAB CompuVtab_16 "" TAB_VERB 2 0 "Not Connected" 1 "Connected" /end COMPU_VTAB
/begin COMPU_VTAB CompuVtab_17 "" TAB_VERB 2 0 "No Ventilation" 1 "Ventilation" /end COMPU_VTAB
/begin COMPU_VTAB CompuVtab_18 "" TAB_VERB 2 0 "BuckyWagon_01/Foreground/Actuators/Eaton HV Charger/motohawk_override_abs1/NewValue" 1 "-" /end COMPU_VTAB
/begin COMPU_VTAB CompuVtab_19 "" TAB_VERB 2 0 "BuckyWagon_01/Foreground/Actuators/Analog Out/Discrete Actuator Characterization2/Override in Engineering Units/OldValue" 1 "-" /end COMPU_VTAB
/begin COMPU_VTAB CompuVtab_20 "" TAB_VERB 2 0 "BuckyWagon_01/Foreground/Actuators/A123 Battery Controller/motohawk_override_abs6/NewValue" 1 "-" /end COMPU_VTAB
/begin COMPU_VTAB CompuVtab_21 "" TAB_VERB 2 0 "BuckyWagon_01/Foreground/Actuators/Analog Out/PWM Characterization2/motohawk_override_abs2/NewValue" 1 "-" /end COMPU_VTAB
/begin COMPU_VTAB CompuVtab_22 "" TAB_VERB 2 0 "BuckyWagon_01/Foreground/Actuators/A123 Battery Controller/motohawk_override_abs6/OldValue" 1 "-" /end COMPU_VTAB
/begin COMPU_VTAB CompuVtab_23 "" TAB_VERB 2 0 "BuckyWagon_01/Foreground/Actuators/A123 Battery Controller/motohawk_override_abs7/NewValue" 1 "-" /end COMPU_VTAB
/begin COMPU_VTAB CompuVtab_24 "" TAB_VERB 2 0 "BuckyWagon_01/Foreground/Actuators/Eaton HV Charger/motohawk_override_abs1/OldValue" 1 "-" /end COMPU_VTAB
/begin COMPU_VTAB CompuVtab_25 "" TAB_VERB 2 0 "BuckyWagon_01/Foreground/Actuators/Eaton HV Charger/motohawk_override_abs2/NewValue" 1 "-" /end COMPU_VTAB
/begin COMPU_VTAB CompuVtab_26 "" TAB_VERB 2 0 "BuckyWagon_01/Foreground/Actuators/Analog Out/PWM Characterization2/motohawk_override_abs2/OldValue" 1 "-" /end COMPU_VTAB
/begin COMPU_VTAB CompuVtab_27 "" TAB_VERB 2 0 "BuckyWagon_01/Foreground/Actuators/EHPAS Power Steering Pump Controller/motohawk_override_abs4/NewValue" 1 "-" /end COMPU_VTAB
/begin COMPU_VTAB CompuVtab_28 "" TAB_VERB 2 0 "BuckyWagon_01/Foreground/Actuators/A123 Battery Controller/motohawk_override_abs7/OldValue" 1 "-" /end COMPU_VTAB
/begin COMPU_VTAB CompuVtab_29 "" TAB_VERB 2 0 "BuckyWagon_01/Foreground/Actuators/EHPAS Power Steering Pump Controller/motohawk_override_abs4/OldValue" 1 "-" /end COMPU_VTAB
/begin COMPU_VTAB CompuVtab_30 "" TAB_VERB 2 0 "BuckyWagon_01/Foreground/Actuators/A123 Battery Controller/motohawk_override_abs8/NewValue" 1 "-" /end COMPU_VTAB
/begin COMPU_VTAB CompuVtab_31 "" TAB_VERB 2 0 "BuckyWagon_01/CCP CAN Protocol/CCP CAN Protocol External Trig1/CCP Command Driver" 1 "-" /end COMPU_VTAB
/begin COMPU_VTAB CompuVtab_32 "" TAB_VERB 2 0 "BuckyWagon_01/Foreground/Actuators/EMP Coolant Pump/motohawk_override_abs1/NewValue" 1 "-" /end COMPU_VTAB
/begin COMPU_VTAB CompuVtab_33 "" TAB_VERB 2 0 "BuckyWagon_01/Foreground/Actuators/A123 Battery Controller/motohawk_override_abs8/OldValue" 1 "-" /end COMPU_VTAB
/begin COMPU_VTAB CompuVtab_34 "" TAB_VERB 2 0 "BuckyWagon_01/CCP CAN Protocol/CCP CAN Protocol External Trig1/CCP Command Driver/While new CCP Command" 1 "-" /end COMPU_VTAB
/begin COMPU_VTAB CompuVtab_35 "" TAB_VERB 2 0 "BuckyWagon_01/Foreground/Actuators/EMP Coolant Pump/motohawk_override_abs1/OldValue" 1 "-" /end COMPU_VTAB
/begin COMPU_VTAB CompuVtab_36 "" TAB_VERB 2 0 "BuckyWagon_01/Foreground/Actuators/Analog Out/Cruise Control Indicator/motohawk_override_abs3/NewValue" 1 "-" /end COMPU_VTAB
/begin COMPU_VTAB CompuVtab_37 "" TAB_VERB 2 0 "BuckyWagon_01/CCP CAN Protocol/CCP CAN Protocol External Trig1/CCP Command Driver/While new CCP Command/Adjust ID" 1 "-" /end COMPU_VTAB
/begin COMPU_VTAB CompuVtab_38 "" TAB_VERB 2 0 "BuckyWagon_01/Foreground/Actuators/EMP Coolant Pump/motohawk_override_abs4/NewValue" 1 "-" /end COMPU_VTAB
/begin COMPU_VTAB CompuVtab_39 "" TAB_VERB 2 0 "BuckyWagon_01/Foreground/Actuators/Analog Out/Cruise Control Indicator/motohawk_override_abs3/OldValue" 1 "-" /end COMPU_VTAB
/begin COMPU_VTAB CompuVtab_40 "" TAB_VERB 2 0 "BuckyWagon_01/CCP CAN Protocol/CCP CAN Protocol External Trig1/CCP Daq Processing" 1 "-" /end COMPU_VTAB
/begin COMPU_VTAB CompuVtab_41 "" TAB_VERB 2 0 "BuckyWagon_01/Foreground/Actuators/EMP Coolant Pump/motohawk_override_abs4/OldValue" 1 "-" /end COMPU_VTAB
/begin COMPU_VTAB CompuVtab_42 "" TAB_VERB 2 0 "BuckyWagon_01/Foreground/Actuators/Analog Out/Discrete Actuator Characterization1/Override in Engineering Units/NewValue" 1 "-" /end COMPU_VTAB
/begin COMPU_VTAB CompuVtab_43 "" TAB_VERB 2 0 "BuckyWagon_01/CCP CAN Protocol/CCP CAN Protocol External Trig1/CCP IDLE Processing" 1 "-" /end COMPU_VTAB
/begin COMPU_VTAB CompuVtab_44 "" TAB_VERB 2 0 "BuckyWagon_01/Foreground/Actuators/EMP Cooling Fan/motohawk_override_abs1/NewValue" 1 "-" /end COMPU_VTAB
/begin COMPU_VTAB CompuVtab_45 "" TAB_VERB 2 0 "BuckyWagon_01/Foreground/Actuators/Analog Out/Discrete Actuator Characterization1/Override in Engineering Units/OldValue" 1 "-" /end COMPU_VTAB
/begin COMPU_VTAB CompuVtab_46 "" TAB_VERB 2 0 "BuckyWagon_01/Foreground/Actuators/A123 Battery Controller/motohawk_override_abs5/NewValue" 1 "-" /end COMPU_VTAB
/begin COMPU_VTAB CompuVtab_47 "" TAB_VERB 2 0 "BuckyWagon_01/Foreground/Actuators/EMP Cooling Fan/motohawk_override_abs1/OldValue" 1 "-" /end COMPU_VTAB
/begin COMPU_VTAB CompuVtab_48 "" TAB_VERB 2 0 "BuckyWagon_01/Foreground/Actuators/Analog Out/Discrete Actuator Characterization2/Override in Engineering Units/NewValue" 1 "-" /end COMPU_VTAB
/begin COMPU_VTAB CompuVtab_49 "" TAB_VERB 2 0 "BuckyWagon_01/Foreground/Actuators/A123 Battery Controller/motohawk_override_abs5/OldValue" 1 "-" /end COMPU_VTAB
/begin COMPU_VTAB CompuVtab_50 "" TAB_VERB 2 0 "BuckyWagon_01/Foreground/Sensors/A123 Battery Inputs/motohawk_override_abs2/OldValue" 1 "-" /end COMPU_VTAB
/begin COMPU_VTAB CompuVtab_51 "" TAB_VERB 2 0 "BuckyWagon_01/Foreground/Sensors/A123 Battery Inputs/motohawk_override_abs4/NewValue" 1 "-" /end COMPU_VTAB
/begin COMPU_VTAB CompuVtab_52 "" TAB_VERB 2 0 "BuckyWagon_01/Foreground/Control Strategy/HV Controller/motohawk_override_abs2/OldValue" 1 "-" /end COMPU_VTAB
/begin COMPU_VTAB CompuVtab_53 "" TAB_VERB 2 0 "BuckyWagon_01/Foreground/Sensors/A123 Battery Inputs/motohawk_override_abs4/OldValue" 1 "-" /end COMPU_VTAB
/begin COMPU_VTAB CompuVtab_54 "" TAB_VERB 2 0 "BuckyWagon_01/Foreground/Control Strategy/Reverse/motohawk_override_abs/NewValue" 1 "-" /end COMPU_VTAB
/begin COMPU_VTAB CompuVtab_55 "" TAB_VERB 2 0 "BuckyWagon_01/Foreground/Actuators/UQM Motor/motohawk_override_abs1/OldValue" 1 "-" /end COMPU_VTAB
/begin COMPU_VTAB CompuVtab_56 "" TAB_VERB 2 0 "BuckyWagon_01/Foreground/Sensors/A123 Battery Inputs/motohawk_override_abs5/NewValue" 1 "-" /end COMPU_VTAB
/begin COMPU_VTAB CompuVtab_57 "" TAB_VERB 2 0 "BuckyWagon_01/Foreground/Control Strategy/Reverse/motohawk_override_abs/OldValue" 1 "-" /end COMPU_VTAB
/begin COMPU_VTAB CompuVtab_58 "" TAB_VERB 2 0 "BuckyWagon_01/Foreground/Actuators/UQM Motor/motohawk_override_abs2/NewValue" 1 "-" /end COMPU_VTAB
/begin COMPU_VTAB CompuVtab_59 "" TAB_VERB 2 0 "BuckyWagon_01/Foreground/Control Strategy/motohawk_override_abs/NewValue" 1 "-" /end COMPU_VTAB
/begin COMPU_VTAB CompuVtab_60 "" TAB_VERB 2 0 "BuckyWagon_01/Foreground/Actuators/UQM Motor/motohawk_override_abs2/OldValue" 1 "-" /end COMPU_VTAB
/begin COMPU_VTAB CompuVtab_61 "" TAB_VERB 2 0 "BuckyWagon_01/Foreground/Control Strategy/motohawk_override_abs/OldValue" 1 "-" /end COMPU_VTAB
/begin COMPU_VTAB CompuVtab_62 "" TAB_VERB 2 0 "BuckyWagon_01/Foreground/Actuators/UQM Motor/motohawk_override_abs5/NewValue" 1 "-" /end COMPU_VTAB
/begin COMPU_VTAB CompuVtab_63 "" TAB_VERB 2 0 "BuckyWagon_01/Foreground/Actuators/Eaton HV Charger/motohawk_override_abs2/OldValue" 1 "-" /end COMPU_VTAB
/begin COMPU_VTAB CompuVtab_64 "" TAB_VERB 2 0 "BuckyWagon_01/Foreground/Sensors/A123 Battery Inputs/motohawk_override_abs/NewValue" 1 "-" /end COMPU_VTAB
/begin COMPU_VTAB CompuVtab_65 "" TAB_VERB 2 0 "BuckyWagon_01/Foreground/Actuators/UQM Motor/motohawk_override_abs5/OldValue" 1 "-" /end COMPU_VTAB
/begin COMPU_VTAB CompuVtab_66 "" TAB_VERB 2 0 "BuckyWagon_01/Foreground/Actuators/Eaton HV Charger/motohawk_override_abs3/NewValue" 1 "-" /end COMPU_VTAB
/begin COMPU_VTAB CompuVtab_67 "" TAB_VERB 2 0 "BuckyWagon_01/Foreground/Sensors/A123 Battery Inputs/motohawk_override_abs/OldValue" 1 "-" /end COMPU_VTAB
/begin COMPU_VTAB CompuVtab_68 "" TAB_VERB 2 0 "BuckyWagon_01/Foreground/Control Strategy/Drive/Normal Driving/Regen/motohawk_override_abs/NewValue" 1 "-" /end COMPU_VTAB
/begin COMPU_VTAB CompuVtab_69 "" TAB_VERB 2 0 "BuckyWagon_01/Foreground/Actuators/Eaton HV Charger/motohawk_override_abs3/OldValue" 1 "-" /end COMPU_VTAB
/begin COMPU_VTAB CompuVtab_70 "" TAB_VERB 2 0 "BuckyWagon_01/Foreground/Sensors/A123 Battery Inputs/motohawk_override_abs1/NewValue" 1 "-" /end COMPU_VTAB
/begin COMPU_VTAB CompuVtab_71 "" TAB_VERB 2 0 "BuckyWagon_01/Foreground/Control Strategy/Drive/Normal Driving/Regen/motohawk_override_abs/OldValue" 1 "-" /end COMPU_VTAB
/begin COMPU_VTAB CompuVtab_72 "" TAB_VERB 2 0 "BuckyWagon_01/Foreground/Actuators/Eaton HV Charger/motohawk_override_abs4/NewValue" 1 "-" /end COMPU_VTAB
/begin COMPU_VTAB CompuVtab_73 "" TAB_VERB 2 0 "BuckyWagon_01/Foreground/Sensors/A123 Battery Inputs/motohawk_override_abs1/OldValue" 1 "-" /end COMPU_VTAB
/begin COMPU_VTAB CompuVtab_74 "" TAB_VERB 2 0 "BuckyWagon_01/Foreground/Control Strategy/EHPAS_PercentControl/motohawk_override_abs1/NewValue" 1 "-" /end COMPU_VTAB
/begin COMPU_VTAB CompuVtab_75 "" TAB_VERB 2 0 "BuckyWagon_01/Foreground/Actuators/Eaton HV Charger/motohawk_override_abs4/OldValue" 1 "-" /end COMPU_VTAB
/begin COMPU_VTAB CompuVtab_76 "" TAB_VERB 2 0 "BuckyWagon_01/Foreground/Sensors/A123 Battery Inputs/motohawk_override_abs2/NewValue" 1 "-" /end COMPU_VTAB
/begin COMPU_VTAB CompuVtab_77 "" TAB_VERB 2 0 "BuckyWagon_01/Foreground/Control Strategy/EHPAS_PercentControl/motohawk_override_abs1/OldValue" 1 "-" /end COMPU_VTAB
/begin COMPU_VTAB CompuVtab_78 "" TAB_VERB 2 0 "BuckyWagon_01/Foreground/Actuators/Eaton HV Charger/motohawk_override_abs5/NewValue" 1 "-" /end COMPU_VTAB
/begin COMPU_VTAB CompuVtab_79 "" TAB_VERB 2 0 "BuckyWagon_01/Foreground/Control Strategy/HV Controller/motohawk_override_abs2/NewValue" 1 "-" /end COMPU_VTAB
/begin COMPU_VTAB CompuVtab_80 "" TAB_VERB 2 0 "BuckyWagon_01/Foreground/Actuators/Eaton HV Charger/motohawk_override_abs5/OldValue" 1 "-" /end COMPU_VTAB
/begin COMPU_VTAB CompuVtab_81 "" TAB_VERB 2 0 "BuckyWagon_01/Foreground/Actuators/UQM Motor/motohawk_override_abs1/NewValue" 1 "-" /end COMPU_VTAB
/begin COMPU_VTAB CompuVtab_82 "" TAB_VERB 2 0 "BuckyWagon_01/Foreground/Sensors/EMP Coolant Pump Inputs/motohawk_override_abs8/OldValue" 1 "-" /end COMPU_VTAB
/begin COMPU_VTAB CompuVtab_83 "" TAB_VERB 2 0 "BuckyWagon_01/Foreground/Sensors/EMP Coolant Pump Inputs/motohawk_override_abs9/NewValue" 1 "-" /end COMPU_VTAB
/begin COMPU_VTAB CompuVtab_84 "" TAB_VERB 2 0 "BuckyWagon_01/Foreground/Sensors/EHPAS Power Steering Pump Inputs/motohawk_override_abs9/OldValue" 1 "-" /end COMPU_VTAB
/begin COMPU_VTAB CompuVtab_85 "" TAB_VERB 2 0 "BuckyWagon_01/Foreground/Sensors/EMP Coolant Pump Inputs/motohawk_override_abs9/OldValue" 1 "-" /end COMPU_VTAB
/begin COMPU_VTAB CompuVtab_86 "" TAB_VERB 2 0 "BuckyWagon_01/Foreground/Sensors/EMP Coolant Pump Inputs/motohawk_override_abs1/NewValue" 1 "-" /end COMPU_VTAB
/begin COMPU_VTAB CompuVtab_87 "" TAB_VERB 2 0 "BuckyWagon_01/Foreground/Sensors/EHPAS Power Steering Pump Inputs/motohawk_override_abs10/OldValue" 1 "-" /end COMPU_VTAB
/begin COMPU_VTAB CompuVtab_88 "" TAB_VERB 2 0 "BuckyWagon_01/Foreground/Sensors/EMP Fan Inputs/motohawk_override_abs1/NewValue" 1 "-" /end COMPU_VTAB
/begin COMPU_VTAB CompuVtab_89 "" TAB_VERB 2 0 "BuckyWagon_01/Foreground/Sensors/EMP Coolant Pump Inputs/motohawk_override_abs1/OldValue" 1 "-" /end COMPU_VTAB
/begin COMPU_VTAB CompuVtab_90 "" TAB_VERB 2 0 "BuckyWagon_01/Foreground/Sensors/EHPAS Power Steering Pump Inputs/motohawk_override_abs2/NewValue" 1 "-" /end COMPU_VTAB
/begin COMPU_VTAB CompuVtab_91 "" TAB_VERB 2 0 "BuckyWagon_01/Foreground/Sensors/EMP Fan Inputs/motohawk_override_abs1/OldValue" 1 "-" /end COMPU_VTAB
/begin COMPU_VTAB CompuVtab_92 "" TAB_VERB 2 0 "BuckyWagon_01/Foreground/Sensors/EMP Coolant Pump Inputs/motohawk_override_abs10/NewValue" 1 "-" /end COMPU_VTAB
/begin COMPU_VTAB CompuVtab_93 "" TAB_VERB 2 0 "BuckyWagon_01/Foreground/Sensors/EHPAS Power Steering Pump Inputs/motohawk_override_abs2/OldValue" 1 "-" /end COMPU_VTAB
/begin COMPU_VTAB CompuVtab_94 "" TAB_VERB 2 0 "BuckyWagon_01/Foreground/Sensors/EMP Fan Inputs/motohawk_override_abs10/NewValue" 1 "-" /end COMPU_VTAB
/begin COMPU_VTAB CompuVtab_95 "" TAB_VERB 2 0 "BuckyWagon_01/Foreground/Sensors/EMP Coolant Pump Inputs/motohawk_override_abs10/OldValue" 1 "-" /end COMPU_VTAB
/begin COMPU_VTAB CompuVtab_96 "" TAB_VERB 2 0 "BuckyWagon_01/Foreground/Sensors/EHPAS Power Steering Pump Inputs/motohawk_override_abs3/NewValue" 1 "-" /end COMPU_VTAB
/begin COMPU_VTAB CompuVtab_97 "" TAB_VERB 2 0 "BuckyWagon_01/Foreground/Sensors/EMP Coolant Pump Inputs/motohawk_override_abs2/NewValue" 1 "-" /end COMPU_VTAB
/begin COMPU_VTAB CompuVtab_98 "" TAB_VERB 2 0 "BuckyWagon_01/Foreground/Sensors/EHPAS Power Steering Pump Inputs/motohawk_override_abs3/OldValue" 1 "-" /end COMPU_VTAB
/begin COMPU_VTAB CompuVtab_99 "" TAB_VERB 2 0 "BuckyWagon_01/Foreground/Sensors/EMP Coolant Pump Inputs/motohawk_override_abs2/OldValue" 1 "-" /end COMPU_VTAB
/begin COMPU_VTAB CompuVtab_100 "" TAB_VERB 2 0 "BuckyWagon_01/Foreground/Sensors/EHPAS Power Steering Pump Inputs/motohawk_override_abs7/NewValue" 1 "-" /end COMPU_VTAB
/begin COMPU_VTAB CompuVtab_101 "" TAB_VERB 2 0 "BuckyWagon_01/Foreground/Sensors/A123 Battery Inputs/motohawk_override_abs5/OldValue" 1 "-" /end COMPU_VTAB
/begin COMPU_VTAB CompuVtab_102 "" TAB_VERB 2 0 "BuckyWagon_01/Foreground/Sensors/EMP Coolant Pump Inputs/motohawk_override_abs3/NewValue" 1 "-" /end COMPU_VTAB
/begin COMPU_VTAB CompuVtab_103 "" TAB_VERB 2 0 "BuckyWagon_01/Foreground/Sensors/EHPAS Power Steering Pump Inputs/motohawk_override_abs7/OldValue" 1 "-" /end COMPU_VTAB
/begin COMPU_VTAB CompuVtab_104 "" TAB_VERB 2 0 "BuckyWagon_01/Foreground/Sensors/Analog Switch1/Override in Engineering Units/NewValue" 1 "-" /end COMPU_VTAB
/begin COMPU_VTAB CompuVtab_105 "" TAB_VERB 2 0 "BuckyWagon_01/Foreground/Sensors/EMP Coolant Pump Inputs/motohawk_override_abs3/OldValue" 1 "-" /end COMPU_VTAB
/begin COMPU_VTAB CompuVtab_106 "" TAB_VERB 2 0 "BuckyWagon_01/Foreground/Sensors/EHPAS Power Steering Pump Inputs/motohawk_override_abs8/NewValue" 1 "-" /end COMPU_VTAB
/begin COMPU_VTAB CompuVtab_107 "" TAB_VERB 2 0 "BuckyWagon_01/Foreground/Sensors/Analog Switch1/Override in Engineering Units/OldValue" 1 "-" /end COMPU_VTAB
/begin COMPU_VTAB CompuVtab_108 "" TAB_VERB 2 0 "BuckyWagon_01/Foreground/Sensors/EMP Coolant Pump Inputs/motohawk_override_abs8/NewValue" 1 "-" /end COMPU_VTAB
/begin COMPU_VTAB CompuVtab_109 "" TAB_VERB 2 0 "BuckyWagon_01/Foreground/Sensors/EHPAS Power Steering Pump Inputs/motohawk_override_abs8/OldValue" 1 "-" /end COMPU_VTAB
/begin COMPU_VTAB CompuVtab_110 "" TAB_VERB 2 0 "BuckyWagon_01/Foreground/Sensors/EHPAS Power Steering Pump Inputs/motohawk_override_abs1/NewValue" 1 "-" /end COMPU_VTAB
/begin COMPU_VTAB CompuVtab_111 "" TAB_VERB 2 0 "BuckyWagon_01/Foreground/Sensors/EHPAS Power Steering Pump Inputs/motohawk_override_abs9/NewValue" 1 "-" /end COMPU_VTAB
/begin COMPU_VTAB CompuVtab_112 "" TAB_VERB 2 0 "BuckyWagon_01/Foreground/Sensors/EHPAS Power Steering Pump Inputs/motohawk_override_abs1/OldValue" 1 "-" /end COMPU_VTAB
/begin COMPU_VTAB CompuVtab_113 "" TAB_VERB 2 0 "BuckyWagon_01/Foreground/Sensors/EHPAS Power Steering Pump Inputs/motohawk_override_abs10/NewValue" 1 "-" /end COMPU_VTAB
/begin COMPU_VTAB CompuVtab_114 "" TAB_VERB 2 0 "BuckyWagon_01/Foreground/Sensors/Eaton HV Charger/motohawk_override_abs7/NewValue" 1 "-" /end COMPU_VTAB
/begin COMPU_VTAB CompuVtab_115 "" TAB_VERB 2 0 "BuckyWagon_01/Foreground/Sensors/Eaton HV Charger/motohawk_override_abs1/OldValue" 1 "-" /end COMPU_VTAB
/begin COMPU_VTAB CompuVtab_116 "" TAB_VERB 2 0 "BuckyWagon_01/Foreground/Sensors/Eaton HV Charger/motohawk_override_abs7/OldValue" 1 "-" /end COMPU_VTAB
/begin COMPU_VTAB CompuVtab_117 "" TAB_VERB 2 0 "BuckyWagon_01/Foreground/Sensors/Eaton HV Charger/motohawk_override_abs2/NewValue" 1 "-" /end COMPU_VTAB
/begin COMPU_VTAB CompuVtab_118 "" TAB_VERB 2 0 "BuckyWagon_01/Foreground/Sensors/Eaton HV Charger/motohawk_override_abs8/NewValue" 1 "-" /end COMPU_VTAB
/begin COMPU_VTAB CompuVtab_119 "" TAB_VERB 2 0 "BuckyWagon_01/Foreground/Sensors/Eaton HV Charger/motohawk_override_abs2/OldValue" 1 "-" /end COMPU_VTAB
/begin COMPU_VTAB CompuVtab_120 "" TAB_VERB 2 0 "BuckyWagon_01/Foreground/Sensors/Eaton HV Charger/motohawk_override_abs3/NewValue" 1 "-" /end COMPU_VTAB
/begin COMPU_VTAB CompuVtab_121 "" TAB_VERB 2 0 "BuckyWagon_01/Foreground/Sensors/EMP Fan Inputs/motohawk_override_abs10/OldValue" 1 "-" /end COMPU_VTAB
/begin COMPU_VTAB CompuVtab_122 "" TAB_VERB 2 0 "BuckyWagon_01/Foreground/Sensors/EMP Fan Inputs/motohawk_override_abs2/NewValue" 1 "-" /end COMPU_VTAB
/begin COMPU_VTAB CompuVtab_123 "" TAB_VERB 2 0 "BuckyWagon_01/Foreground/Sensors/Eaton HV Charger/motohawk_override_abs8/OldValue" 1 "-" /end COMPU_VTAB
/begin COMPU_VTAB CompuVtab_124 "" TAB_VERB 2 0 "BuckyWagon_01/Foreground/Sensors/EMP Fan Inputs/motohawk_override_abs2/OldValue" 1 "-" /end COMPU_VTAB
/begin COMPU_VTAB CompuVtab_125 "" TAB_VERB 2 0 "BuckyWagon_01/Foreground/Sensors/Eaton HV Charger/motohawk_override_abs9/NewValue" 1 "-" /end COMPU_VTAB
/begin COMPU_VTAB CompuVtab_126 "" TAB_VERB 2 0 "BuckyWagon_01/Foreground/Sensors/Eaton HV Charger/motohawk_override_abs3/OldValue" 1 "-" /end COMPU_VTAB
/begin COMPU_VTAB CompuVtab_127 "" TAB_VERB 2 0 "BuckyWagon_01/Foreground/Sensors/EMP Fan Inputs/motohawk_override_abs3/NewValue" 1 "-" /end COMPU_VTAB
/begin COMPU_VTAB CompuVtab_128 "" TAB_VERB 2 0 "BuckyWagon_01/Foreground/Sensors/Eaton HV Charger/motohawk_override_abs9/OldValue" 1 "-" /end COMPU_VTAB
/begin COMPU_VTAB CompuVtab_129 "" TAB_VERB 2 0 "BuckyWagon_01/Foreground/Sensors/Eaton HV Charger/motohawk_override_abs4/NewValue" 1 "-" /end COMPU_VTAB
/begin COMPU_VTAB CompuVtab_130 "" TAB_VERB 2 0 "BuckyWagon_01/Foreground/Sensors/EMP Fan Inputs/motohawk_override_abs3/OldValue" 1 "-" /end COMPU_VTAB
/begin COMPU_VTAB CompuVtab_131 "" TAB_VERB 2 0 "BuckyWagon_01/Foreground/Sensors/Linear Sensor Characterization/Override/NewValue" 1 "-" /end COMPU_VTAB
/begin COMPU_VTAB CompuVtab_132 "" TAB_VERB 2 0 "BuckyWagon_01/Foreground/Sensors/Eaton HV Charger/motohawk_override_abs4/OldValue" 1 "-" /end COMPU_VTAB
/begin COMPU_VTAB CompuVtab_133 "" TAB_VERB 2 0 "BuckyWagon_01/Foreground/Sensors/EMP Fan Inputs/motohawk_override_abs8/NewValue" 1 "-" /end COMPU_VTAB
/begin COMPU_VTAB CompuVtab_134 "" TAB_VERB 2 0 "BuckyWagon_01/Foreground/Sensors/Linear Sensor Characterization/Override/OldValue" 1 "-" /end COMPU_VTAB
/begin COMPU_VTAB CompuVtab_135 "" TAB_VERB 2 0 "BuckyWagon_01/Foreground/Sensors/Eaton HV Charger/motohawk_override_abs5/NewValue" 1 "-" /end COMPU_VTAB
/begin COMPU_VTAB CompuVtab_136 "" TAB_VERB 2 0 "BuckyWagon_01/Foreground/Sensors/EMP Fan Inputs/motohawk_override_abs8/OldValue" 1 "-" /end COMPU_VTAB
/begin COMPU_VTAB CompuVtab_137 "" TAB_VERB 2 0 "BuckyWagon_01/Foreground/Sensors/Linear Sensor Characterization1/Override/NewValue" 1 "-" /end COMPU_VTAB
/begin COMPU_VTAB CompuVtab_138 "" TAB_VERB 2 0 "BuckyWagon_01/Foreground/Sensors/Eaton HV Charger/motohawk_override_abs5/OldValue" 1 "-" /end COMPU_VTAB
/begin COMPU_VTAB CompuVtab_139 "" TAB_VERB 2 0 "BuckyWagon_01/Foreground/Sensors/EMP Fan Inputs/motohawk_override_abs9/NewValue" 1 "-" /end COMPU_VTAB
/begin COMPU_VTAB CompuVtab_140 "" TAB_VERB 2 0 "BuckyWagon_01/Foreground/Sensors/Linear Sensor Characterization1/Override/OldValue" 1 "-" /end COMPU_VTAB
/begin COMPU_VTAB CompuVtab_141 "" TAB_VERB 2 0 "BuckyWagon_01/Foreground/Sensors/Eaton HV Charger/motohawk_override_abs6/NewValue" 1 "-" /end COMPU_VTAB
/begin COMPU_VTAB CompuVtab_142 "" TAB_VERB 2 0 "BuckyWagon_01/Foreground/Sensors/EMP Fan Inputs/motohawk_override_abs9/OldValue" 1 "-" /end COMPU_VTAB
/begin COMPU_VTAB CompuVtab_143 "" TAB_VERB 2 0 "BuckyWagon_01/Foreground/Sensors/Linear Sensor Characterization2/Override/NewValue" 1 "-" /end COMPU_VTAB
/begin COMPU_VTAB CompuVtab_144 "" TAB_VERB 2 0 "BuckyWagon_01/Foreground/Sensors/Eaton HV Charger/motohawk_override_abs6/OldValue" 1 "-" /end COMPU_VTAB
/begin COMPU_VTAB CompuVtab_145 "" TAB_VERB 2 0 "BuckyWagon_01/Foreground/Sensors/Eaton HV Charger/motohawk_override_abs1/NewValue" 1 "-" /end COMPU_VTAB
/begin COMPU_VTAB CompuVtab_146 "" TAB_VERB 2 0 "BuckyWagon_01/Main Power Relay/Background/Save NV Vars one tick before MPRD off" 1 "-" /end COMPU_VTAB
/begin COMPU_VTAB CompuVtab_147 "" TAB_VERB 2 0 "BuckyWagon_01/Foreground/Sensors/Linear Sensor Characterization2/Override/OldValue" 1 "-" /end COMPU_VTAB
/begin COMPU_VTAB CompuVtab_148 "" TAB_VERB 2 0 "BuckyWagon_01/Foreground/Sensors/Vehicle Speed/motohawk_override_abs/NewValue" 1 "-" /end COMPU_VTAB
/begin COMPU_VTAB CompuVtab_149 "" TAB_VERB 2 0 "BuckyWagon_01/Main Power Relay/Background/Save NV Vars one tick before MPRD off/Save NV Vars one tick before MPRD off" 1 "-" /end COMPU_VTAB
/begin COMPU_VTAB CompuVtab_150 "" TAB_VERB 2 0 "BuckyWagon_01/Main Power Relay/Background/Shutdown power on ECU565-128" 1 "-" /end COMPU_VTAB
/begin COMPU_VTAB CompuVtab_151 "" TAB_VERB 2 0 "BuckyWagon_01/Foreground/Sensors/Vehicle Speed/motohawk_override_abs/OldValue" 1 "-" /end COMPU_VTAB
/begin COMPU_VTAB CompuVtab_152 "" TAB_VERB 2 0 "BuckyWagon_01/Main Power Relay/Background/Shutdown power on ECU565-128/Shutdown power on ECU565-128" 1 "-" /end COMPU_VTAB
/begin COMPU_VTAB CompuVtab_153 "" TAB_VERB 2 0 "BuckyWagon_01/Foreground/Sensors/motohawk_override_abs1/NewValue" 1 "-" /end COMPU_VTAB
/begin COMPU_VTAB CompuVtab_154 "" TAB_VERB 2 0 "BuckyWagon_01/Main Power Relay/Background/motohawk_override_abs/NewValue" 1 "-" /end COMPU_VTAB
/begin COMPU_VTAB CompuVtab_155 "" TAB_VERB 2 0 "BuckyWagon_01/Foreground/Sensors/motohawk_override_abs1/OldValue" 1 "-" /end COMPU_VTAB
/begin COMPU_VTAB CompuVtab_156 "" TAB_VERB 2 0 "BuckyWagon_01/Main Power Relay/Background/motohawk_override_abs/OldValue" 1 "-" /end COMPU_VTAB
/begin COMPU_VTAB CompuVtab_157 "" TAB_VERB 2 0 "BuckyWagon_01/Main Power Relay/Background" 1 "-" /end COMPU_VTAB
/begin COMPU_VTAB CompuVtab_158 "" TAB_VERB 2 0 "BuckyWagon_01/Main Power Relay/Background/motohawk_restore_nvmem" 1 "-" /end COMPU_VTAB
/begin COMPU_VTAB CompuVtab_159 "" TAB_VERB 2 0 "BuckyWagon_01/Main Power Relay/Background/Display Variable Event Function-Call/Clear" 1 "-" /end COMPU_VTAB
/begin COMPU_VTAB CompuVtab_160 "" TAB_VERB 2 0 "BuckyWagon_01/Main Power Relay/Background/motohawk_store_nvmem" 1 "-" /end COMPU_VTAB
/begin COMPU_VTAB CompuVtab_161 "" TAB_VERB 2 0 "BuckyWagon_01/Main Power Relay/Background/Display Variable Event Function-Call1/Clear" 1 "-" /end COMPU_VTAB
/begin COMPU_VTAB CompuVtab_162 "" TAB_VERB 2 0 "BuckyWagon_01/Main Power Relay/Background/Post Shutdown two ticks before MPRD off" 1 "-" /end COMPU_VTAB
/begin COMPU_VTAB CompuVtab_163 "" TAB_VERB 2 0 "BuckyWagon_01/Main Power Relay/Background/Post Shutdown two ticks before MPRD off/Post Shutdown two ticks before MPRD off" 1 "-" /end COMPU_VTAB
/begin COMPU_VTAB CompuVtab_164 "" TAB_VERB 2 0 "BuckyWagon_01/Main Power Relay/Background/Processor Reboot" 1 "-" /end COMPU_VTAB
/begin COMPU_VTAB CompuVtab_165 "" TAB_VERB 4 0 "None" 1 "Torque" 2 "Speed" 3 "Voltage" /end COMPU_VTAB
/begin COMPU_VTAB CompuVtab_166 "" TAB_VERB 2 0 "Counter" 1 "None" /end COMPU_VTAB
/begin COMPU_VTAB CompuVtab_167 "" TAB_VERB 6 0 "Off" 1 "Low_Speed_Maneuvering" 2 "Normal_Driving" 3 "Normal_DrivingWithBrake" 4 "KeyUpActive" 5 "ZeroSpeedBraking" /end COMPU_VTAB
/begin COMPU_VTAB CompuVtab_168 "" TAB_VERB 47 -1 "(None)" 56 "AN1M" 57 "AN2M" 58 "AN3M" 59 "AN4M" 60 "AN5M" 61 "AN6M" 62 "AN7M" 63 "AN8M" 64 "AN9M" 65 "AN10M" 66 "AN11M" 67 "AN12M" 68 "AN13M" 69 "AN14M" 70 "AN15M" 71 "AN16M" 72 "AN17M" 73 "AN18M" 74 "AN19M" 75 "AN20M" 76 "AN21M" 77 "AN22M" 78 "AN23M" 79 "AN24M" 80 "AN25M" 81 "AN26M" 82 "AN27M" 83 "AN28M" 84 "AN29M" 85 "AN30M" 86 "AN31M" 87 "AN32M" 88 "AN33M" 89 "AN34M" 90 "O2A" 91 "O2B" 93 "DG1M" 94 "DG2M" 95 "DG3M" 96 "DG4M" 102 "DG5M" 103 "DG6M" 104 "DG7M" 105 "SPD1" 106 "SPD2" 111 "DG8M" /end COMPU_VTAB
/begin COMPU_VTAB CompuVtab_171 "" TAB_VERB 43 -1 "(None)" 1 "H1" 10 "H2" 12 "FINJ1" 13 "FINJ2" 14 "FINJ3" 15 "FINJ4" 16 "FINJ5" 17 "FINJ6" 18 "FINJ7" 19 "FINJ8" 20 "FINJ9" 21 "FINJ10" 22 "FINJ11" 23 "FINJ12" 24 "TACH" 25 "LSD1" 26 "LSD2" 27 "LSD3" 28 "LSD4" 29 "LSD5" 30 "LSD6" 31 "LSD7" 32 "LSD8" 33 "LSD9" 34 "LSD10" 36 "EST 1" 37 "EST 2" 38 "EST 3" 39 "EST 4" 40 "EST 5" 41 "EST 6" 42 "EST 7" 43 "EST 8" 44 "EST 9" 45 "EST 10" 46 "EST 11" 47 "EST 12" 48 "EST 13" 49 "EST 14" 50 "EST 15" 51 "EST 16" 107 "H3" /end COMPU_VTAB
/begin COMPU_VTAB CompuVtab_179 "" TAB_VERB 74 0 "NO_OS_ERROR" 1 "PROSAK_TPU_ALLOCATE" 2 "PROSAK_DEADLOCK_PROT" 3 "QSPI_SEND_SIZE_ZERO" 4 "QSPI_SEND_SIZE_TOO_BIG" 5 "QSPI_RD_SIZE_TOO_BIG" 6 "QSPI_RD_SIZE_ZERO" 7 "QSPI_WR_SIZE_TOO_BIG" 8 "QSPI_WR_SIZE_ZERO" 9 "QSPI_CMD_SIZE_TOO_BIG" 10 "QSPI_CMD_SIZE_ZERO" 11 "IGN_DIAG_MDA_ALLOCATE" 12 "EEDataDirSizeMisMatch" 13 "EE_WRITE_QUEUE_OVFLOW" 14 "ESC_HBRIDGE_MDA_ALLOCATE" 15 "ETC_DIAG_MDA_ALLOCATE" 16 "DFLT_ENCODER_CREATE_ERR" 17 "ADC_TPU_ALLOCATE" 18 "SWISR_QUEUE_OVERFLOW" 19 "WATCHDOG_RESET" 20 "CHECKSTOP_RESET" 21 "SPIEE_WR_STAT_REG_ERR" 22 "SPIEE_QUEUE_OVFL_STATUS" 23 "SPIEE_WRITE_FAIL_ERR" 24 "Requested TPU Func not in mask" 25 "Unable to allocate QSPI knock" 26 "Stack has overflowed!" 27 "TPU Limits not setup" 28 "INVALID TPU MASK" 29 "TPU Mask Corrupt" 30 "Sequence Create with No Encoder" 31 "Illegal Sequence ISR" 32 "TPU Mask Version is insufficient" 33 "MUX PSP requested for 2-Stroke" 34 "Ext Flash Acc Denied" 35 "Ext Flash Erase Fail" 36 "Ext Flash Write Fail" 37 "Ext Flash Allign Error" 38 "EXT_FLASH_WR_ZERO_SIZE" 39 "Illegal Ext Flash Addr" 40 "Error: Write to non-existent Flash" 41 "Too many Logs want to be active" 42 "Bank Seq Destroy Problem" 43 "Transient Seq Destroy Problem" 44 "Transient Seq Update Problem" 45 "SPIEE System had a memory problem" 46 "Spent too long waiting for a sync return" 47 "TPUC Mask does not pair with TPUA/B mask" 48 "The Module Configuration was not available" 49 "Diagnostic Mux did not create" 50 "FGND Angle event queue overflow" 51 "FGND Time event queue overflow" 52 "EEPROM write to CAMDelay failed" 53 "SleepTask call from in ISR" 54 "Bad Kernel API call detected" 55 "Kernel Internal" 56 "SPIEE Device create" 57 "NAND Flash timeout on Write" 58 "NAND Flash timeout on Erase" 59 "NAND Flash WP" 60 "NAND Flash RDY/BUSYb" 61 "NAND Flash Access" 62 "NAND Flash Device" 63 "USB Core Stack Initialisation" 64 "USB Stack Assert" 65 "EXT_EE_ACCESS" 66 "VARCAM_PATTERN_SETUP" 67 "FP Divide by Zero" 68 "Unable to allocate requested memory on heap" 69 "Unable create Fgnd Angle task" 70 "FP Denormalized number" 71 "RPMVector Buffers Full" 72 "RPMVector Overrun" 73 "Failed to Write TPU Self Modify Parameter" /end COMPU_VTAB
/begin COMPU_VTAB CompuVtab_180 "" TAB_VERB 42 -1 "(None)" 53 "ECUP" 54 "DRVP" 55 "XDRP" 56 "AN1M" 57 "AN2M" 58 "AN3M" 59 "AN4M" 60 "AN5M" 61 "AN6M" 62 "AN7M" 63 "AN8M" 64 "AN9M" 65 "AN10M" 66 "AN11M" 67 "AN12M" 68 "AN13M" 69 "AN14M" 70 "AN15M" 71 "AN16M" 72 "AN17M" 73 "AN18M" 74 "AN19M" 75 "AN20M" 76 "AN21M" 77 "AN22M" 78 "AN23M" 79 "AN24M" 80 "AN25M" 81 "AN26M" 82 "AN27M" 83 "AN28M" 84 "AN29M" 85 "AN30M" 86 "AN31M" 87 "AN32M" 88 "AN33M" 89 "AN34M" 90 "O2A" 91 "O2B" 92 "XDRP_B" 143 "REF_14V" /end COMPU_VTAB
/begin COMPU_VTAB CompuVtab_181 "" TAB_VERB 6 0 "Calibratable Development Module" 1 "Non-Calibratable Production Module" 2 "Software Dev Module (with RAM overlay only)" 3 "Software Dev Module (with Trace Pod & RAM)" 4 "Calibratable Development Module with Censorship disabled" 5 "Non-Calibratable Production Module with Censorship disabled" /end COMPU_VTAB
/begin COMPU_VTAB CompuVtab_186 "" TAB_VERB 2 0 "Abnormal Operation!" 1 "Operating Normally" /end COMPU_VTAB
/begin COMPU_VTAB CompuVtab_189 "" TAB_VERB 2 0 "Disable" 1 "Enable" /end COMPU_VTAB
/begin COMPU_VTAB CompuVtab_192 "" TAB_VERB 40 0 "TPU Mask Undefined" 1 "60-6" 2 "GM24Xe" 3 "GM24Xe on Cam" 4 "N-1/N-2 [Half Moon Cam]" 5 "NX Encoder" 6 "NX Encoder on Cam" 7 "30-5 on Cnk" 8 "Hyundai 60" 9 "X Plus 1 on Cnk with ToothCam" 10 "X Shift 1 on Cnk" 11 "N Encoder" 12 "N-1/N-2 [Tooth Cam]" 13 "ISDL" 14 "X Pulse Width on Cam" 15 "X Pulse Width on Cnk" 16 "1 Pulse on Cnk" 17 "1 Pulse on Cam" 18 "N-1/N-2 Dual Redundancy" 19 "N-1/N-2 Variable Cam" 20 "N-1/N-2 [Duramax CAM] [Multiplexed EST (1,2, or 4,5,6,7,8) (9,10,11 or 13,14,15)]" 21 "X Plus 1 on Cnk + MuxPSP on EST > 9" 22 "NX Encoder with Hyundai 4 Tooth CAM with one wide" 23 "NX Encoder with 360Deg CAM Providing Crank Sync" 24 "NissanZ 36-6 Encoder, sync on custom CAM" 25 "36-1 Encoder, sync on custom Coyote CAM" 26 "N Groups of 4 teeth - 2, sync on CAM" 27 "NissanZ 36-6 Encoder, sync on 6Tooth 2Missing Plus2 Variable CAM" 28 "EVO9 2X Encoder with 1X_PLUS1 CAM on Exhaust and 4X Variable CAM on Intake" 29 "N-1/N-2 Variable Cam with Windowed Sync" 30 "36M4 (2x18 teeth sectors with 2 missing) and Kohki Cam" 31 "N-3/N-4 [ToothCam]" 32 "N-3/N-4 [Plus1Cam (X+1)]" 33 "Hyundai 60 with EncoderSynthesizer variant on TPUC" 34 "N-1/N-2 [Half Moon Cam]" 35 "X Plus 1 on Cnk with X Plus 1 Cam" 36 "X Plus 1 on Cnk with X Plus 1 Cam with Encoder Synthesizer" 37 "N-1/N-2 [XPlus1 Cam]" 38 "X Shift 1 Retarded [ToothCam]" 39 "N-1/N-2 [Tooth Cam] with MuxPSP" /end COMPU_VTAB
/begin COMPU_VTAB CompuVtab_193 "" TAB_VERB 2 0 "Reverse" 1 "Forward" /end COMPU_VTAB
/begin COMPU_VTAB CompuVtab_194 "" TAB_VERB 3 0 "Default" 1 "Efficiency" 2 "Acoustic" /end COMPU_VTAB
/*~~~~~~~~~ 6.3.65 FUNCTIONs ~~~~~~~~~*/
/begin FUNCTION Project_Config "" /begin DEF_CHARACTERISTIC project_id ProductID /end DEF_CHARACTERISTIC /end FUNCTION
/begin FUNCTION System_Config "" /begin DEF_CHARACTERISTIC FriendlyName PasswordTxt /end DEF_CHARACTERISTIC /begin SUB_FUNCTION Project_Config Communication_Config /end SUB_FUNCTION /end FUNCTION
/begin FUNCTION System ""
 /begin SUB_FUNCTION System_Config Version Status I_O_Pins Debug CCP Code_Coverage Performance Main_Power_Relay NonVolatile_Storage /end SUB_FUNCTION
/end FUNCTION
/begin FUNCTION Version ""
 /begin DEF_CHARACTERISTIC SwIdTxt CalIdTxt SwRevisionTxt CompilerVersion ControlCoreSDKRelease MatlabVersionTxt MotoHawkBuildGUID MotoHawkModelGUID MotoHawkModelName MotoHawkTokenGUID MotoHawkVersionTxt /end DEF_CHARACTERISTIC
 /begin OUT_MEASUREMENT table_0_rev table_1_rev table_2_rev KeyRev EriRev table_3_rev table_4_rev table_5_rev table_6_rev table_7_rev MotProgRev ApplicationCompatibilityArr LinkStatus MotoHawkModelSecondsInUse SystemFrequency TPUMaskType TPUMaskVers Unused /end OUT_MEASUREMENT
/end FUNCTION
/begin FUNCTION Module_Config "" /begin DEF_CHARACTERISTIC SerialNumber ModelNumber PartNumber /end DEF_CHARACTERISTIC
 /begin OUT_MEASUREMENT BootVerMaj BootVerMin EcuHwMaj EcuHwMin ConfigVerMaj ConfigVerMin ModuleCapability /end OUT_MEASUREMENT
/end FUNCTION
/begin FUNCTION Status "" /begin SUB_FUNCTION Module_Config OS Framework /end SUB_FUNCTION /end FUNCTION
/begin FUNCTION Diagnostics_and_Protection ""
 /begin DEF_CHARACTERISTIC A123_Isolation_Monitor_Ground_Fault_Threshold AccelRstSpd AccelRstThres Battery_OverTemp_Threshold Battery_UnderTemp_Threshold ChargeInterruptor_Voltage High12VThres InverterTemp_Overheat Low12VThres StallSpd StallTrqThres /end DEF_CHARACTERISTIC
 /begin OUT_MEASUREMENT IntStallTorque /end OUT_MEASUREMENT
/end FUNCTION
/begin FUNCTION UQMController "" /begin DEF_CHARACTERISTIC Drive_Enable_Delay /end DEF_CHARACTERISTIC
 /begin OUT_MEASUREMENT ABC_Phase_Order Acceleration_Limited Accurate_Current Accurate_Speed Accurate_Torque Accurate_Voltage ADC_Calibration_Problem ADC_Calibration_Problem_History Angular_Distance Bad_Position_Signal Bad_Switch CAN_Limits_In_Effect Current_Transducer_Fault_IbusIleg Drive_Ready_Prb Forced_Open_Loop Forced_Voltage_Control High_Bound Invalid_Power_Supply Inverter_Fault Inverter_Fault_History Inverter_Fault_Occured Inverter_Fault_Occured_History Inverter_Over_Temperature_History Inverter_Over_Temperautre Inverter_Temperature Leg_Current Limp_Home_Mode Limp_Home_Mode_History Low_Bound Motor_Derate Motor_Not_Enabled Motor_Not_Enabled_History Motor_Shutdown Motor_Stalled Over_Bus_Current Over_Bus_Current_History Over_Leg_Current Over_Leg_Current_History Over_Phase_Advance Over_Phase_Advance_History Over_Speed_Alarm Over_Speed_Alarm_History Over_Speed_Warning Over_Speed_Warning_History Over_Voltage_Alarm Over_Voltage_Alarm_History Over_Voltage_Warning Over_Voltage_Warning_History Phase_Current_Sensor_Error Power_Switches_Off Regen_Switch_Open Rotor_Over_Temperature Rotor_Over_Temperature_History Rotor_Temp Software_Release_Major_Version Software_Release_Minor_Version Software_Release_Sub_Version Stall_Safety_Percentage Stator_Over_Temperature Stator_Over_Temperature_History Stator_Temp Status_A Status_C System_Disabled_In_Motrion Torque_Desired Turbo_Mode Under_Voltage_Warning Under_Voltage_Warning_History Using_Raw_Speed Watchdog_Error Watchdog_Status /end OUT_MEASUREMENT
/end FUNCTION
/begin FUNCTION Sensors "" /begin OUT_MEASUREMENT DC_Voltage /end OUT_MEASUREMENT
 /begin SUB_FUNCTION UQMController Accel EHPAS BCM_1 Brake EatonCharger_1 EMP_Coolant_Pump EMP_Cooling_Fan Vehicle_Speed LVVolt Reverse_2 /end SUB_FUNCTION
/end FUNCTION
/begin FUNCTION Accel_Pedal "" /begin OUT_MEASUREMENT Accel_ADC Accel_Pedal Accel_Raw /end OUT_MEASUREMENT /begin SUB_FUNCTION Accel_Pedal_Config Accel_Pedal_Override /end SUB_FUNCTION /end FUNCTION
/begin FUNCTION Accel "" /begin SUB_FUNCTION Accel_Pedal /end SUB_FUNCTION /end FUNCTION
/begin FUNCTION Accel_Pedal_Config ""
 /begin DEF_CHARACTERISTIC Accel_DfltValue Accel_FilterConst Accel_Full Accel_InputHiFltPos Accel_InputLoFltPos Accel_Zero /end DEF_CHARACTERISTIC
/end FUNCTION
/begin FUNCTION Accel_Pedal_Override "" /begin DEF_CHARACTERISTIC Accel_Pedal_new Accel_Pedal_ovr /end DEF_CHARACTERISTIC /end FUNCTION
/begin FUNCTION Inputs_Config ""
 /begin DEF_CHARACTERISTIC Accel_Pedal_Pin Accel_Pedal_Pin_ref Brake_Pedal_Pin Brake_Pedal_Pin_ref EStop_Switch_Pin LV_Voltage_Pin LV_Voltage_Pin_ref Reverse_Switch_Pin Reverse_Switch_Pin_ref /end DEF_CHARACTERISTIC
/end FUNCTION
/begin FUNCTION I_O_Pins "" /begin SUB_FUNCTION Inputs_Config Outputs_Config /end SUB_FUNCTION /end FUNCTION
/begin FUNCTION Diagnostic___Protection "" /begin OUT_MEASUREMENT Accel_Zeroed_Since_KeyUp /end OUT_MEASUREMENT /end FUNCTION
/begin FUNCTION UQM ""
 /begin DEF_CHARACTERISTIC Acceleration_Limit CAN_Watchdog_Reset Control_Mode Forward_Speed_Limit Heartbeat_Identifier_1 Heartbeat_Identifier_2 Ignore_Accel_Limit Limits_Control_Mode Reverse_Speed_Limit Suge_Limit UQM_TurboMode Use_Raw_Speed Watchdog_Reset_Num /end DEF_CHARACTERISTIC
 /begin OUT_MEASUREMENT UQM_Direction UQM_Enable UQM_Torque /end OUT_MEASUREMENT
 /begin SUB_FUNCTION Counter UQM_Direction_Override UQM_Enable_Override UQM_Torque_Override /end SUB_FUNCTION
/end FUNCTION
/begin FUNCTION Actuators ""
 /begin SUB_FUNCTION UQM BCM Reverse EatonCharger EHPAS_1 EMP_Cooling_Fan_1 EMP_Coolant_Pump_1 Fan DC_DC /end SUB_FUNCTION
/end FUNCTION
/begin FUNCTION Normal_Driving ""
 /begin DEF_CHARACTERISTIC AccelPedalMap_v2Tbl Max_Slect_Tq_drive Temp_ped_switchOver Veh_Speed_Regen_Filter /end DEF_CHARACTERISTIC
 /begin OUT_MEASUREMENT AccelPedalMap_v2 AccelPedalMap_v2Idx AccelPedalMap_v2In /end OUT_MEASUREMENT
 /begin SUB_FUNCTION Regen /end SUB_FUNCTION
/end FUNCTION
/begin FUNCTION Drive "" /begin DEF_CHARACTERISTIC Reverse_TQ_Negative_Enable /end DEF_CHARACTERISTIC /begin SUB_FUNCTION Normal_Driving /end SUB_FUNCTION /end FUNCTION
/begin FUNCTION Control_Strategy "" /begin DEF_CHARACTERISTIC TorqueRequestLP /end DEF_CHARACTERISTIC /begin OUT_MEASUREMENT motor_Torque pre_Filter_Torque_Request /end OUT_MEASUREMENT
 /begin SUB_FUNCTION Drive HV_Controller EHPAS_PercentControl Cooling Calculations Reverse_1 motor_torque_Ovr_Override /end SUB_FUNCTION
/end FUNCTION
/begin FUNCTION Foreground ""
 /begin SUB_FUNCTION Control_Strategy Actuators_1 MiniViewDisplay Sensors_1 Addl_Fault_Detection /end SUB_FUNCTION
/end FUNCTION
/begin FUNCTION BuckyWagon_01 "" /begin OUT_MEASUREMENT TimeSinceKeyOn /end OUT_MEASUREMENT /begin SUB_FUNCTION Foreground Strategy startup onTimeCount /end SUB_FUNCTION /end FUNCTION
/begin FUNCTION EHPAS ""
 /begin OUT_MEASUREMENT AgeCount EHPAS_Fault EHPAS_Input_Current_NA EHPAS_Input_Voltage EHPAS_Op_State EHPAS_Pump_Speed EHPAS_TempCur EHPAS_TempMax /end OUT_MEASUREMENT
/end FUNCTION
/begin FUNCTION AnalogIn ""
 /begin OUT_MEASUREMENT ain_create_Accel_Pedal_Pin ain_create_Brake_Pedal_Pin ain_create_ECUP ain_create_LV_Voltage_Pin ain_create_Reverse_Switch_Pin ain_read_Accel_Pedal_Pin ain_read_Brake_Pedal_Pin ain_read_ECUP ain_read_LV_Voltage_Pin ain_read_Reverse_Switch_Pin /end OUT_MEASUREMENT
/end FUNCTION
/begin FUNCTION Resources "" /begin SUB_FUNCTION AnalogIn CAN DigitalInput DiscreteOut EZLink_1 PWM Other /end SUB_FUNCTION /end FUNCTION
/begin FUNCTION Debug ""
 /begin SUB_FUNCTION Resources Application_Monitor Application_Monitor_Config Event_Pause_Counters General /end SUB_FUNCTION
/end FUNCTION
/begin FUNCTION BCM "" /begin DEF_CHARACTERISTIC Allow_MainContactor_Close /end DEF_CHARACTERISTIC
 /begin OUT_MEASUREMENT hsc_bcm_enable hsc_bcm_epo hsc_bcm_leakage_enable hsc_bcm_mainc_enable /end OUT_MEASUREMENT
 /begin SUB_FUNCTION hsc_bcm_enable_Override hsc_bcm_epo_Override hsc_bcm_leakage_enable_Override hsc_bcm_mainc_enable_Override /end SUB_FUNCTION
/end FUNCTION
/begin FUNCTION Application_Monitor "" /begin DEF_CHARACTERISTIC ApplicationStatus /end DEF_CHARACTERISTIC
 /begin OUT_MEASUREMENT ApplicationInitStatus ApplicationStopReason ApplicationStopReasonBlock /end OUT_MEASUREMENT
/end FUNCTION
/begin FUNCTION Application_Monitor_Config ""
 /begin DEF_CHARACTERISTIC ApplicationMonitorEnable ApplicationPausePoint BgndStackMargin CPUMargin FgndTimeStackMargin HeapMargin IdleStackMargin InterruptStackMargin /end DEF_CHARACTERISTIC
/end FUNCTION
/begin FUNCTION HV_Controller "" /begin DEF_CHARACTERISTIC Batt_Load_Enable /end DEF_CHARACTERISTIC /begin SUB_FUNCTION Contacter_Controller /end SUB_FUNCTION /end FUNCTION
/begin FUNCTION BCM_1 ""
 /begin OUT_MEASUREMENT bcm_alarm bcm_cell_overvolt_probe bcm_cell_tmax bcm_cell_tmin bcm_cell_undervolt bcm_cell_vmax bcm_cell_vmin bcm_chg_buf bcm_chg_done bcm_chg_max bcm_chga_ena bcm_chga_mon bcm_chgc_stat bcm_cool_req bcm_cpwr_cmd bcm_cpwr_mon bcm_dis_buf bcm_dis_max bcm_epo bcm_gfd bcm_hvil_mon bcm_ibat bcm_lvbat bcm_mainc_stat bcm_mod_ena bcm_ready bcm_soc bcm_t_coolant bcm_vbat bcm_veh_mon /end OUT_MEASUREMENT
 /begin SUB_FUNCTION bcm_cell_overvolt_ovr_Override bcm_chargec_stat_Override bcm_mainc_stat_Override bcm_ready_Override SOC_Override /end SUB_FUNCTION
/end FUNCTION
/begin FUNCTION bcm_cell_overvolt_ovr_Override "" /begin DEF_CHARACTERISTIC bcm_cell_overvolt_ovr_new bcm_cell_overvolt_ovr_ovr /end DEF_CHARACTERISTIC /end FUNCTION
/begin FUNCTION bcm_chargec_stat_Override "" /begin DEF_CHARACTERISTIC bcm_chargec_stat_new bcm_chargec_stat_ovr /end DEF_CHARACTERISTIC /end FUNCTION
/begin FUNCTION bcm_mainc_stat_Override "" /begin DEF_CHARACTERISTIC bcm_mainc_stat_new bcm_mainc_stat_ovr /end DEF_CHARACTERISTIC /end FUNCTION
/begin FUNCTION bcm_ready_Override "" /begin DEF_CHARACTERISTIC bcm_ready_new bcm_ready_ovr /end DEF_CHARACTERISTIC /end FUNCTION
/begin FUNCTION Event_Pause_Counters ""
 /begin DEF_CHARACTERISTIC BGND_BASE_PERIODIC_RunCnt BGND_BASEx10_PERIODIC_RunCnt BGND_BASEx2_PERIODIC_RunCnt BGND_BASEx20_PERIODIC_RunCnt FGND_10XRTI_PERIODIC_RunCnt FGND_20XRTI_PERIODIC_RunCnt FGND_2XRTI_PERIODIC_RunCnt FGND_RTI_PERIODIC_RunCnt IDLE_EVENT_RunCnt ONE_SECOND_EVENT_RunCnt SHUTDOWN_EVENT_RunCnt STARTUP_EVENT_RunCnt /end DEF_CHARACTERISTIC
/end FUNCTION
/begin FUNCTION OS ""
 /begin OUT_MEASUREMENT BgndAngTaskStatus BgndStackMinBytesFree BgndTimeTaskStatus FgndAngleStackMinBytesFree FgndAngTaskStatus FgndTimeStackMinBytesFree IdleStackMinBytesFree InterruptStackMinBytesFree LastOSError OSErrorCnt OSStatus PeakHeapBytesUsed SWISRCurrQueueSize /end OUT_MEASUREMENT
/end FUNCTION
/begin FUNCTION EHPAS_PercentControl ""
 /begin DEF_CHARACTERISTIC Brake_Active_Threshold brakeTime_sec creepSpeed EHPAS_brakeEn EHPAS_driveEn EHPAS_driveNbrakeEn EHPAS_IdleEn EHPAS_keyUpEn EHPAS_lowSpeedEn EHPAS_slowingEn EHPAS_stoppingEn hardBrakeLev KeyOnRuntime_Sec LowSpeedManeuverRuntime minPumpRunTime stopSpeed /end DEF_CHARACTERISTIC
 /begin OUT_MEASUREMENT EHPAS_PumpState_probe /end OUT_MEASUREMENT
 /begin SUB_FUNCTION EHPAS_PumpStateEnable_ovr_Override /end SUB_FUNCTION
/end FUNCTION
/begin FUNCTION Brake_Pedal "" /begin OUT_MEASUREMENT Brake_ADC Brake_Pedal Brake_Raw /end OUT_MEASUREMENT /begin SUB_FUNCTION Brake_Pedal_Config Brake_Pedal_Override /end SUB_FUNCTION /end FUNCTION
/begin FUNCTION Brake "" /begin SUB_FUNCTION Brake_Pedal /end SUB_FUNCTION /end FUNCTION
/begin FUNCTION Brake_Pedal_Config ""
 /begin DEF_CHARACTERISTIC Brake_DfltValue Brake_FilterConst Brake_Full Brake_InputHiFltPos Brake_InputLoFltPos Brake_Zero /end DEF_CHARACTERISTIC
/end FUNCTION
/begin FUNCTION Analog_Out "" /begin DEF_CHARACTERISTIC Brake_light_On_Setpoint Enable_Brake_Light_Out /end DEF_CHARACTERISTIC /begin SUB_FUNCTION ReverseInd /end SUB_FUNCTION /end FUNCTION
/begin FUNCTION Actuators_1 "" /begin DEF_CHARACTERISTIC Enable_PowerSteering_CAN_Msg /end DEF_CHARACTERISTIC /begin SUB_FUNCTION Analog_Out A123_Battery_Controller /end SUB_FUNCTION /end FUNCTION
/begin FUNCTION Outputs_Config "" /begin DEF_CHARACTERISTIC Brake_Light_Out DCDCInhibit_Out_Pin Fan_Pin ReverseOut_Pin /end DEF_CHARACTERISTIC /end FUNCTION
/begin FUNCTION Brake_Pedal_Override "" /begin DEF_CHARACTERISTIC Brake_Pedal_new Brake_Pedal_ovr /end DEF_CHARACTERISTIC /end FUNCTION
/begin FUNCTION CAN ""
 /begin OUT_MEASUREMENT CAN_1_ext_handled_count CAN_1_ext_last_unhandled_id CAN_1_ext_receive_count CAN_1_std_handled_count CAN_1_std_last_unhandled_id CAN_1_std_receive_count CAN_2_ext_handled_count CAN_2_ext_last_unhandled_id CAN_2_ext_receive_count CAN_2_std_handled_count CAN_2_std_last_unhandled_id CAN_2_std_receive_count can_create_CAN_1 can_create_CAN_2 can_tx_err_CAN_1_0 can_tx_err_CAN_1_0_27 can_tx_err_CAN_2_0 can_tx_err_CAN_2_0_28 protocol_register_CAN_1 /end OUT_MEASUREMENT
/end FUNCTION
/begin FUNCTION Reverse "" /begin DEF_CHARACTERISTIC cCInd_LongOff cCInd_OnTime cCInd_ShortTime /end DEF_CHARACTERISTIC /begin OUT_MEASUREMENT Flash_Reverse_Lights_Probe /end OUT_MEASUREMENT /begin SUB_FUNCTION Flash_Reverse_Lights_Ovr_Override ReverseOut /end SUB_FUNCTION /end FUNCTION
/begin FUNCTION CCP1 "" /begin DEF_CHARACTERISTIC CCP1_StationAddr CCP1RxID CCP1RxIDMask CCP1TxID /end DEF_CHARACTERISTIC
 /begin OUT_MEASUREMENT CCP_CCP1_Access CCP_CCP1_Access.CCP_CCP1_CAL CCP_CCP1_Access.CCP_CCP1_DAQ CCP_CCP1_Access.CCP_CCP1_PGM CCP_CCP1_ConnectionStatus /end OUT_MEASUREMENT
/end FUNCTION
/begin FUNCTION CCP "" /begin SUB_FUNCTION CCP1 /end SUB_FUNCTION /end FUNCTION
/begin FUNCTION Charge_Complete_Override_Override "" /begin DEF_CHARACTERISTIC Charge_Complete_Override_new Charge_Complete_Override_ovr /end DEF_CHARACTERISTIC /end FUNCTION
/begin FUNCTION EatonCharger "" /begin DEF_CHARACTERISTIC ChargeComplete_SOC Current_Limit Voltage_Limit /end DEF_CHARACTERISTIC
 /begin OUT_MEASUREMENT Charge_Complete_Probe Charge_Enable_Probe Charge_Falt_Probe Current_Limit_Probe Voltage_Limit_Probe /end OUT_MEASUREMENT
 /begin SUB_FUNCTION Charge_Complete_Override_Override Charge_Enable_Override_Override Charge_Falt_Override_Override Current_Limit_Override_Override Voltage_Limit_Override_Override /end SUB_FUNCTION
/end FUNCTION
/begin FUNCTION Charge_Enable_Override_Override "" /begin DEF_CHARACTERISTIC Charge_Enable_Override_new Charge_Enable_Override_ovr /end DEF_CHARACTERISTIC /end FUNCTION
/begin FUNCTION Charge_Falt_Override_Override "" /begin DEF_CHARACTERISTIC Charge_Falt_Override_new Charge_Falt_Override_ovr /end DEF_CHARACTERISTIC /end FUNCTION
/begin FUNCTION Cooling ""
 /begin DEF_CHARACTERISTIC Charger_Temp_Enable Charger_Temp_Offset Coolant_FanTbl Coolant_PumpTbl Inverter_Temp_Enable Inverter_Temp_Offset Overheat_PumpFan_Speed Overheat_Threshold Rotor_Temp_Enable Rotor_Temp_Offset Stator_Temp_Enable Stator_Temp_Offset /end DEF_CHARACTERISTIC
 /begin OUT_MEASUREMENT Coolant_Fan Coolant_FanIdx Coolant_FanIn Coolant_Pump Coolant_PumpIdx Coolant_PumpIn CoolantPumpSpeed_out RadiatorFanSpeed_out /end OUT_MEASUREMENT
/end FUNCTION
/begin FUNCTION EatonCharger_1 "" /begin DEF_CHARACTERISTIC PluggedInHistTimeeaton PluggedInMainsThesEaton /end DEF_CHARACTERISTIC
 /begin OUT_MEASUREMENT ChargerState Eaton_HV_Charger_Temperature_probe EatonpluggedIn FaultSeverityIndicator IgnitionStatus InputCurrentLimitMax Mains_Current_Draw_Probe Mains_Voltage_Probe MessageChecksum MessageCounter OutputCurrent OutputVoltage /end OUT_MEASUREMENT
 /begin SUB_FUNCTION ChargerState_Override Eaton_HV_Charger_Temperature_Override FaultSeverityIndicator_Override IgnitionStatus_Override InputCurrent_Override InputCurrentLimitMax_Override InputVoltage_Override OutputCurrent_Override OutputVoltage_Override /end SUB_FUNCTION
/end FUNCTION
/begin FUNCTION ChargerState_Override "" /begin DEF_CHARACTERISTIC ChargerState_new ChargerState_ovr /end DEF_CHARACTERISTIC /end FUNCTION
/begin FUNCTION Communication_Config "" /begin DEF_CHARACTERISTIC CityID_CAN_1 /end DEF_CHARACTERISTIC /end FUNCTION
/begin FUNCTION Regen ""
 /begin DEF_CHARACTERISTIC Enable_Coast_Neg_Torque Enable_Regen Max_Coast_Tq Max_Regen_Tq Max_SOC_For_Coast_Tq_EN Min_Speed_Allow_Coast_NegT Regen_Full Regen_Start RegenBatteryLimitsMap /end DEF_CHARACTERISTIC
 /begin OUT_MEASUREMENT Coast_Down_Tq_Probe MotorSpdIdx MotorSpdIn Raw_Regen_Tq_Request Regen_SOCSpd_Ramp_probe_preOVR RegenBatteryLimits StateOfChargePctIdx StateOfChargePctIn /end OUT_MEASUREMENT
 /begin SUB_FUNCTION Regen_SOC_Speed_Ramp_ovr_Override /end SUB_FUNCTION
/end FUNCTION
/begin FUNCTION Code_Coverage ""
 /begin OUT_MEASUREMENT CodeCoverParent000 CodeCoverParent000.CodeCover000029 CodeCoverParent000.CodeCover000018 CodeCoverParent000.CodeCover000007 CodeCoverParent000.CodeCover000019 CodeCoverParent000.CodeCover000008 CodeCoverParent000.CodeCover000009 CodeCoverParent000.CodeCover000030 CodeCoverParent000.CodeCover000031 CodeCoverParent000.CodeCover000020 CodeCoverParent000.CodeCover000021 CodeCoverParent000.CodeCover000010 CodeCoverParent000.CodeCover000022 CodeCoverParent000.CodeCover000011 CodeCoverParent000.CodeCover000000 CodeCoverParent000.CodeCover000023 CodeCoverParent000.CodeCover000012 CodeCoverParent000.CodeCover000001 CodeCoverParent000.CodeCover000024 CodeCoverParent000.CodeCover000013 CodeCoverParent000.CodeCover000002 CodeCoverParent000.CodeCover000025 CodeCoverParent000.CodeCover000014 CodeCoverParent000.CodeCover000003 CodeCoverParent000.CodeCover000026 CodeCoverParent000.CodeCover000015 CodeCoverParent000.CodeCover000004 CodeCoverParent000.CodeCover000027 CodeCoverParent000.CodeCover000016 CodeCoverParent000.CodeCover000005 CodeCoverParent000.CodeCover000028 CodeCoverParent000.CodeCover000017 CodeCoverParent000.CodeCover000006 CodeCoverParent001 CodeCoverParent001.CodeCover000060 CodeCoverParent001.CodeCover000061 CodeCoverParent001.CodeCover000050 CodeCoverParent001.CodeCover000062 CodeCoverParent001.CodeCover000051 CodeCoverParent001.CodeCover000040 CodeCoverParent001.CodeCover000063 CodeCoverParent001.CodeCover000052 CodeCoverParent001.CodeCover000041 CodeCoverParent001.CodeCover000053 CodeCoverParent001.CodeCover000042 CodeCoverParent001.CodeCover000054 CodeCoverParent001.CodeCover000043 CodeCoverParent001.CodeCover000032 CodeCoverParent001.CodeCover000055 CodeCoverParent001.CodeCover000044 CodeCoverParent001.CodeCover000033 CodeCoverParent001.CodeCover000056 CodeCoverParent001.CodeCover000045 CodeCoverParent001.CodeCover000034 CodeCoverParent001.CodeCover000057 CodeCoverParent001.CodeCover000046 CodeCoverParent001.CodeCover000035 CodeCoverParent001.CodeCover000058 CodeCoverParent001.CodeCover000047 CodeCoverParent001.CodeCover000036 CodeCoverParent001.CodeCover000059 CodeCoverParent001.CodeCover000048 CodeCoverParent001.CodeCover000037 CodeCoverParent001.CodeCover000049 CodeCoverParent001.CodeCover000038 CodeCoverParent001.CodeCover000039 CodeCoverParent002 CodeCoverParent002.CodeCover000090 CodeCoverParent002.CodeCover000091 CodeCoverParent002.CodeCover000080 CodeCoverParent002.CodeCover000092 CodeCoverParent002.CodeCover000081 CodeCoverParent002.CodeCover000070 CodeCoverParent002.CodeCover000093 CodeCoverParent002.CodeCover000082 CodeCoverParent002.CodeCover000071 CodeCoverParent002.CodeCover000094 CodeCoverParent002.CodeCover000083 CodeCoverParent002.CodeCover000072 CodeCoverParent002.CodeCover000095 CodeCoverParent002.CodeCover000084 CodeCoverParent002.CodeCover000073 CodeCoverParent002.CodeCover000085 CodeCoverParent002.CodeCover000074 CodeCoverParent002.CodeCover000086 CodeCoverParent002.CodeCover000075 CodeCoverParent002.CodeCover000064 CodeCoverParent002.CodeCover000087 CodeCoverParent002.CodeCover000076 CodeCoverParent002.CodeCover000065 CodeCoverParent002.CodeCover000088 CodeCoverParent002.CodeCover000077 CodeCoverParent002.CodeCover000066 CodeCoverParent002.CodeCover000089 CodeCoverParent002.CodeCover000078 CodeCoverParent002.CodeCover000067 CodeCoverParent002.CodeCover000079 CodeCoverParent002.CodeCover000068 CodeCoverParent002.CodeCover000069 CodeCoverParent003 CodeCoverParent003.CodeCover000117 CodeCoverParent003.CodeCover000106 CodeCoverParent003.CodeCover000118 CodeCoverParent003.CodeCover000107 CodeCoverParent003.CodeCover000119 CodeCoverParent003.CodeCover000108 CodeCoverParent003.CodeCover000109 CodeCoverParent003.CodeCover000096 CodeCoverParent003.CodeCover000097 CodeCoverParent003.CodeCover000120 CodeCoverParent003.CodeCover000098 CodeCoverParent003.CodeCover000121 CodeCoverParent003.CodeCover000110 CodeCoverParent003.CodeCover000099 CodeCoverParent003.CodeCover000122 CodeCoverParent003.CodeCover000111 CodeCoverParent003.CodeCover000100 CodeCoverParent003.CodeCover000123 CodeCoverParent003.CodeCover000112 CodeCoverParent003.CodeCover000101 CodeCoverParent003.CodeCover000124 CodeCoverParent003.CodeCover000113 CodeCoverParent003.CodeCover000102 CodeCoverParent003.CodeCover000125 CodeCoverParent003.CodeCover000114 CodeCoverParent003.CodeCover000103 CodeCoverParent003.CodeCover000126 CodeCoverParent003.CodeCover000115 CodeCoverParent003.CodeCover000104 CodeCoverParent003.CodeCover000127 CodeCoverParent003.CodeCover000116 CodeCoverParent003.CodeCover000105 CodeCoverParent004 CodeCoverParent004.CodeCover000139 CodeCoverParent004.CodeCover000128 CodeCoverParent004.CodeCover000129 CodeCoverParent004.CodeCover000140 CodeCoverParent004.CodeCover000141 CodeCoverParent004.CodeCover000130 CodeCoverParent004.CodeCover000142 CodeCoverParent004.CodeCover000131 CodeCoverParent004.CodeCover000143 CodeCoverParent004.CodeCover000132 CodeCoverParent004.CodeCover000144 CodeCoverParent004.CodeCover000133 CodeCoverParent004.CodeCover000145 CodeCoverParent004.CodeCover000134 CodeCoverParent004.CodeCover000146 CodeCoverParent004.CodeCover000135 CodeCoverParent004.CodeCover000136 CodeCoverParent004.CodeCover000137 CodeCoverParent004.CodeCover000138 /end OUT_MEASUREMENT
/end FUNCTION
/begin FUNCTION Counter "" /begin DEF_CHARACTERISTIC Command_Counter Counter_Mode_Select Counter_Multiplier /end DEF_CHARACTERISTIC /begin OUT_MEASUREMENT Counter_Prb /end OUT_MEASUREMENT /end FUNCTION
/begin FUNCTION Contacter_Controller "" /begin DEF_CHARACTERISTIC Contactor_Disable_Delay Load_Enable_Delay /end DEF_CHARACTERISTIC /end FUNCTION
/begin FUNCTION Contactor_Shutdown_Test_Override "" /begin DEF_CHARACTERISTIC Contactor_Shutdown_Test_new Contactor_Shutdown_Test_ovr /end DEF_CHARACTERISTIC /end FUNCTION
/begin FUNCTION HV_Controller_1 "" /begin SUB_FUNCTION Contactor_Shutdown_Test_Override /end SUB_FUNCTION /end FUNCTION
/begin FUNCTION Control_Strategy_1 "" /begin SUB_FUNCTION HV_Controller_1 /end SUB_FUNCTION /end FUNCTION
/begin FUNCTION Strategy "" /begin SUB_FUNCTION Control_Strategy_1 /end SUB_FUNCTION /end FUNCTION
/begin FUNCTION Performance ""
 /begin OUT_MEASUREMENT CPUIdlePcent CPUTime_AppISR CPUTime_Bgnd CPUTime_CAN CPUTime_FgndAngle CPUTime_FgndTime CPUTime_MIOS CPUTime_Serial CPUTime_TimerISR CPUTime_TPU /end OUT_MEASUREMENT
/end FUNCTION
/begin FUNCTION Current_Limit_Override_Override "" /begin DEF_CHARACTERISTIC Current_Limit_Override_new Current_Limit_Override_ovr /end DEF_CHARACTERISTIC /end FUNCTION
/end MODULE
/end PROJECT
