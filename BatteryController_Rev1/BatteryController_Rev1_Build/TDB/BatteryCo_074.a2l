/******************************************************************************
* ASAP2 descrition file /
* Generated by Woodward ASAP2 Generator /
* This file was auto-generated on: Friday, September 7, 2018 9:44 AM /
******************************************************************************/ ASAP2_VERSION 1 51
/begin PROJECT Project ""
/begin MODULE BatteryCo_074 ""
/begin IF_DATA VISION DEVICE_SETTING "CCP=2.1_ASAP1b" DEVICE_SETTING "DefaultCRCType=5" /end IF_DATA
/begin IF_DATA ASAP1B_CCP
 /begin SOURCE "List 1" 0 0 DISPLAY_IDENTIFIER "DAQ1"
  /begin QP_BLOB 0 LENGTH 8 CAN_ID_FIXED 0x98EF3103 RASTER 0 REDUCTION_ALLOWED FIRST_PID 0 /end QP_BLOB
 /end SOURCE
 /begin SOURCE "List 2" 0 0 DISPLAY_IDENTIFIER "DAQ2"
  /begin QP_BLOB 1 LENGTH 8 CAN_ID_FIXED 0x98EF3103 RASTER 1 REDUCTION_ALLOWED FIRST_PID 8 /end QP_BLOB
 /end SOURCE
 /begin SOURCE "List 3" 0 0 DISPLAY_IDENTIFIER "DAQ3"
  /begin QP_BLOB 2 LENGTH 8 CAN_ID_FIXED 0x98EF3103 RASTER 2 REDUCTION_ALLOWED FIRST_PID 16 /end QP_BLOB
 /end SOURCE
 /begin SOURCE "List 4" 0 0 DISPLAY_IDENTIFIER "DAQ4"
  /begin QP_BLOB 3 LENGTH 8 CAN_ID_FIXED 0x98EF3103 RASTER 3 REDUCTION_ALLOWED FIRST_PID 24 /end QP_BLOB
 /end SOURCE
 /begin RASTER "FGND_RTI_PERIODIC" "FGND_RTI_PERIODIC" 0 3 5 /end RASTER
 /begin RASTER "FGND_2XRTI_PERIODIC" "FGND_2XRTI_PERIODIC" 1 3 10 /end RASTER
 /begin RASTER "FGND_10XRTI_PERIODIC" "FGND_10XRTI_PERIODIC" 2 3 50 /end RASTER
 /begin RASTER "FGND_20XRTI_PERIODIC" "FGND_20XRTI_PERIODIC" 3 3 100 /end RASTER
 /begin RASTER "BGND_BASE_PERIODIC" "BGND_BASE_PERIODIC" 4 3 50 /end RASTER
 /begin RASTER "BGND_BASEx2_PERIODIC" "BGND_BASEx2_PERIODIC" 5 3 100 /end RASTER
 /begin RASTER "BGND_BASEx10_PERIODIC" "BGND_BASEx10_PERIODIC" 6 3 500 /end RASTER
 /begin RASTER "ONE_SECOND_EVENT" "ONE_SECOND_EVENT" 7 3 1000 /end RASTER
 /* /begin SEED_KEY */ /* DLL for CAL */ /* Uncomment and supply a value "SecurityCAL.dll" */ /* DLL for DAQ */ /* Uncomment and supply a value "SecurityDAQ.dll" */ /* DLL for PGM */ /* Uncomment and supply a value "SecurityPGM.dll" */ /* /end SEED_KEY */
 /begin TP_BLOB /* CCP version */ 0x201 /* Blob version */ 0x204 /* CAN msg ID - send */ 0x98EF0232 /* CAN msg ID - recv */ 0x98EF3103 /* Station address */ 0x32 /* byte order */ 1 BAUDRATE 500000 SAMPLE_RATE 1 SAMPLE_POINT 75 BTL_CYCLES 8 SJW 2 SYNC_EDGE SINGLE DAQ_MODE BURST CONSISTENCY ODT ADDRESS_EXTENSION DAQ
  /begin CHECKSUM_PARAM /* algorithm */ 0x8009 /* limit */ 0x1000 CHECKSUM_CALCULATION ACTIVE_PAGE /end CHECKSUM_PARAM
  /begin DEFINED_PAGES /* Memory page num */ 1 /* Page Name */ "working page" /* address ext. */ 0x00 /* base address */ 0x80000000 /* page length */ 0x000008F0 RAM /* memory page in RAM */ RAM_INIT_BY_ECU /* memory page is initialised by ECU start-up */ /end DEFINED_PAGES
  OPTIONAL_CMD 0x5 /* TEST */ OPTIONAL_CMD 0x8 /* START_STOP_ALL */ OPTIONAL_CMD 0xC /* SET_S_STATUS */ OPTIONAL_CMD 0xD /* GET_S_STATUS */ OPTIONAL_CMD 0xE /* BUILD_CHECKSUM */ OPTIONAL_CMD 0xF /* SHORT_UP */ OPTIONAL_CMD 0x12 /* GET_SEED */ OPTIONAL_CMD 0x13 /* UNLOCK */ OPTIONAL_CMD 0x23 /* DNLOAD_6 */ /end TP_BLOB
/end IF_DATA
/*~~~~~~~~~ 6.3.91 MOD_PAR ~~~~~~~~~*/
/begin MOD_PAR /* MOD_PAR Comment*/ "" ECU_CALIBRATION_OFFSET 0x00000000
 /begin MEMORY_SEGMENT CAL "" DATA FLASH INTERN 0x80000000 /* Size */ 0x000008F0 /* Offset */ -1 -1 -1 -1 -1 /end MEMORY_SEGMENT
 /begin MEMORY_SEGMENT MeasRAM "" VARIABLES RAM INTERN 0x40000000 /* Size */ 0x00000530 /* Offset */ -1 -1 -1 -1 -1 /end MEMORY_SEGMENT
/end MOD_PAR
/begin MOD_COMMON /* MOD_COMMON Comment */ "" BYTE_ORDER MSB_FIRST ALIGNMENT_BYTE 1 ALIGNMENT_FLOAT32_IEEE 1 ALIGNMENT_FLOAT64_IEEE 1 ALIGNMENT_LONG 1 ALIGNMENT_WORD 1 /end MOD_COMMON
/*~~~~~~~~~ 6.3.86 MEASUREMENTs ~~~~~~~~~*/
/begin MEASUREMENT table_0_rev "VarDec Table0 Revision Number" UBYTE CompuMethod_1 1 0 0 255 ECU_ADDRESS 0x40000000 /end MEASUREMENT
/begin MEASUREMENT table_1_rev "VarDec Table1 Revision Number" UBYTE CompuMethod_1 1 0 0 255 ECU_ADDRESS 0x40000001 /end MEASUREMENT
/begin MEASUREMENT table_2_rev "VarDec Table2 Revision Number" UBYTE CompuMethod_1 1 0 0 255 ECU_ADDRESS 0x40000002 /end MEASUREMENT
/begin MEASUREMENT KeyRev "This is the revision for the key protocol." UBYTE CompuMethod_1 1 0 0 255 ECU_ADDRESS 0x40000003 /end MEASUREMENT
/begin MEASUREMENT EriRev "This is the revision for the ERI protocol." UBYTE CompuMethod_1 1 0 0 255 ECU_ADDRESS 0x40000004 /end MEASUREMENT
/begin MEASUREMENT table_3_rev "VarDec Table3 Revision Number" UBYTE CompuMethod_1 1 0 0 255 ECU_ADDRESS 0x40000005 /end MEASUREMENT
/begin MEASUREMENT table_4_rev "VarDec Table4 Revision Number" UBYTE CompuMethod_1 1 0 0 255 ECU_ADDRESS 0x40000006 /end MEASUREMENT
/begin MEASUREMENT table_5_rev "VarDec Table5 Revision Number" UBYTE CompuMethod_1 1 0 0 255 ECU_ADDRESS 0x40000007 /end MEASUREMENT
/begin MEASUREMENT table_6_rev "VarDec Table6 Revision Number" UBYTE CompuMethod_1 1 0 0 255 ECU_ADDRESS 0x40000008 /end MEASUREMENT
/begin MEASUREMENT table_7_rev "VarDec Table7 Revision Number" UBYTE CompuMethod_1 1 0 0 255 ECU_ADDRESS 0x40000009 /end MEASUREMENT
/begin MEASUREMENT MotProgRev "This is the revision for the MOTPROG protocol." UBYTE CompuMethod_1 1 0 0 255 ECU_ADDRESS 0x40000049 /end MEASUREMENT
/begin MEASUREMENT BootVerMaj "" UBYTE CompuMethod_1 1 0 0 255 ECU_ADDRESS 0x4000004A /end MEASUREMENT
/begin MEASUREMENT BootVerMin "" UBYTE CompuMethod_1 1 0 0 255 ECU_ADDRESS 0x4000004B /end MEASUREMENT
/begin MEASUREMENT EcuHwMaj "" UBYTE CompuMethod_1 1 0 0 255 ECU_ADDRESS 0x4000004C /end MEASUREMENT
/begin MEASUREMENT EcuHwMin "" UBYTE CompuMethod_1 1 0 0 255 ECU_ADDRESS 0x4000004D /end MEASUREMENT
/begin MEASUREMENT ApplicationCompatibilityArr "Software Format ID" UWORD CompuMethod_2 1 0 0 65535 ECU_ADDRESS 0x4000004E MATRIX_DIM 1 50 1 /end MEASUREMENT
/begin MEASUREMENT ActiveDTC_Prb "" FLOAT32_IEEE CompuMethod_2 1 0 -1E+17 1E+17 ECU_ADDRESS 0x40000116 /end MEASUREMENT
/begin MEASUREMENT ain_create_Current_Sensor "Debug Variable" UBYTE CompuMethod_5 1 0 0 0 ECU_ADDRESS 0x4000011A /end MEASUREMENT
/begin MEASUREMENT ain_create_ECUP "Debug Variable" UBYTE CompuMethod_5 1 0 0 0 ECU_ADDRESS 0x4000011B /end MEASUREMENT
/begin MEASUREMENT ain_create_V5V_Reference "Debug Variable" UBYTE CompuMethod_5 1 0 0 0 ECU_ADDRESS 0x4000011C /end MEASUREMENT
/begin MEASUREMENT ain_read_Current_Sensor "Debug Variable" UBYTE CompuMethod_5 1 0 0 0 ECU_ADDRESS 0x4000011D /end MEASUREMENT
/begin MEASUREMENT ain_read_ECUP "Debug Variable" UBYTE CompuMethod_5 1 0 0 0 ECU_ADDRESS 0x4000011E /end MEASUREMENT
/begin MEASUREMENT ain_read_V5V_Reference "Debug Variable" UBYTE CompuMethod_5 1 0 0 0 ECU_ADDRESS 0x4000011F /end MEASUREMENT
/begin MEASUREMENT AMPCurrent_Prb "" FLOAT32_IEEE CompuMethod_7 1 0 -1E+17 1E+17 ECU_ADDRESS 0x40000120 /end MEASUREMENT
/begin MEASUREMENT AMPCurrent_Pre_Filter_Prb "" FLOAT32_IEEE CompuMethod_7 1 0 -1E+17 1E+17 ECU_ADDRESS 0x40000124 /end MEASUREMENT
/begin MEASUREMENT AMPCurrent_Pre_Offset_Prb "" FLOAT32_IEEE CompuMethod_7 1 0 -1E+17 1E+17 ECU_ADDRESS 0x40000128 /end MEASUREMENT
/begin MEASUREMENT ApplicationInitStatus "Shows how far the module initialization has progressed" UBYTE CompuMethod_8 1 0 3 5 ECU_ADDRESS 0x4000012C /end MEASUREMENT
/begin MEASUREMENT ApplicationStopReason "Indicates the reason for an application stop" ULONG CompuMethod_12 1 0 0 5 ECU_ADDRESS 0x4000012D /end MEASUREMENT
/begin MEASUREMENT ApplicationStopReasonBlock "Indicates the block that caused the application stop" ULONG CompuMethod_13 1 0 0 5 ECU_ADDRESS 0x40000131 /end MEASUREMENT
/begin MEASUREMENT BalancingCount_Prb "" FLOAT32_IEEE CompuMethod_2 1 0 -1E+17 1E+17 ECU_ADDRESS 0x40000135 /end MEASUREMENT
/begin MEASUREMENT BatteryCurrent_prb "" FLOAT32_IEEE CompuMethod_2 1 0 -1E+17 1E+17 ECU_ADDRESS 0x40000139 /end MEASUREMENT
/begin MEASUREMENT BatteryVoltage_Prb "" FLOAT32_IEEE CompuMethod_2 1 0 -1E+17 1E+17 ECU_ADDRESS 0x4000013D /end MEASUREMENT
/begin MEASUREMENT Battey_Enable_Prb "" FLOAT32_IEEE CompuMethod_2 1 0 -1E+17 1E+17 ECU_ADDRESS 0x40000141 /end MEASUREMENT
/begin MEASUREMENT BgndAngTaskStatus "Background Time Scheduler Status" UBYTE CompuMethod_15 1 0 0 0 ECU_ADDRESS 0x40000145 /end MEASUREMENT
/begin MEASUREMENT BgndStackMinBytesFree "Min bytes observed on the Background Stack" ULONG CompuMethod_16 1 0 0 0 ECU_ADDRESS 0x40000146 /end MEASUREMENT
/begin MEASUREMENT BgndTimeTaskStatus "Background Time Scheduler Status" UBYTE CompuMethod_17 1 0 0 0 ECU_ADDRESS 0x4000014A /end MEASUREMENT
/begin MEASUREMENT BusVoltage_Prb "" FLOAT32_IEEE CompuMethod_2 1 0 -1E+17 1E+17 ECU_ADDRESS 0x4000014B /end MEASUREMENT
/begin MEASUREMENT CAN_1_ext_handled_count "Total number of handled ext CAN messages on bus CAN_1" ULONG CompuMethod_18 1 0 0 4294970000 ECU_ADDRESS 0x4000014F /end MEASUREMENT
/begin MEASUREMENT CAN_1_ext_last_unhandled_id "Last received ext CAN message on bus CAN_1, which was unhandled" ULONG CompuMethod_18 1 0 0 4294970000 ECU_ADDRESS 0x40000153 /end MEASUREMENT
/begin MEASUREMENT CAN_1_ext_receive_count "Total number of received ext CAN messages on bus CAN_1" ULONG CompuMethod_18 1 0 0 4294970000 ECU_ADDRESS 0x40000157 /end MEASUREMENT
/begin MEASUREMENT CAN_1_std_handled_count "Total number of handled std CAN messages on bus CAN_1" ULONG CompuMethod_18 1 0 0 4294970000 ECU_ADDRESS 0x4000015B /end MEASUREMENT
/begin MEASUREMENT CAN_1_std_last_unhandled_id "Last received std CAN message on bus CAN_1, which was unhandled" ULONG CompuMethod_18 1 0 0 4294970000 ECU_ADDRESS 0x4000015F /end MEASUREMENT
/begin MEASUREMENT CAN_1_std_receive_count "Total number of received std CAN messages on bus CAN_1" ULONG CompuMethod_18 1 0 0 4294970000 ECU_ADDRESS 0x40000163 /end MEASUREMENT
/begin MEASUREMENT can_create_CAN_1 "Debug Variable" UBYTE CompuMethod_5 1 0 0 0 ECU_ADDRESS 0x40000167 /end MEASUREMENT
/begin MEASUREMENT can_tx_err_CAN_1_0 "Debug Variable" UBYTE CompuMethod_5 1 0 0 0 ECU_ADDRESS 0x40000168 /end MEASUREMENT
/begin MEASUREMENT CCP_CCP_BAT_Access.CCP_CCP_BAT_CAL "Calibration Authentication Status for CCP Handler CCP_BAT" UBYTE CompuMethod_19 1 0 0 1 ECU_ADDRESS 0x40000169 BIT_MASK 0x00000001 /end MEASUREMENT
/begin MEASUREMENT CCP_CCP_BAT_Access.CCP_CCP_BAT_DAQ "Data Acquisition Authentication Status for CCP Handler CCP_BAT" UBYTE CompuMethod_20 1 0 0 1 ECU_ADDRESS 0x40000169 BIT_MASK 0x00000002 /end MEASUREMENT
/begin MEASUREMENT CCP_CCP_BAT_Access.CCP_CCP_BAT_PGM "Programming Authentication Status for CCP Handler CCP_BAT" UBYTE CompuMethod_21 1 0 0 1 ECU_ADDRESS 0x40000169 BIT_MASK 0x00000040 /end MEASUREMENT
/begin MEASUREMENT CCP_CCP_BAT_Access "Current Access Code for CCP Handler CCP_BAT" UBYTE CompuMethod_2 1 0 0 255 ECU_ADDRESS 0x40000169 /end MEASUREMENT
/begin MEASUREMENT CCP_CCP_BAT_ConnectionStatus "CCP Handler CCP_BAT connection status" UBYTE CompuMethod_22 1 0 0 255 ECU_ADDRESS 0x4000016A /end MEASUREMENT
/begin MEASUREMENT CellBalancingActive_Prb "" UBYTE CompuMethod_1 1 0 0 255 ECU_ADDRESS 0x4000016B /end MEASUREMENT
/begin MEASUREMENT CellTemp_PreLookupIdx "" UWORD CompuMethod_23 1 0 0 127.998 ECU_ADDRESS 0x4000016C /end MEASUREMENT
/begin MEASUREMENT CellTemp_PreLookupIn "" FLOAT32_IEEE CompuMethod_2 1 0 -1E+17 1E+17 ECU_ADDRESS 0x4000016E /end MEASUREMENT
/begin MEASUREMENT CodeCoverParent000.CodeCover000029 "Determines if this subsystem has run" ULONG CompuMethod_24 1 0 0 1 ECU_ADDRESS 0x40000172 BIT_MASK 0x20000000 /end MEASUREMENT
/begin MEASUREMENT CodeCoverParent000.CodeCover000018 "Determines if this subsystem has run" ULONG CompuMethod_25 1 0 0 1 ECU_ADDRESS 0x40000172 BIT_MASK 0x00040000 /end MEASUREMENT
/begin MEASUREMENT CodeCoverParent000.CodeCover000007 "Determines if this subsystem has run" ULONG CompuMethod_26 1 0 0 1 ECU_ADDRESS 0x40000172 BIT_MASK 0x00000080 /end MEASUREMENT
/begin MEASUREMENT CodeCoverParent000.CodeCover000019 "Determines if this subsystem has run" ULONG CompuMethod_27 1 0 0 1 ECU_ADDRESS 0x40000172 BIT_MASK 0x00080000 /end MEASUREMENT
/begin MEASUREMENT CodeCoverParent000.CodeCover000008 "Determines if this subsystem has run" ULONG CompuMethod_28 1 0 0 1 ECU_ADDRESS 0x40000172 BIT_MASK 0x00000100 /end MEASUREMENT
/begin MEASUREMENT CodeCoverParent000.CodeCover000009 "Determines if this subsystem has run" ULONG CompuMethod_29 1 0 0 1 ECU_ADDRESS 0x40000172 BIT_MASK 0x00000200 /end MEASUREMENT
/begin MEASUREMENT CodeCoverParent000.CodeCover000030 "Determines if this subsystem has run" ULONG CompuMethod_30 1 0 0 1 ECU_ADDRESS 0x40000172 BIT_MASK 0x40000000 /end MEASUREMENT
/begin MEASUREMENT CodeCoverParent000.CodeCover000031 "Determines if this subsystem has run" ULONG CompuMethod_31 1 0 0 1 ECU_ADDRESS 0x40000172 BIT_MASK 0x80000000 /end MEASUREMENT
/begin MEASUREMENT CodeCoverParent000.CodeCover000020 "Determines if this subsystem has run" ULONG CompuMethod_32 1 0 0 1 ECU_ADDRESS 0x40000172 BIT_MASK 0x00100000 /end MEASUREMENT
/begin MEASUREMENT CodeCoverParent000.CodeCover000021 "Determines if this subsystem has run" ULONG CompuMethod_33 1 0 0 1 ECU_ADDRESS 0x40000172 BIT_MASK 0x00200000 /end MEASUREMENT
/begin MEASUREMENT CodeCoverParent000.CodeCover000010 "Determines if this subsystem has run" ULONG CompuMethod_34 1 0 0 1 ECU_ADDRESS 0x40000172 BIT_MASK 0x00000400 /end MEASUREMENT
/begin MEASUREMENT CodeCoverParent000.CodeCover000022 "Determines if this subsystem has run" ULONG CompuMethod_35 1 0 0 1 ECU_ADDRESS 0x40000172 BIT_MASK 0x00400000 /end MEASUREMENT
/begin MEASUREMENT CodeCoverParent000.CodeCover000011 "Determines if this subsystem has run" ULONG CompuMethod_36 1 0 0 1 ECU_ADDRESS 0x40000172 BIT_MASK 0x00000800 /end MEASUREMENT
/begin MEASUREMENT CodeCoverParent000.CodeCover000000 "Determines if this subsystem has run" ULONG CompuMethod_37 1 0 0 1 ECU_ADDRESS 0x40000172 BIT_MASK 0x00000001 /end MEASUREMENT
/begin MEASUREMENT CodeCoverParent000.CodeCover000023 "Determines if this subsystem has run" ULONG CompuMethod_38 1 0 0 1 ECU_ADDRESS 0x40000172 BIT_MASK 0x00800000 /end MEASUREMENT
/begin MEASUREMENT CodeCoverParent000.CodeCover000012 "Determines if this subsystem has run" ULONG CompuMethod_39 1 0 0 1 ECU_ADDRESS 0x40000172 BIT_MASK 0x00001000 /end MEASUREMENT
/begin MEASUREMENT CodeCoverParent000.CodeCover000001 "Determines if this subsystem has run" ULONG CompuMethod_40 1 0 0 1 ECU_ADDRESS 0x40000172 BIT_MASK 0x00000002 /end MEASUREMENT
/begin MEASUREMENT CodeCoverParent000.CodeCover000024 "Determines if this subsystem has run" ULONG CompuMethod_41 1 0 0 1 ECU_ADDRESS 0x40000172 BIT_MASK 0x01000000 /end MEASUREMENT
/begin MEASUREMENT CodeCoverParent000.CodeCover000013 "Determines if this subsystem has run" ULONG CompuMethod_42 1 0 0 1 ECU_ADDRESS 0x40000172 BIT_MASK 0x00002000 /end MEASUREMENT
/begin MEASUREMENT CodeCoverParent000.CodeCover000002 "Determines if this subsystem has run" ULONG CompuMethod_43 1 0 0 1 ECU_ADDRESS 0x40000172 BIT_MASK 0x00000004 /end MEASUREMENT
/begin MEASUREMENT CodeCoverParent000.CodeCover000025 "Determines if this subsystem has run" ULONG CompuMethod_44 1 0 0 1 ECU_ADDRESS 0x40000172 BIT_MASK 0x02000000 /end MEASUREMENT
/begin MEASUREMENT CodeCoverParent000.CodeCover000014 "Determines if this subsystem has run" ULONG CompuMethod_45 1 0 0 1 ECU_ADDRESS 0x40000172 BIT_MASK 0x00004000 /end MEASUREMENT
/begin MEASUREMENT CodeCoverParent000.CodeCover000003 "Determines if this subsystem has run" ULONG CompuMethod_46 1 0 0 1 ECU_ADDRESS 0x40000172 BIT_MASK 0x00000008 /end MEASUREMENT
/begin MEASUREMENT CodeCoverParent000.CodeCover000026 "Determines if this subsystem has run" ULONG CompuMethod_47 1 0 0 1 ECU_ADDRESS 0x40000172 BIT_MASK 0x04000000 /end MEASUREMENT
/begin MEASUREMENT CodeCoverParent000.CodeCover000015 "Determines if this subsystem has run" ULONG CompuMethod_48 1 0 0 1 ECU_ADDRESS 0x40000172 BIT_MASK 0x00008000 /end MEASUREMENT
/begin MEASUREMENT CodeCoverParent000.CodeCover000004 "Determines if this subsystem has run" ULONG CompuMethod_49 1 0 0 1 ECU_ADDRESS 0x40000172 BIT_MASK 0x00000010 /end MEASUREMENT
/begin MEASUREMENT CodeCoverParent000.CodeCover000027 "Determines if this subsystem has run" ULONG CompuMethod_50 1 0 0 1 ECU_ADDRESS 0x40000172 BIT_MASK 0x08000000 /end MEASUREMENT
/begin MEASUREMENT CodeCoverParent000.CodeCover000016 "Determines if this subsystem has run" ULONG CompuMethod_51 1 0 0 1 ECU_ADDRESS 0x40000172 BIT_MASK 0x00010000 /end MEASUREMENT
/begin MEASUREMENT CodeCoverParent000.CodeCover000005 "Determines if this subsystem has run" ULONG CompuMethod_52 1 0 0 1 ECU_ADDRESS 0x40000172 BIT_MASK 0x00000020 /end MEASUREMENT
/begin MEASUREMENT CodeCoverParent000.CodeCover000028 "Determines if this subsystem has run" ULONG CompuMethod_53 1 0 0 1 ECU_ADDRESS 0x40000172 BIT_MASK 0x10000000 /end MEASUREMENT
/begin MEASUREMENT CodeCoverParent000.CodeCover000017 "Determines if this subsystem has run" ULONG CompuMethod_54 1 0 0 1 ECU_ADDRESS 0x40000172 BIT_MASK 0x00020000 /end MEASUREMENT
/begin MEASUREMENT CodeCoverParent000.CodeCover000006 "Determines if this subsystem has run" ULONG CompuMethod_55 1 0 0 1 ECU_ADDRESS 0x40000172 BIT_MASK 0x00000040 /end MEASUREMENT
/begin MEASUREMENT CodeCoverParent000 "Run Status of Subsystems" ULONG CompuMethod_2 1 0 0 4294967295 ECU_ADDRESS 0x40000172 /end MEASUREMENT
/begin MEASUREMENT CodeCoverParent001.CodeCover000060 "Determines if this subsystem has run" ULONG CompuMethod_56 1 0 0 1 ECU_ADDRESS 0x40000176 BIT_MASK 0x10000000 /end MEASUREMENT
/begin MEASUREMENT CodeCoverParent001.CodeCover000061 "Determines if this subsystem has run" ULONG CompuMethod_57 1 0 0 1 ECU_ADDRESS 0x40000176 BIT_MASK 0x20000000 /end MEASUREMENT
/begin MEASUREMENT CodeCoverParent001.CodeCover000050 "Determines if this subsystem has run" ULONG CompuMethod_58 1 0 0 1 ECU_ADDRESS 0x40000176 BIT_MASK 0x00040000 /end MEASUREMENT
/begin MEASUREMENT CodeCoverParent001.CodeCover000062 "Determines if this subsystem has run" ULONG CompuMethod_59 1 0 0 1 ECU_ADDRESS 0x40000176 BIT_MASK 0x40000000 /end MEASUREMENT
/begin MEASUREMENT CodeCoverParent001.CodeCover000051 "Determines if this subsystem has run" ULONG CompuMethod_60 1 0 0 1 ECU_ADDRESS 0x40000176 BIT_MASK 0x00080000 /end MEASUREMENT
/begin MEASUREMENT CodeCoverParent001.CodeCover000040 "Determines if this subsystem has run" ULONG CompuMethod_61 1 0 0 1 ECU_ADDRESS 0x40000176 BIT_MASK 0x00000100 /end MEASUREMENT
/begin MEASUREMENT CodeCoverParent001.CodeCover000063 "Determines if this subsystem has run" ULONG CompuMethod_62 1 0 0 1 ECU_ADDRESS 0x40000176 BIT_MASK 0x80000000 /end MEASUREMENT
/begin MEASUREMENT CodeCoverParent001.CodeCover000052 "Determines if this subsystem has run" ULONG CompuMethod_63 1 0 0 1 ECU_ADDRESS 0x40000176 BIT_MASK 0x00100000 /end MEASUREMENT
/begin MEASUREMENT CodeCoverParent001.CodeCover000041 "Determines if this subsystem has run" ULONG CompuMethod_64 1 0 0 1 ECU_ADDRESS 0x40000176 BIT_MASK 0x00000200 /end MEASUREMENT
/begin MEASUREMENT CodeCoverParent001.CodeCover000053 "Determines if this subsystem has run" ULONG CompuMethod_65 1 0 0 1 ECU_ADDRESS 0x40000176 BIT_MASK 0x00200000 /end MEASUREMENT
/begin MEASUREMENT CodeCoverParent001.CodeCover000042 "Determines if this subsystem has run" ULONG CompuMethod_66 1 0 0 1 ECU_ADDRESS 0x40000176 BIT_MASK 0x00000400 /end MEASUREMENT
/begin MEASUREMENT CodeCoverParent001.CodeCover000054 "Determines if this subsystem has run" ULONG CompuMethod_67 1 0 0 1 ECU_ADDRESS 0x40000176 BIT_MASK 0x00400000 /end MEASUREMENT
/begin MEASUREMENT CodeCoverParent001.CodeCover000043 "Determines if this subsystem has run" ULONG CompuMethod_68 1 0 0 1 ECU_ADDRESS 0x40000176 BIT_MASK 0x00000800 /end MEASUREMENT
/begin MEASUREMENT CodeCoverParent001.CodeCover000032 "Determines if this subsystem has run" ULONG CompuMethod_69 1 0 0 1 ECU_ADDRESS 0x40000176 BIT_MASK 0x00000001 /end MEASUREMENT
/begin MEASUREMENT CodeCoverParent001.CodeCover000055 "Determines if this subsystem has run" ULONG CompuMethod_70 1 0 0 1 ECU_ADDRESS 0x40000176 BIT_MASK 0x00800000 /end MEASUREMENT
/begin MEASUREMENT CodeCoverParent001.CodeCover000044 "Determines if this subsystem has run" ULONG CompuMethod_71 1 0 0 1 ECU_ADDRESS 0x40000176 BIT_MASK 0x00001000 /end MEASUREMENT
/begin MEASUREMENT CodeCoverParent001.CodeCover000033 "Determines if this subsystem has run" ULONG CompuMethod_72 1 0 0 1 ECU_ADDRESS 0x40000176 BIT_MASK 0x00000002 /end MEASUREMENT
/begin MEASUREMENT CodeCoverParent001.CodeCover000056 "Determines if this subsystem has run" ULONG CompuMethod_73 1 0 0 1 ECU_ADDRESS 0x40000176 BIT_MASK 0x01000000 /end MEASUREMENT
/begin MEASUREMENT CodeCoverParent001.CodeCover000045 "Determines if this subsystem has run" ULONG CompuMethod_74 1 0 0 1 ECU_ADDRESS 0x40000176 BIT_MASK 0x00002000 /end MEASUREMENT
/begin MEASUREMENT CodeCoverParent001.CodeCover000034 "Determines if this subsystem has run" ULONG CompuMethod_75 1 0 0 1 ECU_ADDRESS 0x40000176 BIT_MASK 0x00000004 /end MEASUREMENT
/begin MEASUREMENT CodeCoverParent001.CodeCover000057 "Determines if this subsystem has run" ULONG CompuMethod_76 1 0 0 1 ECU_ADDRESS 0x40000176 BIT_MASK 0x02000000 /end MEASUREMENT
/begin MEASUREMENT CodeCoverParent001.CodeCover000046 "Determines if this subsystem has run" ULONG CompuMethod_77 1 0 0 1 ECU_ADDRESS 0x40000176 BIT_MASK 0x00004000 /end MEASUREMENT
/begin MEASUREMENT CodeCoverParent001.CodeCover000035 "Determines if this subsystem has run" ULONG CompuMethod_78 1 0 0 1 ECU_ADDRESS 0x40000176 BIT_MASK 0x00000008 /end MEASUREMENT
/begin MEASUREMENT CodeCoverParent001.CodeCover000058 "Determines if this subsystem has run" ULONG CompuMethod_79 1 0 0 1 ECU_ADDRESS 0x40000176 BIT_MASK 0x04000000 /end MEASUREMENT
/begin MEASUREMENT CodeCoverParent001.CodeCover000047 "Determines if this subsystem has run" ULONG CompuMethod_80 1 0 0 1 ECU_ADDRESS 0x40000176 BIT_MASK 0x00008000 /end MEASUREMENT
/begin MEASUREMENT CodeCoverParent001.CodeCover000036 "Determines if this subsystem has run" ULONG CompuMethod_81 1 0 0 1 ECU_ADDRESS 0x40000176 BIT_MASK 0x00000010 /end MEASUREMENT
/begin MEASUREMENT CodeCoverParent001.CodeCover000059 "Determines if this subsystem has run" ULONG CompuMethod_82 1 0 0 1 ECU_ADDRESS 0x40000176 BIT_MASK 0x08000000 /end MEASUREMENT
/begin MEASUREMENT CodeCoverParent001.CodeCover000048 "Determines if this subsystem has run" ULONG CompuMethod_83 1 0 0 1 ECU_ADDRESS 0x40000176 BIT_MASK 0x00010000 /end MEASUREMENT
/begin MEASUREMENT CodeCoverParent001.CodeCover000037 "Determines if this subsystem has run" ULONG CompuMethod_84 1 0 0 1 ECU_ADDRESS 0x40000176 BIT_MASK 0x00000020 /end MEASUREMENT
/begin MEASUREMENT CodeCoverParent001.CodeCover000049 "Determines if this subsystem has run" ULONG CompuMethod_85 1 0 0 1 ECU_ADDRESS 0x40000176 BIT_MASK 0x00020000 /end MEASUREMENT
/begin MEASUREMENT CodeCoverParent001.CodeCover000038 "Determines if this subsystem has run" ULONG CompuMethod_86 1 0 0 1 ECU_ADDRESS 0x40000176 BIT_MASK 0x00000040 /end MEASUREMENT
/begin MEASUREMENT CodeCoverParent001.CodeCover000039 "Determines if this subsystem has run" ULONG CompuMethod_87 1 0 0 1 ECU_ADDRESS 0x40000176 BIT_MASK 0x00000080 /end MEASUREMENT
/begin MEASUREMENT CodeCoverParent001 "Run Status of Subsystems" ULONG CompuMethod_2 1 0 0 4294967295 ECU_ADDRESS 0x40000176 /end MEASUREMENT
/begin MEASUREMENT CodeCoverParent002.CodeCover000090 "Determines if this subsystem has run" ULONG CompuMethod_88 1 0 0 1 ECU_ADDRESS 0x4000017A BIT_MASK 0x04000000 /end MEASUREMENT
/begin MEASUREMENT CodeCoverParent002.CodeCover000091 "Determines if this subsystem has run" ULONG CompuMethod_89 1 0 0 1 ECU_ADDRESS 0x4000017A BIT_MASK 0x08000000 /end MEASUREMENT
/begin MEASUREMENT CodeCoverParent002.CodeCover000080 "Determines if this subsystem has run" ULONG CompuMethod_90 1 0 0 1 ECU_ADDRESS 0x4000017A BIT_MASK 0x00010000 /end MEASUREMENT
/begin MEASUREMENT CodeCoverParent002.CodeCover000092 "Determines if this subsystem has run" ULONG CompuMethod_91 1 0 0 1 ECU_ADDRESS 0x4000017A BIT_MASK 0x10000000 /end MEASUREMENT
/begin MEASUREMENT CodeCoverParent002.CodeCover000081 "Determines if this subsystem has run" ULONG CompuMethod_92 1 0 0 1 ECU_ADDRESS 0x4000017A BIT_MASK 0x00020000 /end MEASUREMENT
/begin MEASUREMENT CodeCoverParent002.CodeCover000070 "Determines if this subsystem has run" ULONG CompuMethod_93 1 0 0 1 ECU_ADDRESS 0x4000017A BIT_MASK 0x00000040 /end MEASUREMENT
/begin MEASUREMENT CodeCoverParent002.CodeCover000093 "Determines if this subsystem has run" ULONG CompuMethod_94 1 0 0 1 ECU_ADDRESS 0x4000017A BIT_MASK 0x20000000 /end MEASUREMENT
/begin MEASUREMENT CodeCoverParent002.CodeCover000082 "Determines if this subsystem has run" ULONG CompuMethod_95 1 0 0 1 ECU_ADDRESS 0x4000017A BIT_MASK 0x00040000 /end MEASUREMENT
/begin MEASUREMENT CodeCoverParent002.CodeCover000071 "Determines if this subsystem has run" ULONG CompuMethod_96 1 0 0 1 ECU_ADDRESS 0x4000017A BIT_MASK 0x00000080 /end MEASUREMENT
/begin MEASUREMENT CodeCoverParent002.CodeCover000094 "Determines if this subsystem has run" ULONG CompuMethod_97 1 0 0 1 ECU_ADDRESS 0x4000017A BIT_MASK 0x40000000 /end MEASUREMENT
/begin MEASUREMENT CodeCoverParent002.CodeCover000083 "Determines if this subsystem has run" ULONG CompuMethod_98 1 0 0 1 ECU_ADDRESS 0x4000017A BIT_MASK 0x00080000 /end MEASUREMENT
/begin MEASUREMENT CodeCoverParent002.CodeCover000072 "Determines if this subsystem has run" ULONG CompuMethod_99 1 0 0 1 ECU_ADDRESS 0x4000017A BIT_MASK 0x00000100 /end MEASUREMENT
/begin MEASUREMENT CodeCoverParent002.CodeCover000095 "Determines if this subsystem has run" ULONG CompuMethod_100 1 0 0 1 ECU_ADDRESS 0x4000017A BIT_MASK 0x80000000 /end MEASUREMENT
/begin MEASUREMENT CodeCoverParent002.CodeCover000084 "Determines if this subsystem has run" ULONG CompuMethod_101 1 0 0 1 ECU_ADDRESS 0x4000017A BIT_MASK 0x00100000 /end MEASUREMENT
/begin MEASUREMENT CodeCoverParent002.CodeCover000073 "Determines if this subsystem has run" ULONG CompuMethod_102 1 0 0 1 ECU_ADDRESS 0x4000017A BIT_MASK 0x00000200 /end MEASUREMENT
/begin MEASUREMENT CodeCoverParent002.CodeCover000085 "Determines if this subsystem has run" ULONG CompuMethod_103 1 0 0 1 ECU_ADDRESS 0x4000017A BIT_MASK 0x00200000 /end MEASUREMENT
/begin MEASUREMENT CodeCoverParent002.CodeCover000074 "Determines if this subsystem has run" ULONG CompuMethod_104 1 0 0 1 ECU_ADDRESS 0x4000017A BIT_MASK 0x00000400 /end MEASUREMENT
/begin MEASUREMENT CodeCoverParent002.CodeCover000086 "Determines if this subsystem has run" ULONG CompuMethod_105 1 0 0 1 ECU_ADDRESS 0x4000017A BIT_MASK 0x00400000 /end MEASUREMENT
/begin MEASUREMENT CodeCoverParent002.CodeCover000075 "Determines if this subsystem has run" ULONG CompuMethod_106 1 0 0 1 ECU_ADDRESS 0x4000017A BIT_MASK 0x00000800 /end MEASUREMENT
/begin MEASUREMENT CodeCoverParent002.CodeCover000064 "Determines if this subsystem has run" ULONG CompuMethod_107 1 0 0 1 ECU_ADDRESS 0x4000017A BIT_MASK 0x00000001 /end MEASUREMENT
/begin MEASUREMENT CodeCoverParent002.CodeCover000087 "Determines if this subsystem has run" ULONG CompuMethod_108 1 0 0 1 ECU_ADDRESS 0x4000017A BIT_MASK 0x00800000 /end MEASUREMENT
/begin MEASUREMENT CodeCoverParent002.CodeCover000076 "Determines if this subsystem has run" ULONG CompuMethod_109 1 0 0 1 ECU_ADDRESS 0x4000017A BIT_MASK 0x00001000 /end MEASUREMENT
/begin MEASUREMENT CodeCoverParent002.CodeCover000065 "Determines if this subsystem has run" ULONG CompuMethod_110 1 0 0 1 ECU_ADDRESS 0x4000017A BIT_MASK 0x00000002 /end MEASUREMENT
/begin MEASUREMENT CodeCoverParent002.CodeCover000088 "Determines if this subsystem has run" ULONG CompuMethod_111 1 0 0 1 ECU_ADDRESS 0x4000017A BIT_MASK 0x01000000 /end MEASUREMENT
/begin MEASUREMENT CodeCoverParent002.CodeCover000077 "Determines if this subsystem has run" ULONG CompuMethod_112 1 0 0 1 ECU_ADDRESS 0x4000017A BIT_MASK 0x00002000 /end MEASUREMENT
/begin MEASUREMENT CodeCoverParent002.CodeCover000066 "Determines if this subsystem has run" ULONG CompuMethod_113 1 0 0 1 ECU_ADDRESS 0x4000017A BIT_MASK 0x00000004 /end MEASUREMENT
/begin MEASUREMENT CodeCoverParent002.CodeCover000089 "Determines if this subsystem has run" ULONG CompuMethod_114 1 0 0 1 ECU_ADDRESS 0x4000017A BIT_MASK 0x02000000 /end MEASUREMENT
/begin MEASUREMENT CodeCoverParent002.CodeCover000078 "Determines if this subsystem has run" ULONG CompuMethod_115 1 0 0 1 ECU_ADDRESS 0x4000017A BIT_MASK 0x00004000 /end MEASUREMENT
/begin MEASUREMENT CodeCoverParent002.CodeCover000067 "Determines if this subsystem has run" ULONG CompuMethod_116 1 0 0 1 ECU_ADDRESS 0x4000017A BIT_MASK 0x00000008 /end MEASUREMENT
/begin MEASUREMENT CodeCoverParent002.CodeCover000079 "Determines if this subsystem has run" ULONG CompuMethod_117 1 0 0 1 ECU_ADDRESS 0x4000017A BIT_MASK 0x00008000 /end MEASUREMENT
/begin MEASUREMENT CodeCoverParent002.CodeCover000068 "Determines if this subsystem has run" ULONG CompuMethod_118 1 0 0 1 ECU_ADDRESS 0x4000017A BIT_MASK 0x00000010 /end MEASUREMENT
/begin MEASUREMENT CodeCoverParent002.CodeCover000069 "Determines if this subsystem has run" ULONG CompuMethod_119 1 0 0 1 ECU_ADDRESS 0x4000017A BIT_MASK 0x00000020 /end MEASUREMENT
/begin MEASUREMENT CodeCoverParent002 "Run Status of Subsystems" ULONG CompuMethod_2 1 0 0 4294967295 ECU_ADDRESS 0x4000017A /end MEASUREMENT
/begin MEASUREMENT CodeCoverParent003.CodeCover000117 "Determines if this subsystem has run" ULONG CompuMethod_120 1 0 0 1 ECU_ADDRESS 0x4000017E BIT_MASK 0x00200000 /end MEASUREMENT
/begin MEASUREMENT CodeCoverParent003.CodeCover000106 "Determines if this subsystem has run" ULONG CompuMethod_121 1 0 0 1 ECU_ADDRESS 0x4000017E BIT_MASK 0x00000400 /end MEASUREMENT
/begin MEASUREMENT CodeCoverParent003.CodeCover000118 "Determines if this subsystem has run" ULONG CompuMethod_122 1 0 0 1 ECU_ADDRESS 0x4000017E BIT_MASK 0x00400000 /end MEASUREMENT
/begin MEASUREMENT CodeCoverParent003.CodeCover000107 "Determines if this subsystem has run" ULONG CompuMethod_123 1 0 0 1 ECU_ADDRESS 0x4000017E BIT_MASK 0x00000800 /end MEASUREMENT
/begin MEASUREMENT CodeCoverParent003.CodeCover000119 "Determines if this subsystem has run" ULONG CompuMethod_124 1 0 0 1 ECU_ADDRESS 0x4000017E BIT_MASK 0x00800000 /end MEASUREMENT
/begin MEASUREMENT CodeCoverParent003.CodeCover000108 "Determines if this subsystem has run" ULONG CompuMethod_125 1 0 0 1 ECU_ADDRESS 0x4000017E BIT_MASK 0x00001000 /end MEASUREMENT
/begin MEASUREMENT CodeCoverParent003.CodeCover000109 "Determines if this subsystem has run" ULONG CompuMethod_126 1 0 0 1 ECU_ADDRESS 0x4000017E BIT_MASK 0x00002000 /end MEASUREMENT
/begin MEASUREMENT CodeCoverParent003.CodeCover000096 "Determines if this subsystem has run" ULONG CompuMethod_127 1 0 0 1 ECU_ADDRESS 0x4000017E BIT_MASK 0x00000001 /end MEASUREMENT
/begin MEASUREMENT CodeCoverParent003.CodeCover000097 "Determines if this subsystem has run" ULONG CompuMethod_128 1 0 0 1 ECU_ADDRESS 0x4000017E BIT_MASK 0x00000002 /end MEASUREMENT
/begin MEASUREMENT CodeCoverParent003.CodeCover000120 "Determines if this subsystem has run" ULONG CompuMethod_129 1 0 0 1 ECU_ADDRESS 0x4000017E BIT_MASK 0x01000000 /end MEASUREMENT
/begin MEASUREMENT CodeCoverParent003.CodeCover000098 "Determines if this subsystem has run" ULONG CompuMethod_130 1 0 0 1 ECU_ADDRESS 0x4000017E BIT_MASK 0x00000004 /end MEASUREMENT
/begin MEASUREMENT CodeCoverParent003.CodeCover000121 "Determines if this subsystem has run" ULONG CompuMethod_131 1 0 0 1 ECU_ADDRESS 0x4000017E BIT_MASK 0x02000000 /end MEASUREMENT
/begin MEASUREMENT CodeCoverParent003.CodeCover000110 "Determines if this subsystem has run" ULONG CompuMethod_132 1 0 0 1 ECU_ADDRESS 0x4000017E BIT_MASK 0x00004000 /end MEASUREMENT
/begin MEASUREMENT CodeCoverParent003.CodeCover000099 "Determines if this subsystem has run" ULONG CompuMethod_133 1 0 0 1 ECU_ADDRESS 0x4000017E BIT_MASK 0x00000008 /end MEASUREMENT
/begin MEASUREMENT CodeCoverParent003.CodeCover000122 "Determines if this subsystem has run" ULONG CompuMethod_134 1 0 0 1 ECU_ADDRESS 0x4000017E BIT_MASK 0x04000000 /end MEASUREMENT
/begin MEASUREMENT CodeCoverParent003.CodeCover000111 "Determines if this subsystem has run" ULONG CompuMethod_135 1 0 0 1 ECU_ADDRESS 0x4000017E BIT_MASK 0x00008000 /end MEASUREMENT
/begin MEASUREMENT CodeCoverParent003.CodeCover000100 "Determines if this subsystem has run" ULONG CompuMethod_136 1 0 0 1 ECU_ADDRESS 0x4000017E BIT_MASK 0x00000010 /end MEASUREMENT
/begin MEASUREMENT CodeCoverParent003.CodeCover000123 "Determines if this subsystem has run" ULONG CompuMethod_137 1 0 0 1 ECU_ADDRESS 0x4000017E BIT_MASK 0x08000000 /end MEASUREMENT
/begin MEASUREMENT CodeCoverParent003.CodeCover000112 "Determines if this subsystem has run" ULONG CompuMethod_138 1 0 0 1 ECU_ADDRESS 0x4000017E BIT_MASK 0x00010000 /end MEASUREMENT
/begin MEASUREMENT CodeCoverParent003.CodeCover000101 "Determines if this subsystem has run" ULONG CompuMethod_139 1 0 0 1 ECU_ADDRESS 0x4000017E BIT_MASK 0x00000020 /end MEASUREMENT
/begin MEASUREMENT CodeCoverParent003.CodeCover000124 "Determines if this subsystem has run" ULONG CompuMethod_140 1 0 0 1 ECU_ADDRESS 0x4000017E BIT_MASK 0x10000000 /end MEASUREMENT
/begin MEASUREMENT CodeCoverParent003.CodeCover000113 "Determines if this subsystem has run" ULONG CompuMethod_141 1 0 0 1 ECU_ADDRESS 0x4000017E BIT_MASK 0x00020000 /end MEASUREMENT
/begin MEASUREMENT CodeCoverParent003.CodeCover000102 "Determines if this subsystem has run" ULONG CompuMethod_142 1 0 0 1 ECU_ADDRESS 0x4000017E BIT_MASK 0x00000040 /end MEASUREMENT
/begin MEASUREMENT CodeCoverParent003.CodeCover000125 "Determines if this subsystem has run" ULONG CompuMethod_143 1 0 0 1 ECU_ADDRESS 0x4000017E BIT_MASK 0x20000000 /end MEASUREMENT
/begin MEASUREMENT CodeCoverParent003.CodeCover000114 "Determines if this subsystem has run" ULONG CompuMethod_144 1 0 0 1 ECU_ADDRESS 0x4000017E BIT_MASK 0x00040000 /end MEASUREMENT
/begin MEASUREMENT CodeCoverParent003.CodeCover000103 "Determines if this subsystem has run" ULONG CompuMethod_145 1 0 0 1 ECU_ADDRESS 0x4000017E BIT_MASK 0x00000080 /end MEASUREMENT
/begin MEASUREMENT CodeCoverParent003.CodeCover000126 "Determines if this subsystem has run" ULONG CompuMethod_146 1 0 0 1 ECU_ADDRESS 0x4000017E BIT_MASK 0x40000000 /end MEASUREMENT
/begin MEASUREMENT CodeCoverParent003.CodeCover000115 "Determines if this subsystem has run" ULONG CompuMethod_147 1 0 0 1 ECU_ADDRESS 0x4000017E BIT_MASK 0x00080000 /end MEASUREMENT
/begin MEASUREMENT CodeCoverParent003.CodeCover000104 "Determines if this subsystem has run" ULONG CompuMethod_148 1 0 0 1 ECU_ADDRESS 0x4000017E BIT_MASK 0x00000100 /end MEASUREMENT
/begin MEASUREMENT CodeCoverParent003.CodeCover000127 "Determines if this subsystem has run" ULONG CompuMethod_149 1 0 0 1 ECU_ADDRESS 0x4000017E BIT_MASK 0x80000000 /end MEASUREMENT
/begin MEASUREMENT CodeCoverParent003.CodeCover000116 "Determines if this subsystem has run" ULONG CompuMethod_150 1 0 0 1 ECU_ADDRESS 0x4000017E BIT_MASK 0x00100000 /end MEASUREMENT
/begin MEASUREMENT CodeCoverParent003.CodeCover000105 "Determines if this subsystem has run" ULONG CompuMethod_151 1 0 0 1 ECU_ADDRESS 0x4000017E BIT_MASK 0x00000200 /end MEASUREMENT
/begin MEASUREMENT CodeCoverParent003 "Run Status of Subsystems" ULONG CompuMethod_2 1 0 0 4294967295 ECU_ADDRESS 0x4000017E /end MEASUREMENT
/begin MEASUREMENT CodeCoverParent004.CodeCover000128 "Determines if this subsystem has run" ULONG CompuMethod_152 1 0 0 1 ECU_ADDRESS 0x40000182 BIT_MASK 0x00000001 /end MEASUREMENT
/begin MEASUREMENT CodeCoverParent004.CodeCover000129 "Determines if this subsystem has run" ULONG CompuMethod_153 1 0 0 1 ECU_ADDRESS 0x40000182 BIT_MASK 0x00000002 /end MEASUREMENT
/begin MEASUREMENT CodeCoverParent004.CodeCover000130 "Determines if this subsystem has run" ULONG CompuMethod_154 1 0 0 1 ECU_ADDRESS 0x40000182 BIT_MASK 0x00000004 /end MEASUREMENT
/begin MEASUREMENT CodeCoverParent004.CodeCover000131 "Determines if this subsystem has run" ULONG CompuMethod_155 1 0 0 1 ECU_ADDRESS 0x40000182 BIT_MASK 0x00000008 /end MEASUREMENT
/begin MEASUREMENT CodeCoverParent004.CodeCover000132 "Determines if this subsystem has run" ULONG CompuMethod_156 1 0 0 1 ECU_ADDRESS 0x40000182 BIT_MASK 0x00000010 /end MEASUREMENT
/begin MEASUREMENT CodeCoverParent004.CodeCover000133 "Determines if this subsystem has run" ULONG CompuMethod_157 1 0 0 1 ECU_ADDRESS 0x40000182 BIT_MASK 0x00000020 /end MEASUREMENT
/begin MEASUREMENT CodeCoverParent004.CodeCover000134 "Determines if this subsystem has run" ULONG CompuMethod_158 1 0 0 1 ECU_ADDRESS 0x40000182 BIT_MASK 0x00000040 /end MEASUREMENT
/begin MEASUREMENT CodeCoverParent004.CodeCover000135 "Determines if this subsystem has run" ULONG CompuMethod_159 1 0 0 1 ECU_ADDRESS 0x40000182 BIT_MASK 0x00000080 /end MEASUREMENT
/begin MEASUREMENT CodeCoverParent004.CodeCover000136 "Determines if this subsystem has run" ULONG CompuMethod_160 1 0 0 1 ECU_ADDRESS 0x40000182 BIT_MASK 0x00000100 /end MEASUREMENT
/begin MEASUREMENT CodeCoverParent004.CodeCover000137 "Determines if this subsystem has run" ULONG CompuMethod_161 1 0 0 1 ECU_ADDRESS 0x40000182 BIT_MASK 0x00000200 /end MEASUREMENT
/begin MEASUREMENT CodeCoverParent004 "Run Status of Subsystems" ULONG CompuMethod_2 1 0 0 4294967295 ECU_ADDRESS 0x40000182 /end MEASUREMENT
/begin MEASUREMENT Coil1_Neg_Prb "" UBYTE CompuMethod_162 1 0 0 1 ECU_ADDRESS 0x40000186 /end MEASUREMENT
/begin MEASUREMENT Coil1_Pos_Prb "" UBYTE CompuMethod_162 1 0 0 1 ECU_ADDRESS 0x40000187 /end MEASUREMENT
/begin MEASUREMENT Coil2_Pos_Prb "" UBYTE CompuMethod_162 1 0 0 1 ECU_ADDRESS 0x40000188 /end MEASUREMENT
/begin MEASUREMENT Coil3_Pos_Prb "" UBYTE CompuMethod_162 1 0 0 1 ECU_ADDRESS 0x40000189 /end MEASUREMENT
/begin MEASUREMENT ConfigVerMaj "" UBYTE CompuMethod_1 1 0 0 255 ECU_ADDRESS 0x400001DA /end MEASUREMENT
/begin MEASUREMENT ConfigVerMin "" UBYTE CompuMethod_1 1 0 0 255 ECU_ADDRESS 0x400001DB /end MEASUREMENT
/begin MEASUREMENT CoolantTemperature_Prb "" FLOAT32_IEEE CompuMethod_2 1 0 -1E+17 1E+17 ECU_ADDRESS 0x4000020E /end MEASUREMENT
/begin MEASUREMENT CPUIdlePcent "Percentage of the CPU time spent servicing idle priority work." UWORD CompuMethod_163 1 0 0 99.9999 ECU_ADDRESS 0x40000212 /end MEASUREMENT
/begin MEASUREMENT CPUTime_AppISR "Percentage of the CPU time spent executing the periodic timer interrupt" UWORD CompuMethod_163 1 0 0 99.9999 ECU_ADDRESS 0x40000214 /end MEASUREMENT
/begin MEASUREMENT CPUTime_Bgnd "Percentage of the CPU time spent servicing background priority tasks" UWORD CompuMethod_163 1 0 0 99.9999 ECU_ADDRESS 0x40000216 /end MEASUREMENT
/begin MEASUREMENT CPUTime_CAN "Percentage of the CPU time spent executing CAN interrupts" UWORD CompuMethod_163 1 0 0 99.9999 ECU_ADDRESS 0x40000218 /end MEASUREMENT
/begin MEASUREMENT CPUTime_FgndAngle "Percentage of the CPU time spent executing application callbacks due to framework events" UWORD CompuMethod_163 1 0 0 99.9999 ECU_ADDRESS 0x4000021A /end MEASUREMENT
/begin MEASUREMENT CPUTime_FgndTime "Percentage of the CPU time spent servicing background priority tasks" UWORD CompuMethod_163 1 0 0 99.9999 ECU_ADDRESS 0x4000021C /end MEASUREMENT
/begin MEASUREMENT CPUTime_MIOS "Percentage of the CPU time spent executing MIOS interrupts" UWORD CompuMethod_163 1 0 0 99.9999 ECU_ADDRESS 0x4000021E /end MEASUREMENT
/begin MEASUREMENT CPUTime_Serial "Percentage of the CPU time spent executing serial interrupts" UWORD CompuMethod_163 1 0 0 99.9999 ECU_ADDRESS 0x40000220 /end MEASUREMENT
/begin MEASUREMENT CPUTime_TimerISR "Percentage of the CPU time spent executing the periodic timer interrupt" UWORD CompuMethod_163 1 0 0 99.9999 ECU_ADDRESS 0x40000222 /end MEASUREMENT
/begin MEASUREMENT CPUTime_TPU "Percentage of the CPU time spent executing TPU interrupts" UWORD CompuMethod_163 1 0 0 99.9999 ECU_ADDRESS 0x40000224 /end MEASUREMENT
/begin MEASUREMENT Current_Prb "" UWORD CompuMethod_14 1 0 0 65535 ECU_ADDRESS 0x40000226 /end MEASUREMENT
/begin MEASUREMENT currState_Prb "" FLOAT32_IEEE CompuMethod_2 1 0 -1E+17 1E+17 ECU_ADDRESS 0x40000228 /end MEASUREMENT
/begin MEASUREMENT dout_create_DOut2268p0004 "Debug Variable" UBYTE CompuMethod_5 1 0 0 0 ECU_ADDRESS 0x4000022C /end MEASUREMENT
/begin MEASUREMENT dout_create_DOut953p0001 "Debug Variable" UBYTE CompuMethod_5 1 0 0 0 ECU_ADDRESS 0x4000022D /end MEASUREMENT
/begin MEASUREMENT dout_create_DOut954p0001 "Debug Variable" UBYTE CompuMethod_5 1 0 0 0 ECU_ADDRESS 0x4000022E /end MEASUREMENT
/begin MEASUREMENT dout_create_DOut955p0001 "Debug Variable" UBYTE CompuMethod_5 1 0 0 0 ECU_ADDRESS 0x4000022F /end MEASUREMENT
/begin MEASUREMENT dout_create_DOut956p0001 "Debug Variable" UBYTE CompuMethod_5 1 0 0 0 ECU_ADDRESS 0x40000230 /end MEASUREMENT
/begin MEASUREMENT DPI_RollingCounter_Prb "" FLOAT32_IEEE CompuMethod_2 1 0 -1E+17 1E+17 ECU_ADDRESS 0x40000231 /end MEASUREMENT
/begin MEASUREMENT DutyCycle_Prb "" FLOAT32_IEEE CompuMethod_2 1 0 -1E+17 1E+17 ECU_ADDRESS 0x40000235 /end MEASUREMENT
/begin MEASUREMENT FaultsDTC_Prb "" FLOAT32_IEEE CompuMethod_2 1 0 -1E+17 1E+17 ECU_ADDRESS 0x40000239 /end MEASUREMENT
/begin MEASUREMENT FgndAngleStackMinBytesFree "Min bytes observed on the Foreground Angle Stack (may not exist depending onapplication)" ULONG CompuMethod_16 1 0 0 0 ECU_ADDRESS 0x4000023D /end MEASUREMENT
/begin MEASUREMENT FgndAngTaskStatus "Foreground Time Scheduler Status" UBYTE CompuMethod_15 1 0 0 0 ECU_ADDRESS 0x40000241 /end MEASUREMENT
/begin MEASUREMENT FgndTimeStackMinBytesFree "Min bytes observed on the Foreground Time Stack" ULONG CompuMethod_16 1 0 0 0 ECU_ADDRESS 0x40000242 /end MEASUREMENT
/begin MEASUREMENT FrameworkGlueErrors "This indicates the currently Active Errors within the Framework Glue module." UWORD CompuMethod_167 1 0 0 65535 ECU_ADDRESS 0x40000246 /end MEASUREMENT
/begin MEASUREMENT FreqEnd_Prb "" FLOAT32_IEEE CompuMethod_2 1 0 -1E+17 1E+17 ECU_ADDRESS 0x40000248 /end MEASUREMENT
/begin MEASUREMENT FreqStart_Prb "" FLOAT32_IEEE CompuMethod_2 1 0 -1E+17 1E+17 ECU_ADDRESS 0x4000024C /end MEASUREMENT
/begin MEASUREMENT HVIL_Status_Prb "" FLOAT32_IEEE CompuMethod_2 1 0 -1E+17 1E+17 ECU_ADDRESS 0x40000250 /end MEASUREMENT
/begin MEASUREMENT IdleStackMinBytesFree "Min bytes observed on the Idle Stack" ULONG CompuMethod_16 1 0 0 0 ECU_ADDRESS 0x40000254 /end MEASUREMENT
/begin MEASUREMENT InterruptStackMinBytesFree "Minimum observed stack free for use by the interrupts" UWORD CompuMethod_169 1 0 0 65535 ECU_ADDRESS 0x40000258 /end MEASUREMENT
/begin MEASUREMENT IsolationLevel_Prb "" FLOAT32_IEEE CompuMethod_2 1 0 -1E+17 1E+17 ECU_ADDRESS 0x4000025A /end MEASUREMENT
/begin MEASUREMENT IsolationStatus_Prb "" FLOAT32_IEEE CompuMethod_2 1 0 -1E+17 1E+17 ECU_ADDRESS 0x4000025E /end MEASUREMENT
/begin MEASUREMENT IT_Table_Prb "" FLOAT32_IEEE CompuMethod_2 1 0 -1E+17 1E+17 ECU_ADDRESS 0x40000262 /end MEASUREMENT
/begin MEASUREMENT JCS_PackIdentifier_Prb "" FLOAT32_IEEE CompuMethod_2 1 0 -1E+17 1E+17 ECU_ADDRESS 0x40000266 /end MEASUREMENT
/begin MEASUREMENT LastOSError "Monitor of Internal OS Errors" UBYTE CompuMethod_170 1 0 0 0 ECU_ADDRESS 0x4000026A /end MEASUREMENT
/begin MEASUREMENT LinkStatus "This is the Status of the Comms link." UBYTE CompuMethod_1 1 0 0 255 ECU_ADDRESS 0x4000026B /end MEASUREMENT
/begin MEASUREMENT MaxCellTemp_Prb "" FLOAT32_IEEE CompuMethod_2 1 0 -1E+17 1E+17 ECU_ADDRESS 0x400002BC /end MEASUREMENT
/begin MEASUREMENT MaxCellTemperature_Prb "" FLOAT32_IEEE CompuMethod_2 1 0 -1E+17 1E+17 ECU_ADDRESS 0x400002C0 /end MEASUREMENT
/begin MEASUREMENT MaxCellVoltage__Prb "" FLOAT32_IEEE CompuMethod_2 1 0 -1E+17 1E+17 ECU_ADDRESS 0x400002C4 /end MEASUREMENT
/begin MEASUREMENT MaxCellVoltage_Prb "" FLOAT32_IEEE CompuMethod_2 1 0 -1E+17 1E+17 ECU_ADDRESS 0x400002C8 /end MEASUREMENT
/begin MEASUREMENT MaxDisPwr_10s_Table "" FLOAT32_IEEE CompuMethod_2 1 0 -1E+17 1E+17 ECU_ADDRESS 0x400002CC /end MEASUREMENT
/begin MEASUREMENT MaxDisPwr_Cont_Table "" FLOAT32_IEEE CompuMethod_2 1 0 -1E+17 1E+17 ECU_ADDRESS 0x400002D0 /end MEASUREMENT
/begin MEASUREMENT MaximumDischargePower_10s_Prb "" FLOAT32_IEEE CompuMethod_2 1 0 -1E+17 1E+17 ECU_ADDRESS 0x400002D4 /end MEASUREMENT
/begin MEASUREMENT MaximumDischargePower_Continuos_Prb "" FLOAT32_IEEE CompuMethod_2 1 0 -1E+17 1E+17 ECU_ADDRESS 0x400002D8 /end MEASUREMENT
/begin MEASUREMENT MaximumRegenPower_10s_Prb "" FLOAT32_IEEE CompuMethod_2 1 0 -1E+17 1E+17 ECU_ADDRESS 0x400002DC /end MEASUREMENT
/begin MEASUREMENT MaximumRegenPower_Continuous_Prb "" FLOAT32_IEEE CompuMethod_2 1 0 -1E+17 1E+17 ECU_ADDRESS 0x400002E0 /end MEASUREMENT
/begin MEASUREMENT MaxRegenPwr_10s_Table "" FLOAT32_IEEE CompuMethod_2 1 0 -1E+17 1E+17 ECU_ADDRESS 0x400002E4 /end MEASUREMENT
/begin MEASUREMENT MaxRegenPwr_Cont_Table "" FLOAT32_IEEE CompuMethod_2 1 0 -1E+17 1E+17 ECU_ADDRESS 0x400002E8 /end MEASUREMENT
/begin MEASUREMENT MIL_Status_Prb "" FLOAT32_IEEE CompuMethod_2 1 0 -1E+17 1E+17 ECU_ADDRESS 0x400002EC /end MEASUREMENT
/begin MEASUREMENT MinCellTemp_Prb "" FLOAT32_IEEE CompuMethod_2 1 0 -1E+17 1E+17 ECU_ADDRESS 0x400002F0 /end MEASUREMENT
/begin MEASUREMENT MinCellTemperature_Prb "" FLOAT32_IEEE CompuMethod_2 1 0 -1E+17 1E+17 ECU_ADDRESS 0x400002F4 /end MEASUREMENT
/begin MEASUREMENT MinCellVoltage__Prb "" FLOAT32_IEEE CompuMethod_2 1 0 -1E+17 1E+17 ECU_ADDRESS 0x400002F8 /end MEASUREMENT
/begin MEASUREMENT MinCellVoltage_Prb "" FLOAT32_IEEE CompuMethod_2 1 0 -1E+17 1E+17 ECU_ADDRESS 0x400002FC /end MEASUREMENT
/begin MEASUREMENT ModuleCapability "" UBYTE CompuMethod_171 1 0 0 255 ECU_ADDRESS 0x40000300 /end MEASUREMENT
/begin MEASUREMENT MotoHawkInterpolation2D "" FLOAT32_IEEE CompuMethod_2 1 0 -1E+17 1E+17 ECU_ADDRESS 0x40000351 /end MEASUREMENT
/begin MEASUREMENT MotoHawkModelSecondsInUse "Total runtime of this MotoHawk software model" ULONG CompuMethod_172 1 0 0 4294970000 ECU_ADDRESS 0x400003F5 /end MEASUREMENT
/begin MEASUREMENT MPRD "Indicates whether the main power relay is active" UBYTE CompuMethod_173 1 0 0 1 ECU_ADDRESS 0x4000047B /end MEASUREMENT
/begin MEASUREMENT NonVolatileCRC "Calculated NonVolatile CRC" ULONG CompuMethod_162 1 0 0 65535 ECU_ADDRESS 0x4000047C /end MEASUREMENT
/begin MEASUREMENT NonVolatileFormatID "Unique identifier of the NonVolatile memory format.  Used to validate whether stored variables are in the correct form for the program" ULONG CompuMethod_18 1 0 0 4294970000 ECU_ADDRESS 0x40000480 /end MEASUREMENT
/begin MEASUREMENT NonVolatileStatus "Indicates how NonVolatile memory was loaded" UBYTE CompuMethod_177 1 0 0 6 ECU_ADDRESS 0x40000484 /end MEASUREMENT
/begin MEASUREMENT OSErrorCnt "Number of errors observed by the OS" UBYTE CompuMethod_1 1 0 0 255 ECU_ADDRESS 0x40000485 /end MEASUREMENT
/begin MEASUREMENT OSStatus "" UBYTE CompuMethod_178 1 0 0 0 ECU_ADDRESS 0x40000486 /end MEASUREMENT
/begin MEASUREMENT PackState__Prb "" FLOAT32_IEEE CompuMethod_2 1 0 -1E+17 1E+17 ECU_ADDRESS 0x40000487 /end MEASUREMENT
/begin MEASUREMENT PackState_Prb "" FLOAT32_IEEE CompuMethod_2 1 0 -1E+17 1E+17 ECU_ADDRESS 0x4000048B /end MEASUREMENT
/begin MEASUREMENT PeakHeapBytesUsed "The peak number of bytes seen on the heap." ULONG CompuMethod_14 1 0 0 0 ECU_ADDRESS 0x400004B7 /end MEASUREMENT
/begin MEASUREMENT PPL10s_RollingCounter_Prb "" FLOAT32_IEEE CompuMethod_2 1 0 -1E+17 1E+17 ECU_ADDRESS 0x400004BB /end MEASUREMENT
/begin MEASUREMENT PPLCont_RollingCounter_Prb "" FLOAT32_IEEE CompuMethod_2 1 0 -1E+17 1E+17 ECU_ADDRESS 0x400004BF /end MEASUREMENT
/begin MEASUREMENT PreCharge_Duty_Cycle_Prb "" SWORD CompuMethod_14 1 0 -32768 32767 ECU_ADDRESS 0x400004C3 /end MEASUREMENT
/begin MEASUREMENT PreCharge_Enable_Prb "" UBYTE CompuMethod_162 1 0 0 1 ECU_ADDRESS 0x400004C5 /end MEASUREMENT
/begin MEASUREMENT PreCharge_Freq_Prb "" ULONG CompuMethod_18 1 0 0 4294970000 ECU_ADDRESS 0x400004C6 /end MEASUREMENT
/begin MEASUREMENT PreChargeState__Prb "" FLOAT32_IEEE CompuMethod_2 1 0 -1E+17 1E+17 ECU_ADDRESS 0x400004CA /end MEASUREMENT
/begin MEASUREMENT PrechargeState_Prb "" FLOAT32_IEEE CompuMethod_2 1 0 -1E+17 1E+17 ECU_ADDRESS 0x400004CE /end MEASUREMENT
/begin MEASUREMENT protocol_register_CAN_1 "Debug Variable" UBYTE CompuMethod_5 1 0 0 0 ECU_ADDRESS 0x400004D2 /end MEASUREMENT
/begin MEASUREMENT PS_RollingCounter_Prb "" FLOAT32_IEEE CompuMethod_2 1 0 -1E+17 1E+17 ECU_ADDRESS 0x400004D3 /end MEASUREMENT
/begin MEASUREMENT PVC_RollingCounter_Prb "" FLOAT32_IEEE CompuMethod_2 1 0 -1E+17 1E+17 ECU_ADDRESS 0x400004D7 /end MEASUREMENT
/begin MEASUREMENT pwm_create_EST1_PWMOutput "Debug Variable" UBYTE CompuMethod_5 1 0 0 0 ECU_ADDRESS 0x400004DB /end MEASUREMENT
/begin MEASUREMENT pwm_set_EST1_PWMOutput "Debug Variable" UBYTE CompuMethod_5 1 0 0 0 ECU_ADDRESS 0x400004DC /end MEASUREMENT
/begin MEASUREMENT resource_allocation "Debug Variable" UBYTE CompuMethod_5 1 0 0 0 ECU_ADDRESS 0x400004DD /end MEASUREMENT
/begin MEASUREMENT SleepInhibited_Prb "" FLOAT32_IEEE CompuMethod_2 1 0 -1E+17 1E+17 ECU_ADDRESS 0x400004DE /end MEASUREMENT
/begin MEASUREMENT SOC_Prb "" FLOAT32_IEEE CompuMethod_2 1 0 -1E+17 1E+17 ECU_ADDRESS 0x400004E2 /end MEASUREMENT
/begin MEASUREMENT SOC_PreFilter_Prb "" FLOAT32_IEEE CompuMethod_2 1 0 -1E+17 1E+17 ECU_ADDRESS 0x400004E6 /end MEASUREMENT
/begin MEASUREMENT SOC_PreLookupIdx "" UWORD CompuMethod_23 1 0 0 127.998 ECU_ADDRESS 0x400004EA /end MEASUREMENT
/begin MEASUREMENT SOC_PreLookupIn "" FLOAT32_IEEE CompuMethod_2 1 0 -1E+17 1E+17 ECU_ADDRESS 0x400004EC /end MEASUREMENT
/begin MEASUREMENT SOC_TableIdx "" UWORD CompuMethod_23 1 0 0 127.998 ECU_ADDRESS 0x400004F0 /end MEASUREMENT
/begin MEASUREMENT SOC_TableIn "" FLOAT32_IEEE CompuMethod_2 1 0 -1E+17 1E+17 ECU_ADDRESS 0x400004F2 /end MEASUREMENT
/begin MEASUREMENT SOCMap "" FLOAT32_IEEE CompuMethod_181 1 0 -1E+17 1E+17 ECU_ADDRESS 0x400004F6 /end MEASUREMENT
/begin MEASUREMENT StateOfCharge_Prb "" FLOAT32_IEEE CompuMethod_2 1 0 -1E+17 1E+17 ECU_ADDRESS 0x400004FA /end MEASUREMENT
/begin MEASUREMENT StateOfChargeMax_Prb "" FLOAT32_IEEE CompuMethod_2 1 0 -1E+17 1E+17 ECU_ADDRESS 0x400004FE /end MEASUREMENT
/begin MEASUREMENT StateOfChargeMin_Prb "" FLOAT32_IEEE CompuMethod_2 1 0 -1E+17 1E+17 ECU_ADDRESS 0x40000502 /end MEASUREMENT
/begin MEASUREMENT SWISRCurrQueueSize "Current size of the Software ISR Queue" UBYTE CompuMethod_183 1 0 0 255 ECU_ADDRESS 0x40000506 /end MEASUREMENT
/begin MEASUREMENT SystemFrequency "The operating CPU frequency." ULONG CompuMethod_184 1 0 0 56 ECU_ADDRESS 0x40000507 /end MEASUREMENT
/begin MEASUREMENT TAH_RollingCounter_Prb "" FLOAT32_IEEE CompuMethod_2 1 0 -1E+17 1E+17 ECU_ADDRESS 0x4000050B /end MEASUREMENT
/begin MEASUREMENT Temp_IR_PreIdx "" UWORD CompuMethod_23 1 0 0 127.998 ECU_ADDRESS 0x4000050F /end MEASUREMENT
/begin MEASUREMENT Temp_IR_PreIn "" FLOAT32_IEEE CompuMethod_2 1 0 -1E+17 1E+17 ECU_ADDRESS 0x40000511 /end MEASUREMENT
/begin MEASUREMENT TPUMaskType "Describes the TPU Mask selected for use." UBYTE CompuMethod_185 1 0 0 0 ECU_ADDRESS 0x40000515 /end MEASUREMENT
/begin MEASUREMENT TPUMaskVers "Describes the version of the TPU Mask selected." UBYTE CompuMethod_162 1 0 0 255 ECU_ADDRESS 0x40000516 /end MEASUREMENT
/begin MEASUREMENT TripAmoHoursOut_Prb "" FLOAT32_IEEE CompuMethod_2 1 0 -1E+17 1E+17 ECU_ADDRESS 0x40000517 /end MEASUREMENT
/begin MEASUREMENT TripAmpsHoursIn_Prb "" FLOAT32_IEEE CompuMethod_2 1 0 -1E+17 1E+17 ECU_ADDRESS 0x4000051B /end MEASUREMENT
/begin MEASUREMENT Unused "Unused Table Entry" UBYTE CompuMethod_1 1 0 0 255 ECU_ADDRESS 0x4000051F /end MEASUREMENT
/begin MEASUREMENT V5V_Reference_Prb "" UWORD CompuMethod_14 1 0 0 65535 ECU_ADDRESS 0x40000520 /end MEASUREMENT
/begin MEASUREMENT Volt_IR_PreIdx "" UWORD CompuMethod_23 1 0 0 127.998 ECU_ADDRESS 0x40000522 /end MEASUREMENT
/begin MEASUREMENT Volt_IR_PreIn "" FLOAT32_IEEE CompuMethod_2 1 0 -1E+17 1E+17 ECU_ADDRESS 0x40000524 /end MEASUREMENT
/begin MEASUREMENT Voltage_Prb "" FLOAT32_IEEE CompuMethod_2 1 0 -1E+17 1E+17 ECU_ADDRESS 0x40000528 /end MEASUREMENT
/begin MEASUREMENT WakeSignal_Prb "" FLOAT32_IEEE CompuMethod_2 1 0 -1E+17 1E+17 ECU_ADDRESS 0x4000052C /end MEASUREMENT
/*~~~~~~~~~ 6.3.27 CHARACTERISTICs ~~~~~~~~~*/
/begin CHARACTERISTIC project_id "This is the Platform ID used by the tools." VALUE 0x800008EF RecordLayout_1 0 CompuMethod_1 0 255 /end CHARACTERISTIC
/begin CHARACTERISTIC SwIdTxt "Software Format ID" ASCII 0x4000000A RecordLayout_2 0 CompuMethod_2 0 255 NUMBER 13 MATRIX_DIM 13 1 1 READ_ONLY /end CHARACTERISTIC
/begin CHARACTERISTIC CalIdTxt "Calibration ID" ASCII 0x80000002 RecordLayout_2 0 CompuMethod_2 0 255 NUMBER 33 MATRIX_DIM 33 1 1 /end CHARACTERISTIC
/begin CHARACTERISTIC SwRevisionTxt "Software Revision ID" ASCII 0x40000017 RecordLayout_2 0 CompuMethod_2 0 255 NUMBER 50 MATRIX_DIM 50 1 1 READ_ONLY /end CHARACTERISTIC
/begin CHARACTERISTIC FriendlyName "The device's friendly name." ASCII 0x8000002C RecordLayout_2 0 CompuMethod_2 0 255 NUMBER 33 MATRIX_DIM 33 1 1 /end CHARACTERISTIC
/begin CHARACTERISTIC ProductID "Customer's ID used by the tools." VALUE 0x8000004D RecordLayout_3 0 CompuMethod_3 0 4294970000 /end CHARACTERISTIC
/begin CHARACTERISTIC SerialNumber "" ASCII 0x400000B2 RecordLayout_2 0 CompuMethod_2 0 255 NUMBER 50 MATRIX_DIM 50 1 1 READ_ONLY /end CHARACTERISTIC
/begin CHARACTERISTIC ModelNumber "" ASCII 0x400000E4 RecordLayout_2 0 CompuMethod_2 0 255 NUMBER 50 MATRIX_DIM 50 1 1 READ_ONLY /end CHARACTERISTIC
/begin CHARACTERISTIC ActiveDTC_Ovr_new "" VALUE 0x80000051 RecordLayout_4 0 CompuMethod_2 -1E+17 1E+17 /end CHARACTERISTIC
/begin CHARACTERISTIC ActiveDTC_Ovr_ovr "" VALUE 0x80000055 RecordLayout_1 0 CompuMethod_4 0 1 /end CHARACTERISTIC
/begin CHARACTERISTIC Amp_Clamp_K "" VALUE 0x80000056 RecordLayout_4 0 CompuMethod_6 0 1 /end CHARACTERISTIC
/begin CHARACTERISTIC Amp_Offset "" VALUE 0x8000005A RecordLayout_4 0 CompuMethod_2 -1E+17 1E+17 /end CHARACTERISTIC
/begin CHARACTERISTIC AMPCurrent_Ovr_new "" VALUE 0x8000005E RecordLayout_4 0 CompuMethod_2 -1E+17 1E+17 /end CHARACTERISTIC
/begin CHARACTERISTIC AMPCurrent_Ovr_ovr "" VALUE 0x80000062 RecordLayout_1 0 CompuMethod_4 0 1 /end CHARACTERISTIC
/begin CHARACTERISTIC AmpIn "" VALUE 0x80000063 RecordLayout_4 0 CompuMethod_2 -1E+17 1E+17 /end CHARACTERISTIC
/begin CHARACTERISTIC AmpOut "" VALUE 0x80000067 RecordLayout_4 0 CompuMethod_2 -1E+17 1E+17 /end CHARACTERISTIC
/begin CHARACTERISTIC AmpV_Offset "" VALUE 0x8000006B RecordLayout_4 0 CompuMethod_2 -1E+17 1E+17 /end CHARACTERISTIC
/begin CHARACTERISTIC ApplicationMonitorEnable "Enables runtime checking of stack, heap, CPU, and OS errors.  Stops the application on error." VALUE 0x8000006F RecordLayout_1 0 CompuMethod_9 0 1 /end CHARACTERISTIC
/begin CHARACTERISTIC ApplicationPausePoint "Selects the startup pause point, for debugging.  Can be moved forward to step through the initialization" VALUE 0x80000070 RecordLayout_1 0 CompuMethod_10 0 3 /end CHARACTERISTIC
/begin CHARACTERISTIC ApplicationStatus "View and set the application runtime status" VALUE 0x80000071 RecordLayout_1 0 CompuMethod_11 1 3 /end CHARACTERISTIC
/begin CHARACTERISTIC BalancingCount_Ovr_new "" VALUE 0x80000072 RecordLayout_4 0 CompuMethod_2 -1E+17 1E+17 /end CHARACTERISTIC
/begin CHARACTERISTIC BalancingCount_Ovr_ovr "" VALUE 0x80000076 RecordLayout_1 0 CompuMethod_4 0 1 /end CHARACTERISTIC
/begin CHARACTERISTIC Battery_Enable_Ovr_new "" VALUE 0x80000077 RecordLayout_4 0 CompuMethod_2 -1E+17 1E+17 /end CHARACTERISTIC
/begin CHARACTERISTIC Battery_Enable_Ovr_ovr "" VALUE 0x8000007B RecordLayout_1 0 CompuMethod_4 0 1 /end CHARACTERISTIC
/begin CHARACTERISTIC BatteryCurrent_Ovr_new "" VALUE 0x8000007C RecordLayout_4 0 CompuMethod_2 -1E+17 1E+17 /end CHARACTERISTIC
/begin CHARACTERISTIC BatteryCurrent_Ovr_ovr "" VALUE 0x80000080 RecordLayout_1 0 CompuMethod_4 0 1 /end CHARACTERISTIC
/begin CHARACTERISTIC BatteryVoltage_Ovr_new "" VALUE 0x80000081 RecordLayout_4 0 CompuMethod_2 -1E+17 1E+17 /end CHARACTERISTIC
/begin CHARACTERISTIC BatteryVoltage_Ovr_ovr "" VALUE 0x80000085 RecordLayout_1 0 CompuMethod_4 0 1 /end CHARACTERISTIC
/begin CHARACTERISTIC BGND_BASE_PERIODIC_RunCnt "The number of times to execute BGND_BASE_PERIODIC before pausing.  -1 means run forever" VALUE 0x80000086 RecordLayout_5 0 CompuMethod_14 -1 2147480000 /end CHARACTERISTIC
/begin CHARACTERISTIC BGND_BASEx10_PERIODIC_RunCnt "The number of times to execute BGND_BASEx10_PERIODIC before pausing.  -1 means run forever" VALUE 0x8000008A RecordLayout_5 0 CompuMethod_14 -1 2147480000 /end CHARACTERISTIC
/begin CHARACTERISTIC BGND_BASEx2_PERIODIC_RunCnt "The number of times to execute BGND_BASEx2_PERIODIC before pausing.  -1 means run forever" VALUE 0x8000008E RecordLayout_5 0 CompuMethod_14 -1 2147480000 /end CHARACTERISTIC
/begin CHARACTERISTIC BgndStackMargin "When the available stack space drops below this threshold, the application performs a safety stop" VALUE 0x80000092 RecordLayout_6 0 CompuMethod_14 0 2048 /end CHARACTERISTIC
/begin CHARACTERISTIC BusVoltage_Ovr_new "" VALUE 0x80000094 RecordLayout_4 0 CompuMethod_2 -1E+17 1E+17 /end CHARACTERISTIC
/begin CHARACTERISTIC BusVoltage_Ovr_ovr "" VALUE 0x80000098 RecordLayout_1 0 CompuMethod_4 0 1 /end CHARACTERISTIC
/begin CHARACTERISTIC CCP_BAT_StationAddr "Station ID for CCP handler: CCP_BAT" VALUE 0x80000099 RecordLayout_6 0 CompuMethod_14 0 65535 /end CHARACTERISTIC
/begin CHARACTERISTIC CCP_BATRxID "Receive CAN ID for CCP handler: CCP_BAT" VALUE 0x8000009B RecordLayout_3 0 CompuMethod_18 0 4294970000 /end CHARACTERISTIC
/begin CHARACTERISTIC CCP_BATRxIDMask "Receive CAN ID Mask for CCP handler: CCP_BAT" VALUE 0x8000009F RecordLayout_3 0 CompuMethod_18 0 4294970000 /end CHARACTERISTIC
/begin CHARACTERISTIC CCP_BATTxID "Transmit CAN ID for CCP handler: CCP_BAT" VALUE 0x800000A3 RecordLayout_3 0 CompuMethod_18 0 4294970000 /end CHARACTERISTIC
/begin CHARACTERISTIC CellBalancingActive_Ovr_new "" VALUE 0x800000A7 RecordLayout_1 0 CompuMethod_1 0 255 /end CHARACTERISTIC
/begin CHARACTERISTIC CellBalancingActive_Ovr_ovr "" VALUE 0x800000A8 RecordLayout_1 0 CompuMethod_4 0 1 /end CHARACTERISTIC
/begin CHARACTERISTIC CityID_CAN_1 "City ID for CAN bus CAN_1" VALUE 0x800000C5 RecordLayout_1 0 CompuMethod_1 0 255 /end CHARACTERISTIC
/begin CHARACTERISTIC Coil1_Neg_Ovr_new "" VALUE 0x800000C6 RecordLayout_1 0 CompuMethod_162 0 1 /end CHARACTERISTIC
/begin CHARACTERISTIC Coil1_Neg_Ovr_ovr "" VALUE 0x800000C7 RecordLayout_1 0 CompuMethod_4 0 1 /end CHARACTERISTIC
/begin CHARACTERISTIC Coil1_Pos_Ovr_new "" VALUE 0x800000C8 RecordLayout_1 0 CompuMethod_162 0 1 /end CHARACTERISTIC
/begin CHARACTERISTIC Coil1_Pos_Ovr_ovr "" VALUE 0x800000C9 RecordLayout_1 0 CompuMethod_4 0 1 /end CHARACTERISTIC
/begin CHARACTERISTIC Coil2_Pos_Ovr_new "" VALUE 0x800000CA RecordLayout_1 0 CompuMethod_162 0 1 /end CHARACTERISTIC
/begin CHARACTERISTIC Coil2_Pos_Ovr_ovr "" VALUE 0x800000CB RecordLayout_1 0 CompuMethod_4 0 1 /end CHARACTERISTIC
/begin CHARACTERISTIC Coil3_Pos_Ovr_new "" VALUE 0x800000CC RecordLayout_1 0 CompuMethod_162 0 1 /end CHARACTERISTIC
/begin CHARACTERISTIC Coil3_Pos_Ovr_ovr "" VALUE 0x800000CD RecordLayout_1 0 CompuMethod_4 0 1 /end CHARACTERISTIC
/begin CHARACTERISTIC CompilerVersion "Compiler toolchain version used for the MotoHawk build" ASCII 0x4000018A RecordLayout_2 0 CompuMethod_2 0 255 NUMBER 80 MATRIX_DIM 80 1 1 READ_ONLY /end CHARACTERISTIC
/begin CHARACTERISTIC ControlCoreSDKRelease "ControlCoreSDK Build." ASCII 0x400001DC RecordLayout_2 0 CompuMethod_2 0 255 NUMBER 50 MATRIX_DIM 50 1 1 READ_ONLY /end CHARACTERISTIC
/begin CHARACTERISTIC CoolantTemperature "" VALUE 0x800000CE RecordLayout_4 0 CompuMethod_2 -1E+17 1E+17 /end CHARACTERISTIC
/begin CHARACTERISTIC CoolantTemperature_Ovr_new "" VALUE 0x800000D2 RecordLayout_4 0 CompuMethod_2 -1E+17 1E+17 /end CHARACTERISTIC
/begin CHARACTERISTIC CoolantTemperature_Ovr_ovr "" VALUE 0x800000D6 RecordLayout_1 0 CompuMethod_4 0 1 /end CHARACTERISTIC
/begin CHARACTERISTIC CPUMargin "When the available CPU idle time drops below this threshold, the application performs a safety stop" VALUE 0x800000D7 RecordLayout_6 0 CompuMethod_164 0 100 /end CHARACTERISTIC
/begin CHARACTERISTIC Current_Div2 "" VALUE 0x800000D9 RecordLayout_4 0 CompuMethod_2 -1E+17 1E+17 /end CHARACTERISTIC
/begin CHARACTERISTIC Current_Ovr_new "" VALUE 0x800000DD RecordLayout_6 0 CompuMethod_14 0 65535 /end CHARACTERISTIC
/begin CHARACTERISTIC Current_Ovr_ovr "" VALUE 0x800000DF RecordLayout_1 0 CompuMethod_4 0 1 /end CHARACTERISTIC
/begin CHARACTERISTIC Delay_3_Cal "" VALUE 0x800000E0 RecordLayout_4 0 CompuMethod_165 -5E+15 5E+15 /end CHARACTERISTIC
/begin CHARACTERISTIC Delay_5_Cal "" VALUE 0x800000E4 RecordLayout_4 0 CompuMethod_165 -5E+15 5E+15 /end CHARACTERISTIC
/begin CHARACTERISTIC Delay3 "" VALUE 0x800000E8 RecordLayout_1 0 CompuMethod_162 0 1 /end CHARACTERISTIC
/begin CHARACTERISTIC Delay5 "" VALUE 0x800000E9 RecordLayout_1 0 CompuMethod_162 0 1 /end CHARACTERISTIC
/begin CHARACTERISTIC DPI_RollingCounter "" VALUE 0x800000EA RecordLayout_4 0 CompuMethod_2 -1E+17 1E+17 /end CHARACTERISTIC
/begin CHARACTERISTIC DPI_RollingCounter_Ovr_new "" VALUE 0x800000EE RecordLayout_4 0 CompuMethod_2 -1E+17 1E+17 /end CHARACTERISTIC
/begin CHARACTERISTIC DPI_RollingCounter_Ovr_ovr "" VALUE 0x800000F2 RecordLayout_1 0 CompuMethod_4 0 1 /end CHARACTERISTIC
/begin CHARACTERISTIC DutyCycle "" VALUE 0x800000F3 RecordLayout_4 0 CompuMethod_2 -1E+17 1E+17 /end CHARACTERISTIC
/begin CHARACTERISTIC DutyCycle_Ovr_new "" VALUE 0x800000F7 RecordLayout_4 0 CompuMethod_2 -1E+17 1E+17 /end CHARACTERISTIC
/begin CHARACTERISTIC DutyCycle_Ovr_ovr "" VALUE 0x800000FB RecordLayout_1 0 CompuMethod_4 0 1 /end CHARACTERISTIC
/begin CHARACTERISTIC ECUP_Threshold "ADC voltage threshold above which ECU is considered powered" VALUE 0x800000FC RecordLayout_6 0 CompuMethod_166 0 1023 /end CHARACTERISTIC
/begin CHARACTERISTIC FaultsDTC "" VALUE 0x800000FE RecordLayout_4 0 CompuMethod_2 -1E+17 1E+17 /end CHARACTERISTIC
/begin CHARACTERISTIC FaultsDTC_Ovr_new "" VALUE 0x80000102 RecordLayout_4 0 CompuMethod_2 -1E+17 1E+17 /end CHARACTERISTIC
/begin CHARACTERISTIC FaultsDTC_Ovr_ovr "" VALUE 0x80000106 RecordLayout_1 0 CompuMethod_4 0 1 /end CHARACTERISTIC
/begin CHARACTERISTIC FGND_10XRTI_PERIODIC_RunCnt "The number of times to execute FGND_10XRTI_PERIODIC before pausing.  -1 means run forever" VALUE 0x80000107 RecordLayout_5 0 CompuMethod_14 -1 2147480000 /end CHARACTERISTIC
/begin CHARACTERISTIC FGND_20XRTI_PERIODIC_RunCnt "The number of times to execute FGND_20XRTI_PERIODIC before pausing.  -1 means run forever" VALUE 0x8000010B RecordLayout_5 0 CompuMethod_14 -1 2147480000 /end CHARACTERISTIC
/begin CHARACTERISTIC FGND_2XRTI_PERIODIC_RunCnt "The number of times to execute FGND_2XRTI_PERIODIC before pausing.  -1 means run forever" VALUE 0x8000010F RecordLayout_5 0 CompuMethod_14 -1 2147480000 /end CHARACTERISTIC
/begin CHARACTERISTIC FGND_RTI_PERIODIC_RunCnt "The number of times to execute FGND_RTI_PERIODIC before pausing.  -1 means run forever" VALUE 0x80000113 RecordLayout_5 0 CompuMethod_14 -1 2147480000 /end CHARACTERISTIC
/begin CHARACTERISTIC FgndTimeStackMargin "When the available stack space drops below this threshold, the application performs a safety stop" VALUE 0x80000117 RecordLayout_6 0 CompuMethod_14 0 3072 /end CHARACTERISTIC
/begin CHARACTERISTIC FreqEnd "" VALUE 0x80000119 RecordLayout_4 0 CompuMethod_2 -1E+17 1E+17 /end CHARACTERISTIC
/begin CHARACTERISTIC FreqEnd_Ovr_new "" VALUE 0x8000011D RecordLayout_4 0 CompuMethod_2 -1E+17 1E+17 /end CHARACTERISTIC
/begin CHARACTERISTIC FreqEnd_Ovr_ovr "" VALUE 0x80000121 RecordLayout_1 0 CompuMethod_4 0 1 /end CHARACTERISTIC
/begin CHARACTERISTIC FreqStart "" VALUE 0x80000122 RecordLayout_4 0 CompuMethod_2 -1E+17 1E+17 /end CHARACTERISTIC
/begin CHARACTERISTIC FreqStart_Ovr_new "" VALUE 0x80000126 RecordLayout_4 0 CompuMethod_2 -1E+17 1E+17 /end CHARACTERISTIC
/begin CHARACTERISTIC FreqStart_Ovr_ovr "" VALUE 0x8000012A RecordLayout_1 0 CompuMethod_4 0 1 /end CHARACTERISTIC
/begin CHARACTERISTIC G_Sensativity "" VALUE 0x8000012B RecordLayout_4 0 CompuMethod_168 -1E+17 1E+17 /end CHARACTERISTIC
/begin CHARACTERISTIC HeapMargin "When the available heap drops below this threshold, the application performs a safety stop" VALUE 0x8000012F RecordLayout_6 0 CompuMethod_14 0 4096 /end CHARACTERISTIC
/begin CHARACTERISTIC highAmperage "" VALUE 0x80000131 RecordLayout_4 0 CompuMethod_2 -1E+17 1E+17 /end CHARACTERISTIC
/begin CHARACTERISTIC HVIL_Status "" VALUE 0x80000135 RecordLayout_4 0 CompuMethod_2 -1E+17 1E+17 /end CHARACTERISTIC
/begin CHARACTERISTIC HVIL_Status_Ovr_new "" VALUE 0x80000139 RecordLayout_4 0 CompuMethod_2 -1E+17 1E+17 /end CHARACTERISTIC
/begin CHARACTERISTIC HVIL_Status_Ovr_ovr "" VALUE 0x8000013D RecordLayout_1 0 CompuMethod_4 0 1 /end CHARACTERISTIC
/begin CHARACTERISTIC IDLE_EVENT_RunCnt "The number of times to execute IDLE_EVENT before pausing.  -1 means run forever" VALUE 0x8000013E RecordLayout_5 0 CompuMethod_14 -1 2147480000 /end CHARACTERISTIC
/begin CHARACTERISTIC IdleStackMargin "When the available stack space drops below this threshold, the application performs a safety stop" VALUE 0x80000142 RecordLayout_6 0 CompuMethod_14 0 1024 /end CHARACTERISTIC
/begin CHARACTERISTIC InterruptStackMargin "When the available stack space drops below this threshold, the application performs a safety stop" VALUE 0x80000144 RecordLayout_6 0 CompuMethod_14 0 1536 /end CHARACTERISTIC
/begin CHARACTERISTIC IsolationLevel "" VALUE 0x80000146 RecordLayout_4 0 CompuMethod_2 -1E+17 1E+17 /end CHARACTERISTIC
/begin CHARACTERISTIC IsolationLevel_Ovr_new "" VALUE 0x8000014A RecordLayout_4 0 CompuMethod_2 -1E+17 1E+17 /end CHARACTERISTIC
/begin CHARACTERISTIC IsolationLevel_Ovr_ovr "" VALUE 0x8000014E RecordLayout_1 0 CompuMethod_4 0 1 /end CHARACTERISTIC
/begin CHARACTERISTIC IsolationStatus "" VALUE 0x8000014F RecordLayout_4 0 CompuMethod_2 -1E+17 1E+17 /end CHARACTERISTIC
/begin CHARACTERISTIC IsolationStatus_Ovr_new "" VALUE 0x80000153 RecordLayout_4 0 CompuMethod_2 -1E+17 1E+17 /end CHARACTERISTIC
/begin CHARACTERISTIC IsolationStatus_Ovr_ovr "" VALUE 0x80000157 RecordLayout_1 0 CompuMethod_4 0 1 /end CHARACTERISTIC
/begin CHARACTERISTIC JCS_PackIdentifier_Ovr_new "" VALUE 0x80000158 RecordLayout_4 0 CompuMethod_2 -1E+17 1E+17 /end CHARACTERISTIC
/begin CHARACTERISTIC JCS_PackIdentifier_Ovr_ovr "" VALUE 0x8000015C RecordLayout_1 0 CompuMethod_4 0 1 /end CHARACTERISTIC
/begin CHARACTERISTIC lowAmperage "" VALUE 0x8000015D RecordLayout_4 0 CompuMethod_2 -1E+17 1E+17 /end CHARACTERISTIC
/begin CHARACTERISTIC MatlabVersionTxt "MATLAB version used to build the application." ASCII 0x4000026C RecordLayout_2 0 CompuMethod_2 0 255 NUMBER 80 MATRIX_DIM 80 1 1 READ_ONLY /end CHARACTERISTIC
/begin CHARACTERISTIC Max_AmphoursIn "" VALUE 0x80000161 RecordLayout_4 0 CompuMethod_2 -1E+17 1E+17 /end CHARACTERISTIC
/begin CHARACTERISTIC Max_AmphoursOut "" VALUE 0x80000165 RecordLayout_4 0 CompuMethod_2 -1E+17 1E+17 /end CHARACTERISTIC
/begin CHARACTERISTIC MaxCellTemp "" VALUE 0x80000169 RecordLayout_4 0 CompuMethod_2 -1E+17 1E+17 /end CHARACTERISTIC
/begin CHARACTERISTIC MaxCellTemp_Ovr_new "" VALUE 0x8000016D RecordLayout_4 0 CompuMethod_2 -1E+17 1E+17 /end CHARACTERISTIC
/begin CHARACTERISTIC MaxCellTemp_Ovr_ovr "" VALUE 0x80000171 RecordLayout_1 0 CompuMethod_4 0 1 /end CHARACTERISTIC
/begin CHARACTERISTIC MaxCellTemperature_Ovr_new "" VALUE 0x80000172 RecordLayout_4 0 CompuMethod_2 -1E+17 1E+17 /end CHARACTERISTIC
/begin CHARACTERISTIC MaxCellTemperature_Ovr_ovr "" VALUE 0x80000176 RecordLayout_1 0 CompuMethod_4 0 1 /end CHARACTERISTIC
/begin CHARACTERISTIC MaxCellVoltage__Ovr_new "" VALUE 0x80000177 RecordLayout_4 0 CompuMethod_2 -1E+17 1E+17 /end CHARACTERISTIC
/begin CHARACTERISTIC MaxCellVoltage__Ovr_ovr "" VALUE 0x8000017B RecordLayout_1 0 CompuMethod_4 0 1 /end CHARACTERISTIC
/begin CHARACTERISTIC MaxCellVoltage_Ovr_new "" VALUE 0x8000017C RecordLayout_4 0 CompuMethod_2 -1E+17 1E+17 /end CHARACTERISTIC
/begin CHARACTERISTIC MaxCellVoltage_Ovr_ovr "" VALUE 0x80000180 RecordLayout_1 0 CompuMethod_4 0 1 /end CHARACTERISTIC
/begin CHARACTERISTIC MaxDisPwr_10s_TableMap "" MAP 0x80000181 RecordLayout_4 0 CompuMethod_2 -1E+17 1E+17
 /begin AXIS_DESCR COM_AXIS CellTemp_PreLookupIn CompuMethod_2 7 -1E+17 1E+17 AXIS_PTS_REF CellTemp_PreLookupIdxArr /end AXIS_DESCR
 /begin AXIS_DESCR COM_AXIS SOC_PreLookupIn CompuMethod_2 11 -1E+17 1E+17 AXIS_PTS_REF SOC_PreLookupIdxArr /end AXIS_DESCR
/end CHARACTERISTIC
/begin CHARACTERISTIC MaxDisPwr_Cont_TableMap "" MAP 0x800002B5 RecordLayout_4 0 CompuMethod_2 -1E+17 1E+17
 /begin AXIS_DESCR COM_AXIS CellTemp_PreLookupIn CompuMethod_2 7 -1E+17 1E+17 AXIS_PTS_REF CellTemp_PreLookupIdxArr /end AXIS_DESCR
 /begin AXIS_DESCR COM_AXIS SOC_PreLookupIn CompuMethod_2 11 -1E+17 1E+17 AXIS_PTS_REF SOC_PreLookupIdxArr /end AXIS_DESCR
/end CHARACTERISTIC
/begin CHARACTERISTIC MaximumDischargePower_10s_Ovr_new "" VALUE 0x800003E9 RecordLayout_4 0 CompuMethod_2 -1E+17 1E+17 /end CHARACTERISTIC
/begin CHARACTERISTIC MaximumDischargePower_10s_Ovr_ovr "" VALUE 0x800003ED RecordLayout_1 0 CompuMethod_4 0 1 /end CHARACTERISTIC
/begin CHARACTERISTIC MaximumDischargePower_Continuos_Ovr_new "" VALUE 0x800003EE RecordLayout_4 0 CompuMethod_2 -1E+17 1E+17 /end CHARACTERISTIC
/begin CHARACTERISTIC MaximumDischargePower_Continuos_Ovr_ovr "" VALUE 0x800003F2 RecordLayout_1 0 CompuMethod_4 0 1 /end CHARACTERISTIC
/begin CHARACTERISTIC MaximumRegenPower_10s_Ovr_new "" VALUE 0x800003F3 RecordLayout_4 0 CompuMethod_2 -1E+17 1E+17 /end CHARACTERISTIC
/begin CHARACTERISTIC MaximumRegenPower_10s_Ovr_ovr "" VALUE 0x800003F7 RecordLayout_1 0 CompuMethod_4 0 1 /end CHARACTERISTIC
/begin CHARACTERISTIC MaximumRegenPower_Continuous_Ovr_new "" VALUE 0x800003F8 RecordLayout_4 0 CompuMethod_2 -1E+17 1E+17 /end CHARACTERISTIC
/begin CHARACTERISTIC MaximumRegenPower_Continuous_Ovr_ovr "" VALUE 0x800003FC RecordLayout_1 0 CompuMethod_4 0 1 /end CHARACTERISTIC
/begin CHARACTERISTIC MaxRegenPwr_10s_TableMap "" MAP 0x800003FD RecordLayout_4 0 CompuMethod_2 -1E+17 1E+17
 /begin AXIS_DESCR COM_AXIS CellTemp_PreLookupIn CompuMethod_2 7 -1E+17 1E+17 AXIS_PTS_REF CellTemp_PreLookupIdxArr /end AXIS_DESCR
 /begin AXIS_DESCR COM_AXIS SOC_PreLookupIn CompuMethod_2 11 -1E+17 1E+17 AXIS_PTS_REF SOC_PreLookupIdxArr /end AXIS_DESCR
/end CHARACTERISTIC
/begin CHARACTERISTIC MaxRegenPwr_Cont_TableMap "" MAP 0x80000531 RecordLayout_4 0 CompuMethod_2 -1E+17 1E+17
 /begin AXIS_DESCR COM_AXIS CellTemp_PreLookupIn CompuMethod_2 7 -1E+17 1E+17 AXIS_PTS_REF CellTemp_PreLookupIdxArr /end AXIS_DESCR
 /begin AXIS_DESCR COM_AXIS SOC_PreLookupIn CompuMethod_2 11 -1E+17 1E+17 AXIS_PTS_REF SOC_PreLookupIdxArr /end AXIS_DESCR
/end CHARACTERISTIC
/begin CHARACTERISTIC MIL_Status_Ovr_new "" VALUE 0x80000665 RecordLayout_4 0 CompuMethod_2 -1E+17 1E+17 /end CHARACTERISTIC
/begin CHARACTERISTIC MIL_Status_Ovr_ovr "" VALUE 0x80000669 RecordLayout_1 0 CompuMethod_4 0 1 /end CHARACTERISTIC
/begin CHARACTERISTIC MILState "" VALUE 0x8000066A RecordLayout_4 0 CompuMethod_2 -1E+17 1E+17 /end CHARACTERISTIC
/begin CHARACTERISTIC MinCellTemp "" VALUE 0x8000066E RecordLayout_4 0 CompuMethod_2 -1E+17 1E+17 /end CHARACTERISTIC
/begin CHARACTERISTIC MinCellTemp_Ovr_new "" VALUE 0x80000672 RecordLayout_4 0 CompuMethod_2 -1E+17 1E+17 /end CHARACTERISTIC
/begin CHARACTERISTIC MinCellTemp_Ovr_ovr "" VALUE 0x80000676 RecordLayout_1 0 CompuMethod_4 0 1 /end CHARACTERISTIC
/begin CHARACTERISTIC MinCellTemperature_Ovr_new "" VALUE 0x80000677 RecordLayout_4 0 CompuMethod_2 -1E+17 1E+17 /end CHARACTERISTIC
/begin CHARACTERISTIC MinCellTemperature_Ovr_ovr "" VALUE 0x8000067B RecordLayout_1 0 CompuMethod_4 0 1 /end CHARACTERISTIC
/begin CHARACTERISTIC MinCellVoltage__Ovr_new "" VALUE 0x8000067C RecordLayout_4 0 CompuMethod_2 -1E+17 1E+17 /end CHARACTERISTIC
/begin CHARACTERISTIC MinCellVoltage__Ovr_ovr "" VALUE 0x80000680 RecordLayout_1 0 CompuMethod_4 0 1 /end CHARACTERISTIC
/begin CHARACTERISTIC MinCellVoltage_Ovr_new "" VALUE 0x80000681 RecordLayout_4 0 CompuMethod_2 -1E+17 1E+17 /end CHARACTERISTIC
/begin CHARACTERISTIC MinCellVoltage_Ovr_ovr "" VALUE 0x80000685 RecordLayout_1 0 CompuMethod_4 0 1 /end CHARACTERISTIC
/begin CHARACTERISTIC MotoHawkBuildGUID "GUID identifying the MotoHawk build session" ASCII 0x40000301 RecordLayout_2 0 CompuMethod_2 0 255 NUMBER 80 MATRIX_DIM 80 1 1 READ_ONLY /end CHARACTERISTIC
/begin CHARACTERISTIC MotoHawkInterpolation2DMap "" MAP 0x80000686 RecordLayout_4 0 CompuMethod_2 -1E+17 1E+17
 /begin AXIS_DESCR COM_AXIS Volt_IR_PreIn CompuMethod_2 8 -1E+17 1E+17 AXIS_PTS_REF Volt_IR_PreIdxArr /end AXIS_DESCR
 /begin AXIS_DESCR COM_AXIS Temp_IR_PreIn CompuMethod_2 8 -1E+17 1E+17 AXIS_PTS_REF Temp_IR_PreIdxArr /end AXIS_DESCR
/end CHARACTERISTIC
/begin CHARACTERISTIC MotoHawkModelGUID "GUID identifying the MotoHawk model" ASCII 0x40000355 RecordLayout_2 0 CompuMethod_2 0 255 NUMBER 80 MATRIX_DIM 80 1 1 READ_ONLY /end CHARACTERISTIC
/begin CHARACTERISTIC MotoHawkModelName "Simulink model name used for the MotoHawk build" ASCII 0x400003A5 RecordLayout_2 0 CompuMethod_2 0 255 NUMBER 80 MATRIX_DIM 80 1 1 READ_ONLY /end CHARACTERISTIC
/begin CHARACTERISTIC MotoHawkTokenGUID "GUID identifying the token inserted during the build.  May be empty if no token was available" ASCII 0x400003F9 RecordLayout_2 0 CompuMethod_2 0 255 NUMBER 80 MATRIX_DIM 80 1 1 READ_ONLY /end CHARACTERISTIC
/begin CHARACTERISTIC MotoHawkVersionTxt "MotoHawk version used to build the application." ASCII 0x40000449 RecordLayout_2 0 CompuMethod_2 0 255 NUMBER 50 MATRIX_DIM 50 1 1 READ_ONLY /end CHARACTERISTIC
/begin CHARACTERISTIC MPRD_KeepAlive "When enabled, keeps the MPRD output on and keeps the processor alive" VALUE 0x80000786 RecordLayout_1 0 CompuMethod_174 0 1 /end CHARACTERISTIC
/begin CHARACTERISTIC MPRD_new "Directly Override Main Power Relay" VALUE 0x80000787 RecordLayout_1 0 CompuMethod_175 0 1 /end CHARACTERISTIC
/begin CHARACTERISTIC MPRD_ovr "" VALUE 0x80000788 RecordLayout_1 0 CompuMethod_4 0 1 /end CHARACTERISTIC
/begin CHARACTERISTIC NonVolatileRestoreOnFirstStartup "Selects whether to restore from factory defaults the first time an application boots" VALUE 0x80000789 RecordLayout_1 0 CompuMethod_176 0 1 /end CHARACTERISTIC
/begin CHARACTERISTIC NonVolatileRestoreOnStartup "Selects whether to restore from factory defaults on next startup" VALUE 0x8000078A RecordLayout_1 0 CompuMethod_176 0 1 /end CHARACTERISTIC
/begin CHARACTERISTIC ONE_SECOND_EVENT_RunCnt "The number of times to execute ONE_SECOND_EVENT before pausing.  -1 means run forever" VALUE 0x8000078B RecordLayout_5 0 CompuMethod_14 -1 2147480000 /end CHARACTERISTIC
/begin CHARACTERISTIC PackIdentifier "" VALUE 0x8000078F RecordLayout_4 0 CompuMethod_2 -1E+17 1E+17 /end CHARACTERISTIC
/begin CHARACTERISTIC PackState__Ovr_new "" VALUE 0x80000793 RecordLayout_4 0 CompuMethod_2 -1E+17 1E+17 /end CHARACTERISTIC
/begin CHARACTERISTIC PackState__Ovr_ovr "" VALUE 0x80000797 RecordLayout_1 0 CompuMethod_4 0 1 /end CHARACTERISTIC
/begin CHARACTERISTIC PackState_Ovr_new "" VALUE 0x80000798 RecordLayout_4 0 CompuMethod_2 -1E+17 1E+17 /end CHARACTERISTIC
/begin CHARACTERISTIC PackState_Ovr_ovr "" VALUE 0x8000079C RecordLayout_1 0 CompuMethod_4 0 1 /end CHARACTERISTIC
/begin CHARACTERISTIC PartNumber "" ASCII 0x4000048F RecordLayout_2 0 CompuMethod_2 0 255 NUMBER 40 MATRIX_DIM 40 1 1 READ_ONLY /end CHARACTERISTIC
/begin CHARACTERISTIC PasswordTxt "Password protection for this calibration" ASCII 0x8000079D RecordLayout_2 0 CompuMethod_2 0 255 NUMBER 33 MATRIX_DIM 33 1 1 /end CHARACTERISTIC
/begin CHARACTERISTIC PPL_RollingCounter "" VALUE 0x800007BE RecordLayout_4 0 CompuMethod_2 -1E+17 1E+17 /end CHARACTERISTIC
/begin CHARACTERISTIC PPL10S_RollingCounter "" VALUE 0x800007C2 RecordLayout_4 0 CompuMethod_2 -1E+17 1E+17 /end CHARACTERISTIC
/begin CHARACTERISTIC PPL10s_RollingCounter_Ovr_new "" VALUE 0x800007C6 RecordLayout_4 0 CompuMethod_2 -1E+17 1E+17 /end CHARACTERISTIC
/begin CHARACTERISTIC PPL10s_RollingCounter_Ovr_ovr "" VALUE 0x800007CA RecordLayout_1 0 CompuMethod_4 0 1 /end CHARACTERISTIC
/begin CHARACTERISTIC PPLCont_RollingCounter_Ovr_new "" VALUE 0x800007CB RecordLayout_4 0 CompuMethod_2 -1E+17 1E+17 /end CHARACTERISTIC
/begin CHARACTERISTIC PPLCont_RollingCounter_Ovr_ovr "" VALUE 0x800007CF RecordLayout_1 0 CompuMethod_4 0 1 /end CHARACTERISTIC
/begin CHARACTERISTIC Precharge_Current_Threshold "" VALUE 0x800007D0 RecordLayout_4 0 CompuMethod_2 -1E+17 1E+17 /end CHARACTERISTIC
/begin CHARACTERISTIC PreCharge_Duty_Cyle_Ovr_new "" VALUE 0x800007D4 RecordLayout_8 0 CompuMethod_14 -32768 32767 /end CHARACTERISTIC
/begin CHARACTERISTIC PreCharge_Duty_Cyle_Ovr_ovr "" VALUE 0x800007D6 RecordLayout_1 0 CompuMethod_4 0 1 /end CHARACTERISTIC
/begin CHARACTERISTIC PreCharge_Enable_Ovr_new "" VALUE 0x800007D7 RecordLayout_1 0 CompuMethod_162 0 1 /end CHARACTERISTIC
/begin CHARACTERISTIC PreCharge_Enable_Ovr_ovr "" VALUE 0x800007D8 RecordLayout_1 0 CompuMethod_4 0 1 /end CHARACTERISTIC
/begin CHARACTERISTIC PreCharge_Freq_Ovr_new "" VALUE 0x800007D9 RecordLayout_3 0 CompuMethod_18 0 4294970000 /end CHARACTERISTIC
/begin CHARACTERISTIC PreCharge_Freq_Ovr_ovr "" VALUE 0x800007DD RecordLayout_1 0 CompuMethod_4 0 1 /end CHARACTERISTIC
/begin CHARACTERISTIC PrechargeState__Ovr_new "" VALUE 0x800007DE RecordLayout_4 0 CompuMethod_2 -1E+17 1E+17 /end CHARACTERISTIC
/begin CHARACTERISTIC PrechargeState__Ovr_ovr "" VALUE 0x800007E2 RecordLayout_1 0 CompuMethod_4 0 1 /end CHARACTERISTIC
/begin CHARACTERISTIC PrechargeState_Ovr_new "" VALUE 0x800007E3 RecordLayout_4 0 CompuMethod_2 -1E+17 1E+17 /end CHARACTERISTIC
/begin CHARACTERISTIC PrechargeState_Ovr_ovr "" VALUE 0x800007E7 RecordLayout_1 0 CompuMethod_4 0 1 /end CHARACTERISTIC
/begin CHARACTERISTIC ProcessorReboot "Reboots the processor when set." VALUE 0x800007E8 RecordLayout_1 0 CompuMethod_179 0 1 /end CHARACTERISTIC
/begin CHARACTERISTIC PS_RollingCounter "" VALUE 0x800007E9 RecordLayout_4 0 CompuMethod_2 -1E+17 1E+17 /end CHARACTERISTIC
/begin CHARACTERISTIC PS_RollingCounter_Ovr_new "" VALUE 0x800007ED RecordLayout_4 0 CompuMethod_2 -1E+17 1E+17 /end CHARACTERISTIC
/begin CHARACTERISTIC PS_RollingCounter_Ovr_ovr "" VALUE 0x800007F1 RecordLayout_1 0 CompuMethod_4 0 1 /end CHARACTERISTIC
/begin CHARACTERISTIC PVC_RollingCounter "" VALUE 0x800007F2 RecordLayout_4 0 CompuMethod_2 -1E+17 1E+17 /end CHARACTERISTIC
/begin CHARACTERISTIC PVC_RollingCounter_Ovr_new "" VALUE 0x800007F6 RecordLayout_4 0 CompuMethod_2 -1E+17 1E+17 /end CHARACTERISTIC
/begin CHARACTERISTIC PVC_RollingCounter_Ovr_ovr "" VALUE 0x800007FA RecordLayout_1 0 CompuMethod_4 0 1 /end CHARACTERISTIC
/begin CHARACTERISTIC Reset_AmpHoursIn "" VALUE 0x800007FB RecordLayout_4 0 CompuMethod_2 -1E+17 1E+17 /end CHARACTERISTIC
/begin CHARACTERISTIC Reset_AmpHoursOut "" VALUE 0x800007FF RecordLayout_4 0 CompuMethod_2 -1E+17 1E+17 /end CHARACTERISTIC
/begin CHARACTERISTIC RestoreNVFactoryDefaults "Restores NonVolatile Memory to Factory Defaults" VALUE 0x80000803 RecordLayout_1 0 CompuMethod_180 0 1 /end CHARACTERISTIC
/begin CHARACTERISTIC SleepInhibited "" VALUE 0x80000804 RecordLayout_4 0 CompuMethod_2 -1E+17 1E+17 /end CHARACTERISTIC
/begin CHARACTERISTIC SleepInhibited_Ovr_new "" VALUE 0x80000808 RecordLayout_4 0 CompuMethod_2 -1E+17 1E+17 /end CHARACTERISTIC
/begin CHARACTERISTIC SleepInhibited_Ovr_ovr "" VALUE 0x8000080C RecordLayout_1 0 CompuMethod_4 0 1 /end CHARACTERISTIC
/begin CHARACTERISTIC SOC_K "" VALUE 0x8000080D RecordLayout_4 0 CompuMethod_6 0 1 /end CHARACTERISTIC
/begin CHARACTERISTIC SOC_Ovr_new "" VALUE 0x80000811 RecordLayout_4 0 CompuMethod_2 -1E+17 1E+17 /end CHARACTERISTIC
/begin CHARACTERISTIC SOC_Ovr_ovr "" VALUE 0x80000815 RecordLayout_1 0 CompuMethod_4 0 1 /end CHARACTERISTIC
/begin CHARACTERISTIC SOCMapTbl "" CURVE 0x80000852 RecordLayout_4 0 CompuMethod_181 0 100
 /begin AXIS_DESCR COM_AXIS SOC_TableIn CompuMethod_2 4 -1E+17 1E+17 AXIS_PTS_REF SOC_TableIdxArr /end AXIS_DESCR
/end CHARACTERISTIC
/begin CHARACTERISTIC STARTUP_EVENT_RunCnt "The number of times to execute STARTUP_EVENT before pausing.  -1 means run forever" VALUE 0x80000862 RecordLayout_5 0 CompuMethod_14 -1 2147480000 /end CHARACTERISTIC
/begin CHARACTERISTIC StateOfCharge_Ovr_new "" VALUE 0x80000866 RecordLayout_4 0 CompuMethod_2 -1E+17 1E+17 /end CHARACTERISTIC
/begin CHARACTERISTIC StateOfCharge_Ovr_ovr "" VALUE 0x8000086A RecordLayout_1 0 CompuMethod_4 0 1 /end CHARACTERISTIC
/begin CHARACTERISTIC StateOfChargeMax "" VALUE 0x8000086B RecordLayout_4 0 CompuMethod_2 -1E+17 1E+17 /end CHARACTERISTIC
/begin CHARACTERISTIC StateOfChargeMax_Ovr_new "" VALUE 0x8000086F RecordLayout_4 0 CompuMethod_2 -1E+17 1E+17 /end CHARACTERISTIC
/begin CHARACTERISTIC StateOfChargeMax_Ovr_ovr "" VALUE 0x80000873 RecordLayout_1 0 CompuMethod_4 0 1 /end CHARACTERISTIC
/begin CHARACTERISTIC StateOfChargeMin "" VALUE 0x80000874 RecordLayout_4 0 CompuMethod_2 -1E+17 1E+17 /end CHARACTERISTIC
/begin CHARACTERISTIC StateOfChargeMin_Ovr_new "" VALUE 0x80000878 RecordLayout_4 0 CompuMethod_2 -1E+17 1E+17 /end CHARACTERISTIC
/begin CHARACTERISTIC StateOfChargeMin_Ovr_ovr "" VALUE 0x8000087C RecordLayout_1 0 CompuMethod_4 0 1 /end CHARACTERISTIC
/begin CHARACTERISTIC StoreNV "Stores RAM-Shadowed memory to serial EEPROM" VALUE 0x8000087D RecordLayout_1 0 CompuMethod_182 0 1 /end CHARACTERISTIC
/begin CHARACTERISTIC TAH_RollingCounter "" VALUE 0x8000087E RecordLayout_4 0 CompuMethod_2 -1E+17 1E+17 /end CHARACTERISTIC
/begin CHARACTERISTIC TAH_RollingCounter_Ovr_new "" VALUE 0x80000882 RecordLayout_4 0 CompuMethod_2 -1E+17 1E+17 /end CHARACTERISTIC
/begin CHARACTERISTIC TAH_RollingCounter_Ovr_ovr "" VALUE 0x80000886 RecordLayout_1 0 CompuMethod_4 0 1 /end CHARACTERISTIC
/begin CHARACTERISTIC TrimpAmpHoursOut_Ovr_new "" VALUE 0x800008A7 RecordLayout_4 0 CompuMethod_2 -1E+17 1E+17 /end CHARACTERISTIC
/begin CHARACTERISTIC TrimpAmpHoursOut_Ovr_ovr "" VALUE 0x800008AB RecordLayout_1 0 CompuMethod_4 0 1 /end CHARACTERISTIC
/begin CHARACTERISTIC TripAmpsHoursIn_Ovr_new "" VALUE 0x800008AC RecordLayout_4 0 CompuMethod_2 -1E+17 1E+17 /end CHARACTERISTIC
/begin CHARACTERISTIC TripAmpsHoursIn_Ovr_ovr "" VALUE 0x800008B0 RecordLayout_1 0 CompuMethod_4 0 1 /end CHARACTERISTIC
/begin CHARACTERISTIC V5V_Ref2 "" VALUE 0x800008B1 RecordLayout_4 0 CompuMethod_2 -1E+17 1E+17 /end CHARACTERISTIC
/begin CHARACTERISTIC V5V_Reference_Ovr_new "" VALUE 0x800008B5 RecordLayout_6 0 CompuMethod_14 0 65535 /end CHARACTERISTIC
/begin CHARACTERISTIC V5V_Reference_Ovr_ovr "" VALUE 0x800008B7 RecordLayout_1 0 CompuMethod_4 0 1 /end CHARACTERISTIC
/begin CHARACTERISTIC Voltage_Ovr_new "" VALUE 0x800008D8 RecordLayout_4 0 CompuMethod_2 -1E+17 1E+17 /end CHARACTERISTIC
/begin CHARACTERISTIC Voltage_Ovr_ovr "" VALUE 0x800008DC RecordLayout_1 0 CompuMethod_4 0 1 /end CHARACTERISTIC
/begin CHARACTERISTIC Wait_time "" VALUE 0x800008DD RecordLayout_5 0 CompuMethod_186 -107374000 107374000 /end CHARACTERISTIC
/begin CHARACTERISTIC WakeSignal "" VALUE 0x800008E1 RecordLayout_4 0 CompuMethod_2 -1E+17 1E+17 /end CHARACTERISTIC
/begin CHARACTERISTIC WakeSignal_Ovr_new "" VALUE 0x800008E5 RecordLayout_4 0 CompuMethod_2 -1E+17 1E+17 /end CHARACTERISTIC
/begin CHARACTERISTIC WakeSignal_Ovr_ovr "" VALUE 0x800008E9 RecordLayout_1 0 CompuMethod_4 0 1 /end CHARACTERISTIC
/*~~~~~~~~~ 6.3.17 AXIS_PTS ~~~~~~~~~*/
/begin AXIS_PTS CellTemp_PreLookupIdxArr "" 0x800000A9 CellTemp_PreLookupIn RecordLayout_7 0 CompuMethod_2 7 -1E+17 1E+17 DEPOSIT ABSOLUTE /end AXIS_PTS
/begin AXIS_PTS SOC_PreLookupIdxArr "" 0x80000816 SOC_PreLookupIn RecordLayout_7 0 CompuMethod_2 11 -1E+17 1E+17 DEPOSIT ABSOLUTE /end AXIS_PTS
/begin AXIS_PTS SOC_TableIdxArr "" 0x80000842 SOC_TableIn RecordLayout_7 0 CompuMethod_2 4 -1E+17 1E+17 DEPOSIT ABSOLUTE /end AXIS_PTS
/begin AXIS_PTS Temp_IR_PreIdxArr "" 0x80000887 Temp_IR_PreIn RecordLayout_7 0 CompuMethod_2 8 -1E+17 1E+17 DEPOSIT ABSOLUTE /end AXIS_PTS
/begin AXIS_PTS Volt_IR_PreIdxArr "" 0x800008B8 Volt_IR_PreIn RecordLayout_7 0 CompuMethod_2 8 -1E+17 1E+17 DEPOSIT ABSOLUTE /end AXIS_PTS
/*~~~~~~~~~ 6.3.106 RECORD_LAYOUTs ~~~~~~~~~*/
/begin RECORD_LAYOUT RecordLayout_1 FNC_VALUES 1 UBYTE ROW_DIR DIRECT /end RECORD_LAYOUT
/begin RECORD_LAYOUT RecordLayout_2 FNC_VALUES 1 UBYTE ROW_DIR DIRECT /end RECORD_LAYOUT
/begin RECORD_LAYOUT RecordLayout_3 FNC_VALUES 1 ULONG ROW_DIR DIRECT /end RECORD_LAYOUT
/begin RECORD_LAYOUT RecordLayout_4 FNC_VALUES 1 FLOAT32_IEEE ROW_DIR DIRECT /end RECORD_LAYOUT
/begin RECORD_LAYOUT RecordLayout_5 FNC_VALUES 1 SLONG ROW_DIR DIRECT /end RECORD_LAYOUT
/begin RECORD_LAYOUT RecordLayout_6 FNC_VALUES 1 UWORD ROW_DIR DIRECT /end RECORD_LAYOUT
/begin RECORD_LAYOUT RecordLayout_7 AXIS_PTS_X 1 FLOAT32_IEEE /* IndexIncr */ INDEX_INCR /* Addressing */ DIRECT /end RECORD_LAYOUT
/begin RECORD_LAYOUT RecordLayout_8 FNC_VALUES 1 SWORD ROW_DIR DIRECT /end RECORD_LAYOUT
/*~~~~~~~~~ 6.3.31 COMPU_METHODs ~~~~~~~~~*/
/begin COMPU_METHOD CompuMethod_1 "" RAT_FUNC "%3.0" "" COEFFS 0 1 0 0 0 1 /end COMPU_METHOD
/begin COMPU_METHOD CompuMethod_2 "" RAT_FUNC "%6.2" "" COEFFS 0 1 0 0 0 1 /end COMPU_METHOD
/begin COMPU_METHOD CompuMethod_3 "" RAT_FUNC "%6.2" "ID" COEFFS 0 1 0 0 0 1 /end COMPU_METHOD
/begin COMPU_METHOD CompuMethod_4 "" TAB_VERB "%1.0" "" COMPU_TAB_REF CompuVtab_1 /end COMPU_METHOD
/begin COMPU_METHOD CompuMethod_5 "" TAB_VERB "%6.2" "" COMPU_TAB_REF CompuVtab_2 /end COMPU_METHOD
/begin COMPU_METHOD CompuMethod_6 "" RAT_FUNC "%5.4" "" COEFFS 0 1 0 0 0 1 /end COMPU_METHOD
/begin COMPU_METHOD CompuMethod_7 "" RAT_FUNC "%6.5" "A" COEFFS 0 1 0 0 0 1 /end COMPU_METHOD
/begin COMPU_METHOD CompuMethod_8 "" TAB_VERB "%1.0" "" COMPU_TAB_REF CompuVtab_3 /end COMPU_METHOD
/begin COMPU_METHOD CompuMethod_9 "" TAB_VERB "%3.0" "" COMPU_TAB_REF CompuVtab_4 /end COMPU_METHOD
/begin COMPU_METHOD CompuMethod_10 "" TAB_VERB "%3.0" "" COMPU_TAB_REF CompuVtab_3 /end COMPU_METHOD
/begin COMPU_METHOD CompuMethod_11 "" TAB_VERB "%1.0" "" COMPU_TAB_REF CompuVtab_5 /end COMPU_METHOD
/begin COMPU_METHOD CompuMethod_12 "" TAB_VERB "%1.0" "" COMPU_TAB_REF CompuVtab_6 /end COMPU_METHOD
/begin COMPU_METHOD CompuMethod_13 "" TAB_VERB "%1.0" "" COMPU_TAB_REF CompuVtab_7 /end COMPU_METHOD
/begin COMPU_METHOD CompuMethod_14 "" RAT_FUNC "%5.0" "" COEFFS 0 1 0 0 0 1 /end COMPU_METHOD
/begin COMPU_METHOD CompuMethod_15 "" TAB_VERB "%3.0" "" COMPU_TAB_REF CompuVtab_8 /end COMPU_METHOD
/begin COMPU_METHOD CompuMethod_16 "" RAT_FUNC "%4.0" "" COEFFS 0 1 0 0 0 1 /end COMPU_METHOD
/begin COMPU_METHOD CompuMethod_17 "" TAB_VERB "%3.0" "" COMPU_TAB_REF CompuVtab_9 /end COMPU_METHOD
/begin COMPU_METHOD CompuMethod_18 "" RAT_FUNC "%8.0" "" COEFFS 0 1 0 0 0 1 /end COMPU_METHOD
/begin COMPU_METHOD CompuMethod_19 "" TAB_VERB "%1.0" "" COMPU_TAB_REF CompuVtab_10 /end COMPU_METHOD
/begin COMPU_METHOD CompuMethod_20 "" TAB_VERB "%1.0" "" COMPU_TAB_REF CompuVtab_11 /end COMPU_METHOD
/begin COMPU_METHOD CompuMethod_21 "" TAB_VERB "%1.0" "" COMPU_TAB_REF CompuVtab_12 /end COMPU_METHOD
/begin COMPU_METHOD CompuMethod_22 "" TAB_VERB "%1.0" "" COMPU_TAB_REF CompuVtab_13 /end COMPU_METHOD
/begin COMPU_METHOD CompuMethod_23 "" RAT_FUNC "%6.2" "idx.frac" COEFFS 0 1 0 0 0 0.00195313 /end COMPU_METHOD
/begin COMPU_METHOD CompuMethod_24 "" TAB_VERB "%1.0" "" COMPU_TAB_REF CompuVtab_14 /end COMPU_METHOD
/begin COMPU_METHOD CompuMethod_25 "" TAB_VERB "%1.0" "" COMPU_TAB_REF CompuVtab_15 /end COMPU_METHOD
/begin COMPU_METHOD CompuMethod_26 "" TAB_VERB "%1.0" "" COMPU_TAB_REF CompuVtab_16 /end COMPU_METHOD
/begin COMPU_METHOD CompuMethod_27 "" TAB_VERB "%1.0" "" COMPU_TAB_REF CompuVtab_17 /end COMPU_METHOD
/begin COMPU_METHOD CompuMethod_28 "" TAB_VERB "%1.0" "" COMPU_TAB_REF CompuVtab_18 /end COMPU_METHOD
/begin COMPU_METHOD CompuMethod_29 "" TAB_VERB "%1.0" "" COMPU_TAB_REF CompuVtab_19 /end COMPU_METHOD
/begin COMPU_METHOD CompuMethod_30 "" TAB_VERB "%1.0" "" COMPU_TAB_REF CompuVtab_20 /end COMPU_METHOD
/begin COMPU_METHOD CompuMethod_31 "" TAB_VERB "%1.0" "" COMPU_TAB_REF CompuVtab_21 /end COMPU_METHOD
/begin COMPU_METHOD CompuMethod_32 "" TAB_VERB "%1.0" "" COMPU_TAB_REF CompuVtab_22 /end COMPU_METHOD
/begin COMPU_METHOD CompuMethod_33 "" TAB_VERB "%1.0" "" COMPU_TAB_REF CompuVtab_23 /end COMPU_METHOD
/begin COMPU_METHOD CompuMethod_34 "" TAB_VERB "%1.0" "" COMPU_TAB_REF CompuVtab_24 /end COMPU_METHOD
/begin COMPU_METHOD CompuMethod_35 "" TAB_VERB "%1.0" "" COMPU_TAB_REF CompuVtab_25 /end COMPU_METHOD
/begin COMPU_METHOD CompuMethod_36 "" TAB_VERB "%1.0" "" COMPU_TAB_REF CompuVtab_26 /end COMPU_METHOD
/begin COMPU_METHOD CompuMethod_37 "" TAB_VERB "%1.0" "" COMPU_TAB_REF CompuVtab_27 /end COMPU_METHOD
/begin COMPU_METHOD CompuMethod_38 "" TAB_VERB "%1.0" "" COMPU_TAB_REF CompuVtab_28 /end COMPU_METHOD
/begin COMPU_METHOD CompuMethod_39 "" TAB_VERB "%1.0" "" COMPU_TAB_REF CompuVtab_29 /end COMPU_METHOD
/begin COMPU_METHOD CompuMethod_40 "" TAB_VERB "%1.0" "" COMPU_TAB_REF CompuVtab_30 /end COMPU_METHOD
/begin COMPU_METHOD CompuMethod_41 "" TAB_VERB "%1.0" "" COMPU_TAB_REF CompuVtab_31 /end COMPU_METHOD
/begin COMPU_METHOD CompuMethod_42 "" TAB_VERB "%1.0" "" COMPU_TAB_REF CompuVtab_32 /end COMPU_METHOD
/begin COMPU_METHOD CompuMethod_43 "" TAB_VERB "%1.0" "" COMPU_TAB_REF CompuVtab_33 /end COMPU_METHOD
/begin COMPU_METHOD CompuMethod_44 "" TAB_VERB "%1.0" "" COMPU_TAB_REF CompuVtab_34 /end COMPU_METHOD
/begin COMPU_METHOD CompuMethod_45 "" TAB_VERB "%1.0" "" COMPU_TAB_REF CompuVtab_35 /end COMPU_METHOD
/begin COMPU_METHOD CompuMethod_46 "" TAB_VERB "%1.0" "" COMPU_TAB_REF CompuVtab_36 /end COMPU_METHOD
/begin COMPU_METHOD CompuMethod_47 "" TAB_VERB "%1.0" "" COMPU_TAB_REF CompuVtab_37 /end COMPU_METHOD
/begin COMPU_METHOD CompuMethod_48 "" TAB_VERB "%1.0" "" COMPU_TAB_REF CompuVtab_38 /end COMPU_METHOD
/begin COMPU_METHOD CompuMethod_49 "" TAB_VERB "%1.0" "" COMPU_TAB_REF CompuVtab_39 /end COMPU_METHOD
/begin COMPU_METHOD CompuMethod_50 "" TAB_VERB "%1.0" "" COMPU_TAB_REF CompuVtab_40 /end COMPU_METHOD
/begin COMPU_METHOD CompuMethod_51 "" TAB_VERB "%1.0" "" COMPU_TAB_REF CompuVtab_41 /end COMPU_METHOD
/begin COMPU_METHOD CompuMethod_52 "" TAB_VERB "%1.0" "" COMPU_TAB_REF CompuVtab_42 /end COMPU_METHOD
/begin COMPU_METHOD CompuMethod_53 "" TAB_VERB "%1.0" "" COMPU_TAB_REF CompuVtab_43 /end COMPU_METHOD
/begin COMPU_METHOD CompuMethod_54 "" TAB_VERB "%1.0" "" COMPU_TAB_REF CompuVtab_44 /end COMPU_METHOD
/begin COMPU_METHOD CompuMethod_55 "" TAB_VERB "%1.0" "" COMPU_TAB_REF CompuVtab_45 /end COMPU_METHOD
/begin COMPU_METHOD CompuMethod_56 "" TAB_VERB "%1.0" "" COMPU_TAB_REF CompuVtab_46 /end COMPU_METHOD
/begin COMPU_METHOD CompuMethod_57 "" TAB_VERB "%1.0" "" COMPU_TAB_REF CompuVtab_47 /end COMPU_METHOD
/begin COMPU_METHOD CompuMethod_58 "" TAB_VERB "%1.0" "" COMPU_TAB_REF CompuVtab_48 /end COMPU_METHOD
/begin COMPU_METHOD CompuMethod_59 "" TAB_VERB "%1.0" "" COMPU_TAB_REF CompuVtab_49 /end COMPU_METHOD
/begin COMPU_METHOD CompuMethod_60 "" TAB_VERB "%1.0" "" COMPU_TAB_REF CompuVtab_50 /end COMPU_METHOD
/begin COMPU_METHOD CompuMethod_61 "" TAB_VERB "%1.0" "" COMPU_TAB_REF CompuVtab_51 /end COMPU_METHOD
/begin COMPU_METHOD CompuMethod_62 "" TAB_VERB "%1.0" "" COMPU_TAB_REF CompuVtab_52 /end COMPU_METHOD
/begin COMPU_METHOD CompuMethod_63 "" TAB_VERB "%1.0" "" COMPU_TAB_REF CompuVtab_53 /end COMPU_METHOD
/begin COMPU_METHOD CompuMethod_64 "" TAB_VERB "%1.0" "" COMPU_TAB_REF CompuVtab_54 /end COMPU_METHOD
/begin COMPU_METHOD CompuMethod_65 "" TAB_VERB "%1.0" "" COMPU_TAB_REF CompuVtab_55 /end COMPU_METHOD
/begin COMPU_METHOD CompuMethod_66 "" TAB_VERB "%1.0" "" COMPU_TAB_REF CompuVtab_56 /end COMPU_METHOD
/begin COMPU_METHOD CompuMethod_67 "" TAB_VERB "%1.0" "" COMPU_TAB_REF CompuVtab_57 /end COMPU_METHOD
/begin COMPU_METHOD CompuMethod_68 "" TAB_VERB "%1.0" "" COMPU_TAB_REF CompuVtab_58 /end COMPU_METHOD
/begin COMPU_METHOD CompuMethod_69 "" TAB_VERB "%1.0" "" COMPU_TAB_REF CompuVtab_59 /end COMPU_METHOD
/begin COMPU_METHOD CompuMethod_70 "" TAB_VERB "%1.0" "" COMPU_TAB_REF CompuVtab_60 /end COMPU_METHOD
/begin COMPU_METHOD CompuMethod_71 "" TAB_VERB "%1.0" "" COMPU_TAB_REF CompuVtab_61 /end COMPU_METHOD
/begin COMPU_METHOD CompuMethod_72 "" TAB_VERB "%1.0" "" COMPU_TAB_REF CompuVtab_62 /end COMPU_METHOD
/begin COMPU_METHOD CompuMethod_73 "" TAB_VERB "%1.0" "" COMPU_TAB_REF CompuVtab_63 /end COMPU_METHOD
/begin COMPU_METHOD CompuMethod_74 "" TAB_VERB "%1.0" "" COMPU_TAB_REF CompuVtab_64 /end COMPU_METHOD
/begin COMPU_METHOD CompuMethod_75 "" TAB_VERB "%1.0" "" COMPU_TAB_REF CompuVtab_65 /end COMPU_METHOD
/begin COMPU_METHOD CompuMethod_76 "" TAB_VERB "%1.0" "" COMPU_TAB_REF CompuVtab_66 /end COMPU_METHOD
/begin COMPU_METHOD CompuMethod_77 "" TAB_VERB "%1.0" "" COMPU_TAB_REF CompuVtab_67 /end COMPU_METHOD
/begin COMPU_METHOD CompuMethod_78 "" TAB_VERB "%1.0" "" COMPU_TAB_REF CompuVtab_68 /end COMPU_METHOD
/begin COMPU_METHOD CompuMethod_79 "" TAB_VERB "%1.0" "" COMPU_TAB_REF CompuVtab_69 /end COMPU_METHOD
/begin COMPU_METHOD CompuMethod_80 "" TAB_VERB "%1.0" "" COMPU_TAB_REF CompuVtab_70 /end COMPU_METHOD
/begin COMPU_METHOD CompuMethod_81 "" TAB_VERB "%1.0" "" COMPU_TAB_REF CompuVtab_71 /end COMPU_METHOD
/begin COMPU_METHOD CompuMethod_82 "" TAB_VERB "%1.0" "" COMPU_TAB_REF CompuVtab_72 /end COMPU_METHOD
/begin COMPU_METHOD CompuMethod_83 "" TAB_VERB "%1.0" "" COMPU_TAB_REF CompuVtab_73 /end COMPU_METHOD
/begin COMPU_METHOD CompuMethod_84 "" TAB_VERB "%1.0" "" COMPU_TAB_REF CompuVtab_74 /end COMPU_METHOD
/begin COMPU_METHOD CompuMethod_85 "" TAB_VERB "%1.0" "" COMPU_TAB_REF CompuVtab_75 /end COMPU_METHOD
/begin COMPU_METHOD CompuMethod_86 "" TAB_VERB "%1.0" "" COMPU_TAB_REF CompuVtab_76 /end COMPU_METHOD
/begin COMPU_METHOD CompuMethod_87 "" TAB_VERB "%1.0" "" COMPU_TAB_REF CompuVtab_77 /end COMPU_METHOD
/begin COMPU_METHOD CompuMethod_88 "" TAB_VERB "%1.0" "" COMPU_TAB_REF CompuVtab_78 /end COMPU_METHOD
/begin COMPU_METHOD CompuMethod_89 "" TAB_VERB "%1.0" "" COMPU_TAB_REF CompuVtab_79 /end COMPU_METHOD
/begin COMPU_METHOD CompuMethod_90 "" TAB_VERB "%1.0" "" COMPU_TAB_REF CompuVtab_80 /end COMPU_METHOD
/begin COMPU_METHOD CompuMethod_91 "" TAB_VERB "%1.0" "" COMPU_TAB_REF CompuVtab_81 /end COMPU_METHOD
/begin COMPU_METHOD CompuMethod_92 "" TAB_VERB "%1.0" "" COMPU_TAB_REF CompuVtab_82 /end COMPU_METHOD
/begin COMPU_METHOD CompuMethod_93 "" TAB_VERB "%1.0" "" COMPU_TAB_REF CompuVtab_83 /end COMPU_METHOD
/begin COMPU_METHOD CompuMethod_94 "" TAB_VERB "%1.0" "" COMPU_TAB_REF CompuVtab_84 /end COMPU_METHOD
/begin COMPU_METHOD CompuMethod_95 "" TAB_VERB "%1.0" "" COMPU_TAB_REF CompuVtab_85 /end COMPU_METHOD
/begin COMPU_METHOD CompuMethod_96 "" TAB_VERB "%1.0" "" COMPU_TAB_REF CompuVtab_86 /end COMPU_METHOD
/begin COMPU_METHOD CompuMethod_97 "" TAB_VERB "%1.0" "" COMPU_TAB_REF CompuVtab_87 /end COMPU_METHOD
/begin COMPU_METHOD CompuMethod_98 "" TAB_VERB "%1.0" "" COMPU_TAB_REF CompuVtab_88 /end COMPU_METHOD
/begin COMPU_METHOD CompuMethod_99 "" TAB_VERB "%1.0" "" COMPU_TAB_REF CompuVtab_89 /end COMPU_METHOD
/begin COMPU_METHOD CompuMethod_100 "" TAB_VERB "%1.0" "" COMPU_TAB_REF CompuVtab_90 /end COMPU_METHOD
/begin COMPU_METHOD CompuMethod_101 "" TAB_VERB "%1.0" "" COMPU_TAB_REF CompuVtab_91 /end COMPU_METHOD
/begin COMPU_METHOD CompuMethod_102 "" TAB_VERB "%1.0" "" COMPU_TAB_REF CompuVtab_92 /end COMPU_METHOD
/begin COMPU_METHOD CompuMethod_103 "" TAB_VERB "%1.0" "" COMPU_TAB_REF CompuVtab_93 /end COMPU_METHOD
/begin COMPU_METHOD CompuMethod_104 "" TAB_VERB "%1.0" "" COMPU_TAB_REF CompuVtab_94 /end COMPU_METHOD
/begin COMPU_METHOD CompuMethod_105 "" TAB_VERB "%1.0" "" COMPU_TAB_REF CompuVtab_95 /end COMPU_METHOD
/begin COMPU_METHOD CompuMethod_106 "" TAB_VERB "%1.0" "" COMPU_TAB_REF CompuVtab_96 /end COMPU_METHOD
/begin COMPU_METHOD CompuMethod_107 "" TAB_VERB "%1.0" "" COMPU_TAB_REF CompuVtab_97 /end COMPU_METHOD
/begin COMPU_METHOD CompuMethod_108 "" TAB_VERB "%1.0" "" COMPU_TAB_REF CompuVtab_98 /end COMPU_METHOD
/begin COMPU_METHOD CompuMethod_109 "" TAB_VERB "%1.0" "" COMPU_TAB_REF CompuVtab_99 /end COMPU_METHOD
/begin COMPU_METHOD CompuMethod_110 "" TAB_VERB "%1.0" "" COMPU_TAB_REF CompuVtab_100 /end COMPU_METHOD
/begin COMPU_METHOD CompuMethod_111 "" TAB_VERB "%1.0" "" COMPU_TAB_REF CompuVtab_101 /end COMPU_METHOD
/begin COMPU_METHOD CompuMethod_112 "" TAB_VERB "%1.0" "" COMPU_TAB_REF CompuVtab_102 /end COMPU_METHOD
/begin COMPU_METHOD CompuMethod_113 "" TAB_VERB "%1.0" "" COMPU_TAB_REF CompuVtab_103 /end COMPU_METHOD
/begin COMPU_METHOD CompuMethod_114 "" TAB_VERB "%1.0" "" COMPU_TAB_REF CompuVtab_104 /end COMPU_METHOD
/begin COMPU_METHOD CompuMethod_115 "" TAB_VERB "%1.0" "" COMPU_TAB_REF CompuVtab_105 /end COMPU_METHOD
/begin COMPU_METHOD CompuMethod_116 "" TAB_VERB "%1.0" "" COMPU_TAB_REF CompuVtab_106 /end COMPU_METHOD
/begin COMPU_METHOD CompuMethod_117 "" TAB_VERB "%1.0" "" COMPU_TAB_REF CompuVtab_107 /end COMPU_METHOD
/begin COMPU_METHOD CompuMethod_118 "" TAB_VERB "%1.0" "" COMPU_TAB_REF CompuVtab_108 /end COMPU_METHOD
/begin COMPU_METHOD CompuMethod_119 "" TAB_VERB "%1.0" "" COMPU_TAB_REF CompuVtab_109 /end COMPU_METHOD
/begin COMPU_METHOD CompuMethod_120 "" TAB_VERB "%1.0" "" COMPU_TAB_REF CompuVtab_110 /end COMPU_METHOD
/begin COMPU_METHOD CompuMethod_121 "" TAB_VERB "%1.0" "" COMPU_TAB_REF CompuVtab_111 /end COMPU_METHOD
/begin COMPU_METHOD CompuMethod_122 "" TAB_VERB "%1.0" "" COMPU_TAB_REF CompuVtab_112 /end COMPU_METHOD
/begin COMPU_METHOD CompuMethod_123 "" TAB_VERB "%1.0" "" COMPU_TAB_REF CompuVtab_113 /end COMPU_METHOD
/begin COMPU_METHOD CompuMethod_124 "" TAB_VERB "%1.0" "" COMPU_TAB_REF CompuVtab_114 /end COMPU_METHOD
/begin COMPU_METHOD CompuMethod_125 "" TAB_VERB "%1.0" "" COMPU_TAB_REF CompuVtab_115 /end COMPU_METHOD
/begin COMPU_METHOD CompuMethod_126 "" TAB_VERB "%1.0" "" COMPU_TAB_REF CompuVtab_116 /end COMPU_METHOD
/begin COMPU_METHOD CompuMethod_127 "" TAB_VERB "%1.0" "" COMPU_TAB_REF CompuVtab_117 /end COMPU_METHOD
/begin COMPU_METHOD CompuMethod_128 "" TAB_VERB "%1.0" "" COMPU_TAB_REF CompuVtab_118 /end COMPU_METHOD
/begin COMPU_METHOD CompuMethod_129 "" TAB_VERB "%1.0" "" COMPU_TAB_REF CompuVtab_119 /end COMPU_METHOD
/begin COMPU_METHOD CompuMethod_130 "" TAB_VERB "%1.0" "" COMPU_TAB_REF CompuVtab_120 /end COMPU_METHOD
/begin COMPU_METHOD CompuMethod_131 "" TAB_VERB "%1.0" "" COMPU_TAB_REF CompuVtab_121 /end COMPU_METHOD
/begin COMPU_METHOD CompuMethod_132 "" TAB_VERB "%1.0" "" COMPU_TAB_REF CompuVtab_122 /end COMPU_METHOD
/begin COMPU_METHOD CompuMethod_133 "" TAB_VERB "%1.0" "" COMPU_TAB_REF CompuVtab_123 /end COMPU_METHOD
/begin COMPU_METHOD CompuMethod_134 "" TAB_VERB "%1.0" "" COMPU_TAB_REF CompuVtab_124 /end COMPU_METHOD
/begin COMPU_METHOD CompuMethod_135 "" TAB_VERB "%1.0" "" COMPU_TAB_REF CompuVtab_125 /end COMPU_METHOD
/begin COMPU_METHOD CompuMethod_136 "" TAB_VERB "%1.0" "" COMPU_TAB_REF CompuVtab_126 /end COMPU_METHOD
/begin COMPU_METHOD CompuMethod_137 "" TAB_VERB "%1.0" "" COMPU_TAB_REF CompuVtab_127 /end COMPU_METHOD
/begin COMPU_METHOD CompuMethod_138 "" TAB_VERB "%1.0" "" COMPU_TAB_REF CompuVtab_128 /end COMPU_METHOD
/begin COMPU_METHOD CompuMethod_139 "" TAB_VERB "%1.0" "" COMPU_TAB_REF CompuVtab_129 /end COMPU_METHOD
/begin COMPU_METHOD CompuMethod_140 "" TAB_VERB "%1.0" "" COMPU_TAB_REF CompuVtab_130 /end COMPU_METHOD
/begin COMPU_METHOD CompuMethod_141 "" TAB_VERB "%1.0" "" COMPU_TAB_REF CompuVtab_131 /end COMPU_METHOD
/begin COMPU_METHOD CompuMethod_142 "" TAB_VERB "%1.0" "" COMPU_TAB_REF CompuVtab_132 /end COMPU_METHOD
/begin COMPU_METHOD CompuMethod_143 "" TAB_VERB "%1.0" "" COMPU_TAB_REF CompuVtab_133 /end COMPU_METHOD
/begin COMPU_METHOD CompuMethod_144 "" TAB_VERB "%1.0" "" COMPU_TAB_REF CompuVtab_134 /end COMPU_METHOD
/begin COMPU_METHOD CompuMethod_145 "" TAB_VERB "%1.0" "" COMPU_TAB_REF CompuVtab_135 /end COMPU_METHOD
/begin COMPU_METHOD CompuMethod_146 "" TAB_VERB "%1.0" "" COMPU_TAB_REF CompuVtab_136 /end COMPU_METHOD
/begin COMPU_METHOD CompuMethod_147 "" TAB_VERB "%1.0" "" COMPU_TAB_REF CompuVtab_137 /end COMPU_METHOD
/begin COMPU_METHOD CompuMethod_148 "" TAB_VERB "%1.0" "" COMPU_TAB_REF CompuVtab_138 /end COMPU_METHOD
/begin COMPU_METHOD CompuMethod_149 "" TAB_VERB "%1.0" "" COMPU_TAB_REF CompuVtab_139 /end COMPU_METHOD
/begin COMPU_METHOD CompuMethod_150 "" TAB_VERB "%1.0" "" COMPU_TAB_REF CompuVtab_140 /end COMPU_METHOD
/begin COMPU_METHOD CompuMethod_151 "" TAB_VERB "%1.0" "" COMPU_TAB_REF CompuVtab_141 /end COMPU_METHOD
/begin COMPU_METHOD CompuMethod_152 "" TAB_VERB "%1.0" "" COMPU_TAB_REF CompuVtab_142 /end COMPU_METHOD
/begin COMPU_METHOD CompuMethod_153 "" TAB_VERB "%1.0" "" COMPU_TAB_REF CompuVtab_143 /end COMPU_METHOD
/begin COMPU_METHOD CompuMethod_154 "" TAB_VERB "%1.0" "" COMPU_TAB_REF CompuVtab_144 /end COMPU_METHOD
/begin COMPU_METHOD CompuMethod_155 "" TAB_VERB "%1.0" "" COMPU_TAB_REF CompuVtab_145 /end COMPU_METHOD
/begin COMPU_METHOD CompuMethod_156 "" TAB_VERB "%1.0" "" COMPU_TAB_REF CompuVtab_146 /end COMPU_METHOD
/begin COMPU_METHOD CompuMethod_157 "" TAB_VERB "%1.0" "" COMPU_TAB_REF CompuVtab_147 /end COMPU_METHOD
/begin COMPU_METHOD CompuMethod_158 "" TAB_VERB "%1.0" "" COMPU_TAB_REF CompuVtab_148 /end COMPU_METHOD
/begin COMPU_METHOD CompuMethod_159 "" TAB_VERB "%1.0" "" COMPU_TAB_REF CompuVtab_149 /end COMPU_METHOD
/begin COMPU_METHOD CompuMethod_160 "" TAB_VERB "%1.0" "" COMPU_TAB_REF CompuVtab_150 /end COMPU_METHOD
/begin COMPU_METHOD CompuMethod_161 "" TAB_VERB "%1.0" "" COMPU_TAB_REF CompuVtab_151 /end COMPU_METHOD
/begin COMPU_METHOD CompuMethod_162 "" RAT_FUNC "%1.0" "" COEFFS 0 1 0 0 0 1 /end COMPU_METHOD
/begin COMPU_METHOD CompuMethod_163 "" RAT_FUNC "%6.2" "%" COEFFS 0 1 0 0 0 0.0015259 /end COMPU_METHOD
/begin COMPU_METHOD CompuMethod_164 "" RAT_FUNC "%3.0" "" COEFFS 0 1 0 0 0 0.0015259 /end COMPU_METHOD
/begin COMPU_METHOD CompuMethod_165 "" RAT_FUNC "%6.2" "" COEFFS 0 1 0 0 0 0.05 /end COMPU_METHOD
/begin COMPU_METHOD CompuMethod_166 "" RAT_FUNC "%5.0" "ADC_counts" COEFFS 0 1 0 0 0 1 /end COMPU_METHOD
/begin COMPU_METHOD CompuMethod_167 "" TAB_VERB "%3.0" "" COMPU_TAB_REF CompuVtab_2 /end COMPU_METHOD
/begin COMPU_METHOD CompuMethod_168 "" RAT_FUNC "%6.5" "V" COEFFS 0 1 0 0 0 1 /end COMPU_METHOD
/begin COMPU_METHOD CompuMethod_169 "" RAT_FUNC "%5.0" "bytes" COEFFS 0 1 0 0 0 1 /end COMPU_METHOD
/begin COMPU_METHOD CompuMethod_170 "" TAB_VERB "%6.2" "" COMPU_TAB_REF CompuVtab_152 /end COMPU_METHOD
/begin COMPU_METHOD CompuMethod_171 "" TAB_VERB "%3.0" "" COMPU_TAB_REF CompuVtab_153 /end COMPU_METHOD
/begin COMPU_METHOD CompuMethod_172 "" RAT_FUNC "%8.0" "seconds" COEFFS 0 1 0 0 0 1 /end COMPU_METHOD
/begin COMPU_METHOD CompuMethod_173 "" TAB_VERB "%1.0" "" COMPU_TAB_REF CompuVtab_4 /end COMPU_METHOD
/begin COMPU_METHOD CompuMethod_174 "" TAB_VERB "%1.0" "" COMPU_TAB_REF CompuVtab_154 /end COMPU_METHOD
/begin COMPU_METHOD CompuMethod_175 "" TAB_VERB "%1.0" "boolean" COMPU_TAB_REF CompuVtab_155 /end COMPU_METHOD
/begin COMPU_METHOD CompuMethod_176 "" TAB_VERB "%1.0" "" COMPU_TAB_REF CompuVtab_156 /end COMPU_METHOD
/begin COMPU_METHOD CompuMethod_177 "" TAB_VERB "%1.0" "" COMPU_TAB_REF CompuVtab_157 /end COMPU_METHOD
/begin COMPU_METHOD CompuMethod_178 "" TAB_VERB "%6.2" "" COMPU_TAB_REF CompuVtab_158 /end COMPU_METHOD
/begin COMPU_METHOD CompuMethod_179 "" TAB_VERB "%1.0" "" COMPU_TAB_REF CompuVtab_159 /end COMPU_METHOD
/begin COMPU_METHOD CompuMethod_180 "" TAB_VERB "%1.0" "" COMPU_TAB_REF CompuVtab_160 /end COMPU_METHOD
/begin COMPU_METHOD CompuMethod_181 "" RAT_FUNC "%3.2" "" COEFFS 0 1 0 0 0 1 /end COMPU_METHOD
/begin COMPU_METHOD CompuMethod_182 "" TAB_VERB "%1.0" "" COMPU_TAB_REF CompuVtab_161 /end COMPU_METHOD
/begin COMPU_METHOD CompuMethod_183 "" RAT_FUNC "%2.0" "ISRs" COEFFS 0 1 0 0 0 1 /end COMPU_METHOD
/begin COMPU_METHOD CompuMethod_184 "" RAT_FUNC "%5.0" "MHz" COEFFS 0 1 0 0 0 1E-06 /end COMPU_METHOD
/begin COMPU_METHOD CompuMethod_185 "" TAB_VERB "%1.0" "" COMPU_TAB_REF CompuVtab_162 /end COMPU_METHOD
/begin COMPU_METHOD CompuMethod_186 "" RAT_FUNC "%8.0" "" COEFFS 0 1 0 0 0 0.05 /end COMPU_METHOD
/*~~~~~~~~~ 6.3.34 COMPU_VTABs ~~~~~~~~~*/
/begin COMPU_VTAB CompuVtab_1 "" TAB_VERB 2 0 "Pass-Through" 1 "Override" /end COMPU_VTAB
/begin COMPU_VTAB CompuVtab_2 "" TAB_VERB 90 0 "Normal Operation" 1 "Bad Resource ID" 2 "Hardware Not Supported" 3 "Behaviour Not Supported" 4 "Bad Attribute Data" 5 "Fail On Create" 6 "Fail On Set Attributes" 7 "Resource Not Created" 8 "Missing Attribute" 9 "Behaviour Method Not Supported" 10 "A Service Failed" 11 "Failed to destroy a resource" 12 "Resource Was Created" 13 "Resource Conflict" 14 "Invalid Encoder Type" 15 "2-Strike Not Supported" 16 "720degCA Pattern Not Supported" 17 "CAM Pattern Not Supported" 18 "Unknown CAM Pattern Supplied" 19 "Engine Speed Present" 20 "Hardware Interface Not Supported" 21 "Service Already Started" 22 "Register Write Failed to verify" 23 "Register access was denied" 24 "Out of free store memory" 25 "Software Q Overrun" 26 "Hardware Q Overrun" 27 "Feature unsupported in archive" 28 "Insufficient FW resource" 29 "OS Resource conflict" 30 "Driver Mode conflict" 31 "RTC time is illegal" 32 "FFS unmounted" 33 "Access from an ISR" 34 "FFS internal" 35 "Operation timed out" 36 "Task Kernel API Usage" 37 "Operation aborted" 38 "File not Found" 39 "Invalid characters in filename" 40 "Duplicate filename" 41 "Filename is too long" 42 "Dir not empty on remove" 43 "Dir not found" 44 "Dir name invalid" 45 "Dir exists" 46 "Dir too deep" 47 "Illegal Handle" 48 "End of File" 49 "Media Full" 50 "Media Write" 51 "Media Read" 52 "Media Write Protected" 53 "File Read Only" 54 "FS Media Changed" 55 "Internal USB" 56 "Voltage too high for USB IC" 57 "Encoder not created" 64 "TPU Chan Conflict" 65 "TPU Func Unavailable" 66 "TPU Config" 67 "TPU Primative Usage" 68 "TPU Primitive Count" 69 "TPU Restricted TPU channel" 70 "TPU Not Created" 71 "TPU Self Modify constant write err" 72 "TPU Error 0x48" 73 "TPU Error 0x49" 74 "TPU Error 0x4A" 75 "TPU Error 0x4B" 76 "TPU Error 0x4C" 77 "TPU Error 0x4D" 78 "TPU Error 0x4E" 79 "TPU Error 0x4F" 80 "TPU Error 0x50" 81 "TPU Error 0x51" 82 "TPU Error 0x52" 83 "TPU Error 0x53" 84 "TPU Error 0x54" 85 "TPU Error 0x55" 86 "TPU Error 0x56" 87 "TPU Error 0x57" 88 "TPU Error 0x58" 89 "TPU Error 0x59" 90 "TPU Error 0x5A" 91 "TPU Error 0x5B" 92 "TPU Error 0x5C" 93 "TPU Error 0x5D" 94 "TPU Error 0x5E" 95 "TPU Error 0x5F" /end COMPU_VTAB
/begin COMPU_VTAB CompuVtab_3 "" TAB_VERB 4 0 "Before Model Initialize" 1 "After Model Init - Before STARTUP Event" 2 "After STARTUP Event - Before Run" 3 "Run" /end COMPU_VTAB
/begin COMPU_VTAB CompuVtab_4 "" TAB_VERB 2 0 "Disabled" 1 "Enabled" /end COMPU_VTAB
/begin COMPU_VTAB CompuVtab_5 "" TAB_VERB 4 0 "Initializing" 1 "Run" 2 "Pause" 3 "Stop" /end COMPU_VTAB
/begin COMPU_VTAB CompuVtab_6 "" TAB_VERB 9 0 "Running normally" 1 "Requested by user" 2 "Foreground stack margin violation" 3 "Background stack margin violation" 4 "Idle stack margin violation" 5 "Interrupt stack margin violation" 6 "Heap margin violation" 7 "Idle CPU margin violation" 8 "OS error detected" /end COMPU_VTAB
/begin COMPU_VTAB CompuVtab_7 "" TAB_VERB 9 0 "-" 1 "-" 2 "Application Monitor" 3 "Application Monitor" 4 "Application Monitor" 5 "Application Monitor" 6 "Application Monitor" 7 "Application Monitor" 8 "Application Monitor" /end COMPU_VTAB
/begin COMPU_VTAB CompuVtab_8 "" TAB_VERB 11 0 "None Late" 1 "720 Late" 2 "360 Late" 4 "180 Late" 6 "360, 180 Late" 8 "120 Late" 16 "90 Late" 32 "60 Late" 64 "30 Late" 128 "HIRES Late" 192 "HIRES, 30 Late" /end COMPU_VTAB
/begin COMPU_VTAB CompuVtab_9 "" TAB_VERB 8 0 "None Late" 1 "x1 Late" 2 "x2 Late" 3 "x1, x2 Late" 4 "x10 Late" 5 "x1, x10 Late" 6 "x2, x10 Late" 7 "x1, 2, 10 Late" /end COMPU_VTAB
/begin COMPU_VTAB CompuVtab_10 "" TAB_VERB 2 0 "Calibration Locked" 1 "Calibration Unlocked" /end COMPU_VTAB
/begin COMPU_VTAB CompuVtab_11 "" TAB_VERB 2 0 "Data Acquisition Locked" 1 "Data Acquisition Unlocked" /end COMPU_VTAB
/begin COMPU_VTAB CompuVtab_12 "" TAB_VERB 2 0 "Programming Locked" 1 "Programming Unlocked" /end COMPU_VTAB
/begin COMPU_VTAB CompuVtab_13 "" TAB_VERB 2 0 "Not Connected" 1 "Connected" /end COMPU_VTAB
/begin COMPU_VTAB CompuVtab_14 "" TAB_VERB 2 0 "BatteryController_Rev1/Foreground/Battery/Inputs/AMP Clamp/motohawk_override_abs1/OldValue" 1 "-" /end COMPU_VTAB
/begin COMPU_VTAB CompuVtab_15 "" TAB_VERB 2 0 "BatteryController_Rev1/Foreground/Battery/Inputs/2G BMS/motohawk_override_abs5/NewValue" 1 "-" /end COMPU_VTAB
/begin COMPU_VTAB CompuVtab_16 "" TAB_VERB 2 0 "BatteryController_Rev1/Foreground/Battery/Control/AMP Clamp/motohawk_override_abs9/OldValue" 1 "-" /end COMPU_VTAB
/begin COMPU_VTAB CompuVtab_17 "" TAB_VERB 2 0 "BatteryController_Rev1/Foreground/Battery/Inputs/2G BMS/motohawk_override_abs5/OldValue" 1 "-" /end COMPU_VTAB
/begin COMPU_VTAB CompuVtab_18 "" TAB_VERB 2 0 "BatteryController_Rev1/Foreground/Battery/Control/Battery States/motohawk_override_abs1/NewValue" 1 "-" /end COMPU_VTAB
/begin COMPU_VTAB CompuVtab_19 "" TAB_VERB 2 0 "BatteryController_Rev1/Foreground/Battery/Control/Battery States/motohawk_override_abs1/OldValue" 1 "-" /end COMPU_VTAB
/begin COMPU_VTAB CompuVtab_20 "" TAB_VERB 2 0 "BatteryController_Rev1/Foreground/Battery/Inputs/AMP Clamp/motohawk_override_abs9/NewValue" 1 "-" /end COMPU_VTAB
/begin COMPU_VTAB CompuVtab_21 "" TAB_VERB 2 0 "BatteryController_Rev1/Foreground/Battery/Inputs/AMP Clamp/motohawk_override_abs9/OldValue" 1 "-" /end COMPU_VTAB
/begin COMPU_VTAB CompuVtab_22 "" TAB_VERB 2 0 "BatteryController_Rev1/Foreground/Battery/Inputs/2G BMS/motohawk_override_abs6/NewValue" 1 "-" /end COMPU_VTAB
/begin COMPU_VTAB CompuVtab_23 "" TAB_VERB 2 0 "BatteryController_Rev1/Foreground/Battery/Inputs/2G BMS/motohawk_override_abs6/OldValue" 1 "-" /end COMPU_VTAB
/begin COMPU_VTAB CompuVtab_24 "" TAB_VERB 2 0 "BatteryController_Rev1/Foreground/Battery/Control/Battery States/motohawk_override_abs9/NewValue" 1 "-" /end COMPU_VTAB
/begin COMPU_VTAB CompuVtab_25 "" TAB_VERB 2 0 "BatteryController_Rev1/Foreground/Battery/Inputs/2G BMS/motohawk_override_abs7/NewValue" 1 "-" /end COMPU_VTAB
/begin COMPU_VTAB CompuVtab_26 "" TAB_VERB 2 0 "BatteryController_Rev1/Foreground/Battery/Control/Battery States/motohawk_override_abs9/OldValue" 1 "-" /end COMPU_VTAB
/begin COMPU_VTAB CompuVtab_27 "" TAB_VERB 2 0 "BatteryController_Rev1/CCP CAN Protocol/CCP CAN Protocol External Trig1/CCP Command Driver" 1 "-" /end COMPU_VTAB
/begin COMPU_VTAB CompuVtab_28 "" TAB_VERB 2 0 "BatteryController_Rev1/Foreground/Battery/Inputs/2G BMS/motohawk_override_abs7/OldValue" 1 "-" /end COMPU_VTAB
/begin COMPU_VTAB CompuVtab_29 "" TAB_VERB 2 0 "BatteryController_Rev1/Foreground/Battery/Control/SOC/motohawk_override_abs9/NewValue" 1 "-" /end COMPU_VTAB
/begin COMPU_VTAB CompuVtab_30 "" TAB_VERB 2 0 "BatteryController_Rev1/CCP CAN Protocol/CCP CAN Protocol External Trig1/CCP Command Driver/While new CCP Command" 1 "-" /end COMPU_VTAB
/begin COMPU_VTAB CompuVtab_31 "" TAB_VERB 2 0 "BatteryController_Rev1/Foreground/Battery/Inputs/2G BMS/motohawk_override_abs8/NewValue" 1 "-" /end COMPU_VTAB
/begin COMPU_VTAB CompuVtab_32 "" TAB_VERB 2 0 "BatteryController_Rev1/Foreground/Battery/Control/SOC/motohawk_override_abs9/OldValue" 1 "-" /end COMPU_VTAB
/begin COMPU_VTAB CompuVtab_33 "" TAB_VERB 2 0 "BatteryController_Rev1/CCP CAN Protocol/CCP CAN Protocol External Trig1/CCP Command Driver/While new CCP Command/Adjust ID" 1 "-" /end COMPU_VTAB
/begin COMPU_VTAB CompuVtab_34 "" TAB_VERB 2 0 "BatteryController_Rev1/Foreground/Battery/Inputs/2G BMS/motohawk_override_abs8/OldValue" 1 "-" /end COMPU_VTAB
/begin COMPU_VTAB CompuVtab_35 "" TAB_VERB 2 0 "BatteryController_Rev1/Foreground/Battery/Inputs/2G BMS/motohawk_override_abs3/NewValue" 1 "-" /end COMPU_VTAB
/begin COMPU_VTAB CompuVtab_36 "" TAB_VERB 2 0 "BatteryController_Rev1/CCP CAN Protocol/CCP CAN Protocol External Trig1/CCP Daq Processing" 1 "-" /end COMPU_VTAB
/begin COMPU_VTAB CompuVtab_37 "" TAB_VERB 2 0 "BatteryController_Rev1/Foreground/Battery/Inputs/2G BMS/motohawk_override_abs9/NewValue" 1 "-" /end COMPU_VTAB
/begin COMPU_VTAB CompuVtab_38 "" TAB_VERB 2 0 "BatteryController_Rev1/Foreground/Battery/Inputs/2G BMS/motohawk_override_abs3/OldValue" 1 "-" /end COMPU_VTAB
/begin COMPU_VTAB CompuVtab_39 "" TAB_VERB 2 0 "BatteryController_Rev1/CCP CAN Protocol/CCP CAN Protocol External Trig1/CCP IDLE Processing" 1 "-" /end COMPU_VTAB
/begin COMPU_VTAB CompuVtab_40 "" TAB_VERB 2 0 "BatteryController_Rev1/Foreground/Battery/Inputs/2G BMS/motohawk_override_abs9/OldValue" 1 "-" /end COMPU_VTAB
/begin COMPU_VTAB CompuVtab_41 "" TAB_VERB 2 0 "BatteryController_Rev1/Foreground/Battery/Inputs/2G BMS/motohawk_override_abs4/NewValue" 1 "-" /end COMPU_VTAB
/begin COMPU_VTAB CompuVtab_42 "" TAB_VERB 2 0 "BatteryController_Rev1/Foreground" 1 "-" /end COMPU_VTAB
/begin COMPU_VTAB CompuVtab_43 "" TAB_VERB 2 0 "BatteryController_Rev1/Foreground/Battery/Inputs/AMP Clamp/motohawk_override_abs1/NewValue" 1 "-" /end COMPU_VTAB
/begin COMPU_VTAB CompuVtab_44 "" TAB_VERB 2 0 "BatteryController_Rev1/Foreground/Battery/Inputs/2G BMS/motohawk_override_abs4/OldValue" 1 "-" /end COMPU_VTAB
/begin COMPU_VTAB CompuVtab_45 "" TAB_VERB 2 0 "BatteryController_Rev1/Foreground/Battery/Control/AMP Clamp/motohawk_override_abs9/NewValue" 1 "-" /end COMPU_VTAB
/begin COMPU_VTAB CompuVtab_46 "" TAB_VERB 2 0 "BatteryController_Rev1/Foreground/Battery/Outputs/Battery/motohawk_override_abs18/NewValue" 1 "-" /end COMPU_VTAB
/begin COMPU_VTAB CompuVtab_47 "" TAB_VERB 2 0 "BatteryController_Rev1/Foreground/Battery/Outputs/Battery/motohawk_override_abs18/OldValue" 1 "-" /end COMPU_VTAB
/begin COMPU_VTAB CompuVtab_48 "" TAB_VERB 2 0 "BatteryController_Rev1/Foreground/Battery/Outputs/Battery/motohawk_override_abs13/NewValue" 1 "-" /end COMPU_VTAB
/begin COMPU_VTAB CompuVtab_49 "" TAB_VERB 2 0 "BatteryController_Rev1/Foreground/Battery/Outputs/Battery/motohawk_override_abs19/NewValue" 1 "-" /end COMPU_VTAB
/begin COMPU_VTAB CompuVtab_50 "" TAB_VERB 2 0 "BatteryController_Rev1/Foreground/Battery/Outputs/Battery/motohawk_override_abs13/OldValue" 1 "-" /end COMPU_VTAB
/begin COMPU_VTAB CompuVtab_51 "" TAB_VERB 2 0 "BatteryController_Rev1/Foreground/Battery/Inputs/Contactors/motohawk_override_abs9/NewValue" 1 "-" /end COMPU_VTAB
/begin COMPU_VTAB CompuVtab_52 "" TAB_VERB 2 0 "BatteryController_Rev1/Foreground/Battery/Outputs/Battery/motohawk_override_abs19/OldValue" 1 "-" /end COMPU_VTAB
/begin COMPU_VTAB CompuVtab_53 "" TAB_VERB 2 0 "BatteryController_Rev1/Foreground/Battery/Outputs/Battery/motohawk_override_abs14/NewValue" 1 "-" /end COMPU_VTAB
/begin COMPU_VTAB CompuVtab_54 "" TAB_VERB 2 0 "BatteryController_Rev1/Foreground/Battery/Inputs/Contactors/motohawk_override_abs9/OldValue" 1 "-" /end COMPU_VTAB
/begin COMPU_VTAB CompuVtab_55 "" TAB_VERB 2 0 "BatteryController_Rev1/Foreground/Battery/Outputs/Battery/motohawk_override_abs14/OldValue" 1 "-" /end COMPU_VTAB
/begin COMPU_VTAB CompuVtab_56 "" TAB_VERB 2 0 "BatteryController_Rev1/Foreground/Battery/Outputs/Battery/motohawk_override_abs1/NewValue" 1 "-" /end COMPU_VTAB
/begin COMPU_VTAB CompuVtab_57 "" TAB_VERB 2 0 "BatteryController_Rev1/Foreground/Battery/Outputs/Battery/motohawk_override_abs15/NewValue" 1 "-" /end COMPU_VTAB
/begin COMPU_VTAB CompuVtab_58 "" TAB_VERB 2 0 "BatteryController_Rev1/Foreground/Battery/Outputs/Battery/motohawk_override_abs1/OldValue" 1 "-" /end COMPU_VTAB
/begin COMPU_VTAB CompuVtab_59 "" TAB_VERB 2 0 "BatteryController_Rev1/Foreground/Battery/Inputs/Contactors/Save NV on disconnect" 1 "-" /end COMPU_VTAB
/begin COMPU_VTAB CompuVtab_60 "" TAB_VERB 2 0 "BatteryController_Rev1/Foreground/Battery/Outputs/Battery/motohawk_override_abs15/OldValue" 1 "-" /end COMPU_VTAB
/begin COMPU_VTAB CompuVtab_61 "" TAB_VERB 2 0 "BatteryController_Rev1/Foreground/Battery/Outputs/Battery/motohawk_override_abs10/NewValue" 1 "-" /end COMPU_VTAB
/begin COMPU_VTAB CompuVtab_62 "" TAB_VERB 2 0 "BatteryController_Rev1/Foreground/Battery/Inputs/Contactors/Save NV on disconnect/Save NV Vars one tick before MPRD off" 1 "-" /end COMPU_VTAB
/begin COMPU_VTAB CompuVtab_63 "" TAB_VERB 2 0 "BatteryController_Rev1/Foreground/Battery/Outputs/Battery/motohawk_override_abs16/NewValue" 1 "-" /end COMPU_VTAB
/begin COMPU_VTAB CompuVtab_64 "" TAB_VERB 2 0 "BatteryController_Rev1/Foreground/Battery/Outputs/Battery/motohawk_override_abs10/OldValue" 1 "-" /end COMPU_VTAB
/begin COMPU_VTAB CompuVtab_65 "" TAB_VERB 2 0 "BatteryController_Rev1/Foreground/Battery/Inputs/Contactors/motohawk_override_abs10/NewValue" 1 "-" /end COMPU_VTAB
/begin COMPU_VTAB CompuVtab_66 "" TAB_VERB 2 0 "BatteryController_Rev1/Foreground/Battery/Outputs/Battery/motohawk_override_abs16/OldValue" 1 "-" /end COMPU_VTAB
/begin COMPU_VTAB CompuVtab_67 "" TAB_VERB 2 0 "BatteryController_Rev1/Foreground/Battery/Outputs/Battery/motohawk_override_abs11/NewValue" 1 "-" /end COMPU_VTAB
/begin COMPU_VTAB CompuVtab_68 "" TAB_VERB 2 0 "BatteryController_Rev1/Foreground/Battery/Inputs/Contactors/motohawk_override_abs10/OldValue" 1 "-" /end COMPU_VTAB
/begin COMPU_VTAB CompuVtab_69 "" TAB_VERB 2 0 "BatteryController_Rev1/Foreground/Battery/Outputs/Battery/motohawk_override_abs17/NewValue" 1 "-" /end COMPU_VTAB
/begin COMPU_VTAB CompuVtab_70 "" TAB_VERB 2 0 "BatteryController_Rev1/Foreground/Battery/Outputs/Battery/motohawk_override_abs11/OldValue" 1 "-" /end COMPU_VTAB
/begin COMPU_VTAB CompuVtab_71 "" TAB_VERB 2 0 "BatteryController_Rev1/Foreground/Battery/Inputs/Contactors/motohawk_override_abs11/NewValue" 1 "-" /end COMPU_VTAB
/begin COMPU_VTAB CompuVtab_72 "" TAB_VERB 2 0 "BatteryController_Rev1/Foreground/Battery/Outputs/Battery/motohawk_override_abs17/OldValue" 1 "-" /end COMPU_VTAB
/begin COMPU_VTAB CompuVtab_73 "" TAB_VERB 2 0 "BatteryController_Rev1/Foreground/Battery/Outputs/Battery/motohawk_override_abs12/NewValue" 1 "-" /end COMPU_VTAB
/begin COMPU_VTAB CompuVtab_74 "" TAB_VERB 2 0 "BatteryController_Rev1/Foreground/Battery/Inputs/Contactors/motohawk_override_abs11/OldValue" 1 "-" /end COMPU_VTAB
/begin COMPU_VTAB CompuVtab_75 "" TAB_VERB 2 0 "BatteryController_Rev1/Foreground/Battery/Outputs/Battery/motohawk_override_abs12/OldValue" 1 "-" /end COMPU_VTAB
/begin COMPU_VTAB CompuVtab_76 "" TAB_VERB 2 0 "BatteryController_Rev1/Foreground/Battery/Inputs/Contactors/motohawk_override_abs8/NewValue" 1 "-" /end COMPU_VTAB
/begin COMPU_VTAB CompuVtab_77 "" TAB_VERB 2 0 "BatteryController_Rev1/Foreground/Battery/Inputs/Contactors/motohawk_override_abs8/OldValue" 1 "-" /end COMPU_VTAB
/begin COMPU_VTAB CompuVtab_78 "" TAB_VERB 2 0 "BatteryController_Rev1/Foreground/Battery/Outputs/Battery/motohawk_override_abs31/NewValue" 1 "-" /end COMPU_VTAB
/begin COMPU_VTAB CompuVtab_79 "" TAB_VERB 2 0 "BatteryController_Rev1/Foreground/Battery/Outputs/Battery/motohawk_override_abs31/OldValue" 1 "-" /end COMPU_VTAB
/begin COMPU_VTAB CompuVtab_80 "" TAB_VERB 2 0 "BatteryController_Rev1/Foreground/Battery/Outputs/Battery/motohawk_override_abs27/NewValue" 1 "-" /end COMPU_VTAB
/begin COMPU_VTAB CompuVtab_81 "" TAB_VERB 2 0 "BatteryController_Rev1/Foreground/Battery/Outputs/Battery/motohawk_override_abs32/NewValue" 1 "-" /end COMPU_VTAB
/begin COMPU_VTAB CompuVtab_82 "" TAB_VERB 2 0 "BatteryController_Rev1/Foreground/Battery/Outputs/Battery/motohawk_override_abs27/OldValue" 1 "-" /end COMPU_VTAB
/begin COMPU_VTAB CompuVtab_83 "" TAB_VERB 2 0 "BatteryController_Rev1/Foreground/Battery/Outputs/Battery/motohawk_override_abs22/NewValue" 1 "-" /end COMPU_VTAB
/begin COMPU_VTAB CompuVtab_84 "" TAB_VERB 2 0 "BatteryController_Rev1/Foreground/Battery/Outputs/Battery/motohawk_override_abs32/OldValue" 1 "-" /end COMPU_VTAB
/begin COMPU_VTAB CompuVtab_85 "" TAB_VERB 2 0 "BatteryController_Rev1/Foreground/Battery/Outputs/Battery/motohawk_override_abs28/NewValue" 1 "-" /end COMPU_VTAB
/begin COMPU_VTAB CompuVtab_86 "" TAB_VERB 2 0 "BatteryController_Rev1/Foreground/Battery/Outputs/Battery/motohawk_override_abs22/OldValue" 1 "-" /end COMPU_VTAB
/begin COMPU_VTAB CompuVtab_87 "" TAB_VERB 2 0 "BatteryController_Rev1/Foreground/Battery/Outputs/Battery/motohawk_override_abs33/NewValue" 1 "-" /end COMPU_VTAB
/begin COMPU_VTAB CompuVtab_88 "" TAB_VERB 2 0 "BatteryController_Rev1/Foreground/Battery/Outputs/Battery/motohawk_override_abs28/OldValue" 1 "-" /end COMPU_VTAB
/begin COMPU_VTAB CompuVtab_89 "" TAB_VERB 2 0 "BatteryController_Rev1/Foreground/Battery/Outputs/Battery/motohawk_override_abs23/NewValue" 1 "-" /end COMPU_VTAB
/begin COMPU_VTAB CompuVtab_90 "" TAB_VERB 2 0 "BatteryController_Rev1/Foreground/Battery/Outputs/Battery/motohawk_override_abs33/OldValue" 1 "-" /end COMPU_VTAB
/begin COMPU_VTAB CompuVtab_91 "" TAB_VERB 2 0 "BatteryController_Rev1/Foreground/Battery/Outputs/Battery/motohawk_override_abs29/NewValue" 1 "-" /end COMPU_VTAB
/begin COMPU_VTAB CompuVtab_92 "" TAB_VERB 2 0 "BatteryController_Rev1/Foreground/Battery/Outputs/Battery/motohawk_override_abs23/OldValue" 1 "-" /end COMPU_VTAB
/begin COMPU_VTAB CompuVtab_93 "" TAB_VERB 2 0 "BatteryController_Rev1/Foreground/Battery/Outputs/Battery/motohawk_override_abs29/OldValue" 1 "-" /end COMPU_VTAB
/begin COMPU_VTAB CompuVtab_94 "" TAB_VERB 2 0 "BatteryController_Rev1/Foreground/Battery/Outputs/Battery/motohawk_override_abs24/NewValue" 1 "-" /end COMPU_VTAB
/begin COMPU_VTAB CompuVtab_95 "" TAB_VERB 2 0 "BatteryController_Rev1/Foreground/Battery/Outputs/Battery/motohawk_override_abs3/NewValue" 1 "-" /end COMPU_VTAB
/begin COMPU_VTAB CompuVtab_96 "" TAB_VERB 2 0 "BatteryController_Rev1/Foreground/Battery/Outputs/Battery/motohawk_override_abs24/OldValue" 1 "-" /end COMPU_VTAB
/begin COMPU_VTAB CompuVtab_97 "" TAB_VERB 2 0 "BatteryController_Rev1/Foreground/Battery/Outputs/Battery/motohawk_override_abs2/NewValue" 1 "-" /end COMPU_VTAB
/begin COMPU_VTAB CompuVtab_98 "" TAB_VERB 2 0 "BatteryController_Rev1/Foreground/Battery/Outputs/Battery/motohawk_override_abs3/OldValue" 1 "-" /end COMPU_VTAB
/begin COMPU_VTAB CompuVtab_99 "" TAB_VERB 2 0 "BatteryController_Rev1/Foreground/Battery/Outputs/Battery/motohawk_override_abs25/NewValue" 1 "-" /end COMPU_VTAB
/begin COMPU_VTAB CompuVtab_100 "" TAB_VERB 2 0 "BatteryController_Rev1/Foreground/Battery/Outputs/Battery/motohawk_override_abs2/OldValue" 1 "-" /end COMPU_VTAB
/begin COMPU_VTAB CompuVtab_101 "" TAB_VERB 2 0 "BatteryController_Rev1/Foreground/Battery/Outputs/Battery/motohawk_override_abs30/NewValue" 1 "-" /end COMPU_VTAB
/begin COMPU_VTAB CompuVtab_102 "" TAB_VERB 2 0 "BatteryController_Rev1/Foreground/Battery/Outputs/Battery/motohawk_override_abs25/OldValue" 1 "-" /end COMPU_VTAB
/begin COMPU_VTAB CompuVtab_103 "" TAB_VERB 2 0 "BatteryController_Rev1/Foreground/Battery/Outputs/Battery/motohawk_override_abs20/NewValue" 1 "-" /end COMPU_VTAB
/begin COMPU_VTAB CompuVtab_104 "" TAB_VERB 2 0 "BatteryController_Rev1/Foreground/Battery/Outputs/Battery/motohawk_override_abs30/OldValue" 1 "-" /end COMPU_VTAB
/begin COMPU_VTAB CompuVtab_105 "" TAB_VERB 2 0 "BatteryController_Rev1/Foreground/Battery/Outputs/Battery/motohawk_override_abs26/NewValue" 1 "-" /end COMPU_VTAB
/begin COMPU_VTAB CompuVtab_106 "" TAB_VERB 2 0 "BatteryController_Rev1/Foreground/Battery/Outputs/Battery/motohawk_override_abs20/OldValue" 1 "-" /end COMPU_VTAB
/begin COMPU_VTAB CompuVtab_107 "" TAB_VERB 2 0 "BatteryController_Rev1/Foreground/Battery/Outputs/Battery/motohawk_override_abs26/OldValue" 1 "-" /end COMPU_VTAB
/begin COMPU_VTAB CompuVtab_108 "" TAB_VERB 2 0 "BatteryController_Rev1/Foreground/Battery/Outputs/Battery/motohawk_override_abs21/NewValue" 1 "-" /end COMPU_VTAB
/begin COMPU_VTAB CompuVtab_109 "" TAB_VERB 2 0 "BatteryController_Rev1/Foreground/Battery/Outputs/Battery/motohawk_override_abs21/OldValue" 1 "-" /end COMPU_VTAB
/begin COMPU_VTAB CompuVtab_110 "" TAB_VERB 2 0 "BatteryController_Rev1/Foreground/Battery/Outputs/Contactors/motohawk_override_abs4/OldValue" 1 "-" /end COMPU_VTAB
/begin COMPU_VTAB CompuVtab_111 "" TAB_VERB 2 0 "BatteryController_Rev1/Foreground/Battery/Outputs/Battery/motohawk_override_abs8/NewValue" 1 "-" /end COMPU_VTAB
/begin COMPU_VTAB CompuVtab_112 "" TAB_VERB 2 0 "BatteryController_Rev1/Foreground/Battery/Outputs/Contactors/motohawk_override_abs5/NewValue" 1 "-" /end COMPU_VTAB
/begin COMPU_VTAB CompuVtab_113 "" TAB_VERB 2 0 "BatteryController_Rev1/Foreground/Battery/Outputs/Battery/motohawk_override_abs8/OldValue" 1 "-" /end COMPU_VTAB
/begin COMPU_VTAB CompuVtab_114 "" TAB_VERB 2 0 "BatteryController_Rev1/Foreground/Battery/Outputs/Contactors/motohawk_override_abs5/OldValue" 1 "-" /end COMPU_VTAB
/begin COMPU_VTAB CompuVtab_115 "" TAB_VERB 2 0 "BatteryController_Rev1/Foreground/Battery/Outputs/Battery/motohawk_override_abs9/NewValue" 1 "-" /end COMPU_VTAB
/begin COMPU_VTAB CompuVtab_116 "" TAB_VERB 2 0 "BatteryController_Rev1/Foreground/Battery/Outputs/Battery/motohawk_override_abs9/OldValue" 1 "-" /end COMPU_VTAB
/begin COMPU_VTAB CompuVtab_117 "" TAB_VERB 2 0 "BatteryController_Rev1/Foreground/Battery/Outputs/Battery/motohawk_override_abs34/NewValue" 1 "-" /end COMPU_VTAB
/begin COMPU_VTAB CompuVtab_118 "" TAB_VERB 2 0 "BatteryController_Rev1/Foreground/Battery/Outputs/Battery/motohawk_override_abs34/OldValue" 1 "-" /end COMPU_VTAB
/begin COMPU_VTAB CompuVtab_119 "" TAB_VERB 2 0 "BatteryController_Rev1/Foreground/Battery/Outputs/Contactors/motohawk_override_abs6/NewValue" 1 "-" /end COMPU_VTAB
/begin COMPU_VTAB CompuVtab_120 "" TAB_VERB 2 0 "BatteryController_Rev1/Foreground/Battery/Outputs/Battery/motohawk_override_abs4/NewValue" 1 "-" /end COMPU_VTAB
/begin COMPU_VTAB CompuVtab_121 "" TAB_VERB 2 0 "BatteryController_Rev1/Foreground/Battery/Outputs/Contactors/motohawk_override_abs6/OldValue" 1 "-" /end COMPU_VTAB
/begin COMPU_VTAB CompuVtab_122 "" TAB_VERB 2 0 "BatteryController_Rev1/Foreground/Battery/Outputs/Contactors/motohawk_override_abs1/NewValue" 1 "-" /end COMPU_VTAB
/begin COMPU_VTAB CompuVtab_123 "" TAB_VERB 2 0 "BatteryController_Rev1/Foreground/Battery/Outputs/Battery/motohawk_override_abs4/OldValue" 1 "-" /end COMPU_VTAB
/begin COMPU_VTAB CompuVtab_124 "" TAB_VERB 2 0 "BatteryController_Rev1/Foreground/Battery/Outputs/Contactors/motohawk_override_abs7/NewValue" 1 "-" /end COMPU_VTAB
/begin COMPU_VTAB CompuVtab_125 "" TAB_VERB 2 0 "BatteryController_Rev1/Foreground/Battery/Outputs/Contactors/motohawk_override_abs1/OldValue" 1 "-" /end COMPU_VTAB
/begin COMPU_VTAB CompuVtab_126 "" TAB_VERB 2 0 "BatteryController_Rev1/Foreground/Battery/Outputs/Battery/motohawk_override_abs5/NewValue" 1 "-" /end COMPU_VTAB
/begin COMPU_VTAB CompuVtab_127 "" TAB_VERB 2 0 "BatteryController_Rev1/Foreground/Battery/Outputs/Contactors/motohawk_override_abs7/OldValue" 1 "-" /end COMPU_VTAB
/begin COMPU_VTAB CompuVtab_128 "" TAB_VERB 2 0 "BatteryController_Rev1/Foreground/Battery/Outputs/Contactors/motohawk_override_abs2/NewValue" 1 "-" /end COMPU_VTAB
/begin COMPU_VTAB CompuVtab_129 "" TAB_VERB 2 0 "BatteryController_Rev1/Foreground/Battery/Outputs/Battery/motohawk_override_abs5/OldValue" 1 "-" /end COMPU_VTAB
/begin COMPU_VTAB CompuVtab_130 "" TAB_VERB 2 0 "BatteryController_Rev1/Main Power Relay/Background" 1 "-" /end COMPU_VTAB
/begin COMPU_VTAB CompuVtab_131 "" TAB_VERB 2 0 "BatteryController_Rev1/Foreground/Battery/Outputs/Contactors/motohawk_override_abs2/OldValue" 1 "-" /end COMPU_VTAB
/begin COMPU_VTAB CompuVtab_132 "" TAB_VERB 2 0 "BatteryController_Rev1/Foreground/Battery/Outputs/Battery/motohawk_override_abs6/NewValue" 1 "-" /end COMPU_VTAB
/begin COMPU_VTAB CompuVtab_133 "" TAB_VERB 2 0 "BatteryController_Rev1/Main Power Relay/Background/Display Variable Event Function-Call/Clear" 1 "-" /end COMPU_VTAB
/begin COMPU_VTAB CompuVtab_134 "" TAB_VERB 2 0 "BatteryController_Rev1/Foreground/Battery/Outputs/Contactors/motohawk_override_abs3/NewValue" 1 "-" /end COMPU_VTAB
/begin COMPU_VTAB CompuVtab_135 "" TAB_VERB 2 0 "BatteryController_Rev1/Foreground/Battery/Outputs/Battery/motohawk_override_abs6/OldValue" 1 "-" /end COMPU_VTAB
/begin COMPU_VTAB CompuVtab_136 "" TAB_VERB 2 0 "BatteryController_Rev1/Main Power Relay/Background/Display Variable Event Function-Call1/Clear" 1 "-" /end COMPU_VTAB
/begin COMPU_VTAB CompuVtab_137 "" TAB_VERB 2 0 "BatteryController_Rev1/Foreground/Battery/Outputs/Contactors/motohawk_override_abs3/OldValue" 1 "-" /end COMPU_VTAB
/begin COMPU_VTAB CompuVtab_138 "" TAB_VERB 2 0 "BatteryController_Rev1/Foreground/Battery/Outputs/Battery/motohawk_override_abs7/NewValue" 1 "-" /end COMPU_VTAB
/begin COMPU_VTAB CompuVtab_139 "" TAB_VERB 2 0 "BatteryController_Rev1/Main Power Relay/Background/Post Shutdown two ticks before MPRD off" 1 "-" /end COMPU_VTAB
/begin COMPU_VTAB CompuVtab_140 "" TAB_VERB 2 0 "BatteryController_Rev1/Foreground/Battery/Outputs/Contactors/motohawk_override_abs4/NewValue" 1 "-" /end COMPU_VTAB
/begin COMPU_VTAB CompuVtab_141 "" TAB_VERB 2 0 "BatteryController_Rev1/Foreground/Battery/Outputs/Battery/motohawk_override_abs7/OldValue" 1 "-" /end COMPU_VTAB
/begin COMPU_VTAB CompuVtab_142 "" TAB_VERB 2 0 "BatteryController_Rev1/Main Power Relay/Background/Post Shutdown two ticks before MPRD off/Post Shutdown two ticks before MPRD off" 1 "-" /end COMPU_VTAB
/begin COMPU_VTAB CompuVtab_143 "" TAB_VERB 2 0 "BatteryController_Rev1/Main Power Relay/Background/Processor Reboot" 1 "-" /end COMPU_VTAB
/begin COMPU_VTAB CompuVtab_144 "" TAB_VERB 2 0 "BatteryController_Rev1/Main Power Relay/Background/Save NV Vars one tick before MPRD off" 1 "-" /end COMPU_VTAB
/begin COMPU_VTAB CompuVtab_145 "" TAB_VERB 2 0 "BatteryController_Rev1/Main Power Relay/Background/Save NV Vars one tick before MPRD off/Save NV Vars one tick before MPRD off" 1 "-" /end COMPU_VTAB
/begin COMPU_VTAB CompuVtab_146 "" TAB_VERB 2 0 "BatteryController_Rev1/Main Power Relay/Background/Shutdown power on ECU565-128" 1 "-" /end COMPU_VTAB
/begin COMPU_VTAB CompuVtab_147 "" TAB_VERB 2 0 "BatteryController_Rev1/Main Power Relay/Background/Shutdown power on ECU565-128/Shutdown power on ECU565-128" 1 "-" /end COMPU_VTAB
/begin COMPU_VTAB CompuVtab_148 "" TAB_VERB 2 0 "BatteryController_Rev1/Main Power Relay/Background/motohawk_override_abs/NewValue" 1 "-" /end COMPU_VTAB
/begin COMPU_VTAB CompuVtab_149 "" TAB_VERB 2 0 "BatteryController_Rev1/Main Power Relay/Background/motohawk_override_abs/OldValue" 1 "-" /end COMPU_VTAB
/begin COMPU_VTAB CompuVtab_150 "" TAB_VERB 2 0 "BatteryController_Rev1/Main Power Relay/Background/motohawk_restore_nvmem" 1 "-" /end COMPU_VTAB
/begin COMPU_VTAB CompuVtab_151 "" TAB_VERB 2 0 "BatteryController_Rev1/Main Power Relay/Background/motohawk_store_nvmem" 1 "-" /end COMPU_VTAB
/begin COMPU_VTAB CompuVtab_152 "" TAB_VERB 74 0 "NO_OS_ERROR" 1 "PROSAK_TPU_ALLOCATE" 2 "PROSAK_DEADLOCK_PROT" 3 "QSPI_SEND_SIZE_ZERO" 4 "QSPI_SEND_SIZE_TOO_BIG" 5 "QSPI_RD_SIZE_TOO_BIG" 6 "QSPI_RD_SIZE_ZERO" 7 "QSPI_WR_SIZE_TOO_BIG" 8 "QSPI_WR_SIZE_ZERO" 9 "QSPI_CMD_SIZE_TOO_BIG" 10 "QSPI_CMD_SIZE_ZERO" 11 "IGN_DIAG_MDA_ALLOCATE" 12 "EEDataDirSizeMisMatch" 13 "EE_WRITE_QUEUE_OVFLOW" 14 "ESC_HBRIDGE_MDA_ALLOCATE" 15 "ETC_DIAG_MDA_ALLOCATE" 16 "DFLT_ENCODER_CREATE_ERR" 17 "ADC_TPU_ALLOCATE" 18 "SWISR_QUEUE_OVERFLOW" 19 "WATCHDOG_RESET" 20 "CHECKSTOP_RESET" 21 "SPIEE_WR_STAT_REG_ERR" 22 "SPIEE_QUEUE_OVFL_STATUS" 23 "SPIEE_WRITE_FAIL_ERR" 24 "Requested TPU Func not in mask" 25 "Unable to allocate QSPI knock" 26 "Stack has overflowed!" 27 "TPU Limits not setup" 28 "INVALID TPU MASK" 29 "TPU Mask Corrupt" 30 "Sequence Create with No Encoder" 31 "Illegal Sequence ISR" 32 "TPU Mask Version is insufficient" 33 "MUX PSP requested for 2-Stroke" 34 "Ext Flash Acc Denied" 35 "Ext Flash Erase Fail" 36 "Ext Flash Write Fail" 37 "Ext Flash Allign Error" 38 "EXT_FLASH_WR_ZERO_SIZE" 39 "Illegal Ext Flash Addr" 40 "Error: Write to non-existent Flash" 41 "Too many Logs want to be active" 42 "Bank Seq Destroy Problem" 43 "Transient Seq Destroy Problem" 44 "Transient Seq Update Problem" 45 "SPIEE System had a memory problem" 46 "Spent too long waiting for a sync return" 47 "TPUC Mask does not pair with TPUA/B mask" 48 "The Module Configuration was not available" 49 "Diagnostic Mux did not create" 50 "FGND Angle event queue overflow" 51 "FGND Time event queue overflow" 52 "EEPROM write to CAMDelay failed" 53 "SleepTask call from in ISR" 54 "Bad Kernel API call detected" 55 "Kernel Internal" 56 "SPIEE Device create" 57 "NAND Flash timeout on Write" 58 "NAND Flash timeout on Erase" 59 "NAND Flash WP" 60 "NAND Flash RDY/BUSYb" 61 "NAND Flash Access" 62 "NAND Flash Device" 63 "USB Core Stack Initialisation" 64 "USB Stack Assert" 65 "EXT_EE_ACCESS" 66 "VARCAM_PATTERN_SETUP" 67 "FP Divide by Zero" 68 "Unable to allocate requested memory on heap" 69 "Unable create Fgnd Angle task" 70 "FP Denormalized number" 71 "RPMVector Buffers Full" 72 "RPMVector Overrun" 73 "Failed to Write TPU Self Modify Parameter" /end COMPU_VTAB
/begin COMPU_VTAB CompuVtab_153 "" TAB_VERB 6 0 "Calibratable Development Module" 1 "Non-Calibratable Production Module" 2 "Software Dev Module (with RAM overlay only)" 3 "Software Dev Module (with Trace Pod & RAM)" 4 "Calibratable Development Module with Censorship disabled" 5 "Non-Calibratable Production Module with Censorship disabled" /end COMPU_VTAB
/begin COMPU_VTAB CompuVtab_154 "" TAB_VERB 2 0 "Disable on low ECUP" 1 "Keep alive" /end COMPU_VTAB
/begin COMPU_VTAB CompuVtab_155 "" TAB_VERB 2 0 "Off" 1 "On" /end COMPU_VTAB
/begin COMPU_VTAB CompuVtab_156 "" TAB_VERB 2 0 "Load saved application values on next startup" 1 "Load factory defaults on next startup" /end COMPU_VTAB
/begin COMPU_VTAB CompuVtab_157 "" TAB_VERB 7 0 "Currently loading NV from Factory FLASH to RAM" 1 "Currently loading NV from EEPROM to RAM" 2 "Currently storing NV from RAM to EEPROM" 3 "Detected new program.  Loaded Factory Defaults from FLASH" 4 "CRC failure.  Loaded Factory Defaults from FLASH" 5 "User requested refresh from Factory Defaults in FLASH." 6 "Successful refresh of EEPROM values from last shutdown" /end COMPU_VTAB
/begin COMPU_VTAB CompuVtab_158 "" TAB_VERB 2 0 "Abnormal Operation!" 1 "Operating Normally" /end COMPU_VTAB
/begin COMPU_VTAB CompuVtab_159 "" TAB_VERB 2 0 "Run" 1 "Reboot" /end COMPU_VTAB
/begin COMPU_VTAB CompuVtab_160 "" TAB_VERB 2 0 "Run" 1 "Restore To Defaults" /end COMPU_VTAB
/begin COMPU_VTAB CompuVtab_161 "" TAB_VERB 2 0 "Run" 1 "Store To EEPROM" /end COMPU_VTAB
/begin COMPU_VTAB CompuVtab_162 "" TAB_VERB 40 0 "TPU Mask Undefined" 1 "60-6" 2 "GM24Xe" 3 "GM24Xe on Cam" 4 "N-1/N-2 [Half Moon Cam]" 5 "NX Encoder" 6 "NX Encoder on Cam" 7 "30-5 on Cnk" 8 "Hyundai 60" 9 "X Plus 1 on Cnk with ToothCam" 10 "X Shift 1 on Cnk" 11 "N Encoder" 12 "N-1/N-2 [Tooth Cam]" 13 "ISDL" 14 "X Pulse Width on Cam" 15 "X Pulse Width on Cnk" 16 "1 Pulse on Cnk" 17 "1 Pulse on Cam" 18 "N-1/N-2 Dual Redundancy" 19 "N-1/N-2 Variable Cam" 20 "N-1/N-2 [Duramax CAM] [Multiplexed EST (1,2, or 4,5,6,7,8) (9,10,11 or 13,14,15)]" 21 "X Plus 1 on Cnk + MuxPSP on EST > 9" 22 "NX Encoder with Hyundai 4 Tooth CAM with one wide" 23 "NX Encoder with 360Deg CAM Providing Crank Sync" 24 "NissanZ 36-6 Encoder, sync on custom CAM" 25 "36-1 Encoder, sync on custom Coyote CAM" 26 "N Groups of 4 teeth - 2, sync on CAM" 27 "NissanZ 36-6 Encoder, sync on 6Tooth 2Missing Plus2 Variable CAM" 28 "EVO9 2X Encoder with 1X_PLUS1 CAM on Exhaust and 4X Variable CAM on Intake" 29 "N-1/N-2 Variable Cam with Windowed Sync" 30 "36M4 (2x18 teeth sectors with 2 missing) and Kohki Cam" 31 "N-3/N-4 [ToothCam]" 32 "N-3/N-4 [Plus1Cam (X+1)]" 33 "Hyundai 60 with EncoderSynthesizer variant on TPUC" 34 "N-1/N-2 [Half Moon Cam]" 35 "X Plus 1 on Cnk with X Plus 1 Cam" 36 "X Plus 1 on Cnk with X Plus 1 Cam with Encoder Synthesizer" 37 "N-1/N-2 [XPlus1 Cam]" 38 "X Shift 1 Retarded [ToothCam]" 39 "N-1/N-2 [Tooth Cam] with MuxPSP" /end COMPU_VTAB
/*~~~~~~~~~ 6.3.65 FUNCTIONs ~~~~~~~~~*/
/begin FUNCTION Project_Config "" /begin DEF_CHARACTERISTIC project_id ProductID /end DEF_CHARACTERISTIC /end FUNCTION
/begin FUNCTION System_Config "" /begin DEF_CHARACTERISTIC FriendlyName PasswordTxt /end DEF_CHARACTERISTIC /begin SUB_FUNCTION Project_Config Communication_Config /end SUB_FUNCTION /end FUNCTION
/begin FUNCTION System ""
 /begin SUB_FUNCTION System_Config Version Status Debug CCP Code_Coverage Performance Main_Power_Relay NonVolatile_Storage /end SUB_FUNCTION
/end FUNCTION
/begin FUNCTION Version ""
 /begin DEF_CHARACTERISTIC SwIdTxt CalIdTxt SwRevisionTxt CompilerVersion ControlCoreSDKRelease MatlabVersionTxt MotoHawkBuildGUID MotoHawkModelGUID MotoHawkModelName MotoHawkTokenGUID MotoHawkVersionTxt /end DEF_CHARACTERISTIC
 /begin OUT_MEASUREMENT table_0_rev table_1_rev table_2_rev KeyRev EriRev table_3_rev table_4_rev table_5_rev table_6_rev table_7_rev MotProgRev ApplicationCompatibilityArr LinkStatus MotoHawkModelSecondsInUse SystemFrequency TPUMaskType TPUMaskVers Unused /end OUT_MEASUREMENT
/end FUNCTION
/begin FUNCTION Module_Config "" /begin DEF_CHARACTERISTIC SerialNumber ModelNumber PartNumber /end DEF_CHARACTERISTIC
 /begin OUT_MEASUREMENT BootVerMaj BootVerMin EcuHwMaj EcuHwMin ConfigVerMaj ConfigVerMin ModuleCapability /end OUT_MEASUREMENT
/end FUNCTION
/begin FUNCTION Status "" /begin SUB_FUNCTION Module_Config OS Framework /end SUB_FUNCTION /end FUNCTION
/begin FUNCTION ActiveDTC_Ovr_Override "" /begin DEF_CHARACTERISTIC ActiveDTC_Ovr_new ActiveDTC_Ovr_ovr /end DEF_CHARACTERISTIC /end FUNCTION
/begin FUNCTION Battery_1 ""
 /begin DEF_CHARACTERISTIC CoolantTemperature DPI_RollingCounter HVIL_Status IsolationLevel IsolationStatus MaxDisPwr_10s_TableMap MaxDisPwr_Cont_TableMap MaxRegenPwr_10s_TableMap MaxRegenPwr_Cont_TableMap MILState PackIdentifier PPL_RollingCounter PPL10S_RollingCounter PS_RollingCounter PVC_RollingCounter SleepInhibited StateOfChargeMax StateOfChargeMin TAH_RollingCounter WakeSignal /end DEF_CHARACTERISTIC
 /begin OUT_MEASUREMENT ActiveDTC_Prb BatteryCurrent_prb BatteryVoltage_Prb BusVoltage_Prb CellBalancingActive_Prb CellTemp_PreLookupIdx CellTemp_PreLookupIn CoolantTemperature_Prb DPI_RollingCounter_Prb HVIL_Status_Prb IsolationLevel_Prb IsolationStatus_Prb JCS_PackIdentifier_Prb MaxCellTemperature_Prb MaxCellVoltage_Prb MaxDisPwr_10s_Table MaxDisPwr_Cont_Table MaximumDischargePower_10s_Prb MaximumDischargePower_Continuos_Prb MaximumRegenPower_10s_Prb MaximumRegenPower_Continuous_Prb MaxRegenPwr_10s_Table MaxRegenPwr_Cont_Table MIL_Status_Prb MinCellTemperature_Prb MinCellVoltage_Prb PackState_Prb PPL10s_RollingCounter_Prb PPLCont_RollingCounter_Prb PrechargeState_Prb PS_RollingCounter_Prb PVC_RollingCounter_Prb SleepInhibited_Prb SOC_PreLookupIdx SOC_PreLookupIn StateOfCharge_Prb StateOfChargeMax_Prb StateOfChargeMin_Prb TAH_RollingCounter_Prb TripAmoHoursOut_Prb TripAmpsHoursIn_Prb WakeSignal_Prb /end OUT_MEASUREMENT
 /begin SUB_FUNCTION ActiveDTC_Ovr_Override TripAmpHours BatteryCurrent_Ovr_Override BatteryVoltage_Ovr_Override BusVoltage_Ovr_Override CellBalancingActive_Ovr_Override CoolantTemperature_Ovr_Override DPI_RollingCounter_Ovr_Override HVIL_Status_Ovr_Override IsolationLevel_Ovr_Override IsolationStatus_Ovr_Override JCS_PackIdentifier_Ovr_Override MaxCellTemperature_Ovr_Override MaxCellVoltage_Ovr_Override MaximumDischargePower_10s_Ovr_Override MaximumDischargePower_Continuos_Ovr_Override MaximumRegenPower_10s_Ovr_Override MaximumRegenPower_Continuous_Ovr_Override MIL_Status_Ovr_Override MinCellTemperature_Ovr_Override MinCellVoltage_Ovr_Override PackState_Ovr_Override PPL10s_RollingCounter_Ovr_Override PPLCont_RollingCounter_Ovr_Override PrechargeState_Ovr_Override PS_RollingCounter_Ovr_Override PVC_RollingCounter_Ovr_Override SleepInhibited_Ovr_Override StateOfCharge_Ovr_Override StateOfChargeMax_Ovr_Override StateOfChargeMin_Ovr_Override TAH_RollingCounter_Ovr_Override TrimpAmpHoursOut_Ovr_Override TripAmpsHoursIn_Ovr_Override WakeSignal_Ovr_Override /end SUB_FUNCTION
/end FUNCTION
/begin FUNCTION Outputs "" /begin SUB_FUNCTION Battery_1 Contactors_1 /end SUB_FUNCTION /end FUNCTION
/begin FUNCTION Battery "" /begin SUB_FUNCTION Outputs Control Inputs /end SUB_FUNCTION /end FUNCTION
/begin FUNCTION Foreground "" /begin SUB_FUNCTION Battery /end SUB_FUNCTION /end FUNCTION
/begin FUNCTION BatteryController_Rev1 "" /begin SUB_FUNCTION Foreground /end SUB_FUNCTION /end FUNCTION
/begin FUNCTION AnalogIn ""
 /begin OUT_MEASUREMENT ain_create_Current_Sensor ain_create_ECUP ain_create_V5V_Reference ain_read_Current_Sensor ain_read_ECUP ain_read_V5V_Reference /end OUT_MEASUREMENT
/end FUNCTION
/begin FUNCTION Resources "" /begin SUB_FUNCTION AnalogIn CAN DiscreteOut PWM Other /end SUB_FUNCTION /end FUNCTION
/begin FUNCTION Debug ""
 /begin SUB_FUNCTION Resources Application_Monitor Application_Monitor_Config Event_Pause_Counters /end SUB_FUNCTION
/end FUNCTION
/begin FUNCTION Amp_Clamp_Conditioning "" /begin DEF_CHARACTERISTIC Amp_Clamp_K /end DEF_CHARACTERISTIC /end FUNCTION
/begin FUNCTION AMP_Clamp "" /begin DEF_CHARACTERISTIC Amp_Offset AmpV_Offset Current_Div2 G_Sensativity V5V_Ref2 /end DEF_CHARACTERISTIC
 /begin OUT_MEASUREMENT AMPCurrent_Prb AMPCurrent_Pre_Filter_Prb AMPCurrent_Pre_Offset_Prb /end OUT_MEASUREMENT
 /begin SUB_FUNCTION Amp_Clamp_Conditioning AMPCurrent_Ovr_Override /end SUB_FUNCTION
/end FUNCTION
/begin FUNCTION Control "" /begin SUB_FUNCTION AMP_Clamp SOC Battery_States /end SUB_FUNCTION /end FUNCTION
/begin FUNCTION AMPCurrent_Ovr_Override "" /begin DEF_CHARACTERISTIC AMPCurrent_Ovr_new AMPCurrent_Ovr_ovr /end DEF_CHARACTERISTIC /end FUNCTION
/begin FUNCTION TripAmpHours ""
 /begin DEF_CHARACTERISTIC AmpIn AmpOut Max_AmphoursIn Max_AmphoursOut Reset_AmpHoursIn Reset_AmpHoursOut /end DEF_CHARACTERISTIC
/end FUNCTION
/begin FUNCTION Application_Monitor "" /begin DEF_CHARACTERISTIC ApplicationStatus /end DEF_CHARACTERISTIC
 /begin OUT_MEASUREMENT ApplicationInitStatus ApplicationStopReason ApplicationStopReasonBlock /end OUT_MEASUREMENT
/end FUNCTION
/begin FUNCTION Application_Monitor_Config ""
 /begin DEF_CHARACTERISTIC ApplicationMonitorEnable ApplicationPausePoint BgndStackMargin CPUMargin FgndTimeStackMargin HeapMargin IdleStackMargin InterruptStackMargin /end DEF_CHARACTERISTIC
/end FUNCTION
/begin FUNCTION BalancingCount_Ovr_Override "" /begin DEF_CHARACTERISTIC BalancingCount_Ovr_new BalancingCount_Ovr_ovr /end DEF_CHARACTERISTIC /end FUNCTION
/begin FUNCTION _2G_BMS "" /begin DEF_CHARACTERISTIC FaultsDTC MaxCellTemp MinCellTemp /end DEF_CHARACTERISTIC
 /begin OUT_MEASUREMENT BalancingCount_Prb FaultsDTC_Prb MaxCellTemp_Prb MaxCellVoltage__Prb MinCellTemp_Prb MinCellVoltage__Prb Voltage_Prb /end OUT_MEASUREMENT
 /begin SUB_FUNCTION BalancingCount_Ovr_Override FaultsDTC_Ovr_Override MaxCellTemp_Ovr_Override MaxCellVoltage__Ovr_Override MinCellTemp_Ovr_Override MinCellVoltage__Ovr_Override Voltage_Ovr_Override /end SUB_FUNCTION
/end FUNCTION
/begin FUNCTION Inputs "" /begin SUB_FUNCTION _2G_BMS Contactors AMP_Clamp_1 /end SUB_FUNCTION /end FUNCTION
/begin FUNCTION Battery_Enable_Ovr_Override "" /begin DEF_CHARACTERISTIC Battery_Enable_Ovr_new Battery_Enable_Ovr_ovr /end DEF_CHARACTERISTIC /end FUNCTION
/begin FUNCTION Contactors "" /begin DEF_CHARACTERISTIC DutyCycle FreqEnd FreqStart /end DEF_CHARACTERISTIC /begin OUT_MEASUREMENT Battey_Enable_Prb DutyCycle_Prb FreqEnd_Prb FreqStart_Prb /end OUT_MEASUREMENT
 /begin SUB_FUNCTION Battery_Enable_Ovr_Override DutyCycle_Ovr_Override FreqEnd_Ovr_Override FreqStart_Ovr_Override /end SUB_FUNCTION
/end FUNCTION
/begin FUNCTION BatteryCurrent_Ovr_Override "" /begin DEF_CHARACTERISTIC BatteryCurrent_Ovr_new BatteryCurrent_Ovr_ovr /end DEF_CHARACTERISTIC /end FUNCTION
/begin FUNCTION BatteryVoltage_Ovr_Override "" /begin DEF_CHARACTERISTIC BatteryVoltage_Ovr_new BatteryVoltage_Ovr_ovr /end DEF_CHARACTERISTIC /end FUNCTION
/begin FUNCTION Event_Pause_Counters ""
 /begin DEF_CHARACTERISTIC BGND_BASE_PERIODIC_RunCnt BGND_BASEx10_PERIODIC_RunCnt BGND_BASEx2_PERIODIC_RunCnt FGND_10XRTI_PERIODIC_RunCnt FGND_20XRTI_PERIODIC_RunCnt FGND_2XRTI_PERIODIC_RunCnt FGND_RTI_PERIODIC_RunCnt IDLE_EVENT_RunCnt ONE_SECOND_EVENT_RunCnt STARTUP_EVENT_RunCnt /end DEF_CHARACTERISTIC
/end FUNCTION
/begin FUNCTION OS ""
 /begin OUT_MEASUREMENT BgndAngTaskStatus BgndStackMinBytesFree BgndTimeTaskStatus FgndAngleStackMinBytesFree FgndAngTaskStatus FgndTimeStackMinBytesFree IdleStackMinBytesFree InterruptStackMinBytesFree LastOSError OSErrorCnt OSStatus PeakHeapBytesUsed SWISRCurrQueueSize /end OUT_MEASUREMENT
/end FUNCTION
/begin FUNCTION BusVoltage_Ovr_Override "" /begin DEF_CHARACTERISTIC BusVoltage_Ovr_new BusVoltage_Ovr_ovr /end DEF_CHARACTERISTIC /end FUNCTION
/begin FUNCTION CAN ""
 /begin OUT_MEASUREMENT CAN_1_ext_handled_count CAN_1_ext_last_unhandled_id CAN_1_ext_receive_count CAN_1_std_handled_count CAN_1_std_last_unhandled_id CAN_1_std_receive_count can_create_CAN_1 can_tx_err_CAN_1_0 protocol_register_CAN_1 /end OUT_MEASUREMENT
/end FUNCTION
/begin FUNCTION CCP_BAT ""
 /begin DEF_CHARACTERISTIC CCP_BAT_StationAddr CCP_BATRxID CCP_BATRxIDMask CCP_BATTxID /end DEF_CHARACTERISTIC
 /begin OUT_MEASUREMENT CCP_CCP_BAT_Access CCP_CCP_BAT_Access.CCP_CCP_BAT_CAL CCP_CCP_BAT_Access.CCP_CCP_BAT_DAQ CCP_CCP_BAT_Access.CCP_CCP_BAT_PGM CCP_CCP_BAT_ConnectionStatus /end OUT_MEASUREMENT
/end FUNCTION
/begin FUNCTION CCP "" /begin SUB_FUNCTION CCP_BAT /end SUB_FUNCTION /end FUNCTION
/begin FUNCTION CellBalancingActive_Ovr_Override "" /begin DEF_CHARACTERISTIC CellBalancingActive_Ovr_new CellBalancingActive_Ovr_ovr /end DEF_CHARACTERISTIC /end FUNCTION
/begin FUNCTION Communication_Config "" /begin DEF_CHARACTERISTIC CityID_CAN_1 /end DEF_CHARACTERISTIC /end FUNCTION
/begin FUNCTION Code_Coverage ""
 /begin OUT_MEASUREMENT CodeCoverParent000 CodeCoverParent000.CodeCover000029 CodeCoverParent000.CodeCover000018 CodeCoverParent000.CodeCover000007 CodeCoverParent000.CodeCover000019 CodeCoverParent000.CodeCover000008 CodeCoverParent000.CodeCover000009 CodeCoverParent000.CodeCover000030 CodeCoverParent000.CodeCover000031 CodeCoverParent000.CodeCover000020 CodeCoverParent000.CodeCover000021 CodeCoverParent000.CodeCover000010 CodeCoverParent000.CodeCover000022 CodeCoverParent000.CodeCover000011 CodeCoverParent000.CodeCover000000 CodeCoverParent000.CodeCover000023 CodeCoverParent000.CodeCover000012 CodeCoverParent000.CodeCover000001 CodeCoverParent000.CodeCover000024 CodeCoverParent000.CodeCover000013 CodeCoverParent000.CodeCover000002 CodeCoverParent000.CodeCover000025 CodeCoverParent000.CodeCover000014 CodeCoverParent000.CodeCover000003 CodeCoverParent000.CodeCover000026 CodeCoverParent000.CodeCover000015 CodeCoverParent000.CodeCover000004 CodeCoverParent000.CodeCover000027 CodeCoverParent000.CodeCover000016 CodeCoverParent000.CodeCover000005 CodeCoverParent000.CodeCover000028 CodeCoverParent000.CodeCover000017 CodeCoverParent000.CodeCover000006 CodeCoverParent001 CodeCoverParent001.CodeCover000060 CodeCoverParent001.CodeCover000061 CodeCoverParent001.CodeCover000050 CodeCoverParent001.CodeCover000062 CodeCoverParent001.CodeCover000051 CodeCoverParent001.CodeCover000040 CodeCoverParent001.CodeCover000063 CodeCoverParent001.CodeCover000052 CodeCoverParent001.CodeCover000041 CodeCoverParent001.CodeCover000053 CodeCoverParent001.CodeCover000042 CodeCoverParent001.CodeCover000054 CodeCoverParent001.CodeCover000043 CodeCoverParent001.CodeCover000032 CodeCoverParent001.CodeCover000055 CodeCoverParent001.CodeCover000044 CodeCoverParent001.CodeCover000033 CodeCoverParent001.CodeCover000056 CodeCoverParent001.CodeCover000045 CodeCoverParent001.CodeCover000034 CodeCoverParent001.CodeCover000057 CodeCoverParent001.CodeCover000046 CodeCoverParent001.CodeCover000035 CodeCoverParent001.CodeCover000058 CodeCoverParent001.CodeCover000047 CodeCoverParent001.CodeCover000036 CodeCoverParent001.CodeCover000059 CodeCoverParent001.CodeCover000048 CodeCoverParent001.CodeCover000037 CodeCoverParent001.CodeCover000049 CodeCoverParent001.CodeCover000038 CodeCoverParent001.CodeCover000039 CodeCoverParent002 CodeCoverParent002.CodeCover000090 CodeCoverParent002.CodeCover000091 CodeCoverParent002.CodeCover000080 CodeCoverParent002.CodeCover000092 CodeCoverParent002.CodeCover000081 CodeCoverParent002.CodeCover000070 CodeCoverParent002.CodeCover000093 CodeCoverParent002.CodeCover000082 CodeCoverParent002.CodeCover000071 CodeCoverParent002.CodeCover000094 CodeCoverParent002.CodeCover000083 CodeCoverParent002.CodeCover000072 CodeCoverParent002.CodeCover000095 CodeCoverParent002.CodeCover000084 CodeCoverParent002.CodeCover000073 CodeCoverParent002.CodeCover000085 CodeCoverParent002.CodeCover000074 CodeCoverParent002.CodeCover000086 CodeCoverParent002.CodeCover000075 CodeCoverParent002.CodeCover000064 CodeCoverParent002.CodeCover000087 CodeCoverParent002.CodeCover000076 CodeCoverParent002.CodeCover000065 CodeCoverParent002.CodeCover000088 CodeCoverParent002.CodeCover000077 CodeCoverParent002.CodeCover000066 CodeCoverParent002.CodeCover000089 CodeCoverParent002.CodeCover000078 CodeCoverParent002.CodeCover000067 CodeCoverParent002.CodeCover000079 CodeCoverParent002.CodeCover000068 CodeCoverParent002.CodeCover000069 CodeCoverParent003 CodeCoverParent003.CodeCover000117 CodeCoverParent003.CodeCover000106 CodeCoverParent003.CodeCover000118 CodeCoverParent003.CodeCover000107 CodeCoverParent003.CodeCover000119 CodeCoverParent003.CodeCover000108 CodeCoverParent003.CodeCover000109 CodeCoverParent003.CodeCover000096 CodeCoverParent003.CodeCover000097 CodeCoverParent003.CodeCover000120 CodeCoverParent003.CodeCover000098 CodeCoverParent003.CodeCover000121 CodeCoverParent003.CodeCover000110 CodeCoverParent003.CodeCover000099 CodeCoverParent003.CodeCover000122 CodeCoverParent003.CodeCover000111 CodeCoverParent003.CodeCover000100 CodeCoverParent003.CodeCover000123 CodeCoverParent003.CodeCover000112 CodeCoverParent003.CodeCover000101 CodeCoverParent003.CodeCover000124 CodeCoverParent003.CodeCover000113 CodeCoverParent003.CodeCover000102 CodeCoverParent003.CodeCover000125 CodeCoverParent003.CodeCover000114 CodeCoverParent003.CodeCover000103 CodeCoverParent003.CodeCover000126 CodeCoverParent003.CodeCover000115 CodeCoverParent003.CodeCover000104 CodeCoverParent003.CodeCover000127 CodeCoverParent003.CodeCover000116 CodeCoverParent003.CodeCover000105 CodeCoverParent004 CodeCoverParent004.CodeCover000128 CodeCoverParent004.CodeCover000129 CodeCoverParent004.CodeCover000130 CodeCoverParent004.CodeCover000131 CodeCoverParent004.CodeCover000132 CodeCoverParent004.CodeCover000133 CodeCoverParent004.CodeCover000134 CodeCoverParent004.CodeCover000135 CodeCoverParent004.CodeCover000136 CodeCoverParent004.CodeCover000137 /end OUT_MEASUREMENT
/end FUNCTION
/begin FUNCTION Coil1_Neg_Ovr_Override "" /begin DEF_CHARACTERISTIC Coil1_Neg_Ovr_new Coil1_Neg_Ovr_ovr /end DEF_CHARACTERISTIC /end FUNCTION
/begin FUNCTION Contactors_1 ""
 /begin OUT_MEASUREMENT Coil1_Neg_Prb Coil1_Pos_Prb Coil2_Pos_Prb Coil3_Pos_Prb PreCharge_Duty_Cycle_Prb PreCharge_Enable_Prb PreCharge_Freq_Prb /end OUT_MEASUREMENT
 /begin SUB_FUNCTION Coil1_Neg_Ovr_Override Coil1_Pos_Ovr_Override Coil2_Pos_Ovr_Override Coil3_Pos_Ovr_Override PreCharge_Duty_Cyle_Ovr_Override PreCharge_Enable_Ovr_Override PreCharge_Freq_Ovr_Override /end SUB_FUNCTION
/end FUNCTION
/begin FUNCTION Coil1_Pos_Ovr_Override "" /begin DEF_CHARACTERISTIC Coil1_Pos_Ovr_new Coil1_Pos_Ovr_ovr /end DEF_CHARACTERISTIC /end FUNCTION
/begin FUNCTION Coil2_Pos_Ovr_Override "" /begin DEF_CHARACTERISTIC Coil2_Pos_Ovr_new Coil2_Pos_Ovr_ovr /end DEF_CHARACTERISTIC /end FUNCTION
/begin FUNCTION Coil3_Pos_Ovr_Override "" /begin DEF_CHARACTERISTIC Coil3_Pos_Ovr_new Coil3_Pos_Ovr_ovr /end DEF_CHARACTERISTIC /end FUNCTION
/begin FUNCTION CoolantTemperature_Ovr_Override "" /begin DEF_CHARACTERISTIC CoolantTemperature_Ovr_new CoolantTemperature_Ovr_ovr /end DEF_CHARACTERISTIC /end FUNCTION
/begin FUNCTION Performance ""
 /begin OUT_MEASUREMENT CPUIdlePcent CPUTime_AppISR CPUTime_Bgnd CPUTime_CAN CPUTime_FgndAngle CPUTime_FgndTime CPUTime_MIOS CPUTime_Serial CPUTime_TimerISR CPUTime_TPU /end OUT_MEASUREMENT
/end FUNCTION
/begin FUNCTION Current_Ovr_Override "" /begin DEF_CHARACTERISTIC Current_Ovr_new Current_Ovr_ovr /end DEF_CHARACTERISTIC /end FUNCTION
/begin FUNCTION AMP_Clamp_1 "" /begin OUT_MEASUREMENT Current_Prb V5V_Reference_Prb /end OUT_MEASUREMENT /begin SUB_FUNCTION Current_Ovr_Override V5V_Reference_Ovr_Override /end SUB_FUNCTION /end FUNCTION
/begin FUNCTION SOC ""
 /begin DEF_CHARACTERISTIC highAmperage lowAmperage MotoHawkInterpolation2DMap SOCMapTbl Wait_time /end DEF_CHARACTERISTIC
 /begin OUT_MEASUREMENT currState_Prb IT_Table_Prb MotoHawkInterpolation2D SOC_Prb SOC_PreFilter_Prb SOC_TableIdx SOC_TableIn SOCMap Temp_IR_PreIdx Temp_IR_PreIn Volt_IR_PreIdx Volt_IR_PreIn /end OUT_MEASUREMENT
 /begin SUB_FUNCTION SOC_Conditioning SOC_Ovr_Override /end SUB_FUNCTION
/end FUNCTION
/begin FUNCTION Delay3 "" /begin DEF_CHARACTERISTIC Delay_3_Cal /end DEF_CHARACTERISTIC /end FUNCTION
/begin FUNCTION Battery_States "" /begin DEF_CHARACTERISTIC Delay3 Delay5 Precharge_Current_Threshold /end DEF_CHARACTERISTIC /begin OUT_MEASUREMENT PackState__Prb PreChargeState__Prb /end OUT_MEASUREMENT
 /begin SUB_FUNCTION Delay3 Delay5 PackState__Ovr_Override PrechargeState__Ovr_Override /end SUB_FUNCTION
/end FUNCTION
/begin FUNCTION Delay5 "" /begin DEF_CHARACTERISTIC Delay_5_Cal /end DEF_CHARACTERISTIC /end FUNCTION
/begin FUNCTION DiscreteOut ""
 /begin OUT_MEASUREMENT dout_create_DOut2268p0004 dout_create_DOut953p0001 dout_create_DOut954p0001 dout_create_DOut955p0001 dout_create_DOut956p0001 /end OUT_MEASUREMENT
/end FUNCTION
/begin FUNCTION DPI_RollingCounter_Ovr_Override "" /begin DEF_CHARACTERISTIC DPI_RollingCounter_Ovr_new DPI_RollingCounter_Ovr_ovr /end DEF_CHARACTERISTIC /end FUNCTION
/begin FUNCTION DutyCycle_Ovr_Override "" /begin DEF_CHARACTERISTIC DutyCycle_Ovr_new DutyCycle_Ovr_ovr /end DEF_CHARACTERISTIC /end FUNCTION
/begin FUNCTION Main_Power_Relay_Config "" /begin DEF_CHARACTERISTIC ECUP_Threshold /end DEF_CHARACTERISTIC /end FUNCTION
/begin FUNCTION Main_Power_Relay "" /begin DEF_CHARACTERISTIC MPRD_KeepAlive ProcessorReboot /end DEF_CHARACTERISTIC /begin OUT_MEASUREMENT MPRD /end OUT_MEASUREMENT /begin SUB_FUNCTION Main_Power_Relay_Config MPRD_Override /end SUB_FUNCTION /end FUNCTION
/begin FUNCTION FaultsDTC_Ovr_Override "" /begin DEF_CHARACTERISTIC FaultsDTC_Ovr_new FaultsDTC_Ovr_ovr /end DEF_CHARACTERISTIC /end FUNCTION
/begin FUNCTION Framework "" /begin OUT_MEASUREMENT FrameworkGlueErrors /end OUT_MEASUREMENT /end FUNCTION
/begin FUNCTION FreqEnd_Ovr_Override "" /begin DEF_CHARACTERISTIC FreqEnd_Ovr_new FreqEnd_Ovr_ovr /end DEF_CHARACTERISTIC /end FUNCTION
/begin FUNCTION FreqStart_Ovr_Override "" /begin DEF_CHARACTERISTIC FreqStart_Ovr_new FreqStart_Ovr_ovr /end DEF_CHARACTERISTIC /end FUNCTION
/begin FUNCTION HVIL_Status_Ovr_Override "" /begin DEF_CHARACTERISTIC HVIL_Status_Ovr_new HVIL_Status_Ovr_ovr /end DEF_CHARACTERISTIC /end FUNCTION
/begin FUNCTION IsolationLevel_Ovr_Override "" /begin DEF_CHARACTERISTIC IsolationLevel_Ovr_new IsolationLevel_Ovr_ovr /end DEF_CHARACTERISTIC /end FUNCTION
/begin FUNCTION IsolationStatus_Ovr_Override "" /begin DEF_CHARACTERISTIC IsolationStatus_Ovr_new IsolationStatus_Ovr_ovr /end DEF_CHARACTERISTIC /end FUNCTION
/begin FUNCTION JCS_PackIdentifier_Ovr_Override "" /begin DEF_CHARACTERISTIC JCS_PackIdentifier_Ovr_new JCS_PackIdentifier_Ovr_ovr /end DEF_CHARACTERISTIC /end FUNCTION
/begin FUNCTION MaxCellTemp_Ovr_Override "" /begin DEF_CHARACTERISTIC MaxCellTemp_Ovr_new MaxCellTemp_Ovr_ovr /end DEF_CHARACTERISTIC /end FUNCTION
/begin FUNCTION MaxCellTemperature_Ovr_Override "" /begin DEF_CHARACTERISTIC MaxCellTemperature_Ovr_new MaxCellTemperature_Ovr_ovr /end DEF_CHARACTERISTIC /end FUNCTION
/begin FUNCTION MaxCellVoltage__Ovr_Override "" /begin DEF_CHARACTERISTIC MaxCellVoltage__Ovr_new MaxCellVoltage__Ovr_ovr /end DEF_CHARACTERISTIC /end FUNCTION
/begin FUNCTION MaxCellVoltage_Ovr_Override "" /begin DEF_CHARACTERISTIC MaxCellVoltage_Ovr_new MaxCellVoltage_Ovr_ovr /end DEF_CHARACTERISTIC /end FUNCTION
/begin FUNCTION MaximumDischargePower_10s_Ovr_Override ""
 /begin DEF_CHARACTERISTIC MaximumDischargePower_10s_Ovr_new MaximumDischargePower_10s_Ovr_ovr /end DEF_CHARACTERISTIC
/end FUNCTION
/begin FUNCTION MaximumDischargePower_Continuos_Ovr_Override ""
 /begin DEF_CHARACTERISTIC MaximumDischargePower_Continuos_Ovr_new MaximumDischargePower_Continuos_Ovr_ovr /end DEF_CHARACTERISTIC
/end FUNCTION
/begin FUNCTION MaximumRegenPower_10s_Ovr_Override ""
 /begin DEF_CHARACTERISTIC MaximumRegenPower_10s_Ovr_new MaximumRegenPower_10s_Ovr_ovr /end DEF_CHARACTERISTIC
/end FUNCTION
/begin FUNCTION MaximumRegenPower_Continuous_Ovr_Override ""
 /begin DEF_CHARACTERISTIC MaximumRegenPower_Continuous_Ovr_new MaximumRegenPower_Continuous_Ovr_ovr /end DEF_CHARACTERISTIC
/end FUNCTION
/begin FUNCTION MIL_Status_Ovr_Override "" /begin DEF_CHARACTERISTIC MIL_Status_Ovr_new MIL_Status_Ovr_ovr /end DEF_CHARACTERISTIC /end FUNCTION
/begin FUNCTION MinCellTemp_Ovr_Override "" /begin DEF_CHARACTERISTIC MinCellTemp_Ovr_new MinCellTemp_Ovr_ovr /end DEF_CHARACTERISTIC /end FUNCTION
/begin FUNCTION MinCellTemperature_Ovr_Override "" /begin DEF_CHARACTERISTIC MinCellTemperature_Ovr_new MinCellTemperature_Ovr_ovr /end DEF_CHARACTERISTIC /end FUNCTION
/begin FUNCTION MinCellVoltage__Ovr_Override "" /begin DEF_CHARACTERISTIC MinCellVoltage__Ovr_new MinCellVoltage__Ovr_ovr /end DEF_CHARACTERISTIC /end FUNCTION
/begin FUNCTION MinCellVoltage_Ovr_Override "" /begin DEF_CHARACTERISTIC MinCellVoltage_Ovr_new MinCellVoltage_Ovr_ovr /end DEF_CHARACTERISTIC /end FUNCTION
/begin FUNCTION MPRD_Override "" /begin DEF_CHARACTERISTIC MPRD_new MPRD_ovr /end DEF_CHARACTERISTIC /end FUNCTION
/begin FUNCTION NonVolatile_Storage "" /begin DEF_CHARACTERISTIC RestoreNVFactoryDefaults StoreNV /end DEF_CHARACTERISTIC /begin OUT_MEASUREMENT NonVolatileCRC NonVolatileFormatID NonVolatileStatus /end OUT_MEASUREMENT /begin SUB_FUNCTION NonVolatile_Storage_Config /end SUB_FUNCTION /end FUNCTION
/begin FUNCTION NonVolatile_Storage_Config ""
 /begin DEF_CHARACTERISTIC NonVolatileRestoreOnFirstStartup NonVolatileRestoreOnStartup /end DEF_CHARACTERISTIC
/end FUNCTION
/begin FUNCTION PackState__Ovr_Override "" /begin DEF_CHARACTERISTIC PackState__Ovr_new PackState__Ovr_ovr /end DEF_CHARACTERISTIC /end FUNCTION
/begin FUNCTION PackState_Ovr_Override "" /begin DEF_CHARACTERISTIC PackState_Ovr_new PackState_Ovr_ovr /end DEF_CHARACTERISTIC /end FUNCTION
/begin FUNCTION PPL10s_RollingCounter_Ovr_Override ""
 /begin DEF_CHARACTERISTIC PPL10s_RollingCounter_Ovr_new PPL10s_RollingCounter_Ovr_ovr /end DEF_CHARACTERISTIC
/end FUNCTION
/begin FUNCTION PPLCont_RollingCounter_Ovr_Override ""
 /begin DEF_CHARACTERISTIC PPLCont_RollingCounter_Ovr_new PPLCont_RollingCounter_Ovr_ovr /end DEF_CHARACTERISTIC
/end FUNCTION
/begin FUNCTION PreCharge_Duty_Cyle_Ovr_Override "" /begin DEF_CHARACTERISTIC PreCharge_Duty_Cyle_Ovr_new PreCharge_Duty_Cyle_Ovr_ovr /end DEF_CHARACTERISTIC /end FUNCTION
/begin FUNCTION PreCharge_Enable_Ovr_Override "" /begin DEF_CHARACTERISTIC PreCharge_Enable_Ovr_new PreCharge_Enable_Ovr_ovr /end DEF_CHARACTERISTIC /end FUNCTION
/begin FUNCTION PreCharge_Freq_Ovr_Override "" /begin DEF_CHARACTERISTIC PreCharge_Freq_Ovr_new PreCharge_Freq_Ovr_ovr /end DEF_CHARACTERISTIC /end FUNCTION
/begin FUNCTION PrechargeState__Ovr_Override "" /begin DEF_CHARACTERISTIC PrechargeState__Ovr_new PrechargeState__Ovr_ovr /end DEF_CHARACTERISTIC /end FUNCTION
/begin FUNCTION PrechargeState_Ovr_Override "" /begin DEF_CHARACTERISTIC PrechargeState_Ovr_new PrechargeState_Ovr_ovr /end DEF_CHARACTERISTIC /end FUNCTION
/begin FUNCTION PS_RollingCounter_Ovr_Override "" /begin DEF_CHARACTERISTIC PS_RollingCounter_Ovr_new PS_RollingCounter_Ovr_ovr /end DEF_CHARACTERISTIC /end FUNCTION
/begin FUNCTION PVC_RollingCounter_Ovr_Override "" /begin DEF_CHARACTERISTIC PVC_RollingCounter_Ovr_new PVC_RollingCounter_Ovr_ovr /end DEF_CHARACTERISTIC /end FUNCTION
/begin FUNCTION PWM "" /begin OUT_MEASUREMENT pwm_create_EST1_PWMOutput pwm_set_EST1_PWMOutput /end OUT_MEASUREMENT /end FUNCTION
/begin FUNCTION Other "" /begin OUT_MEASUREMENT resource_allocation /end OUT_MEASUREMENT /end FUNCTION
/begin FUNCTION SleepInhibited_Ovr_Override "" /begin DEF_CHARACTERISTIC SleepInhibited_Ovr_new SleepInhibited_Ovr_ovr /end DEF_CHARACTERISTIC /end FUNCTION
/begin FUNCTION SOC_Conditioning "" /begin DEF_CHARACTERISTIC SOC_K /end DEF_CHARACTERISTIC /end FUNCTION
/begin FUNCTION SOC_Ovr_Override "" /begin DEF_CHARACTERISTIC SOC_Ovr_new SOC_Ovr_ovr /end DEF_CHARACTERISTIC /end FUNCTION
/begin FUNCTION StateOfCharge_Ovr_Override "" /begin DEF_CHARACTERISTIC StateOfCharge_Ovr_new StateOfCharge_Ovr_ovr /end DEF_CHARACTERISTIC /end FUNCTION
/begin FUNCTION StateOfChargeMax_Ovr_Override "" /begin DEF_CHARACTERISTIC StateOfChargeMax_Ovr_new StateOfChargeMax_Ovr_ovr /end DEF_CHARACTERISTIC /end FUNCTION
/begin FUNCTION StateOfChargeMin_Ovr_Override "" /begin DEF_CHARACTERISTIC StateOfChargeMin_Ovr_new StateOfChargeMin_Ovr_ovr /end DEF_CHARACTERISTIC /end FUNCTION
/begin FUNCTION TAH_RollingCounter_Ovr_Override "" /begin DEF_CHARACTERISTIC TAH_RollingCounter_Ovr_new TAH_RollingCounter_Ovr_ovr /end DEF_CHARACTERISTIC /end FUNCTION
/begin FUNCTION TrimpAmpHoursOut_Ovr_Override "" /begin DEF_CHARACTERISTIC TrimpAmpHoursOut_Ovr_new TrimpAmpHoursOut_Ovr_ovr /end DEF_CHARACTERISTIC /end FUNCTION
/begin FUNCTION TripAmpsHoursIn_Ovr_Override "" /begin DEF_CHARACTERISTIC TripAmpsHoursIn_Ovr_new TripAmpsHoursIn_Ovr_ovr /end DEF_CHARACTERISTIC /end FUNCTION
/begin FUNCTION V5V_Reference_Ovr_Override "" /begin DEF_CHARACTERISTIC V5V_Reference_Ovr_new V5V_Reference_Ovr_ovr /end DEF_CHARACTERISTIC /end FUNCTION
/begin FUNCTION Voltage_Ovr_Override "" /begin DEF_CHARACTERISTIC Voltage_Ovr_new Voltage_Ovr_ovr /end DEF_CHARACTERISTIC /end FUNCTION
/begin FUNCTION WakeSignal_Ovr_Override "" /begin DEF_CHARACTERISTIC WakeSignal_Ovr_new WakeSignal_Ovr_ovr /end DEF_CHARACTERISTIC /end FUNCTION
/end MODULE
/end PROJECT
