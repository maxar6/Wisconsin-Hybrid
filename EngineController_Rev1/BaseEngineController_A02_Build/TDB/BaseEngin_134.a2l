/******************************************************************************
* ASAP2 descrition file /
* Generated by Woodward ASAP2 Generator /
* This file was auto-generated on: Friday, September 7, 2018 11:03 AM /
******************************************************************************/
ASAP2_VERSION 1 51
/begin PROJECT Project ""
/begin MODULE BaseEngin_134 ""
/begin IF_DATA VISION DEVICE_SETTING "CCP=2.1_ASAP1b" DEVICE_SETTING "DefaultCRCType=5" /end IF_DATA
/begin IF_DATA ASAP1B_CCP
 /begin SOURCE "List 1" 0 0 DISPLAY_IDENTIFIER "DAQ1"
  /begin QP_BLOB 0 LENGTH 8 CAN_ID_FIXED 0x98EF3104 RASTER 0 REDUCTION_ALLOWED FIRST_PID 0 /end QP_BLOB
 /end SOURCE
 /begin SOURCE "List 2" 0 0 DISPLAY_IDENTIFIER "DAQ2"
  /begin QP_BLOB 1 LENGTH 8 CAN_ID_FIXED 0x98EF3104 RASTER 1 REDUCTION_ALLOWED FIRST_PID 8 /end QP_BLOB
 /end SOURCE
 /begin SOURCE "List 3" 0 0 DISPLAY_IDENTIFIER "DAQ3"
  /begin QP_BLOB 2 LENGTH 8 CAN_ID_FIXED 0x98EF3104 RASTER 2 REDUCTION_ALLOWED FIRST_PID 16 /end QP_BLOB
 /end SOURCE
 /begin SOURCE "List 4" 0 0 DISPLAY_IDENTIFIER "DAQ4"
  /begin QP_BLOB 3 LENGTH 8 CAN_ID_FIXED 0x98EF3104 RASTER 3 REDUCTION_ALLOWED FIRST_PID 24 /end QP_BLOB
 /end SOURCE
 /begin RASTER "FGND_RTI_PERIODIC" "FGND_RTI_PERIODIC" 0 3 5 /end RASTER
 /begin RASTER "FGND_2XRTI_PERIODIC" "FGND_2XRTI_PERIODIC" 1 3 10 /end RASTER
 /begin RASTER "FGND_10XRTI_PERIODIC" "FGND_10XRTI_PERIODIC" 2 3 50 /end RASTER
 /begin RASTER "FGND_20XRTI_PERIODIC" "FGND_20XRTI_PERIODIC" 3 3 100 /end RASTER
 /begin RASTER "BGND_BASE_PERIODIC" "BGND_BASE_PERIODIC" 4 3 50 /end RASTER
 /begin RASTER "BGND_BASEx2_PERIODIC" "BGND_BASEx2_PERIODIC" 5 3 100 /end RASTER
 /begin RASTER "BGND_BASEx10_PERIODIC" "BGND_BASEx10_PERIODIC" 6 3 500 /end RASTER
 /begin RASTER "ONE_SECOND_EVENT" "ONE_SECOND_EVENT" 7 3 1000 /end RASTER
 /* /begin SEED_KEY */ /* DLL for CAL */ /* Uncomment and supply a value "SecurityCAL.dll" */ /* DLL for DAQ */ /* Uncomment and supply a value "SecurityDAQ.dll" */ /* DLL for PGM */ /* Uncomment and supply a value "SecurityPGM.dll" */ /* /end SEED_KEY */
 /begin TP_BLOB /* CCP version */ 0x201 /* Blob version */ 0x204 /* CAN msg ID - send */ 0x98EF0233 /* CAN msg ID - recv */ 0x98EF3104 /* Station address */ 0x33 /* byte order */ 1 BAUDRATE 500000 SAMPLE_RATE 1 SAMPLE_POINT 75 BTL_CYCLES 8 SJW 2 SYNC_EDGE SINGLE DAQ_MODE BURST CONSISTENCY ODT ADDRESS_EXTENSION DAQ
  /begin CHECKSUM_PARAM /* algorithm */ 0x8009 /* limit */ 0x1000 CHECKSUM_CALCULATION ACTIVE_PAGE /end CHECKSUM_PARAM
  /begin DEFINED_PAGES /* Memory page num */ 1 /* Page Name */ "working page" /* address ext. */ 0x00 /* base address */ 0x80000000 /* page length */ 0x00004585 RAM /* memory page in RAM */ RAM_INIT_BY_ECU /* memory page is initialised by ECU start-up */ /end DEFINED_PAGES
  OPTIONAL_CMD 0x5 /* TEST */ OPTIONAL_CMD 0x8 /* START_STOP_ALL */ OPTIONAL_CMD 0xC /* SET_S_STATUS */ OPTIONAL_CMD 0xD /* GET_S_STATUS */ OPTIONAL_CMD 0xE /* BUILD_CHECKSUM */ OPTIONAL_CMD 0xF /* SHORT_UP */ OPTIONAL_CMD 0x12 /* GET_SEED */ OPTIONAL_CMD 0x13 /* UNLOCK */ OPTIONAL_CMD 0x23 /* DNLOAD_6 */ /end TP_BLOB
/end IF_DATA
/*~~~~~~~~~ 6.3.91 MOD_PAR ~~~~~~~~~*/
/begin MOD_PAR /* MOD_PAR Comment*/ "" ECU_CALIBRATION_OFFSET 0x00000000
 /begin MEMORY_SEGMENT CAL "" DATA FLASH INTERN 0x80000000 /* Size */ 0x00004585 /* Offset */ -1 -1 -1 -1 -1 /end MEMORY_SEGMENT
 /begin MEMORY_SEGMENT MeasRAM "" VARIABLES RAM INTERN 0x40000000 /* Size */ 0x00000A5E /* Offset */ -1 -1 -1 -1 -1 /end MEMORY_SEGMENT
/end MOD_PAR
/begin MOD_COMMON /* MOD_COMMON Comment */ "" BYTE_ORDER MSB_FIRST ALIGNMENT_BYTE 1 ALIGNMENT_FLOAT32_IEEE 1 ALIGNMENT_FLOAT64_IEEE 1 ALIGNMENT_LONG 1 ALIGNMENT_WORD 1 /end MOD_COMMON
/*~~~~~~~~~ 6.3.86 MEASUREMENTs ~~~~~~~~~*/
/begin MEASUREMENT table_0_rev "VarDec Table0 Revision Number" UBYTE CompuMethod_1 1 0 0 255 ECU_ADDRESS 0x40000000 /end MEASUREMENT
/begin MEASUREMENT table_1_rev "VarDec Table1 Revision Number" UBYTE CompuMethod_1 1 0 0 255 ECU_ADDRESS 0x40000001 /end MEASUREMENT
/begin MEASUREMENT table_2_rev "VarDec Table2 Revision Number" UBYTE CompuMethod_1 1 0 0 255 ECU_ADDRESS 0x40000002 /end MEASUREMENT
/begin MEASUREMENT KeyRev "This is the revision for the key protocol." UBYTE CompuMethod_1 1 0 0 255 ECU_ADDRESS 0x40000003 /end MEASUREMENT
/begin MEASUREMENT EriRev "This is the revision for the ERI protocol." UBYTE CompuMethod_1 1 0 0 255 ECU_ADDRESS 0x40000004 /end MEASUREMENT
/begin MEASUREMENT table_3_rev "VarDec Table3 Revision Number" UBYTE CompuMethod_1 1 0 0 255 ECU_ADDRESS 0x40000005 /end MEASUREMENT
/begin MEASUREMENT table_4_rev "VarDec Table4 Revision Number" UBYTE CompuMethod_1 1 0 0 255 ECU_ADDRESS 0x40000006 /end MEASUREMENT
/begin MEASUREMENT table_5_rev "VarDec Table5 Revision Number" UBYTE CompuMethod_1 1 0 0 255 ECU_ADDRESS 0x40000007 /end MEASUREMENT
/begin MEASUREMENT table_6_rev "VarDec Table6 Revision Number" UBYTE CompuMethod_1 1 0 0 255 ECU_ADDRESS 0x40000008 /end MEASUREMENT
/begin MEASUREMENT table_7_rev "VarDec Table7 Revision Number" UBYTE CompuMethod_1 1 0 0 255 ECU_ADDRESS 0x40000009 /end MEASUREMENT
/begin MEASUREMENT MotProgRev "This is the revision for the MOTPROG protocol." UBYTE CompuMethod_1 1 0 0 255 ECU_ADDRESS 0x40000049 /end MEASUREMENT
/begin MEASUREMENT BootVerMaj "" UBYTE CompuMethod_1 1 0 0 255 ECU_ADDRESS 0x4000004A /end MEASUREMENT
/begin MEASUREMENT BootVerMin "" UBYTE CompuMethod_1 1 0 0 255 ECU_ADDRESS 0x4000004B /end MEASUREMENT
/begin MEASUREMENT EcuHwMaj "" UBYTE CompuMethod_1 1 0 0 255 ECU_ADDRESS 0x4000004C /end MEASUREMENT
/begin MEASUREMENT EcuHwMin "" UBYTE CompuMethod_1 1 0 0 255 ECU_ADDRESS 0x4000004D /end MEASUREMENT
/begin MEASUREMENT ApplicationCompatibilityArr "Software Format ID" UWORD CompuMethod_2 1 0 0 65535 ECU_ADDRESS 0x4000004E MATRIX_DIM 1 50 1 /end MEASUREMENT
/begin MEASUREMENT AD_Input1_En_Prb "" FLOAT32_IEEE CompuMethod_2 1 0 -1E+17 1E+17 ECU_ADDRESS 0x40000116 /end MEASUREMENT
/begin MEASUREMENT AD_Input1_Vin_Prb "" FLOAT32_IEEE CompuMethod_2 1 0 -1E+17 1E+17 ECU_ADDRESS 0x4000011A /end MEASUREMENT
/begin MEASUREMENT AD_Input2_En_Prb "" FLOAT32_IEEE CompuMethod_2 1 0 -1E+17 1E+17 ECU_ADDRESS 0x4000011E /end MEASUREMENT
/begin MEASUREMENT AD_Input2_Vin_Prb "" FLOAT32_IEEE CompuMethod_2 1 0 -1E+17 1E+17 ECU_ADDRESS 0x40000122 /end MEASUREMENT
/begin MEASUREMENT An_PosSense1_Prb "" FLOAT32_IEEE CompuMethod_2 1 0 -1E+17 1E+17 ECU_ADDRESS 0x4000016C /end MEASUREMENT
/begin MEASUREMENT An_PosSense2_Prb "" FLOAT32_IEEE CompuMethod_2 1 0 -1E+17 1E+17 ECU_ADDRESS 0x40000170 /end MEASUREMENT
/begin MEASUREMENT Bus_HVIL_Status_Prb "" FLOAT32_IEEE CompuMethod_2 1 0 -1E+17 1E+17 ECU_ADDRESS 0x400001C8 /end MEASUREMENT
/begin MEASUREMENT ConfigVerMaj "" UBYTE CompuMethod_1 1 0 0 255 ECU_ADDRESS 0x40000271 /end MEASUREMENT
/begin MEASUREMENT ConfigVerMin "" UBYTE CompuMethod_1 1 0 0 255 ECU_ADDRESS 0x40000272 /end MEASUREMENT
/begin MEASUREMENT Control_Mode_Prb "" FLOAT32_IEEE CompuMethod_2 1 0 -1E+17 1E+17 ECU_ADDRESS 0x40000277 /end MEASUREMENT
/begin MEASUREMENT CtrlBoard_Temp_Prb "" FLOAT32_IEEE CompuMethod_2 1 0 -1E+17 1E+17 ECU_ADDRESS 0x400002E7 /end MEASUREMENT
/begin MEASUREMENT DigPos_Sens2_Prb "" FLOAT32_IEEE CompuMethod_2 1 0 -1E+17 1E+17 ECU_ADDRESS 0x40000302 /end MEASUREMENT
/begin MEASUREMENT DigPos_Sens3_Prb "" FLOAT32_IEEE CompuMethod_2 1 0 -1E+17 1E+17 ECU_ADDRESS 0x40000306 /end MEASUREMENT
/begin MEASUREMENT DigPos_Sens4_Prb "" FLOAT32_IEEE CompuMethod_2 1 0 -1E+17 1E+17 ECU_ADDRESS 0x4000030A /end MEASUREMENT
/begin MEASUREMENT DigPos_Sens5_Prb "" FLOAT32_IEEE CompuMethod_2 1 0 -1E+17 1E+17 ECU_ADDRESS 0x4000030E /end MEASUREMENT
/begin MEASUREMENT DPos_Sens1_Prb "" FLOAT32_IEEE CompuMethod_2 1 0 -1E+17 1E+17 ECU_ADDRESS 0x40000316 /end MEASUREMENT
/begin MEASUREMENT Drive_Temp_Prb "" FLOAT32_IEEE CompuMethod_2 1 0 -1E+17 1E+17 ECU_ADDRESS 0x4000031A /end MEASUREMENT
/begin MEASUREMENT Est_Absolute_Torque_Prb "" FLOAT32_IEEE CompuMethod_2 1 0 -1E+17 1E+17 ECU_ADDRESS 0x4000038C /end MEASUREMENT
/begin MEASUREMENT Est_Relative_Torque_Prb "" FLOAT32_IEEE CompuMethod_2 1 0 -1E+17 1E+17 ECU_ADDRESS 0x400003A0 /end MEASUREMENT
/begin MEASUREMENT Estimating_VBATT_Lv_Prb "" FLOAT32_IEEE CompuMethod_2 1 0 -1E+17 1E+17 ECU_ADDRESS 0x400003A7 /end MEASUREMENT
/begin MEASUREMENT FaultMarquees.FaultMarquees.Current_Suspected "Displays a rolling marquee for suspected, active and occurred faults." UBYTE CompuMethod_87 1 0 0 255 ECU_ADDRESS 0x4000043E /end MEASUREMENT
/begin MEASUREMENT FaultMarquees.FaultMarquees.Current_Active "Displays a rolling marquee for suspected, active and occurred faults." UBYTE CompuMethod_87 1 0 0 255 ECU_ADDRESS 0x4000043F /end MEASUREMENT
/begin MEASUREMENT FaultMarquees.FaultMarquees.Current_Occurred "Displays a rolling marquee for suspected, active and occurred faults." UBYTE CompuMethod_87 1 0 0 255 ECU_ADDRESS 0x40000440 /end MEASUREMENT
/begin MEASUREMENT Generating_Prb "" FLOAT32_IEEE CompuMethod_2 1 0 -1E+17 1E+17 ECU_ADDRESS 0x400004D0 /end MEASUREMENT
/begin MEASUREMENT GeneratingTq_Curve_Prb "" FLOAT32_IEEE CompuMethod_2 1 0 -1E+17 1E+17 ECU_ADDRESS 0x400004DC /end MEASUREMENT
/begin MEASUREMENT HVBus_Voltage_Prb "" FLOAT32_IEEE CompuMethod_2 1 0 -1E+17 1E+17 ECU_ADDRESS 0x400004E9 /end MEASUREMENT
/begin MEASUREMENT Keyed_Voltage_Prb "" FLOAT32_IEEE CompuMethod_2 1 0 -1E+17 1E+17 ECU_ADDRESS 0x4000058F /end MEASUREMENT
/begin MEASUREMENT LinkStatus "This is the Status of the Comms link." UBYTE CompuMethod_1 1 0 0 255 ECU_ADDRESS 0x4000059C /end MEASUREMENT
/begin MEASUREMENT ModuleCapability "" UBYTE CompuMethod_128 1 0 0 255 ECU_ADDRESS 0x40000695 /end MEASUREMENT
/begin MEASUREMENT MotoHawkModelSecondsInUse "Total runtime of this MotoHawk software model" ULONG CompuMethod_129 1 0 0 4294970000 ECU_ADDRESS 0x40000786 /end MEASUREMENT
/begin MEASUREMENT Motor_Estimated_HP "" FLOAT32_IEEE CompuMethod_2 1 0 -1E+17 1E+17 ECU_ADDRESS 0x4000080C /end MEASUREMENT
/begin MEASUREMENT Motor_Estimated_KW "" FLOAT32_IEEE CompuMethod_2 1 0 -1E+17 1E+17 ECU_ADDRESS 0x40000810 /end MEASUREMENT
/begin MEASUREMENT Motor_Speed_Prb "" FLOAT32_IEEE CompuMethod_2 1 0 -1E+17 1E+17 ECU_ADDRESS 0x40000814 /end MEASUREMENT
/begin MEASUREMENT Motor_Temp_Prb "" FLOAT32_IEEE CompuMethod_2 1 0 -1E+17 1E+17 ECU_ADDRESS 0x40000818 /end MEASUREMENT
/begin MEASUREMENT MotoringTq_Curve_Prb "" FLOAT32_IEEE CompuMethod_2 1 0 -1E+17 1E+17 ECU_ADDRESS 0x40000829 /end MEASUREMENT
/begin MEASUREMENT NegativeTq_Prb "" FLOAT32_IEEE CompuMethod_2 1 0 -1E+17 1E+17 ECU_ADDRESS 0x40000838 /end MEASUREMENT
/begin MEASUREMENT Phoenix_Fault_Prb "" FLOAT32_IEEE CompuMethod_2 1 0 -1E+17 1E+17 ECU_ADDRESS 0x400008D0 /end MEASUREMENT
/begin MEASUREMENT PWMOutput_State_Prb "" FLOAT32_IEEE CompuMethod_2 1 0 -1E+17 1E+17 ECU_ADDRESS 0x400008EA /end MEASUREMENT
/begin MEASUREMENT Run_Enable_Prb "" FLOAT32_IEEE CompuMethod_2 1 0 -1E+17 1E+17 ECU_ADDRESS 0x4000091E /end MEASUREMENT
/begin MEASUREMENT Status1_Age_Count_Prb "" ULONG CompuMethod_33 1 0 0 4294970000 ECU_ADDRESS 0x40000989 /end MEASUREMENT
/begin MEASUREMENT Status2_Age_Count_Prb "" ULONG CompuMethod_33 1 0 0 4294970000 ECU_ADDRESS 0x4000098D /end MEASUREMENT
/begin MEASUREMENT Status3_Age_Count_Prb "" ULONG CompuMethod_33 1 0 0 4294970000 ECU_ADDRESS 0x40000991 /end MEASUREMENT
/begin MEASUREMENT Status4_Age_Count_Prb "" ULONG CompuMethod_33 1 0 0 4294970000 ECU_ADDRESS 0x40000995 /end MEASUREMENT
/begin MEASUREMENT SystemFrequency "The operating CPU frequency." ULONG CompuMethod_160 1 0 0 56 ECU_ADDRESS 0x4000099A /end MEASUREMENT
/begin MEASUREMENT ThreePhase_HVIL_Status_Prb "" FLOAT32_IEEE CompuMethod_2 1 0 -1E+17 1E+17 ECU_ADDRESS 0x400009B4 /end MEASUREMENT
/begin MEASUREMENT TPUMaskType "Describes the TPU Mask selected for use." UBYTE CompuMethod_165 1 0 0 0 ECU_ADDRESS 0x40000A24 /end MEASUREMENT
/begin MEASUREMENT TPUMaskVers "Describes the version of the TPU Mask selected." UBYTE CompuMethod_38 1 0 0 255 ECU_ADDRESS 0x40000A25 /end MEASUREMENT
/begin MEASUREMENT TqLimiting_Reason_Prb "" FLOAT32_IEEE CompuMethod_2 1 0 -1E+17 1E+17 ECU_ADDRESS 0x40000A26 /end MEASUREMENT
/begin MEASUREMENT Unused "Unused Table Entry" UBYTE CompuMethod_1 1 0 0 255 ECU_ADDRESS 0x40000A2F /end MEASUREMENT
/begin MEASUREMENT XDRP_Internal_Meas_Prb "" FLOAT32_IEEE CompuMethod_2 1 0 -1E+17 1E+17 ECU_ADDRESS 0x40000A52 /end MEASUREMENT
/begin MEASUREMENT XDRP_State_Prb "" FLOAT32_IEEE CompuMethod_2 1 0 -1E+17 1E+17 ECU_ADDRESS 0x40000A56 /end MEASUREMENT
/*~~~~~~~~~ 6.3.27 CHARACTERISTICs ~~~~~~~~~*/
/begin CHARACTERISTIC project_id "This is the Platform ID used by the tools." VALUE 0x80004584 RecordLayout_1 0 CompuMethod_1 0 255 /end CHARACTERISTIC
/begin CHARACTERISTIC SwIdTxt "Software Format ID" ASCII 0x4000000A RecordLayout_2 0 CompuMethod_2 0 255 NUMBER 13 MATRIX_DIM 13 1 1 READ_ONLY /end CHARACTERISTIC
/begin CHARACTERISTIC CalIdTxt "Calibration ID" ASCII 0x80000002 RecordLayout_2 0 CompuMethod_2 0 255 NUMBER 33 MATRIX_DIM 33 1 1 /end CHARACTERISTIC
/begin CHARACTERISTIC SwRevisionTxt "Software Revision ID" ASCII 0x40000017 RecordLayout_2 0 CompuMethod_2 0 255 NUMBER 50 MATRIX_DIM 50 1 1 READ_ONLY /end CHARACTERISTIC
/begin CHARACTERISTIC FriendlyName "The device's friendly name." ASCII 0x8000002C RecordLayout_2 0 CompuMethod_2 0 255 NUMBER 33 MATRIX_DIM 33 1 1 /end CHARACTERISTIC
/begin CHARACTERISTIC ProductID "Customer's ID used by the tools." VALUE 0x8000004D RecordLayout_3 0 CompuMethod_3 0 4294970000 /end CHARACTERISTIC
/begin CHARACTERISTIC SerialNumber "" ASCII 0x400000B2 RecordLayout_2 0 CompuMethod_2 0 255 NUMBER 50 MATRIX_DIM 50 1 1 READ_ONLY /end CHARACTERISTIC
/begin CHARACTERISTIC ModelNumber "" ASCII 0x400000E4 RecordLayout_2 0 CompuMethod_2 0 255 NUMBER 50 MATRIX_DIM 50 1 1 READ_ONLY /end CHARACTERISTIC
/begin CHARACTERISTIC AD_Input1_En_Ovr_new "" VALUE 0x80000051 RecordLayout_4 0 CompuMethod_2 -1E+17 1E+17 /end CHARACTERISTIC
/begin CHARACTERISTIC AD_Input1_En_Ovr_ovr "" VALUE 0x80000055 RecordLayout_1 0 CompuMethod_4 0 1 /end CHARACTERISTIC
/begin CHARACTERISTIC CompilerVersion "Compiler toolchain version used for the MotoHawk build" ASCII 0x40000221 RecordLayout_2 0 CompuMethod_2 0 255 NUMBER 80 MATRIX_DIM 80 1 1 READ_ONLY /end CHARACTERISTIC
/begin CHARACTERISTIC ControlCoreSDKRelease "ControlCoreSDK Build." ASCII 0x4000027B RecordLayout_2 0 CompuMethod_2 0 255 NUMBER 50 MATRIX_DIM 50 1 1 READ_ONLY /end CHARACTERISTIC
/begin CHARACTERISTIC FaultCommand "Select a command to control the fault manager." VALUE 0x800017EB RecordLayout_1 0 CompuMethod_88 0 255 /end CHARACTERISTIC
/begin CHARACTERISTIC FaultManager.CAN_Timeout_112.Mode "Fault manager configuration.  Select up to 4 actions for each fault." VALUE 0x800017EC RecordLayout_7 0 CompuMethod_89 0 65535 /end CHARACTERISTIC
/begin CHARACTERISTIC FaultManager.CAN_Timeout_112.ID "Fault manager configuration.  Select up to 4 actions for each fault." VALUE 0x800017EE RecordLayout_7 0 CompuMethod_1 0 65535 /end CHARACTERISTIC
/begin CHARACTERISTIC FaultManager.CAN_Timeout_112.Test "Fault manager configuration.  Select up to 4 actions for each fault." VALUE 0x800017F0 RecordLayout_7 0 CompuMethod_90 0 65535 /end CHARACTERISTIC
/begin CHARACTERISTIC FaultManager.CAN_Timeout_112.Faulty_Samples__X_ "Fault manager configuration.  Select up to 4 actions for each fault." VALUE 0x800017F2 RecordLayout_7 0 CompuMethod_1 0 65535 /end CHARACTERISTIC
/begin CHARACTERISTIC FaultManager.CAN_Timeout_112.Total_Samples__Y_ "Fault manager configuration.  Select up to 4 actions for each fault." VALUE 0x800017F4 RecordLayout_7 0 CompuMethod_1 0 65535 /end CHARACTERISTIC
/begin CHARACTERISTIC FaultManager.CAN_Timeout_112.Action_1 "Fault manager configuration.  Select up to 4 actions for each fault." VALUE 0x800017F6 RecordLayout_7 0 CompuMethod_91 0 65535 /end CHARACTERISTIC
/begin CHARACTERISTIC FaultManager.CAN_Timeout_112.Action_1_Condition "Fault manager configuration.  Select up to 4 actions for each fault." VALUE 0x800017F8 RecordLayout_7 0 CompuMethod_92 0 65535 /end CHARACTERISTIC
/begin CHARACTERISTIC FaultManager.CAN_Timeout_112.Action_2 "Fault manager configuration.  Select up to 4 actions for each fault." VALUE 0x800017FA RecordLayout_7 0 CompuMethod_91 0 65535 /end CHARACTERISTIC
/begin CHARACTERISTIC FaultManager.CAN_Timeout_112.Action_2_Condition "Fault manager configuration.  Select up to 4 actions for each fault." VALUE 0x800017FC RecordLayout_7 0 CompuMethod_92 0 65535 /end CHARACTERISTIC
/begin CHARACTERISTIC FaultManager.CAN_Timeout_112.Action_3 "Fault manager configuration.  Select up to 4 actions for each fault." VALUE 0x800017FE RecordLayout_7 0 CompuMethod_91 0 65535 /end CHARACTERISTIC
/begin CHARACTERISTIC FaultManager.CAN_Timeout_112.Action_3_Condition "Fault manager configuration.  Select up to 4 actions for each fault." VALUE 0x80001800 RecordLayout_7 0 CompuMethod_92 0 65535 /end CHARACTERISTIC
/begin CHARACTERISTIC FaultManager.CAN_Timeout_112.Action_4 "Fault manager configuration.  Select up to 4 actions for each fault." VALUE 0x80001802 RecordLayout_7 0 CompuMethod_91 0 65535 /end CHARACTERISTIC
/begin CHARACTERISTIC FaultManager.CAN_Timeout_112.Action_4_Condition "Fault manager configuration.  Select up to 4 actions for each fault." VALUE 0x80001804 RecordLayout_7 0 CompuMethod_92 0 65535 /end CHARACTERISTIC
/begin CHARACTERISTIC FaultManager.CAN_Timeout_Phoenix_1.Mode "Fault manager configuration.  Select up to 4 actions for each fault." VALUE 0x80001806 RecordLayout_7 0 CompuMethod_89 0 65535 /end CHARACTERISTIC
/begin CHARACTERISTIC FaultManager.CAN_Timeout_Phoenix_1.ID "Fault manager configuration.  Select up to 4 actions for each fault." VALUE 0x80001808 RecordLayout_7 0 CompuMethod_1 0 65535 /end CHARACTERISTIC
/begin CHARACTERISTIC FaultManager.CAN_Timeout_Phoenix_1.Test "Fault manager configuration.  Select up to 4 actions for each fault." VALUE 0x8000180A RecordLayout_7 0 CompuMethod_90 0 65535 /end CHARACTERISTIC
/begin CHARACTERISTIC FaultManager.CAN_Timeout_Phoenix_1.Faulty_Samples__X_ "Fault manager configuration.  Select up to 4 actions for each fault." VALUE 0x8000180C RecordLayout_7 0 CompuMethod_1 0 65535 /end CHARACTERISTIC
/begin CHARACTERISTIC FaultManager.CAN_Timeout_Phoenix_1.Total_Samples__Y_ "Fault manager configuration.  Select up to 4 actions for each fault." VALUE 0x8000180E RecordLayout_7 0 CompuMethod_1 0 65535 /end CHARACTERISTIC
/begin CHARACTERISTIC FaultManager.CAN_Timeout_Phoenix_1.Action_1 "Fault manager configuration.  Select up to 4 actions for each fault." VALUE 0x80001810 RecordLayout_7 0 CompuMethod_91 0 65535 /end CHARACTERISTIC
/begin CHARACTERISTIC FaultManager.CAN_Timeout_Phoenix_1.Action_1_Condition "Fault manager configuration.  Select up to 4 actions for each fault." VALUE 0x80001812 RecordLayout_7 0 CompuMethod_92 0 65535 /end CHARACTERISTIC
/begin CHARACTERISTIC FaultManager.CAN_Timeout_Phoenix_1.Action_2 "Fault manager configuration.  Select up to 4 actions for each fault." VALUE 0x80001814 RecordLayout_7 0 CompuMethod_91 0 65535 /end CHARACTERISTIC
/begin CHARACTERISTIC FaultManager.CAN_Timeout_Phoenix_1.Action_2_Condition "Fault manager configuration.  Select up to 4 actions for each fault." VALUE 0x80001816 RecordLayout_7 0 CompuMethod_92 0 65535 /end CHARACTERISTIC
/begin CHARACTERISTIC FaultManager.CAN_Timeout_Phoenix_1.Action_3 "Fault manager configuration.  Select up to 4 actions for each fault." VALUE 0x80001818 RecordLayout_7 0 CompuMethod_91 0 65535 /end CHARACTERISTIC
/begin CHARACTERISTIC FaultManager.CAN_Timeout_Phoenix_1.Action_3_Condition "Fault manager configuration.  Select up to 4 actions for each fault." VALUE 0x8000181A RecordLayout_7 0 CompuMethod_92 0 65535 /end CHARACTERISTIC
/begin CHARACTERISTIC FaultManager.CAN_Timeout_Phoenix_1.Action_4 "Fault manager configuration.  Select up to 4 actions for each fault." VALUE 0x8000181C RecordLayout_7 0 CompuMethod_91 0 65535 /end CHARACTERISTIC
/begin CHARACTERISTIC FaultManager.CAN_Timeout_Phoenix_1.Action_4_Condition "Fault manager configuration.  Select up to 4 actions for each fault." VALUE 0x8000181E RecordLayout_7 0 CompuMethod_92 0 65535 /end CHARACTERISTIC
/begin CHARACTERISTIC FaultManager.CAN_Timeout_Phoenix_2.Mode "Fault manager configuration.  Select up to 4 actions for each fault." VALUE 0x80001820 RecordLayout_7 0 CompuMethod_89 0 65535 /end CHARACTERISTIC
/begin CHARACTERISTIC FaultManager.CAN_Timeout_Phoenix_2.ID "Fault manager configuration.  Select up to 4 actions for each fault." VALUE 0x80001822 RecordLayout_7 0 CompuMethod_1 0 65535 /end CHARACTERISTIC
/begin CHARACTERISTIC FaultManager.CAN_Timeout_Phoenix_2.Test "Fault manager configuration.  Select up to 4 actions for each fault." VALUE 0x80001824 RecordLayout_7 0 CompuMethod_90 0 65535 /end CHARACTERISTIC
/begin CHARACTERISTIC FaultManager.CAN_Timeout_Phoenix_2.Faulty_Samples__X_ "Fault manager configuration.  Select up to 4 actions for each fault." VALUE 0x80001826 RecordLayout_7 0 CompuMethod_1 0 65535 /end CHARACTERISTIC
/begin CHARACTERISTIC FaultManager.CAN_Timeout_Phoenix_2.Total_Samples__Y_ "Fault manager configuration.  Select up to 4 actions for each fault." VALUE 0x80001828 RecordLayout_7 0 CompuMethod_1 0 65535 /end CHARACTERISTIC
/begin CHARACTERISTIC FaultManager.CAN_Timeout_Phoenix_2.Action_1 "Fault manager configuration.  Select up to 4 actions for each fault." VALUE 0x8000182A RecordLayout_7 0 CompuMethod_91 0 65535 /end CHARACTERISTIC
/begin CHARACTERISTIC FaultManager.CAN_Timeout_Phoenix_2.Action_1_Condition "Fault manager configuration.  Select up to 4 actions for each fault." VALUE 0x8000182C RecordLayout_7 0 CompuMethod_92 0 65535 /end CHARACTERISTIC
/begin CHARACTERISTIC FaultManager.CAN_Timeout_Phoenix_2.Action_2 "Fault manager configuration.  Select up to 4 actions for each fault." VALUE 0x8000182E RecordLayout_7 0 CompuMethod_91 0 65535 /end CHARACTERISTIC
/begin CHARACTERISTIC FaultManager.CAN_Timeout_Phoenix_2.Action_2_Condition "Fault manager configuration.  Select up to 4 actions for each fault." VALUE 0x80001830 RecordLayout_7 0 CompuMethod_92 0 65535 /end CHARACTERISTIC
/begin CHARACTERISTIC FaultManager.CAN_Timeout_Phoenix_2.Action_3 "Fault manager configuration.  Select up to 4 actions for each fault." VALUE 0x80001832 RecordLayout_7 0 CompuMethod_91 0 65535 /end CHARACTERISTIC
/begin CHARACTERISTIC FaultManager.CAN_Timeout_Phoenix_2.Action_3_Condition "Fault manager configuration.  Select up to 4 actions for each fault." VALUE 0x80001834 RecordLayout_7 0 CompuMethod_92 0 65535 /end CHARACTERISTIC
/begin CHARACTERISTIC FaultManager.CAN_Timeout_Phoenix_2.Action_4 "Fault manager configuration.  Select up to 4 actions for each fault." VALUE 0x80001836 RecordLayout_7 0 CompuMethod_91 0 65535 /end CHARACTERISTIC
/begin CHARACTERISTIC FaultManager.CAN_Timeout_Phoenix_2.Action_4_Condition "Fault manager configuration.  Select up to 4 actions for each fault." VALUE 0x80001838 RecordLayout_7 0 CompuMethod_92 0 65535 /end CHARACTERISTIC
/begin CHARACTERISTIC FaultManager.CAN_Timeout_Phoenix_3.Mode "Fault manager configuration.  Select up to 4 actions for each fault." VALUE 0x8000183A RecordLayout_7 0 CompuMethod_89 0 65535 /end CHARACTERISTIC
/begin CHARACTERISTIC FaultManager.CAN_Timeout_Phoenix_3.ID "Fault manager configuration.  Select up to 4 actions for each fault." VALUE 0x8000183C RecordLayout_7 0 CompuMethod_1 0 65535 /end CHARACTERISTIC
/begin CHARACTERISTIC FaultManager.CAN_Timeout_Phoenix_3.Test "Fault manager configuration.  Select up to 4 actions for each fault." VALUE 0x8000183E RecordLayout_7 0 CompuMethod_90 0 65535 /end CHARACTERISTIC
/begin CHARACTERISTIC FaultManager.CAN_Timeout_Phoenix_3.Faulty_Samples__X_ "Fault manager configuration.  Select up to 4 actions for each fault." VALUE 0x80001840 RecordLayout_7 0 CompuMethod_1 0 65535 /end CHARACTERISTIC
/begin CHARACTERISTIC FaultManager.CAN_Timeout_Phoenix_3.Total_Samples__Y_ "Fault manager configuration.  Select up to 4 actions for each fault." VALUE 0x80001842 RecordLayout_7 0 CompuMethod_1 0 65535 /end CHARACTERISTIC
/begin CHARACTERISTIC FaultManager.CAN_Timeout_Phoenix_3.Action_1 "Fault manager configuration.  Select up to 4 actions for each fault." VALUE 0x80001844 RecordLayout_7 0 CompuMethod_91 0 65535 /end CHARACTERISTIC
/begin CHARACTERISTIC FaultManager.CAN_Timeout_Phoenix_3.Action_1_Condition "Fault manager configuration.  Select up to 4 actions for each fault." VALUE 0x80001846 RecordLayout_7 0 CompuMethod_92 0 65535 /end CHARACTERISTIC
/begin CHARACTERISTIC FaultManager.CAN_Timeout_Phoenix_3.Action_2 "Fault manager configuration.  Select up to 4 actions for each fault." VALUE 0x80001848 RecordLayout_7 0 CompuMethod_91 0 65535 /end CHARACTERISTIC
/begin CHARACTERISTIC FaultManager.CAN_Timeout_Phoenix_3.Action_2_Condition "Fault manager configuration.  Select up to 4 actions for each fault." VALUE 0x8000184A RecordLayout_7 0 CompuMethod_92 0 65535 /end CHARACTERISTIC
/begin CHARACTERISTIC FaultManager.CAN_Timeout_Phoenix_3.Action_3 "Fault manager configuration.  Select up to 4 actions for each fault." VALUE 0x8000184C RecordLayout_7 0 CompuMethod_91 0 65535 /end CHARACTERISTIC
/begin CHARACTERISTIC FaultManager.CAN_Timeout_Phoenix_3.Action_3_Condition "Fault manager configuration.  Select up to 4 actions for each fault." VALUE 0x8000184E RecordLayout_7 0 CompuMethod_92 0 65535 /end CHARACTERISTIC
/begin CHARACTERISTIC FaultManager.CAN_Timeout_Phoenix_3.Action_4 "Fault manager configuration.  Select up to 4 actions for each fault." VALUE 0x80001850 RecordLayout_7 0 CompuMethod_91 0 65535 /end CHARACTERISTIC
/begin CHARACTERISTIC FaultManager.CAN_Timeout_Phoenix_3.Action_4_Condition "Fault manager configuration.  Select up to 4 actions for each fault." VALUE 0x80001852 RecordLayout_7 0 CompuMethod_92 0 65535 /end CHARACTERISTIC
/begin CHARACTERISTIC FaultManager.CAN_Timeout_Phoenix_4.Mode "Fault manager configuration.  Select up to 4 actions for each fault." VALUE 0x80001854 RecordLayout_7 0 CompuMethod_89 0 65535 /end CHARACTERISTIC
/begin CHARACTERISTIC FaultManager.CAN_Timeout_Phoenix_4.ID "Fault manager configuration.  Select up to 4 actions for each fault." VALUE 0x80001856 RecordLayout_7 0 CompuMethod_1 0 65535 /end CHARACTERISTIC
/begin CHARACTERISTIC FaultManager.CAN_Timeout_Phoenix_4.Test "Fault manager configuration.  Select up to 4 actions for each fault." VALUE 0x80001858 RecordLayout_7 0 CompuMethod_90 0 65535 /end CHARACTERISTIC
/begin CHARACTERISTIC FaultManager.CAN_Timeout_Phoenix_4.Faulty_Samples__X_ "Fault manager configuration.  Select up to 4 actions for each fault." VALUE 0x8000185A RecordLayout_7 0 CompuMethod_1 0 65535 /end CHARACTERISTIC
/begin CHARACTERISTIC FaultManager.CAN_Timeout_Phoenix_4.Total_Samples__Y_ "Fault manager configuration.  Select up to 4 actions for each fault." VALUE 0x8000185C RecordLayout_7 0 CompuMethod_1 0 65535 /end CHARACTERISTIC
/begin CHARACTERISTIC FaultManager.CAN_Timeout_Phoenix_4.Action_1 "Fault manager configuration.  Select up to 4 actions for each fault." VALUE 0x8000185E RecordLayout_7 0 CompuMethod_91 0 65535 /end CHARACTERISTIC
/begin CHARACTERISTIC FaultManager.CAN_Timeout_Phoenix_4.Action_1_Condition "Fault manager configuration.  Select up to 4 actions for each fault." VALUE 0x80001860 RecordLayout_7 0 CompuMethod_92 0 65535 /end CHARACTERISTIC
/begin CHARACTERISTIC FaultManager.CAN_Timeout_Phoenix_4.Action_2 "Fault manager configuration.  Select up to 4 actions for each fault." VALUE 0x80001862 RecordLayout_7 0 CompuMethod_91 0 65535 /end CHARACTERISTIC
/begin CHARACTERISTIC FaultManager.CAN_Timeout_Phoenix_4.Action_2_Condition "Fault manager configuration.  Select up to 4 actions for each fault." VALUE 0x80001864 RecordLayout_7 0 CompuMethod_92 0 65535 /end CHARACTERISTIC
/begin CHARACTERISTIC FaultManager.CAN_Timeout_Phoenix_4.Action_3 "Fault manager configuration.  Select up to 4 actions for each fault." VALUE 0x80001866 RecordLayout_7 0 CompuMethod_91 0 65535 /end CHARACTERISTIC
/begin CHARACTERISTIC FaultManager.CAN_Timeout_Phoenix_4.Action_3_Condition "Fault manager configuration.  Select up to 4 actions for each fault." VALUE 0x80001868 RecordLayout_7 0 CompuMethod_92 0 65535 /end CHARACTERISTIC
/begin CHARACTERISTIC FaultManager.CAN_Timeout_Phoenix_4.Action_4 "Fault manager configuration.  Select up to 4 actions for each fault." VALUE 0x8000186A RecordLayout_7 0 CompuMethod_91 0 65535 /end CHARACTERISTIC
/begin CHARACTERISTIC FaultManager.CAN_Timeout_Phoenix_4.Action_4_Condition "Fault manager configuration.  Select up to 4 actions for each fault." VALUE 0x8000186C RecordLayout_7 0 CompuMethod_92 0 65535 /end CHARACTERISTIC
/begin CHARACTERISTIC FaultManager.CamEdgesFault.Mode "Fault manager configuration.  Select up to 4 actions for each fault." VALUE 0x8000186E RecordLayout_7 0 CompuMethod_89 0 65535 /end CHARACTERISTIC
/begin CHARACTERISTIC FaultManager.CamEdgesFault.ID "Fault manager configuration.  Select up to 4 actions for each fault." VALUE 0x80001870 RecordLayout_7 0 CompuMethod_1 0 65535 /end CHARACTERISTIC
/begin CHARACTERISTIC FaultManager.CamEdgesFault.Test "Fault manager configuration.  Select up to 4 actions for each fault." VALUE 0x80001872 RecordLayout_7 0 CompuMethod_90 0 65535 /end CHARACTERISTIC
/begin CHARACTERISTIC FaultManager.CamEdgesFault.Faulty_Samples__X_ "Fault manager configuration.  Select up to 4 actions for each fault." VALUE 0x80001874 RecordLayout_7 0 CompuMethod_1 0 65535 /end CHARACTERISTIC
/begin CHARACTERISTIC FaultManager.CamEdgesFault.Total_Samples__Y_ "Fault manager configuration.  Select up to 4 actions for each fault." VALUE 0x80001876 RecordLayout_7 0 CompuMethod_1 0 65535 /end CHARACTERISTIC
/begin CHARACTERISTIC FaultManager.CamEdgesFault.Action_1 "Fault manager configuration.  Select up to 4 actions for each fault." VALUE 0x80001878 RecordLayout_7 0 CompuMethod_91 0 65535 /end CHARACTERISTIC
/begin CHARACTERISTIC FaultManager.CamEdgesFault.Action_1_Condition "Fault manager configuration.  Select up to 4 actions for each fault." VALUE 0x8000187A RecordLayout_7 0 CompuMethod_92 0 65535 /end CHARACTERISTIC
/begin CHARACTERISTIC FaultManager.CamEdgesFault.Action_2 "Fault manager configuration.  Select up to 4 actions for each fault." VALUE 0x8000187C RecordLayout_7 0 CompuMethod_91 0 65535 /end CHARACTERISTIC
/begin CHARACTERISTIC FaultManager.CamEdgesFault.Action_2_Condition "Fault manager configuration.  Select up to 4 actions for each fault." VALUE 0x8000187E RecordLayout_7 0 CompuMethod_92 0 65535 /end CHARACTERISTIC
/begin CHARACTERISTIC FaultManager.CamEdgesFault.Action_3 "Fault manager configuration.  Select up to 4 actions for each fault." VALUE 0x80001880 RecordLayout_7 0 CompuMethod_91 0 65535 /end CHARACTERISTIC
/begin CHARACTERISTIC FaultManager.CamEdgesFault.Action_3_Condition "Fault manager configuration.  Select up to 4 actions for each fault." VALUE 0x80001882 RecordLayout_7 0 CompuMethod_92 0 65535 /end CHARACTERISTIC
/begin CHARACTERISTIC FaultManager.CamEdgesFault.Action_4 "Fault manager configuration.  Select up to 4 actions for each fault." VALUE 0x80001884 RecordLayout_7 0 CompuMethod_91 0 65535 /end CHARACTERISTIC
/begin CHARACTERISTIC FaultManager.CamEdgesFault.Action_4_Condition "Fault manager configuration.  Select up to 4 actions for each fault." VALUE 0x80001886 RecordLayout_7 0 CompuMethod_92 0 65535 /end CHARACTERISTIC
/begin CHARACTERISTIC FaultManager.CamSyncFault.Mode "Fault manager configuration.  Select up to 4 actions for each fault." VALUE 0x80001888 RecordLayout_7 0 CompuMethod_89 0 65535 /end CHARACTERISTIC
/begin CHARACTERISTIC FaultManager.CamSyncFault.ID "Fault manager configuration.  Select up to 4 actions for each fault." VALUE 0x8000188A RecordLayout_7 0 CompuMethod_1 0 65535 /end CHARACTERISTIC
/begin CHARACTERISTIC FaultManager.CamSyncFault.Test "Fault manager configuration.  Select up to 4 actions for each fault." VALUE 0x8000188C RecordLayout_7 0 CompuMethod_90 0 65535 /end CHARACTERISTIC
/begin CHARACTERISTIC FaultManager.CamSyncFault.Faulty_Samples__X_ "Fault manager configuration.  Select up to 4 actions for each fault." VALUE 0x8000188E RecordLayout_7 0 CompuMethod_1 0 65535 /end CHARACTERISTIC
/begin CHARACTERISTIC FaultManager.CamSyncFault.Total_Samples__Y_ "Fault manager configuration.  Select up to 4 actions for each fault." VALUE 0x80001890 RecordLayout_7 0 CompuMethod_1 0 65535 /end CHARACTERISTIC
/begin CHARACTERISTIC FaultManager.CamSyncFault.Action_1 "Fault manager configuration.  Select up to 4 actions for each fault." VALUE 0x80001892 RecordLayout_7 0 CompuMethod_91 0 65535 /end CHARACTERISTIC
/begin CHARACTERISTIC FaultManager.CamSyncFault.Action_1_Condition "Fault manager configuration.  Select up to 4 actions for each fault." VALUE 0x80001894 RecordLayout_7 0 CompuMethod_92 0 65535 /end CHARACTERISTIC
/begin CHARACTERISTIC FaultManager.CamSyncFault.Action_2 "Fault manager configuration.  Select up to 4 actions for each fault." VALUE 0x80001896 RecordLayout_7 0 CompuMethod_91 0 65535 /end CHARACTERISTIC
/begin CHARACTERISTIC FaultManager.CamSyncFault.Action_2_Condition "Fault manager configuration.  Select up to 4 actions for each fault." VALUE 0x80001898 RecordLayout_7 0 CompuMethod_92 0 65535 /end CHARACTERISTIC
/begin CHARACTERISTIC FaultManager.CamSyncFault.Action_3 "Fault manager configuration.  Select up to 4 actions for each fault." VALUE 0x8000189A RecordLayout_7 0 CompuMethod_91 0 65535 /end CHARACTERISTIC
/begin CHARACTERISTIC FaultManager.CamSyncFault.Action_3_Condition "Fault manager configuration.  Select up to 4 actions for each fault." VALUE 0x8000189C RecordLayout_7 0 CompuMethod_92 0 65535 /end CHARACTERISTIC
/begin CHARACTERISTIC FaultManager.CamSyncFault.Action_4 "Fault manager configuration.  Select up to 4 actions for each fault." VALUE 0x8000189E RecordLayout_7 0 CompuMethod_91 0 65535 /end CHARACTERISTIC
/begin CHARACTERISTIC FaultManager.CamSyncFault.Action_4_Condition "Fault manager configuration.  Select up to 4 actions for each fault." VALUE 0x800018A0 RecordLayout_7 0 CompuMethod_92 0 65535 /end CHARACTERISTIC
/begin CHARACTERISTIC FaultManager.CrankEdgesFault.Mode "Fault manager configuration.  Select up to 4 actions for each fault." VALUE 0x800018A2 RecordLayout_7 0 CompuMethod_89 0 65535 /end CHARACTERISTIC
/begin CHARACTERISTIC FaultManager.CrankEdgesFault.ID "Fault manager configuration.  Select up to 4 actions for each fault." VALUE 0x800018A4 RecordLayout_7 0 CompuMethod_1 0 65535 /end CHARACTERISTIC
/begin CHARACTERISTIC FaultManager.CrankEdgesFault.Test "Fault manager configuration.  Select up to 4 actions for each fault." VALUE 0x800018A6 RecordLayout_7 0 CompuMethod_90 0 65535 /end CHARACTERISTIC
/begin CHARACTERISTIC FaultManager.CrankEdgesFault.Faulty_Samples__X_ "Fault manager configuration.  Select up to 4 actions for each fault." VALUE 0x800018A8 RecordLayout_7 0 CompuMethod_1 0 65535 /end CHARACTERISTIC
/begin CHARACTERISTIC FaultManager.CrankEdgesFault.Total_Samples__Y_ "Fault manager configuration.  Select up to 4 actions for each fault." VALUE 0x800018AA RecordLayout_7 0 CompuMethod_1 0 65535 /end CHARACTERISTIC
/begin CHARACTERISTIC FaultManager.CrankEdgesFault.Action_1 "Fault manager configuration.  Select up to 4 actions for each fault." VALUE 0x800018AC RecordLayout_7 0 CompuMethod_91 0 65535 /end CHARACTERISTIC
/begin CHARACTERISTIC FaultManager.CrankEdgesFault.Action_1_Condition "Fault manager configuration.  Select up to 4 actions for each fault." VALUE 0x800018AE RecordLayout_7 0 CompuMethod_92 0 65535 /end CHARACTERISTIC
/begin CHARACTERISTIC FaultManager.CrankEdgesFault.Action_2 "Fault manager configuration.  Select up to 4 actions for each fault." VALUE 0x800018B0 RecordLayout_7 0 CompuMethod_91 0 65535 /end CHARACTERISTIC
/begin CHARACTERISTIC FaultManager.CrankEdgesFault.Action_2_Condition "Fault manager configuration.  Select up to 4 actions for each fault." VALUE 0x800018B2 RecordLayout_7 0 CompuMethod_92 0 65535 /end CHARACTERISTIC
/begin CHARACTERISTIC FaultManager.CrankEdgesFault.Action_3 "Fault manager configuration.  Select up to 4 actions for each fault." VALUE 0x800018B4 RecordLayout_7 0 CompuMethod_91 0 65535 /end CHARACTERISTIC
/begin CHARACTERISTIC FaultManager.CrankEdgesFault.Action_3_Condition "Fault manager configuration.  Select up to 4 actions for each fault." VALUE 0x800018B6 RecordLayout_7 0 CompuMethod_92 0 65535 /end CHARACTERISTIC
/begin CHARACTERISTIC FaultManager.CrankEdgesFault.Action_4 "Fault manager configuration.  Select up to 4 actions for each fault." VALUE 0x800018B8 RecordLayout_7 0 CompuMethod_91 0 65535 /end CHARACTERISTIC
/begin CHARACTERISTIC FaultManager.CrankEdgesFault.Action_4_Condition "Fault manager configuration.  Select up to 4 actions for each fault." VALUE 0x800018BA RecordLayout_7 0 CompuMethod_92 0 65535 /end CHARACTERISTIC
/begin CHARACTERISTIC FaultManager.CrankSyncFault.Mode "Fault manager configuration.  Select up to 4 actions for each fault." VALUE 0x800018BC RecordLayout_7 0 CompuMethod_89 0 65535 /end CHARACTERISTIC
/begin CHARACTERISTIC FaultManager.CrankSyncFault.ID "Fault manager configuration.  Select up to 4 actions for each fault." VALUE 0x800018BE RecordLayout_7 0 CompuMethod_1 0 65535 /end CHARACTERISTIC
/begin CHARACTERISTIC FaultManager.CrankSyncFault.Test "Fault manager configuration.  Select up to 4 actions for each fault." VALUE 0x800018C0 RecordLayout_7 0 CompuMethod_90 0 65535 /end CHARACTERISTIC
/begin CHARACTERISTIC FaultManager.CrankSyncFault.Faulty_Samples__X_ "Fault manager configuration.  Select up to 4 actions for each fault." VALUE 0x800018C2 RecordLayout_7 0 CompuMethod_1 0 65535 /end CHARACTERISTIC
/begin CHARACTERISTIC FaultManager.CrankSyncFault.Total_Samples__Y_ "Fault manager configuration.  Select up to 4 actions for each fault." VALUE 0x800018C4 RecordLayout_7 0 CompuMethod_1 0 65535 /end CHARACTERISTIC
/begin CHARACTERISTIC FaultManager.CrankSyncFault.Action_1 "Fault manager configuration.  Select up to 4 actions for each fault." VALUE 0x800018C6 RecordLayout_7 0 CompuMethod_91 0 65535 /end CHARACTERISTIC
/begin CHARACTERISTIC FaultManager.CrankSyncFault.Action_1_Condition "Fault manager configuration.  Select up to 4 actions for each fault." VALUE 0x800018C8 RecordLayout_7 0 CompuMethod_92 0 65535 /end CHARACTERISTIC
/begin CHARACTERISTIC FaultManager.CrankSyncFault.Action_2 "Fault manager configuration.  Select up to 4 actions for each fault." VALUE 0x800018CA RecordLayout_7 0 CompuMethod_91 0 65535 /end CHARACTERISTIC
/begin CHARACTERISTIC FaultManager.CrankSyncFault.Action_2_Condition "Fault manager configuration.  Select up to 4 actions for each fault." VALUE 0x800018CC RecordLayout_7 0 CompuMethod_92 0 65535 /end CHARACTERISTIC
/begin CHARACTERISTIC FaultManager.CrankSyncFault.Action_3 "Fault manager configuration.  Select up to 4 actions for each fault." VALUE 0x800018CE RecordLayout_7 0 CompuMethod_91 0 65535 /end CHARACTERISTIC
/begin CHARACTERISTIC FaultManager.CrankSyncFault.Action_3_Condition "Fault manager configuration.  Select up to 4 actions for each fault." VALUE 0x800018D0 RecordLayout_7 0 CompuMethod_92 0 65535 /end CHARACTERISTIC
/begin CHARACTERISTIC FaultManager.CrankSyncFault.Action_4 "Fault manager configuration.  Select up to 4 actions for each fault." VALUE 0x800018D2 RecordLayout_7 0 CompuMethod_91 0 65535 /end CHARACTERISTIC
/begin CHARACTERISTIC FaultManager.CrankSyncFault.Action_4_Condition "Fault manager configuration.  Select up to 4 actions for each fault." VALUE 0x800018D4 RecordLayout_7 0 CompuMethod_92 0 65535 /end CHARACTERISTIC
/begin CHARACTERISTIC FaultManager.Drive_Hot.Mode "Fault manager configuration.  Select up to 4 actions for each fault." VALUE 0x800018D6 RecordLayout_7 0 CompuMethod_89 0 65535 /end CHARACTERISTIC
/begin CHARACTERISTIC FaultManager.Drive_Hot.ID "Fault manager configuration.  Select up to 4 actions for each fault." VALUE 0x800018D8 RecordLayout_7 0 CompuMethod_1 0 65535 /end CHARACTERISTIC
/begin CHARACTERISTIC FaultManager.Drive_Hot.Test "Fault manager configuration.  Select up to 4 actions for each fault." VALUE 0x800018DA RecordLayout_7 0 CompuMethod_90 0 65535 /end CHARACTERISTIC
/begin CHARACTERISTIC FaultManager.Drive_Hot.Faulty_Samples__X_ "Fault manager configuration.  Select up to 4 actions for each fault." VALUE 0x800018DC RecordLayout_7 0 CompuMethod_1 0 65535 /end CHARACTERISTIC
/begin CHARACTERISTIC FaultManager.Drive_Hot.Total_Samples__Y_ "Fault manager configuration.  Select up to 4 actions for each fault." VALUE 0x800018DE RecordLayout_7 0 CompuMethod_1 0 65535 /end CHARACTERISTIC
/begin CHARACTERISTIC FaultManager.Drive_Hot.Action_1 "Fault manager configuration.  Select up to 4 actions for each fault." VALUE 0x800018E0 RecordLayout_7 0 CompuMethod_91 0 65535 /end CHARACTERISTIC
/begin CHARACTERISTIC FaultManager.Drive_Hot.Action_1_Condition "Fault manager configuration.  Select up to 4 actions for each fault." VALUE 0x800018E2 RecordLayout_7 0 CompuMethod_92 0 65535 /end CHARACTERISTIC
/begin CHARACTERISTIC FaultManager.Drive_Hot.Action_2 "Fault manager configuration.  Select up to 4 actions for each fault." VALUE 0x800018E4 RecordLayout_7 0 CompuMethod_91 0 65535 /end CHARACTERISTIC
/begin CHARACTERISTIC FaultManager.Drive_Hot.Action_2_Condition "Fault manager configuration.  Select up to 4 actions for each fault." VALUE 0x800018E6 RecordLayout_7 0 CompuMethod_92 0 65535 /end CHARACTERISTIC
/begin CHARACTERISTIC FaultManager.Drive_Hot.Action_3 "Fault manager configuration.  Select up to 4 actions for each fault." VALUE 0x800018E8 RecordLayout_7 0 CompuMethod_91 0 65535 /end CHARACTERISTIC
/begin CHARACTERISTIC FaultManager.Drive_Hot.Action_3_Condition "Fault manager configuration.  Select up to 4 actions for each fault." VALUE 0x800018EA RecordLayout_7 0 CompuMethod_92 0 65535 /end CHARACTERISTIC
/begin CHARACTERISTIC FaultManager.Drive_Hot.Action_4 "Fault manager configuration.  Select up to 4 actions for each fault." VALUE 0x800018EC RecordLayout_7 0 CompuMethod_91 0 65535 /end CHARACTERISTIC
/begin CHARACTERISTIC FaultManager.Drive_Hot.Action_4_Condition "Fault manager configuration.  Select up to 4 actions for each fault." VALUE 0x800018EE RecordLayout_7 0 CompuMethod_92 0 65535 /end CHARACTERISTIC
/begin CHARACTERISTIC FaultManager.Drive_Warm.Mode "Fault manager configuration.  Select up to 4 actions for each fault." VALUE 0x800018F0 RecordLayout_7 0 CompuMethod_89 0 65535 /end CHARACTERISTIC
/begin CHARACTERISTIC FaultManager.Drive_Warm.ID "Fault manager configuration.  Select up to 4 actions for each fault." VALUE 0x800018F2 RecordLayout_7 0 CompuMethod_1 0 65535 /end CHARACTERISTIC
/begin CHARACTERISTIC FaultManager.Drive_Warm.Test "Fault manager configuration.  Select up to 4 actions for each fault." VALUE 0x800018F4 RecordLayout_7 0 CompuMethod_90 0 65535 /end CHARACTERISTIC
/begin CHARACTERISTIC FaultManager.Drive_Warm.Faulty_Samples__X_ "Fault manager configuration.  Select up to 4 actions for each fault." VALUE 0x800018F6 RecordLayout_7 0 CompuMethod_1 0 65535 /end CHARACTERISTIC
/begin CHARACTERISTIC FaultManager.Drive_Warm.Total_Samples__Y_ "Fault manager configuration.  Select up to 4 actions for each fault." VALUE 0x800018F8 RecordLayout_7 0 CompuMethod_1 0 65535 /end CHARACTERISTIC
/begin CHARACTERISTIC FaultManager.Drive_Warm.Action_1 "Fault manager configuration.  Select up to 4 actions for each fault." VALUE 0x800018FA RecordLayout_7 0 CompuMethod_91 0 65535 /end CHARACTERISTIC
/begin CHARACTERISTIC FaultManager.Drive_Warm.Action_1_Condition "Fault manager configuration.  Select up to 4 actions for each fault." VALUE 0x800018FC RecordLayout_7 0 CompuMethod_92 0 65535 /end CHARACTERISTIC
/begin CHARACTERISTIC FaultManager.Drive_Warm.Action_2 "Fault manager configuration.  Select up to 4 actions for each fault." VALUE 0x800018FE RecordLayout_7 0 CompuMethod_91 0 65535 /end CHARACTERISTIC
/begin CHARACTERISTIC FaultManager.Drive_Warm.Action_2_Condition "Fault manager configuration.  Select up to 4 actions for each fault." VALUE 0x80001900 RecordLayout_7 0 CompuMethod_92 0 65535 /end CHARACTERISTIC
/begin CHARACTERISTIC FaultManager.Drive_Warm.Action_3 "Fault manager configuration.  Select up to 4 actions for each fault." VALUE 0x80001902 RecordLayout_7 0 CompuMethod_91 0 65535 /end CHARACTERISTIC
/begin CHARACTERISTIC FaultManager.Drive_Warm.Action_3_Condition "Fault manager configuration.  Select up to 4 actions for each fault." VALUE 0x80001904 RecordLayout_7 0 CompuMethod_92 0 65535 /end CHARACTERISTIC
/begin CHARACTERISTIC FaultManager.Drive_Warm.Action_4 "Fault manager configuration.  Select up to 4 actions for each fault." VALUE 0x80001906 RecordLayout_7 0 CompuMethod_91 0 65535 /end CHARACTERISTIC
/begin CHARACTERISTIC FaultManager.Drive_Warm.Action_4_Condition "Fault manager configuration.  Select up to 4 actions for each fault." VALUE 0x80001908 RecordLayout_7 0 CompuMethod_92 0 65535 /end CHARACTERISTIC
/begin CHARACTERISTIC FaultManager.ECTOverTempFault.Mode "Fault manager configuration.  Select up to 4 actions for each fault." VALUE 0x8000190A RecordLayout_7 0 CompuMethod_89 0 65535 /end CHARACTERISTIC
/begin CHARACTERISTIC FaultManager.ECTOverTempFault.ID "Fault manager configuration.  Select up to 4 actions for each fault." VALUE 0x8000190C RecordLayout_7 0 CompuMethod_1 0 65535 /end CHARACTERISTIC
/begin CHARACTERISTIC FaultManager.ECTOverTempFault.Test "Fault manager configuration.  Select up to 4 actions for each fault." VALUE 0x8000190E RecordLayout_7 0 CompuMethod_90 0 65535 /end CHARACTERISTIC
/begin CHARACTERISTIC FaultManager.ECTOverTempFault.Faulty_Samples__X_ "Fault manager configuration.  Select up to 4 actions for each fault." VALUE 0x80001910 RecordLayout_7 0 CompuMethod_1 0 65535 /end CHARACTERISTIC
/begin CHARACTERISTIC FaultManager.ECTOverTempFault.Total_Samples__Y_ "Fault manager configuration.  Select up to 4 actions for each fault." VALUE 0x80001912 RecordLayout_7 0 CompuMethod_1 0 65535 /end CHARACTERISTIC
/begin CHARACTERISTIC FaultManager.ECTOverTempFault.Action_1 "Fault manager configuration.  Select up to 4 actions for each fault." VALUE 0x80001914 RecordLayout_7 0 CompuMethod_91 0 65535 /end CHARACTERISTIC
/begin CHARACTERISTIC FaultManager.ECTOverTempFault.Action_1_Condition "Fault manager configuration.  Select up to 4 actions for each fault." VALUE 0x80001916 RecordLayout_7 0 CompuMethod_92 0 65535 /end CHARACTERISTIC
/begin CHARACTERISTIC FaultManager.ECTOverTempFault.Action_2 "Fault manager configuration.  Select up to 4 actions for each fault." VALUE 0x80001918 RecordLayout_7 0 CompuMethod_91 0 65535 /end CHARACTERISTIC
/begin CHARACTERISTIC FaultManager.ECTOverTempFault.Action_2_Condition "Fault manager configuration.  Select up to 4 actions for each fault." VALUE 0x8000191A RecordLayout_7 0 CompuMethod_92 0 65535 /end CHARACTERISTIC
/begin CHARACTERISTIC FaultManager.ECTOverTempFault.Action_3 "Fault manager configuration.  Select up to 4 actions for each fault." VALUE 0x8000191C RecordLayout_7 0 CompuMethod_91 0 65535 /end CHARACTERISTIC
/begin CHARACTERISTIC FaultManager.ECTOverTempFault.Action_3_Condition "Fault manager configuration.  Select up to 4 actions for each fault." VALUE 0x8000191E RecordLayout_7 0 CompuMethod_92 0 65535 /end CHARACTERISTIC
/begin CHARACTERISTIC FaultManager.ECTOverTempFault.Action_4 "Fault manager configuration.  Select up to 4 actions for each fault." VALUE 0x80001920 RecordLayout_7 0 CompuMethod_91 0 65535 /end CHARACTERISTIC
/begin CHARACTERISTIC FaultManager.ECTOverTempFault.Action_4_Condition "Fault manager configuration.  Select up to 4 actions for each fault." VALUE 0x80001922 RecordLayout_7 0 CompuMethod_92 0 65535 /end CHARACTERISTIC
/begin CHARACTERISTIC FaultManager.ECTRangeHigh.Mode "Fault manager configuration.  Select up to 4 actions for each fault." VALUE 0x80001924 RecordLayout_7 0 CompuMethod_89 0 65535 /end CHARACTERISTIC
/begin CHARACTERISTIC FaultManager.ECTRangeHigh.ID "Fault manager configuration.  Select up to 4 actions for each fault." VALUE 0x80001926 RecordLayout_7 0 CompuMethod_1 0 65535 /end CHARACTERISTIC
/begin CHARACTERISTIC FaultManager.ECTRangeHigh.Test "Fault manager configuration.  Select up to 4 actions for each fault." VALUE 0x80001928 RecordLayout_7 0 CompuMethod_90 0 65535 /end CHARACTERISTIC
/begin CHARACTERISTIC FaultManager.ECTRangeHigh.Faulty_Samples__X_ "Fault manager configuration.  Select up to 4 actions for each fault." VALUE 0x8000192A RecordLayout_7 0 CompuMethod_1 0 65535 /end CHARACTERISTIC
/begin CHARACTERISTIC FaultManager.ECTRangeHigh.Total_Samples__Y_ "Fault manager configuration.  Select up to 4 actions for each fault." VALUE 0x8000192C RecordLayout_7 0 CompuMethod_1 0 65535 /end CHARACTERISTIC
/begin CHARACTERISTIC FaultManager.ECTRangeHigh.Action_1 "Fault manager configuration.  Select up to 4 actions for each fault." VALUE 0x8000192E RecordLayout_7 0 CompuMethod_91 0 65535 /end CHARACTERISTIC
/begin CHARACTERISTIC FaultManager.ECTRangeHigh.Action_1_Condition "Fault manager configuration.  Select up to 4 actions for each fault." VALUE 0x80001930 RecordLayout_7 0 CompuMethod_92 0 65535 /end CHARACTERISTIC
/begin CHARACTERISTIC FaultManager.ECTRangeHigh.Action_2 "Fault manager configuration.  Select up to 4 actions for each fault." VALUE 0x80001932 RecordLayout_7 0 CompuMethod_91 0 65535 /end CHARACTERISTIC
/begin CHARACTERISTIC FaultManager.ECTRangeHigh.Action_2_Condition "Fault manager configuration.  Select up to 4 actions for each fault." VALUE 0x80001934 RecordLayout_7 0 CompuMethod_92 0 65535 /end CHARACTERISTIC
/begin CHARACTERISTIC FaultManager.ECTRangeHigh.Action_3 "Fault manager configuration.  Select up to 4 actions for each fault." VALUE 0x80001936 RecordLayout_7 0 CompuMethod_91 0 65535 /end CHARACTERISTIC
/begin CHARACTERISTIC FaultManager.ECTRangeHigh.Action_3_Condition "Fault manager configuration.  Select up to 4 actions for each fault." VALUE 0x80001938 RecordLayout_7 0 CompuMethod_92 0 65535 /end CHARACTERISTIC
/begin CHARACTERISTIC FaultManager.ECTRangeHigh.Action_4 "Fault manager configuration.  Select up to 4 actions for each fault." VALUE 0x8000193A RecordLayout_7 0 CompuMethod_91 0 65535 /end CHARACTERISTIC
/begin CHARACTERISTIC FaultManager.ECTRangeHigh.Action_4_Condition "Fault manager configuration.  Select up to 4 actions for each fault." VALUE 0x8000193C RecordLayout_7 0 CompuMethod_92 0 65535 /end CHARACTERISTIC
/begin CHARACTERISTIC FaultManager.ECTRangeLow.Mode "Fault manager configuration.  Select up to 4 actions for each fault." VALUE 0x8000193E RecordLayout_7 0 CompuMethod_89 0 65535 /end CHARACTERISTIC
/begin CHARACTERISTIC FaultManager.ECTRangeLow.ID "Fault manager configuration.  Select up to 4 actions for each fault." VALUE 0x80001940 RecordLayout_7 0 CompuMethod_1 0 65535 /end CHARACTERISTIC
/begin CHARACTERISTIC FaultManager.ECTRangeLow.Test "Fault manager configuration.  Select up to 4 actions for each fault." VALUE 0x80001942 RecordLayout_7 0 CompuMethod_90 0 65535 /end CHARACTERISTIC
/begin CHARACTERISTIC FaultManager.ECTRangeLow.Faulty_Samples__X_ "Fault manager configuration.  Select up to 4 actions for each fault." VALUE 0x80001944 RecordLayout_7 0 CompuMethod_1 0 65535 /end CHARACTERISTIC
/begin CHARACTERISTIC FaultManager.ECTRangeLow.Total_Samples__Y_ "Fault manager configuration.  Select up to 4 actions for each fault." VALUE 0x80001946 RecordLayout_7 0 CompuMethod_1 0 65535 /end CHARACTERISTIC
/begin CHARACTERISTIC FaultManager.ECTRangeLow.Action_1 "Fault manager configuration.  Select up to 4 actions for each fault." VALUE 0x80001948 RecordLayout_7 0 CompuMethod_91 0 65535 /end CHARACTERISTIC
/begin CHARACTERISTIC FaultManager.ECTRangeLow.Action_1_Condition "Fault manager configuration.  Select up to 4 actions for each fault." VALUE 0x8000194A RecordLayout_7 0 CompuMethod_92 0 65535 /end CHARACTERISTIC
/begin CHARACTERISTIC FaultManager.ECTRangeLow.Action_2 "Fault manager configuration.  Select up to 4 actions for each fault." VALUE 0x8000194C RecordLayout_7 0 CompuMethod_91 0 65535 /end CHARACTERISTIC
/begin CHARACTERISTIC FaultManager.ECTRangeLow.Action_2_Condition "Fault manager configuration.  Select up to 4 actions for each fault." VALUE 0x8000194E RecordLayout_7 0 CompuMethod_92 0 65535 /end CHARACTERISTIC
/begin CHARACTERISTIC FaultManager.ECTRangeLow.Action_3 "Fault manager configuration.  Select up to 4 actions for each fault." VALUE 0x80001950 RecordLayout_7 0 CompuMethod_91 0 65535 /end CHARACTERISTIC
/begin CHARACTERISTIC FaultManager.ECTRangeLow.Action_3_Condition "Fault manager configuration.  Select up to 4 actions for each fault." VALUE 0x80001952 RecordLayout_7 0 CompuMethod_92 0 65535 /end CHARACTERISTIC
/begin CHARACTERISTIC FaultManager.ECTRangeLow.Action_4 "Fault manager configuration.  Select up to 4 actions for each fault." VALUE 0x80001954 RecordLayout_7 0 CompuMethod_91 0 65535 /end CHARACTERISTIC
/begin CHARACTERISTIC FaultManager.ECTRangeLow.Action_4_Condition "Fault manager configuration.  Select up to 4 actions for each fault." VALUE 0x80001956 RecordLayout_7 0 CompuMethod_92 0 65535 /end CHARACTERISTIC
/begin CHARACTERISTIC FaultManager.ECTSevereOverTempFault.Mode "Fault manager configuration.  Select up to 4 actions for each fault." VALUE 0x80001958 RecordLayout_7 0 CompuMethod_89 0 65535 /end CHARACTERISTIC
/begin CHARACTERISTIC FaultManager.ECTSevereOverTempFault.ID "Fault manager configuration.  Select up to 4 actions for each fault." VALUE 0x8000195A RecordLayout_7 0 CompuMethod_1 0 65535 /end CHARACTERISTIC
/begin CHARACTERISTIC FaultManager.ECTSevereOverTempFault.Test "Fault manager configuration.  Select up to 4 actions for each fault." VALUE 0x8000195C RecordLayout_7 0 CompuMethod_90 0 65535 /end CHARACTERISTIC
/begin CHARACTERISTIC FaultManager.ECTSevereOverTempFault.Faulty_Samples__X_ "Fault manager configuration.  Select up to 4 actions for each fault." VALUE 0x8000195E RecordLayout_7 0 CompuMethod_1 0 65535 /end CHARACTERISTIC
/begin CHARACTERISTIC FaultManager.ECTSevereOverTempFault.Total_Samples__Y_ "Fault manager configuration.  Select up to 4 actions for each fault." VALUE 0x80001960 RecordLayout_7 0 CompuMethod_1 0 65535 /end CHARACTERISTIC
/begin CHARACTERISTIC FaultManager.ECTSevereOverTempFault.Action_1 "Fault manager configuration.  Select up to 4 actions for each fault." VALUE 0x80001962 RecordLayout_7 0 CompuMethod_91 0 65535 /end CHARACTERISTIC
/begin CHARACTERISTIC FaultManager.ECTSevereOverTempFault.Action_1_Condition "Fault manager configuration.  Select up to 4 actions for each fault." VALUE 0x80001964 RecordLayout_7 0 CompuMethod_92 0 65535 /end CHARACTERISTIC
/begin CHARACTERISTIC FaultManager.ECTSevereOverTempFault.Action_2 "Fault manager configuration.  Select up to 4 actions for each fault." VALUE 0x80001966 RecordLayout_7 0 CompuMethod_91 0 65535 /end CHARACTERISTIC
/begin CHARACTERISTIC FaultManager.ECTSevereOverTempFault.Action_2_Condition "Fault manager configuration.  Select up to 4 actions for each fault." VALUE 0x80001968 RecordLayout_7 0 CompuMethod_92 0 65535 /end CHARACTERISTIC
/begin CHARACTERISTIC FaultManager.ECTSevereOverTempFault.Action_3 "Fault manager configuration.  Select up to 4 actions for each fault." VALUE 0x8000196A RecordLayout_7 0 CompuMethod_91 0 65535 /end CHARACTERISTIC
/begin CHARACTERISTIC FaultManager.ECTSevereOverTempFault.Action_3_Condition "Fault manager configuration.  Select up to 4 actions for each fault." VALUE 0x8000196C RecordLayout_7 0 CompuMethod_92 0 65535 /end CHARACTERISTIC
/begin CHARACTERISTIC FaultManager.ECTSevereOverTempFault.Action_4 "Fault manager configuration.  Select up to 4 actions for each fault." VALUE 0x8000196E RecordLayout_7 0 CompuMethod_91 0 65535 /end CHARACTERISTIC
/begin CHARACTERISTIC FaultManager.ECTSevereOverTempFault.Action_4_Condition "Fault manager configuration.  Select up to 4 actions for each fault." VALUE 0x80001970 RecordLayout_7 0 CompuMethod_92 0 65535 /end CHARACTERISTIC
/begin CHARACTERISTIC FaultManager.EGRSenseRangeHigh.Mode "Fault manager configuration.  Select up to 4 actions for each fault." VALUE 0x80001972 RecordLayout_7 0 CompuMethod_89 0 65535 /end CHARACTERISTIC
/begin CHARACTERISTIC FaultManager.EGRSenseRangeHigh.ID "Fault manager configuration.  Select up to 4 actions for each fault." VALUE 0x80001974 RecordLayout_7 0 CompuMethod_1 0 65535 /end CHARACTERISTIC
/begin CHARACTERISTIC FaultManager.EGRSenseRangeHigh.Test "Fault manager configuration.  Select up to 4 actions for each fault." VALUE 0x80001976 RecordLayout_7 0 CompuMethod_90 0 65535 /end CHARACTERISTIC
/begin CHARACTERISTIC FaultManager.EGRSenseRangeHigh.Faulty_Samples__X_ "Fault manager configuration.  Select up to 4 actions for each fault." VALUE 0x80001978 RecordLayout_7 0 CompuMethod_1 0 65535 /end CHARACTERISTIC
/begin CHARACTERISTIC FaultManager.EGRSenseRangeHigh.Total_Samples__Y_ "Fault manager configuration.  Select up to 4 actions for each fault." VALUE 0x8000197A RecordLayout_7 0 CompuMethod_1 0 65535 /end CHARACTERISTIC
/begin CHARACTERISTIC FaultManager.EGRSenseRangeHigh.Action_1 "Fault manager configuration.  Select up to 4 actions for each fault." VALUE 0x8000197C RecordLayout_7 0 CompuMethod_91 0 65535 /end CHARACTERISTIC
/begin CHARACTERISTIC FaultManager.EGRSenseRangeHigh.Action_1_Condition "Fault manager configuration.  Select up to 4 actions for each fault." VALUE 0x8000197E RecordLayout_7 0 CompuMethod_92 0 65535 /end CHARACTERISTIC
/begin CHARACTERISTIC FaultManager.EGRSenseRangeHigh.Action_2 "Fault manager configuration.  Select up to 4 actions for each fault." VALUE 0x80001980 RecordLayout_7 0 CompuMethod_91 0 65535 /end CHARACTERISTIC
/begin CHARACTERISTIC FaultManager.EGRSenseRangeHigh.Action_2_Condition "Fault manager configuration.  Select up to 4 actions for each fault." VALUE 0x80001982 RecordLayout_7 0 CompuMethod_92 0 65535 /end CHARACTERISTIC
/begin CHARACTERISTIC FaultManager.EGRSenseRangeHigh.Action_3 "Fault manager configuration.  Select up to 4 actions for each fault." VALUE 0x80001984 RecordLayout_7 0 CompuMethod_91 0 65535 /end CHARACTERISTIC
/begin CHARACTERISTIC FaultManager.EGRSenseRangeHigh.Action_3_Condition "Fault manager configuration.  Select up to 4 actions for each fault." VALUE 0x80001986 RecordLayout_7 0 CompuMethod_92 0 65535 /end CHARACTERISTIC
/begin CHARACTERISTIC FaultManager.EGRSenseRangeHigh.Action_4 "Fault manager configuration.  Select up to 4 actions for each fault." VALUE 0x80001988 RecordLayout_7 0 CompuMethod_91 0 65535 /end CHARACTERISTIC
/begin CHARACTERISTIC FaultManager.EGRSenseRangeHigh.Action_4_Condition "Fault manager configuration.  Select up to 4 actions for each fault." VALUE 0x8000198A RecordLayout_7 0 CompuMethod_92 0 65535 /end CHARACTERISTIC
/begin CHARACTERISTIC FaultManager.EGRSenseRangeLow.Mode "Fault manager configuration.  Select up to 4 actions for each fault." VALUE 0x8000198C RecordLayout_7 0 CompuMethod_89 0 65535 /end CHARACTERISTIC
/begin CHARACTERISTIC FaultManager.EGRSenseRangeLow.ID "Fault manager configuration.  Select up to 4 actions for each fault." VALUE 0x8000198E RecordLayout_7 0 CompuMethod_1 0 65535 /end CHARACTERISTIC
/begin CHARACTERISTIC FaultManager.EGRSenseRangeLow.Test "Fault manager configuration.  Select up to 4 actions for each fault." VALUE 0x80001990 RecordLayout_7 0 CompuMethod_90 0 65535 /end CHARACTERISTIC
/begin CHARACTERISTIC FaultManager.EGRSenseRangeLow.Faulty_Samples__X_ "Fault manager configuration.  Select up to 4 actions for each fault." VALUE 0x80001992 RecordLayout_7 0 CompuMethod_1 0 65535 /end CHARACTERISTIC
/begin CHARACTERISTIC FaultManager.EGRSenseRangeLow.Total_Samples__Y_ "Fault manager configuration.  Select up to 4 actions for each fault." VALUE 0x80001994 RecordLayout_7 0 CompuMethod_1 0 65535 /end CHARACTERISTIC
/begin CHARACTERISTIC FaultManager.EGRSenseRangeLow.Action_1 "Fault manager configuration.  Select up to 4 actions for each fault." VALUE 0x80001996 RecordLayout_7 0 CompuMethod_91 0 65535 /end CHARACTERISTIC
/begin CHARACTERISTIC FaultManager.EGRSenseRangeLow.Action_1_Condition "Fault manager configuration.  Select up to 4 actions for each fault." VALUE 0x80001998 RecordLayout_7 0 CompuMethod_92 0 65535 /end CHARACTERISTIC
/begin CHARACTERISTIC FaultManager.EGRSenseRangeLow.Action_2 "Fault manager configuration.  Select up to 4 actions for each fault." VALUE 0x8000199A RecordLayout_7 0 CompuMethod_91 0 65535 /end CHARACTERISTIC
/begin CHARACTERISTIC FaultManager.EGRSenseRangeLow.Action_2_Condition "Fault manager configuration.  Select up to 4 actions for each fault." VALUE 0x8000199C RecordLayout_7 0 CompuMethod_92 0 65535 /end CHARACTERISTIC
/begin CHARACTERISTIC FaultManager.EGRSenseRangeLow.Action_3 "Fault manager configuration.  Select up to 4 actions for each fault." VALUE 0x8000199E RecordLayout_7 0 CompuMethod_91 0 65535 /end CHARACTERISTIC
/begin CHARACTERISTIC FaultManager.EGRSenseRangeLow.Action_3_Condition "Fault manager configuration.  Select up to 4 actions for each fault." VALUE 0x800019A0 RecordLayout_7 0 CompuMethod_92 0 65535 /end CHARACTERISTIC
/begin CHARACTERISTIC FaultManager.EGRSenseRangeLow.Action_4 "Fault manager configuration.  Select up to 4 actions for each fault." VALUE 0x800019A2 RecordLayout_7 0 CompuMethod_91 0 65535 /end CHARACTERISTIC
/begin CHARACTERISTIC FaultManager.EGRSenseRangeLow.Action_4_Condition "Fault manager configuration.  Select up to 4 actions for each fault." VALUE 0x800019A4 RecordLayout_7 0 CompuMethod_92 0 65535 /end CHARACTERISTIC
/begin CHARACTERISTIC FaultManager.EST1_Open.Mode "Fault manager configuration.  Select up to 4 actions for each fault." VALUE 0x800019A6 RecordLayout_7 0 CompuMethod_89 0 65535 /end CHARACTERISTIC
/begin CHARACTERISTIC FaultManager.EST1_Open.ID "Fault manager configuration.  Select up to 4 actions for each fault." VALUE 0x800019A8 RecordLayout_7 0 CompuMethod_1 0 65535 /end CHARACTERISTIC
/begin CHARACTERISTIC FaultManager.EST1_Open.Test "Fault manager configuration.  Select up to 4 actions for each fault." VALUE 0x800019AA RecordLayout_7 0 CompuMethod_90 0 65535 /end CHARACTERISTIC
/begin CHARACTERISTIC FaultManager.EST1_Open.Faulty_Samples__X_ "Fault manager configuration.  Select up to 4 actions for each fault." VALUE 0x800019AC RecordLayout_7 0 CompuMethod_1 0 65535 /end CHARACTERISTIC
/begin CHARACTERISTIC FaultManager.EST1_Open.Total_Samples__Y_ "Fault manager configuration.  Select up to 4 actions for each fault." VALUE 0x800019AE RecordLayout_7 0 CompuMethod_1 0 65535 /end CHARACTERISTIC
/begin CHARACTERISTIC FaultManager.EST1_Open.Action_1 "Fault manager configuration.  Select up to 4 actions for each fault." VALUE 0x800019B0 RecordLayout_7 0 CompuMethod_91 0 65535 /end CHARACTERISTIC
/begin CHARACTERISTIC FaultManager.EST1_Open.Action_1_Condition "Fault manager configuration.  Select up to 4 actions for each fault." VALUE 0x800019B2 RecordLayout_7 0 CompuMethod_92 0 65535 /end CHARACTERISTIC
/begin CHARACTERISTIC FaultManager.EST1_Open.Action_2 "Fault manager configuration.  Select up to 4 actions for each fault." VALUE 0x800019B4 RecordLayout_7 0 CompuMethod_91 0 65535 /end CHARACTERISTIC
/begin CHARACTERISTIC FaultManager.EST1_Open.Action_2_Condition "Fault manager configuration.  Select up to 4 actions for each fault." VALUE 0x800019B6 RecordLayout_7 0 CompuMethod_92 0 65535 /end CHARACTERISTIC
/begin CHARACTERISTIC FaultManager.EST1_Open.Action_3 "Fault manager configuration.  Select up to 4 actions for each fault." VALUE 0x800019B8 RecordLayout_7 0 CompuMethod_91 0 65535 /end CHARACTERISTIC
/begin CHARACTERISTIC FaultManager.EST1_Open.Action_3_Condition "Fault manager configuration.  Select up to 4 actions for each fault." VALUE 0x800019BA RecordLayout_7 0 CompuMethod_92 0 65535 /end CHARACTERISTIC
/begin CHARACTERISTIC FaultManager.EST1_Open.Action_4 "Fault manager configuration.  Select up to 4 actions for each fault." VALUE 0x800019BC RecordLayout_7 0 CompuMethod_91 0 65535 /end CHARACTERISTIC
/begin CHARACTERISTIC FaultManager.EST1_Open.Action_4_Condition "Fault manager configuration.  Select up to 4 actions for each fault." VALUE 0x800019BE RecordLayout_7 0 CompuMethod_92 0 65535 /end CHARACTERISTIC
/begin CHARACTERISTIC FaultManager.EST1_Short.Mode "Fault manager configuration.  Select up to 4 actions for each fault." VALUE 0x800019C0 RecordLayout_7 0 CompuMethod_89 0 65535 /end CHARACTERISTIC
/begin CHARACTERISTIC FaultManager.EST1_Short.ID "Fault manager configuration.  Select up to 4 actions for each fault." VALUE 0x800019C2 RecordLayout_7 0 CompuMethod_1 0 65535 /end CHARACTERISTIC
/begin CHARACTERISTIC FaultManager.EST1_Short.Test "Fault manager configuration.  Select up to 4 actions for each fault." VALUE 0x800019C4 RecordLayout_7 0 CompuMethod_90 0 65535 /end CHARACTERISTIC
/begin CHARACTERISTIC FaultManager.EST1_Short.Faulty_Samples__X_ "Fault manager configuration.  Select up to 4 actions for each fault." VALUE 0x800019C6 RecordLayout_7 0 CompuMethod_1 0 65535 /end CHARACTERISTIC
/begin CHARACTERISTIC FaultManager.EST1_Short.Total_Samples__Y_ "Fault manager configuration.  Select up to 4 actions for each fault." VALUE 0x800019C8 RecordLayout_7 0 CompuMethod_1 0 65535 /end CHARACTERISTIC
/begin CHARACTERISTIC FaultManager.EST1_Short.Action_1 "Fault manager configuration.  Select up to 4 actions for each fault." VALUE 0x800019CA RecordLayout_7 0 CompuMethod_91 0 65535 /end CHARACTERISTIC
/begin CHARACTERISTIC FaultManager.EST1_Short.Action_1_Condition "Fault manager configuration.  Select up to 4 actions for each fault." VALUE 0x800019CC RecordLayout_7 0 CompuMethod_92 0 65535 /end CHARACTERISTIC
/begin CHARACTERISTIC FaultManager.EST1_Short.Action_2 "Fault manager configuration.  Select up to 4 actions for each fault." VALUE 0x800019CE RecordLayout_7 0 CompuMethod_91 0 65535 /end CHARACTERISTIC
/begin CHARACTERISTIC FaultManager.EST1_Short.Action_2_Condition "Fault manager configuration.  Select up to 4 actions for each fault." VALUE 0x800019D0 RecordLayout_7 0 CompuMethod_92 0 65535 /end CHARACTERISTIC
/begin CHARACTERISTIC FaultManager.EST1_Short.Action_3 "Fault manager configuration.  Select up to 4 actions for each fault." VALUE 0x800019D2 RecordLayout_7 0 CompuMethod_91 0 65535 /end CHARACTERISTIC
/begin CHARACTERISTIC FaultManager.EST1_Short.Action_3_Condition "Fault manager configuration.  Select up to 4 actions for each fault." VALUE 0x800019D4 RecordLayout_7 0 CompuMethod_92 0 65535 /end CHARACTERISTIC
/begin CHARACTERISTIC FaultManager.EST1_Short.Action_4 "Fault manager configuration.  Select up to 4 actions for each fault." VALUE 0x800019D6 RecordLayout_7 0 CompuMethod_91 0 65535 /end CHARACTERISTIC
/begin CHARACTERISTIC FaultManager.EST1_Short.Action_4_Condition "Fault manager configuration.  Select up to 4 actions for each fault." VALUE 0x800019D8 RecordLayout_7 0 CompuMethod_92 0 65535 /end CHARACTERISTIC
/begin CHARACTERISTIC FaultManager.EST2_Open.Mode "Fault manager configuration.  Select up to 4 actions for each fault." VALUE 0x800019DA RecordLayout_7 0 CompuMethod_89 0 65535 /end CHARACTERISTIC
/begin CHARACTERISTIC FaultManager.EST2_Open.ID "Fault manager configuration.  Select up to 4 actions for each fault." VALUE 0x800019DC RecordLayout_7 0 CompuMethod_1 0 65535 /end CHARACTERISTIC
/begin CHARACTERISTIC FaultManager.EST2_Open.Test "Fault manager configuration.  Select up to 4 actions for each fault." VALUE 0x800019DE RecordLayout_7 0 CompuMethod_90 0 65535 /end CHARACTERISTIC
/begin CHARACTERISTIC FaultManager.EST2_Open.Faulty_Samples__X_ "Fault manager configuration.  Select up to 4 actions for each fault." VALUE 0x800019E0 RecordLayout_7 0 CompuMethod_1 0 65535 /end CHARACTERISTIC
/begin CHARACTERISTIC FaultManager.EST2_Open.Total_Samples__Y_ "Fault manager configuration.  Select up to 4 actions for each fault." VALUE 0x800019E2 RecordLayout_7 0 CompuMethod_1 0 65535 /end CHARACTERISTIC
/begin CHARACTERISTIC FaultManager.EST2_Open.Action_1 "Fault manager configuration.  Select up to 4 actions for each fault." VALUE 0x800019E4 RecordLayout_7 0 CompuMethod_91 0 65535 /end CHARACTERISTIC
/begin CHARACTERISTIC FaultManager.EST2_Open.Action_1_Condition "Fault manager configuration.  Select up to 4 actions for each fault." VALUE 0x800019E6 RecordLayout_7 0 CompuMethod_92 0 65535 /end CHARACTERISTIC
/begin CHARACTERISTIC FaultManager.EST2_Open.Action_2 "Fault manager configuration.  Select up to 4 actions for each fault." VALUE 0x800019E8 RecordLayout_7 0 CompuMethod_91 0 65535 /end CHARACTERISTIC
/begin CHARACTERISTIC FaultManager.EST2_Open.Action_2_Condition "Fault manager configuration.  Select up to 4 actions for each fault." VALUE 0x800019EA RecordLayout_7 0 CompuMethod_92 0 65535 /end CHARACTERISTIC
/begin CHARACTERISTIC FaultManager.EST2_Open.Action_3 "Fault manager configuration.  Select up to 4 actions for each fault." VALUE 0x800019EC RecordLayout_7 0 CompuMethod_91 0 65535 /end CHARACTERISTIC
/begin CHARACTERISTIC FaultManager.EST2_Open.Action_3_Condition "Fault manager configuration.  Select up to 4 actions for each fault." VALUE 0x800019EE RecordLayout_7 0 CompuMethod_92 0 65535 /end CHARACTERISTIC
/begin CHARACTERISTIC FaultManager.EST2_Open.Action_4 "Fault manager configuration.  Select up to 4 actions for each fault." VALUE 0x800019F0 RecordLayout_7 0 CompuMethod_91 0 65535 /end CHARACTERISTIC
/begin CHARACTERISTIC FaultManager.EST2_Open.Action_4_Condition "Fault manager configuration.  Select up to 4 actions for each fault." VALUE 0x800019F2 RecordLayout_7 0 CompuMethod_92 0 65535 /end CHARACTERISTIC
/begin CHARACTERISTIC FaultManager.EST2_Short.Mode "Fault manager configuration.  Select up to 4 actions for each fault." VALUE 0x800019F4 RecordLayout_7 0 CompuMethod_89 0 65535 /end CHARACTERISTIC
/begin CHARACTERISTIC FaultManager.EST2_Short.ID "Fault manager configuration.  Select up to 4 actions for each fault." VALUE 0x800019F6 RecordLayout_7 0 CompuMethod_1 0 65535 /end CHARACTERISTIC
/begin CHARACTERISTIC FaultManager.EST2_Short.Test "Fault manager configuration.  Select up to 4 actions for each fault." VALUE 0x800019F8 RecordLayout_7 0 CompuMethod_90 0 65535 /end CHARACTERISTIC
/begin CHARACTERISTIC FaultManager.EST2_Short.Faulty_Samples__X_ "Fault manager configuration.  Select up to 4 actions for each fault." VALUE 0x800019FA RecordLayout_7 0 CompuMethod_1 0 65535 /end CHARACTERISTIC
/begin CHARACTERISTIC FaultManager.EST2_Short.Total_Samples__Y_ "Fault manager configuration.  Select up to 4 actions for each fault." VALUE 0x800019FC RecordLayout_7 0 CompuMethod_1 0 65535 /end CHARACTERISTIC
/begin CHARACTERISTIC FaultManager.EST2_Short.Action_1 "Fault manager configuration.  Select up to 4 actions for each fault." VALUE 0x800019FE RecordLayout_7 0 CompuMethod_91 0 65535 /end CHARACTERISTIC
/begin CHARACTERISTIC FaultManager.EST2_Short.Action_1_Condition "Fault manager configuration.  Select up to 4 actions for each fault." VALUE 0x80001A00 RecordLayout_7 0 CompuMethod_92 0 65535 /end CHARACTERISTIC
/begin CHARACTERISTIC FaultManager.EST2_Short.Action_2 "Fault manager configuration.  Select up to 4 actions for each fault." VALUE 0x80001A02 RecordLayout_7 0 CompuMethod_91 0 65535 /end CHARACTERISTIC
/begin CHARACTERISTIC FaultManager.EST2_Short.Action_2_Condition "Fault manager configuration.  Select up to 4 actions for each fault." VALUE 0x80001A04 RecordLayout_7 0 CompuMethod_92 0 65535 /end CHARACTERISTIC
/begin CHARACTERISTIC FaultManager.EST2_Short.Action_3 "Fault manager configuration.  Select up to 4 actions for each fault." VALUE 0x80001A06 RecordLayout_7 0 CompuMethod_91 0 65535 /end CHARACTERISTIC
/begin CHARACTERISTIC FaultManager.EST2_Short.Action_3_Condition "Fault manager configuration.  Select up to 4 actions for each fault." VALUE 0x80001A08 RecordLayout_7 0 CompuMethod_92 0 65535 /end CHARACTERISTIC
/begin CHARACTERISTIC FaultManager.EST2_Short.Action_4 "Fault manager configuration.  Select up to 4 actions for each fault." VALUE 0x80001A0A RecordLayout_7 0 CompuMethod_91 0 65535 /end CHARACTERISTIC
/begin CHARACTERISTIC FaultManager.EST2_Short.Action_4_Condition "Fault manager configuration.  Select up to 4 actions for each fault." VALUE 0x80001A0C RecordLayout_7 0 CompuMethod_92 0 65535 /end CHARACTERISTIC
/begin CHARACTERISTIC FaultManager.ETCSpringTest.Mode "Fault manager configuration.  Select up to 4 actions for each fault." VALUE 0x80001A0E RecordLayout_7 0 CompuMethod_89 0 65535 /end CHARACTERISTIC
/begin CHARACTERISTIC FaultManager.ETCSpringTest.ID "Fault manager configuration.  Select up to 4 actions for each fault." VALUE 0x80001A10 RecordLayout_7 0 CompuMethod_1 0 65535 /end CHARACTERISTIC
/begin CHARACTERISTIC FaultManager.ETCSpringTest.Test "Fault manager configuration.  Select up to 4 actions for each fault." VALUE 0x80001A12 RecordLayout_7 0 CompuMethod_90 0 65535 /end CHARACTERISTIC
/begin CHARACTERISTIC FaultManager.ETCSpringTest.Faulty_Samples__X_ "Fault manager configuration.  Select up to 4 actions for each fault." VALUE 0x80001A14 RecordLayout_7 0 CompuMethod_1 0 65535 /end CHARACTERISTIC
/begin CHARACTERISTIC FaultManager.ETCSpringTest.Total_Samples__Y_ "Fault manager configuration.  Select up to 4 actions for each fault." VALUE 0x80001A16 RecordLayout_7 0 CompuMethod_1 0 65535 /end CHARACTERISTIC
/begin CHARACTERISTIC FaultManager.ETCSpringTest.Action_1 "Fault manager configuration.  Select up to 4 actions for each fault." VALUE 0x80001A18 RecordLayout_7 0 CompuMethod_91 0 65535 /end CHARACTERISTIC
/begin CHARACTERISTIC FaultManager.ETCSpringTest.Action_1_Condition "Fault manager configuration.  Select up to 4 actions for each fault." VALUE 0x80001A1A RecordLayout_7 0 CompuMethod_92 0 65535 /end CHARACTERISTIC
/begin CHARACTERISTIC FaultManager.ETCSpringTest.Action_2 "Fault manager configuration.  Select up to 4 actions for each fault." VALUE 0x80001A1C RecordLayout_7 0 CompuMethod_91 0 65535 /end CHARACTERISTIC
/begin CHARACTERISTIC FaultManager.ETCSpringTest.Action_2_Condition "Fault manager configuration.  Select up to 4 actions for each fault." VALUE 0x80001A1E RecordLayout_7 0 CompuMethod_92 0 65535 /end CHARACTERISTIC
/begin CHARACTERISTIC FaultManager.ETCSpringTest.Action_3 "Fault manager configuration.  Select up to 4 actions for each fault." VALUE 0x80001A20 RecordLayout_7 0 CompuMethod_91 0 65535 /end CHARACTERISTIC
/begin CHARACTERISTIC FaultManager.ETCSpringTest.Action_3_Condition "Fault manager configuration.  Select up to 4 actions for each fault." VALUE 0x80001A22 RecordLayout_7 0 CompuMethod_92 0 65535 /end CHARACTERISTIC
/begin CHARACTERISTIC FaultManager.ETCSpringTest.Action_4 "Fault manager configuration.  Select up to 4 actions for each fault." VALUE 0x80001A24 RecordLayout_7 0 CompuMethod_91 0 65535 /end CHARACTERISTIC
/begin CHARACTERISTIC FaultManager.ETCSpringTest.Action_4_Condition "Fault manager configuration.  Select up to 4 actions for each fault." VALUE 0x80001A26 RecordLayout_7 0 CompuMethod_92 0 65535 /end CHARACTERISTIC
/begin CHARACTERISTIC FaultManager.ETC_Open_Fault.Mode "Fault manager configuration.  Select up to 4 actions for each fault." VALUE 0x80001A28 RecordLayout_7 0 CompuMethod_89 0 65535 /end CHARACTERISTIC
/begin CHARACTERISTIC FaultManager.ETC_Open_Fault.ID "Fault manager configuration.  Select up to 4 actions for each fault." VALUE 0x80001A2A RecordLayout_7 0 CompuMethod_1 0 65535 /end CHARACTERISTIC
/begin CHARACTERISTIC FaultManager.ETC_Open_Fault.Test "Fault manager configuration.  Select up to 4 actions for each fault." VALUE 0x80001A2C RecordLayout_7 0 CompuMethod_90 0 65535 /end CHARACTERISTIC
/begin CHARACTERISTIC FaultManager.ETC_Open_Fault.Faulty_Samples__X_ "Fault manager configuration.  Select up to 4 actions for each fault." VALUE 0x80001A2E RecordLayout_7 0 CompuMethod_1 0 65535 /end CHARACTERISTIC
/begin CHARACTERISTIC FaultManager.ETC_Open_Fault.Total_Samples__Y_ "Fault manager configuration.  Select up to 4 actions for each fault." VALUE 0x80001A30 RecordLayout_7 0 CompuMethod_1 0 65535 /end CHARACTERISTIC
/begin CHARACTERISTIC FaultManager.ETC_Open_Fault.Action_1 "Fault manager configuration.  Select up to 4 actions for each fault." VALUE 0x80001A32 RecordLayout_7 0 CompuMethod_91 0 65535 /end CHARACTERISTIC
/begin CHARACTERISTIC FaultManager.ETC_Open_Fault.Action_1_Condition "Fault manager configuration.  Select up to 4 actions for each fault." VALUE 0x80001A34 RecordLayout_7 0 CompuMethod_92 0 65535 /end CHARACTERISTIC
/begin CHARACTERISTIC FaultManager.ETC_Open_Fault.Action_2 "Fault manager configuration.  Select up to 4 actions for each fault." VALUE 0x80001A36 RecordLayout_7 0 CompuMethod_91 0 65535 /end CHARACTERISTIC
/begin CHARACTERISTIC FaultManager.ETC_Open_Fault.Action_2_Condition "Fault manager configuration.  Select up to 4 actions for each fault." VALUE 0x80001A38 RecordLayout_7 0 CompuMethod_92 0 65535 /end CHARACTERISTIC
/begin CHARACTERISTIC FaultManager.ETC_Open_Fault.Action_3 "Fault manager configuration.  Select up to 4 actions for each fault." VALUE 0x80001A3A RecordLayout_7 0 CompuMethod_91 0 65535 /end CHARACTERISTIC
/begin CHARACTERISTIC FaultManager.ETC_Open_Fault.Action_3_Condition "Fault manager configuration.  Select up to 4 actions for each fault." VALUE 0x80001A3C RecordLayout_7 0 CompuMethod_92 0 65535 /end CHARACTERISTIC
/begin CHARACTERISTIC FaultManager.ETC_Open_Fault.Action_4 "Fault manager configuration.  Select up to 4 actions for each fault." VALUE 0x80001A3E RecordLayout_7 0 CompuMethod_91 0 65535 /end CHARACTERISTIC
/begin CHARACTERISTIC FaultManager.ETC_Open_Fault.Action_4_Condition "Fault manager configuration.  Select up to 4 actions for each fault." VALUE 0x80001A40 RecordLayout_7 0 CompuMethod_92 0 65535 /end CHARACTERISTIC
/begin CHARACTERISTIC FaultManager.ETC_Sticking.Mode "Fault manager configuration.  Select up to 4 actions for each fault." VALUE 0x80001A42 RecordLayout_7 0 CompuMethod_89 0 65535 /end CHARACTERISTIC
/begin CHARACTERISTIC FaultManager.ETC_Sticking.ID "Fault manager configuration.  Select up to 4 actions for each fault." VALUE 0x80001A44 RecordLayout_7 0 CompuMethod_1 0 65535 /end CHARACTERISTIC
/begin CHARACTERISTIC FaultManager.ETC_Sticking.Test "Fault manager configuration.  Select up to 4 actions for each fault." VALUE 0x80001A46 RecordLayout_7 0 CompuMethod_90 0 65535 /end CHARACTERISTIC
/begin CHARACTERISTIC FaultManager.ETC_Sticking.Faulty_Samples__X_ "Fault manager configuration.  Select up to 4 actions for each fault." VALUE 0x80001A48 RecordLayout_7 0 CompuMethod_1 0 65535 /end CHARACTERISTIC
/begin CHARACTERISTIC FaultManager.ETC_Sticking.Total_Samples__Y_ "Fault manager configuration.  Select up to 4 actions for each fault." VALUE 0x80001A4A RecordLayout_7 0 CompuMethod_1 0 65535 /end CHARACTERISTIC
/begin CHARACTERISTIC FaultManager.ETC_Sticking.Action_1 "Fault manager configuration.  Select up to 4 actions for each fault." VALUE 0x80001A4C RecordLayout_7 0 CompuMethod_91 0 65535 /end CHARACTERISTIC
/begin CHARACTERISTIC FaultManager.ETC_Sticking.Action_1_Condition "Fault manager configuration.  Select up to 4 actions for each fault." VALUE 0x80001A4E RecordLayout_7 0 CompuMethod_92 0 65535 /end CHARACTERISTIC
/begin CHARACTERISTIC FaultManager.ETC_Sticking.Action_2 "Fault manager configuration.  Select up to 4 actions for each fault." VALUE 0x80001A50 RecordLayout_7 0 CompuMethod_91 0 65535 /end CHARACTERISTIC
/begin CHARACTERISTIC FaultManager.ETC_Sticking.Action_2_Condition "Fault manager configuration.  Select up to 4 actions for each fault." VALUE 0x80001A52 RecordLayout_7 0 CompuMethod_92 0 65535 /end CHARACTERISTIC
/begin CHARACTERISTIC FaultManager.ETC_Sticking.Action_3 "Fault manager configuration.  Select up to 4 actions for each fault." VALUE 0x80001A54 RecordLayout_7 0 CompuMethod_91 0 65535 /end CHARACTERISTIC
/begin CHARACTERISTIC FaultManager.ETC_Sticking.Action_3_Condition "Fault manager configuration.  Select up to 4 actions for each fault." VALUE 0x80001A56 RecordLayout_7 0 CompuMethod_92 0 65535 /end CHARACTERISTIC
/begin CHARACTERISTIC FaultManager.ETC_Sticking.Action_4 "Fault manager configuration.  Select up to 4 actions for each fault." VALUE 0x80001A58 RecordLayout_7 0 CompuMethod_91 0 65535 /end CHARACTERISTIC
/begin CHARACTERISTIC FaultManager.ETC_Sticking.Action_4_Condition "Fault manager configuration.  Select up to 4 actions for each fault." VALUE 0x80001A5A RecordLayout_7 0 CompuMethod_92 0 65535 /end CHARACTERISTIC
/begin CHARACTERISTIC FaultManager.FuelAdaptRangeHi.Mode "Fault manager configuration.  Select up to 4 actions for each fault." VALUE 0x80001A5C RecordLayout_7 0 CompuMethod_89 0 65535 /end CHARACTERISTIC
/begin CHARACTERISTIC FaultManager.FuelAdaptRangeHi.ID "Fault manager configuration.  Select up to 4 actions for each fault." VALUE 0x80001A5E RecordLayout_7 0 CompuMethod_1 0 65535 /end CHARACTERISTIC
/begin CHARACTERISTIC FaultManager.FuelAdaptRangeHi.Test "Fault manager configuration.  Select up to 4 actions for each fault." VALUE 0x80001A60 RecordLayout_7 0 CompuMethod_90 0 65535 /end CHARACTERISTIC
/begin CHARACTERISTIC FaultManager.FuelAdaptRangeHi.Faulty_Samples__X_ "Fault manager configuration.  Select up to 4 actions for each fault." VALUE 0x80001A62 RecordLayout_7 0 CompuMethod_1 0 65535 /end CHARACTERISTIC
/begin CHARACTERISTIC FaultManager.FuelAdaptRangeHi.Total_Samples__Y_ "Fault manager configuration.  Select up to 4 actions for each fault." VALUE 0x80001A64 RecordLayout_7 0 CompuMethod_1 0 65535 /end CHARACTERISTIC
/begin CHARACTERISTIC FaultManager.FuelAdaptRangeHi.Action_1 "Fault manager configuration.  Select up to 4 actions for each fault." VALUE 0x80001A66 RecordLayout_7 0 CompuMethod_91 0 65535 /end CHARACTERISTIC
/begin CHARACTERISTIC FaultManager.FuelAdaptRangeHi.Action_1_Condition "Fault manager configuration.  Select up to 4 actions for each fault." VALUE 0x80001A68 RecordLayout_7 0 CompuMethod_92 0 65535 /end CHARACTERISTIC
/begin CHARACTERISTIC FaultManager.FuelAdaptRangeHi.Action_2 "Fault manager configuration.  Select up to 4 actions for each fault." VALUE 0x80001A6A RecordLayout_7 0 CompuMethod_91 0 65535 /end CHARACTERISTIC
/begin CHARACTERISTIC FaultManager.FuelAdaptRangeHi.Action_2_Condition "Fault manager configuration.  Select up to 4 actions for each fault." VALUE 0x80001A6C RecordLayout_7 0 CompuMethod_92 0 65535 /end CHARACTERISTIC
/begin CHARACTERISTIC FaultManager.FuelAdaptRangeHi.Action_3 "Fault manager configuration.  Select up to 4 actions for each fault." VALUE 0x80001A6E RecordLayout_7 0 CompuMethod_91 0 65535 /end CHARACTERISTIC
/begin CHARACTERISTIC FaultManager.FuelAdaptRangeHi.Action_3_Condition "Fault manager configuration.  Select up to 4 actions for each fault." VALUE 0x80001A70 RecordLayout_7 0 CompuMethod_92 0 65535 /end CHARACTERISTIC
/begin CHARACTERISTIC FaultManager.FuelAdaptRangeHi.Action_4 "Fault manager configuration.  Select up to 4 actions for each fault." VALUE 0x80001A72 RecordLayout_7 0 CompuMethod_91 0 65535 /end CHARACTERISTIC
/begin CHARACTERISTIC FaultManager.FuelAdaptRangeHi.Action_4_Condition "Fault manager configuration.  Select up to 4 actions for each fault." VALUE 0x80001A74 RecordLayout_7 0 CompuMethod_92 0 65535 /end CHARACTERISTIC
/begin CHARACTERISTIC FaultManager.FuelAdaptRangeLow.Mode "Fault manager configuration.  Select up to 4 actions for each fault." VALUE 0x80001A76 RecordLayout_7 0 CompuMethod_89 0 65535 /end CHARACTERISTIC
/begin CHARACTERISTIC FaultManager.FuelAdaptRangeLow.ID "Fault manager configuration.  Select up to 4 actions for each fault." VALUE 0x80001A78 RecordLayout_7 0 CompuMethod_1 0 65535 /end CHARACTERISTIC
/begin CHARACTERISTIC FaultManager.FuelAdaptRangeLow.Test "Fault manager configuration.  Select up to 4 actions for each fault." VALUE 0x80001A7A RecordLayout_7 0 CompuMethod_90 0 65535 /end CHARACTERISTIC
/begin CHARACTERISTIC FaultManager.FuelAdaptRangeLow.Faulty_Samples__X_ "Fault manager configuration.  Select up to 4 actions for each fault." VALUE 0x80001A7C RecordLayout_7 0 CompuMethod_1 0 65535 /end CHARACTERISTIC
/begin CHARACTERISTIC FaultManager.FuelAdaptRangeLow.Total_Samples__Y_ "Fault manager configuration.  Select up to 4 actions for each fault." VALUE 0x80001A7E RecordLayout_7 0 CompuMethod_1 0 65535 /end CHARACTERISTIC
/begin CHARACTERISTIC FaultManager.FuelAdaptRangeLow.Action_1 "Fault manager configuration.  Select up to 4 actions for each fault." VALUE 0x80001A80 RecordLayout_7 0 CompuMethod_91 0 65535 /end CHARACTERISTIC
/begin CHARACTERISTIC FaultManager.FuelAdaptRangeLow.Action_1_Condition "Fault manager configuration.  Select up to 4 actions for each fault." VALUE 0x80001A82 RecordLayout_7 0 CompuMethod_92 0 65535 /end CHARACTERISTIC
/begin CHARACTERISTIC FaultManager.FuelAdaptRangeLow.Action_2 "Fault manager configuration.  Select up to 4 actions for each fault." VALUE 0x80001A84 RecordLayout_7 0 CompuMethod_91 0 65535 /end CHARACTERISTIC
/begin CHARACTERISTIC FaultManager.FuelAdaptRangeLow.Action_2_Condition "Fault manager configuration.  Select up to 4 actions for each fault." VALUE 0x80001A86 RecordLayout_7 0 CompuMethod_92 0 65535 /end CHARACTERISTIC
/begin CHARACTERISTIC FaultManager.FuelAdaptRangeLow.Action_3 "Fault manager configuration.  Select up to 4 actions for each fault." VALUE 0x80001A88 RecordLayout_7 0 CompuMethod_91 0 65535 /end CHARACTERISTIC
/begin CHARACTERISTIC FaultManager.FuelAdaptRangeLow.Action_3_Condition "Fault manager configuration.  Select up to 4 actions for each fault." VALUE 0x80001A8A RecordLayout_7 0 CompuMethod_92 0 65535 /end CHARACTERISTIC
/begin CHARACTERISTIC FaultManager.FuelAdaptRangeLow.Action_4 "Fault manager configuration.  Select up to 4 actions for each fault." VALUE 0x80001A8C RecordLayout_7 0 CompuMethod_91 0 65535 /end CHARACTERISTIC
/begin CHARACTERISTIC FaultManager.FuelAdaptRangeLow.Action_4_Condition "Fault manager configuration.  Select up to 4 actions for each fault." VALUE 0x80001A8E RecordLayout_7 0 CompuMethod_92 0 65535 /end CHARACTERISTIC
/begin CHARACTERISTIC FaultManager.FuelPresHigh_Fault.Mode "Fault manager configuration.  Select up to 4 actions for each fault." VALUE 0x80001A90 RecordLayout_7 0 CompuMethod_89 0 65535 /end CHARACTERISTIC
/begin CHARACTERISTIC FaultManager.FuelPresHigh_Fault.ID "Fault manager configuration.  Select up to 4 actions for each fault." VALUE 0x80001A92 RecordLayout_7 0 CompuMethod_1 0 65535 /end CHARACTERISTIC
/begin CHARACTERISTIC FaultManager.FuelPresHigh_Fault.Test "Fault manager configuration.  Select up to 4 actions for each fault." VALUE 0x80001A94 RecordLayout_7 0 CompuMethod_90 0 65535 /end CHARACTERISTIC
/begin CHARACTERISTIC FaultManager.FuelPresHigh_Fault.Faulty_Samples__X_ "Fault manager configuration.  Select up to 4 actions for each fault." VALUE 0x80001A96 RecordLayout_7 0 CompuMethod_1 0 65535 /end CHARACTERISTIC
/begin CHARACTERISTIC FaultManager.FuelPresHigh_Fault.Total_Samples__Y_ "Fault manager configuration.  Select up to 4 actions for each fault." VALUE 0x80001A98 RecordLayout_7 0 CompuMethod_1 0 65535 /end CHARACTERISTIC
/begin CHARACTERISTIC FaultManager.FuelPresHigh_Fault.Action_1 "Fault manager configuration.  Select up to 4 actions for each fault." VALUE 0x80001A9A RecordLayout_7 0 CompuMethod_91 0 65535 /end CHARACTERISTIC
/begin CHARACTERISTIC FaultManager.FuelPresHigh_Fault.Action_1_Condition "Fault manager configuration.  Select up to 4 actions for each fault." VALUE 0x80001A9C RecordLayout_7 0 CompuMethod_92 0 65535 /end CHARACTERISTIC
/begin CHARACTERISTIC FaultManager.FuelPresHigh_Fault.Action_2 "Fault manager configuration.  Select up to 4 actions for each fault." VALUE 0x80001A9E RecordLayout_7 0 CompuMethod_91 0 65535 /end CHARACTERISTIC
/begin CHARACTERISTIC FaultManager.FuelPresHigh_Fault.Action_2_Condition "Fault manager configuration.  Select up to 4 actions for each fault." VALUE 0x80001AA0 RecordLayout_7 0 CompuMethod_92 0 65535 /end CHARACTERISTIC
/begin CHARACTERISTIC FaultManager.FuelPresHigh_Fault.Action_3 "Fault manager configuration.  Select up to 4 actions for each fault." VALUE 0x80001AA2 RecordLayout_7 0 CompuMethod_91 0 65535 /end CHARACTERISTIC
/begin CHARACTERISTIC FaultManager.FuelPresHigh_Fault.Action_3_Condition "Fault manager configuration.  Select up to 4 actions for each fault." VALUE 0x80001AA4 RecordLayout_7 0 CompuMethod_92 0 65535 /end CHARACTERISTIC
/begin CHARACTERISTIC FaultManager.FuelPresHigh_Fault.Action_4 "Fault manager configuration.  Select up to 4 actions for each fault." VALUE 0x80001AA6 RecordLayout_7 0 CompuMethod_91 0 65535 /end CHARACTERISTIC
/begin CHARACTERISTIC FaultManager.FuelPresHigh_Fault.Action_4_Condition "Fault manager configuration.  Select up to 4 actions for each fault." VALUE 0x80001AA8 RecordLayout_7 0 CompuMethod_92 0 65535 /end CHARACTERISTIC
/begin CHARACTERISTIC FaultManager.FuelPresLow_Fault.Mode "Fault manager configuration.  Select up to 4 actions for each fault." VALUE 0x80001AAA RecordLayout_7 0 CompuMethod_89 0 65535 /end CHARACTERISTIC
/begin CHARACTERISTIC FaultManager.FuelPresLow_Fault.ID "Fault manager configuration.  Select up to 4 actions for each fault." VALUE 0x80001AAC RecordLayout_7 0 CompuMethod_1 0 65535 /end CHARACTERISTIC
/begin CHARACTERISTIC FaultManager.FuelPresLow_Fault.Test "Fault manager configuration.  Select up to 4 actions for each fault." VALUE 0x80001AAE RecordLayout_7 0 CompuMethod_90 0 65535 /end CHARACTERISTIC
/begin CHARACTERISTIC FaultManager.FuelPresLow_Fault.Faulty_Samples__X_ "Fault manager configuration.  Select up to 4 actions for each fault." VALUE 0x80001AB0 RecordLayout_7 0 CompuMethod_1 0 65535 /end CHARACTERISTIC
/begin CHARACTERISTIC FaultManager.FuelPresLow_Fault.Total_Samples__Y_ "Fault manager configuration.  Select up to 4 actions for each fault." VALUE 0x80001AB2 RecordLayout_7 0 CompuMethod_1 0 65535 /end CHARACTERISTIC
/begin CHARACTERISTIC FaultManager.FuelPresLow_Fault.Action_1 "Fault manager configuration.  Select up to 4 actions for each fault." VALUE 0x80001AB4 RecordLayout_7 0 CompuMethod_91 0 65535 /end CHARACTERISTIC
/begin CHARACTERISTIC FaultManager.FuelPresLow_Fault.Action_1_Condition "Fault manager configuration.  Select up to 4 actions for each fault." VALUE 0x80001AB6 RecordLayout_7 0 CompuMethod_92 0 65535 /end CHARACTERISTIC
/begin CHARACTERISTIC FaultManager.FuelPresLow_Fault.Action_2 "Fault manager configuration.  Select up to 4 actions for each fault." VALUE 0x80001AB8 RecordLayout_7 0 CompuMethod_91 0 65535 /end CHARACTERISTIC
/begin CHARACTERISTIC FaultManager.FuelPresLow_Fault.Action_2_Condition "Fault manager configuration.  Select up to 4 actions for each fault." VALUE 0x80001ABA RecordLayout_7 0 CompuMethod_92 0 65535 /end CHARACTERISTIC
/begin CHARACTERISTIC FaultManager.FuelPresLow_Fault.Action_3 "Fault manager configuration.  Select up to 4 actions for each fault." VALUE 0x80001ABC RecordLayout_7 0 CompuMethod_91 0 65535 /end CHARACTERISTIC
/begin CHARACTERISTIC FaultManager.FuelPresLow_Fault.Action_3_Condition "Fault manager configuration.  Select up to 4 actions for each fault." VALUE 0x80001ABE RecordLayout_7 0 CompuMethod_92 0 65535 /end CHARACTERISTIC
/begin CHARACTERISTIC FaultManager.FuelPresLow_Fault.Action_4 "Fault manager configuration.  Select up to 4 actions for each fault." VALUE 0x80001AC0 RecordLayout_7 0 CompuMethod_91 0 65535 /end CHARACTERISTIC
/begin CHARACTERISTIC FaultManager.FuelPresLow_Fault.Action_4_Condition "Fault manager configuration.  Select up to 4 actions for each fault." VALUE 0x80001AC2 RecordLayout_7 0 CompuMethod_92 0 65535 /end CHARACTERISTIC
/begin CHARACTERISTIC FaultManager.FuelPresRangeHigh.Mode "Fault manager configuration.  Select up to 4 actions for each fault." VALUE 0x80001AC4 RecordLayout_7 0 CompuMethod_89 0 65535 /end CHARACTERISTIC
/begin CHARACTERISTIC FaultManager.FuelPresRangeHigh.ID "Fault manager configuration.  Select up to 4 actions for each fault." VALUE 0x80001AC6 RecordLayout_7 0 CompuMethod_1 0 65535 /end CHARACTERISTIC
/begin CHARACTERISTIC FaultManager.FuelPresRangeHigh.Test "Fault manager configuration.  Select up to 4 actions for each fault." VALUE 0x80001AC8 RecordLayout_7 0 CompuMethod_90 0 65535 /end CHARACTERISTIC
/begin CHARACTERISTIC FaultManager.FuelPresRangeHigh.Faulty_Samples__X_ "Fault manager configuration.  Select up to 4 actions for each fault." VALUE 0x80001ACA RecordLayout_7 0 CompuMethod_1 0 65535 /end CHARACTERISTIC
/begin CHARACTERISTIC FaultManager.FuelPresRangeHigh.Total_Samples__Y_ "Fault manager configuration.  Select up to 4 actions for each fault." VALUE 0x80001ACC RecordLayout_7 0 CompuMethod_1 0 65535 /end CHARACTERISTIC
/begin CHARACTERISTIC FaultManager.FuelPresRangeHigh.Action_1 "Fault manager configuration.  Select up to 4 actions for each fault." VALUE 0x80001ACE RecordLayout_7 0 CompuMethod_91 0 65535 /end CHARACTERISTIC
/begin CHARACTERISTIC FaultManager.FuelPresRangeHigh.Action_1_Condition "Fault manager configuration.  Select up to 4 actions for each fault." VALUE 0x80001AD0 RecordLayout_7 0 CompuMethod_92 0 65535 /end CHARACTERISTIC
/begin CHARACTERISTIC FaultManager.FuelPresRangeHigh.Action_2 "Fault manager configuration.  Select up to 4 actions for each fault." VALUE 0x80001AD2 RecordLayout_7 0 CompuMethod_91 0 65535 /end CHARACTERISTIC
/begin CHARACTERISTIC FaultManager.FuelPresRangeHigh.Action_2_Condition "Fault manager configuration.  Select up to 4 actions for each fault." VALUE 0x80001AD4 RecordLayout_7 0 CompuMethod_92 0 65535 /end CHARACTERISTIC
/begin CHARACTERISTIC FaultManager.FuelPresRangeHigh.Action_3 "Fault manager configuration.  Select up to 4 actions for each fault." VALUE 0x80001AD6 RecordLayout_7 0 CompuMethod_91 0 65535 /end CHARACTERISTIC
/begin CHARACTERISTIC FaultManager.FuelPresRangeHigh.Action_3_Condition "Fault manager configuration.  Select up to 4 actions for each fault." VALUE 0x80001AD8 RecordLayout_7 0 CompuMethod_92 0 65535 /end CHARACTERISTIC
/begin CHARACTERISTIC FaultManager.FuelPresRangeHigh.Action_4 "Fault manager configuration.  Select up to 4 actions for each fault." VALUE 0x80001ADA RecordLayout_7 0 CompuMethod_91 0 65535 /end CHARACTERISTIC
/begin CHARACTERISTIC FaultManager.FuelPresRangeHigh.Action_4_Condition "Fault manager configuration.  Select up to 4 actions for each fault." VALUE 0x80001ADC RecordLayout_7 0 CompuMethod_92 0 65535 /end CHARACTERISTIC
/begin CHARACTERISTIC FaultManager.FuelPresRangeLow.Mode "Fault manager configuration.  Select up to 4 actions for each fault." VALUE 0x80001ADE RecordLayout_7 0 CompuMethod_89 0 65535 /end CHARACTERISTIC
/begin CHARACTERISTIC FaultManager.FuelPresRangeLow.ID "Fault manager configuration.  Select up to 4 actions for each fault." VALUE 0x80001AE0 RecordLayout_7 0 CompuMethod_1 0 65535 /end CHARACTERISTIC
/begin CHARACTERISTIC FaultManager.FuelPresRangeLow.Test "Fault manager configuration.  Select up to 4 actions for each fault." VALUE 0x80001AE2 RecordLayout_7 0 CompuMethod_90 0 65535 /end CHARACTERISTIC
/begin CHARACTERISTIC FaultManager.FuelPresRangeLow.Faulty_Samples__X_ "Fault manager configuration.  Select up to 4 actions for each fault." VALUE 0x80001AE4 RecordLayout_7 0 CompuMethod_1 0 65535 /end CHARACTERISTIC
/begin CHARACTERISTIC FaultManager.FuelPresRangeLow.Total_Samples__Y_ "Fault manager configuration.  Select up to 4 actions for each fault." VALUE 0x80001AE6 RecordLayout_7 0 CompuMethod_1 0 65535 /end CHARACTERISTIC
/begin CHARACTERISTIC FaultManager.FuelPresRangeLow.Action_1 "Fault manager configuration.  Select up to 4 actions for each fault." VALUE 0x80001AE8 RecordLayout_7 0 CompuMethod_91 0 65535 /end CHARACTERISTIC
/begin CHARACTERISTIC FaultManager.FuelPresRangeLow.Action_1_Condition "Fault manager configuration.  Select up to 4 actions for each fault." VALUE 0x80001AEA RecordLayout_7 0 CompuMethod_92 0 65535 /end CHARACTERISTIC
/begin CHARACTERISTIC FaultManager.FuelPresRangeLow.Action_2 "Fault manager configuration.  Select up to 4 actions for each fault." VALUE 0x80001AEC RecordLayout_7 0 CompuMethod_91 0 65535 /end CHARACTERISTIC
/begin CHARACTERISTIC FaultManager.FuelPresRangeLow.Action_2_Condition "Fault manager configuration.  Select up to 4 actions for each fault." VALUE 0x80001AEE RecordLayout_7 0 CompuMethod_92 0 65535 /end CHARACTERISTIC
/begin CHARACTERISTIC FaultManager.FuelPresRangeLow.Action_3 "Fault manager configuration.  Select up to 4 actions for each fault." VALUE 0x80001AF0 RecordLayout_7 0 CompuMethod_91 0 65535 /end CHARACTERISTIC
/begin CHARACTERISTIC FaultManager.FuelPresRangeLow.Action_3_Condition "Fault manager configuration.  Select up to 4 actions for each fault." VALUE 0x80001AF2 RecordLayout_7 0 CompuMethod_92 0 65535 /end CHARACTERISTIC
/begin CHARACTERISTIC FaultManager.FuelPresRangeLow.Action_4 "Fault manager configuration.  Select up to 4 actions for each fault." VALUE 0x80001AF4 RecordLayout_7 0 CompuMethod_91 0 65535 /end CHARACTERISTIC
/begin CHARACTERISTIC FaultManager.FuelPresRangeLow.Action_4_Condition "Fault manager configuration.  Select up to 4 actions for each fault." VALUE 0x80001AF6 RecordLayout_7 0 CompuMethod_92 0 65535 /end CHARACTERISTIC
/begin CHARACTERISTIC FaultManager.FuelSensRangeHigh.Mode "Fault manager configuration.  Select up to 4 actions for each fault." VALUE 0x80001AF8 RecordLayout_7 0 CompuMethod_89 0 65535 /end CHARACTERISTIC
/begin CHARACTERISTIC FaultManager.FuelSensRangeHigh.ID "Fault manager configuration.  Select up to 4 actions for each fault." VALUE 0x80001AFA RecordLayout_7 0 CompuMethod_1 0 65535 /end CHARACTERISTIC
/begin CHARACTERISTIC FaultManager.FuelSensRangeHigh.Test "Fault manager configuration.  Select up to 4 actions for each fault." VALUE 0x80001AFC RecordLayout_7 0 CompuMethod_90 0 65535 /end CHARACTERISTIC
/begin CHARACTERISTIC FaultManager.FuelSensRangeHigh.Faulty_Samples__X_ "Fault manager configuration.  Select up to 4 actions for each fault." VALUE 0x80001AFE RecordLayout_7 0 CompuMethod_1 0 65535 /end CHARACTERISTIC
/begin CHARACTERISTIC FaultManager.FuelSensRangeHigh.Total_Samples__Y_ "Fault manager configuration.  Select up to 4 actions for each fault." VALUE 0x80001B00 RecordLayout_7 0 CompuMethod_1 0 65535 /end CHARACTERISTIC
/begin CHARACTERISTIC FaultManager.FuelSensRangeHigh.Action_1 "Fault manager configuration.  Select up to 4 actions for each fault." VALUE 0x80001B02 RecordLayout_7 0 CompuMethod_91 0 65535 /end CHARACTERISTIC
/begin CHARACTERISTIC FaultManager.FuelSensRangeHigh.Action_1_Condition "Fault manager configuration.  Select up to 4 actions for each fault." VALUE 0x80001B04 RecordLayout_7 0 CompuMethod_92 0 65535 /end CHARACTERISTIC
/begin CHARACTERISTIC FaultManager.FuelSensRangeHigh.Action_2 "Fault manager configuration.  Select up to 4 actions for each fault." VALUE 0x80001B06 RecordLayout_7 0 CompuMethod_91 0 65535 /end CHARACTERISTIC
/begin CHARACTERISTIC FaultManager.FuelSensRangeHigh.Action_2_Condition "Fault manager configuration.  Select up to 4 actions for each fault." VALUE 0x80001B08 RecordLayout_7 0 CompuMethod_92 0 65535 /end CHARACTERISTIC
/begin CHARACTERISTIC FaultManager.FuelSensRangeHigh.Action_3 "Fault manager configuration.  Select up to 4 actions for each fault." VALUE 0x80001B0A RecordLayout_7 0 CompuMethod_91 0 65535 /end CHARACTERISTIC
/begin CHARACTERISTIC FaultManager.FuelSensRangeHigh.Action_3_Condition "Fault manager configuration.  Select up to 4 actions for each fault." VALUE 0x80001B0C RecordLayout_7 0 CompuMethod_92 0 65535 /end CHARACTERISTIC
/begin CHARACTERISTIC FaultManager.FuelSensRangeHigh.Action_4 "Fault manager configuration.  Select up to 4 actions for each fault." VALUE 0x80001B0E RecordLayout_7 0 CompuMethod_91 0 65535 /end CHARACTERISTIC
/begin CHARACTERISTIC FaultManager.FuelSensRangeHigh.Action_4_Condition "Fault manager configuration.  Select up to 4 actions for each fault." VALUE 0x80001B10 RecordLayout_7 0 CompuMethod_92 0 65535 /end CHARACTERISTIC
/begin CHARACTERISTIC FaultManager.FuelSensRangeLow.Mode "Fault manager configuration.  Select up to 4 actions for each fault." VALUE 0x80001B12 RecordLayout_7 0 CompuMethod_89 0 65535 /end CHARACTERISTIC
/begin CHARACTERISTIC FaultManager.FuelSensRangeLow.ID "Fault manager configuration.  Select up to 4 actions for each fault." VALUE 0x80001B14 RecordLayout_7 0 CompuMethod_1 0 65535 /end CHARACTERISTIC
/begin CHARACTERISTIC FaultManager.FuelSensRangeLow.Test "Fault manager configuration.  Select up to 4 actions for each fault." VALUE 0x80001B16 RecordLayout_7 0 CompuMethod_90 0 65535 /end CHARACTERISTIC
/begin CHARACTERISTIC FaultManager.FuelSensRangeLow.Faulty_Samples__X_ "Fault manager configuration.  Select up to 4 actions for each fault." VALUE 0x80001B18 RecordLayout_7 0 CompuMethod_1 0 65535 /end CHARACTERISTIC
/begin CHARACTERISTIC FaultManager.FuelSensRangeLow.Total_Samples__Y_ "Fault manager configuration.  Select up to 4 actions for each fault." VALUE 0x80001B1A RecordLayout_7 0 CompuMethod_1 0 65535 /end CHARACTERISTIC
/begin CHARACTERISTIC FaultManager.FuelSensRangeLow.Action_1 "Fault manager configuration.  Select up to 4 actions for each fault." VALUE 0x80001B1C RecordLayout_7 0 CompuMethod_91 0 65535 /end CHARACTERISTIC
/begin CHARACTERISTIC FaultManager.FuelSensRangeLow.Action_1_Condition "Fault manager configuration.  Select up to 4 actions for each fault." VALUE 0x80001B1E RecordLayout_7 0 CompuMethod_92 0 65535 /end CHARACTERISTIC
/begin CHARACTERISTIC FaultManager.FuelSensRangeLow.Action_2 "Fault manager configuration.  Select up to 4 actions for each fault." VALUE 0x80001B20 RecordLayout_7 0 CompuMethod_91 0 65535 /end CHARACTERISTIC
/begin CHARACTERISTIC FaultManager.FuelSensRangeLow.Action_2_Condition "Fault manager configuration.  Select up to 4 actions for each fault." VALUE 0x80001B22 RecordLayout_7 0 CompuMethod_92 0 65535 /end CHARACTERISTIC
/begin CHARACTERISTIC FaultManager.FuelSensRangeLow.Action_3 "Fault manager configuration.  Select up to 4 actions for each fault." VALUE 0x80001B24 RecordLayout_7 0 CompuMethod_91 0 65535 /end CHARACTERISTIC
/begin CHARACTERISTIC FaultManager.FuelSensRangeLow.Action_3_Condition "Fault manager configuration.  Select up to 4 actions for each fault." VALUE 0x80001B26 RecordLayout_7 0 CompuMethod_92 0 65535 /end CHARACTERISTIC
/begin CHARACTERISTIC FaultManager.FuelSensRangeLow.Action_4 "Fault manager configuration.  Select up to 4 actions for each fault." VALUE 0x80001B28 RecordLayout_7 0 CompuMethod_91 0 65535 /end CHARACTERISTIC
/begin CHARACTERISTIC FaultManager.FuelSensRangeLow.Action_4_Condition "Fault manager configuration.  Select up to 4 actions for each fault." VALUE 0x80001B2A RecordLayout_7 0 CompuMethod_92 0 65535 /end CHARACTERISTIC
/begin CHARACTERISTIC FaultManager.HardOverspeed.Mode "Fault manager configuration.  Select up to 4 actions for each fault." VALUE 0x80001B2C RecordLayout_7 0 CompuMethod_89 0 65535 /end CHARACTERISTIC
/begin CHARACTERISTIC FaultManager.HardOverspeed.ID "Fault manager configuration.  Select up to 4 actions for each fault." VALUE 0x80001B2E RecordLayout_7 0 CompuMethod_1 0 65535 /end CHARACTERISTIC
/begin CHARACTERISTIC FaultManager.HardOverspeed.Test "Fault manager configuration.  Select up to 4 actions for each fault." VALUE 0x80001B30 RecordLayout_7 0 CompuMethod_90 0 65535 /end CHARACTERISTIC
/begin CHARACTERISTIC FaultManager.HardOverspeed.Faulty_Samples__X_ "Fault manager configuration.  Select up to 4 actions for each fault." VALUE 0x80001B32 RecordLayout_7 0 CompuMethod_1 0 65535 /end CHARACTERISTIC
/begin CHARACTERISTIC FaultManager.HardOverspeed.Total_Samples__Y_ "Fault manager configuration.  Select up to 4 actions for each fault." VALUE 0x80001B34 RecordLayout_7 0 CompuMethod_1 0 65535 /end CHARACTERISTIC
/begin CHARACTERISTIC FaultManager.HardOverspeed.Action_1 "Fault manager configuration.  Select up to 4 actions for each fault." VALUE 0x80001B36 RecordLayout_7 0 CompuMethod_91 0 65535 /end CHARACTERISTIC
/begin CHARACTERISTIC FaultManager.HardOverspeed.Action_1_Condition "Fault manager configuration.  Select up to 4 actions for each fault." VALUE 0x80001B38 RecordLayout_7 0 CompuMethod_92 0 65535 /end CHARACTERISTIC
/begin CHARACTERISTIC FaultManager.HardOverspeed.Action_2 "Fault manager configuration.  Select up to 4 actions for each fault." VALUE 0x80001B3A RecordLayout_7 0 CompuMethod_91 0 65535 /end CHARACTERISTIC
/begin CHARACTERISTIC FaultManager.HardOverspeed.Action_2_Condition "Fault manager configuration.  Select up to 4 actions for each fault." VALUE 0x80001B3C RecordLayout_7 0 CompuMethod_92 0 65535 /end CHARACTERISTIC
/begin CHARACTERISTIC FaultManager.HardOverspeed.Action_3 "Fault manager configuration.  Select up to 4 actions for each fault." VALUE 0x80001B3E RecordLayout_7 0 CompuMethod_91 0 65535 /end CHARACTERISTIC
/begin CHARACTERISTIC FaultManager.HardOverspeed.Action_3_Condition "Fault manager configuration.  Select up to 4 actions for each fault." VALUE 0x80001B40 RecordLayout_7 0 CompuMethod_92 0 65535 /end CHARACTERISTIC
/begin CHARACTERISTIC FaultManager.HardOverspeed.Action_4 "Fault manager configuration.  Select up to 4 actions for each fault." VALUE 0x80001B42 RecordLayout_7 0 CompuMethod_91 0 65535 /end CHARACTERISTIC
/begin CHARACTERISTIC FaultManager.HardOverspeed.Action_4_Condition "Fault manager configuration.  Select up to 4 actions for each fault." VALUE 0x80001B44 RecordLayout_7 0 CompuMethod_92 0 65535 /end CHARACTERISTIC
/begin CHARACTERISTIC FaultManager.IATRangeHigh.Mode "Fault manager configuration.  Select up to 4 actions for each fault." VALUE 0x80001B46 RecordLayout_7 0 CompuMethod_89 0 65535 /end CHARACTERISTIC
/begin CHARACTERISTIC FaultManager.IATRangeHigh.ID "Fault manager configuration.  Select up to 4 actions for each fault." VALUE 0x80001B48 RecordLayout_7 0 CompuMethod_1 0 65535 /end CHARACTERISTIC
/begin CHARACTERISTIC FaultManager.IATRangeHigh.Test "Fault manager configuration.  Select up to 4 actions for each fault." VALUE 0x80001B4A RecordLayout_7 0 CompuMethod_90 0 65535 /end CHARACTERISTIC
/begin CHARACTERISTIC FaultManager.IATRangeHigh.Faulty_Samples__X_ "Fault manager configuration.  Select up to 4 actions for each fault." VALUE 0x80001B4C RecordLayout_7 0 CompuMethod_1 0 65535 /end CHARACTERISTIC
/begin CHARACTERISTIC FaultManager.IATRangeHigh.Total_Samples__Y_ "Fault manager configuration.  Select up to 4 actions for each fault." VALUE 0x80001B4E RecordLayout_7 0 CompuMethod_1 0 65535 /end CHARACTERISTIC
/begin CHARACTERISTIC FaultManager.IATRangeHigh.Action_1 "Fault manager configuration.  Select up to 4 actions for each fault." VALUE 0x80001B50 RecordLayout_7 0 CompuMethod_91 0 65535 /end CHARACTERISTIC
/begin CHARACTERISTIC FaultManager.IATRangeHigh.Action_1_Condition "Fault manager configuration.  Select up to 4 actions for each fault." VALUE 0x80001B52 RecordLayout_7 0 CompuMethod_92 0 65535 /end CHARACTERISTIC
/begin CHARACTERISTIC FaultManager.IATRangeHigh.Action_2 "Fault manager configuration.  Select up to 4 actions for each fault." VALUE 0x80001B54 RecordLayout_7 0 CompuMethod_91 0 65535 /end CHARACTERISTIC
/begin CHARACTERISTIC FaultManager.IATRangeHigh.Action_2_Condition "Fault manager configuration.  Select up to 4 actions for each fault." VALUE 0x80001B56 RecordLayout_7 0 CompuMethod_92 0 65535 /end CHARACTERISTIC
/begin CHARACTERISTIC FaultManager.IATRangeHigh.Action_3 "Fault manager configuration.  Select up to 4 actions for each fault." VALUE 0x80001B58 RecordLayout_7 0 CompuMethod_91 0 65535 /end CHARACTERISTIC
/begin CHARACTERISTIC FaultManager.IATRangeHigh.Action_3_Condition "Fault manager configuration.  Select up to 4 actions for each fault." VALUE 0x80001B5A RecordLayout_7 0 CompuMethod_92 0 65535 /end CHARACTERISTIC
/begin CHARACTERISTIC FaultManager.IATRangeHigh.Action_4 "Fault manager configuration.  Select up to 4 actions for each fault." VALUE 0x80001B5C RecordLayout_7 0 CompuMethod_91 0 65535 /end CHARACTERISTIC
/begin CHARACTERISTIC FaultManager.IATRangeHigh.Action_4_Condition "Fault manager configuration.  Select up to 4 actions for each fault." VALUE 0x80001B5E RecordLayout_7 0 CompuMethod_92 0 65535 /end CHARACTERISTIC
/begin CHARACTERISTIC FaultManager.IATRangeLow.Mode "Fault manager configuration.  Select up to 4 actions for each fault." VALUE 0x80001B60 RecordLayout_7 0 CompuMethod_89 0 65535 /end CHARACTERISTIC
/begin CHARACTERISTIC FaultManager.IATRangeLow.ID "Fault manager configuration.  Select up to 4 actions for each fault." VALUE 0x80001B62 RecordLayout_7 0 CompuMethod_1 0 65535 /end CHARACTERISTIC
/begin CHARACTERISTIC FaultManager.IATRangeLow.Test "Fault manager configuration.  Select up to 4 actions for each fault." VALUE 0x80001B64 RecordLayout_7 0 CompuMethod_90 0 65535 /end CHARACTERISTIC
/begin CHARACTERISTIC FaultManager.IATRangeLow.Faulty_Samples__X_ "Fault manager configuration.  Select up to 4 actions for each fault." VALUE 0x80001B66 RecordLayout_7 0 CompuMethod_1 0 65535 /end CHARACTERISTIC
/begin CHARACTERISTIC FaultManager.IATRangeLow.Total_Samples__Y_ "Fault manager configuration.  Select up to 4 actions for each fault." VALUE 0x80001B68 RecordLayout_7 0 CompuMethod_1 0 65535 /end CHARACTERISTIC
/begin CHARACTERISTIC FaultManager.IATRangeLow.Action_1 "Fault manager configuration.  Select up to 4 actions for each fault." VALUE 0x80001B6A RecordLayout_7 0 CompuMethod_91 0 65535 /end CHARACTERISTIC
/begin CHARACTERISTIC FaultManager.IATRangeLow.Action_1_Condition "Fault manager configuration.  Select up to 4 actions for each fault." VALUE 0x80001B6C RecordLayout_7 0 CompuMethod_92 0 65535 /end CHARACTERISTIC
/begin CHARACTERISTIC FaultManager.IATRangeLow.Action_2 "Fault manager configuration.  Select up to 4 actions for each fault." VALUE 0x80001B6E RecordLayout_7 0 CompuMethod_91 0 65535 /end CHARACTERISTIC
/begin CHARACTERISTIC FaultManager.IATRangeLow.Action_2_Condition "Fault manager configuration.  Select up to 4 actions for each fault." VALUE 0x80001B70 RecordLayout_7 0 CompuMethod_92 0 65535 /end CHARACTERISTIC
/begin CHARACTERISTIC FaultManager.IATRangeLow.Action_3 "Fault manager configuration.  Select up to 4 actions for each fault." VALUE 0x80001B72 RecordLayout_7 0 CompuMethod_91 0 65535 /end CHARACTERISTIC
/begin CHARACTERISTIC FaultManager.IATRangeLow.Action_3_Condition "Fault manager configuration.  Select up to 4 actions for each fault." VALUE 0x80001B74 RecordLayout_7 0 CompuMethod_92 0 65535 /end CHARACTERISTIC
/begin CHARACTERISTIC FaultManager.IATRangeLow.Action_4 "Fault manager configuration.  Select up to 4 actions for each fault." VALUE 0x80001B76 RecordLayout_7 0 CompuMethod_91 0 65535 /end CHARACTERISTIC
/begin CHARACTERISTIC FaultManager.IATRangeLow.Action_4_Condition "Fault manager configuration.  Select up to 4 actions for each fault." VALUE 0x80001B78 RecordLayout_7 0 CompuMethod_92 0 65535 /end CHARACTERISTIC
/begin CHARACTERISTIC FaultManager.Inj1Open.Mode "Fault manager configuration.  Select up to 4 actions for each fault." VALUE 0x80001B7A RecordLayout_7 0 CompuMethod_89 0 65535 /end CHARACTERISTIC
/begin CHARACTERISTIC FaultManager.Inj1Open.ID "Fault manager configuration.  Select up to 4 actions for each fault." VALUE 0x80001B7C RecordLayout_7 0 CompuMethod_1 0 65535 /end CHARACTERISTIC
/begin CHARACTERISTIC FaultManager.Inj1Open.Test "Fault manager configuration.  Select up to 4 actions for each fault." VALUE 0x80001B7E RecordLayout_7 0 CompuMethod_90 0 65535 /end CHARACTERISTIC
/begin CHARACTERISTIC FaultManager.Inj1Open.Faulty_Samples__X_ "Fault manager configuration.  Select up to 4 actions for each fault." VALUE 0x80001B80 RecordLayout_7 0 CompuMethod_1 0 65535 /end CHARACTERISTIC
/begin CHARACTERISTIC FaultManager.Inj1Open.Total_Samples__Y_ "Fault manager configuration.  Select up to 4 actions for each fault." VALUE 0x80001B82 RecordLayout_7 0 CompuMethod_1 0 65535 /end CHARACTERISTIC
/begin CHARACTERISTIC FaultManager.Inj1Open.Action_1 "Fault manager configuration.  Select up to 4 actions for each fault." VALUE 0x80001B84 RecordLayout_7 0 CompuMethod_91 0 65535 /end CHARACTERISTIC
/begin CHARACTERISTIC FaultManager.Inj1Open.Action_1_Condition "Fault manager configuration.  Select up to 4 actions for each fault." VALUE 0x80001B86 RecordLayout_7 0 CompuMethod_92 0 65535 /end CHARACTERISTIC
/begin CHARACTERISTIC FaultManager.Inj1Open.Action_2 "Fault manager configuration.  Select up to 4 actions for each fault." VALUE 0x80001B88 RecordLayout_7 0 CompuMethod_91 0 65535 /end CHARACTERISTIC
/begin CHARACTERISTIC FaultManager.Inj1Open.Action_2_Condition "Fault manager configuration.  Select up to 4 actions for each fault." VALUE 0x80001B8A RecordLayout_7 0 CompuMethod_92 0 65535 /end CHARACTERISTIC
/begin CHARACTERISTIC FaultManager.Inj1Open.Action_3 "Fault manager configuration.  Select up to 4 actions for each fault." VALUE 0x80001B8C RecordLayout_7 0 CompuMethod_91 0 65535 /end CHARACTERISTIC
/begin CHARACTERISTIC FaultManager.Inj1Open.Action_3_Condition "Fault manager configuration.  Select up to 4 actions for each fault." VALUE 0x80001B8E RecordLayout_7 0 CompuMethod_92 0 65535 /end CHARACTERISTIC
/begin CHARACTERISTIC FaultManager.Inj1Open.Action_4 "Fault manager configuration.  Select up to 4 actions for each fault." VALUE 0x80001B90 RecordLayout_7 0 CompuMethod_91 0 65535 /end CHARACTERISTIC
/begin CHARACTERISTIC FaultManager.Inj1Open.Action_4_Condition "Fault manager configuration.  Select up to 4 actions for each fault." VALUE 0x80001B92 RecordLayout_7 0 CompuMethod_92 0 65535 /end CHARACTERISTIC
/begin CHARACTERISTIC FaultManager.Inj2Open.Mode "Fault manager configuration.  Select up to 4 actions for each fault." VALUE 0x80001B94 RecordLayout_7 0 CompuMethod_89 0 65535 /end CHARACTERISTIC
/begin CHARACTERISTIC FaultManager.Inj2Open.ID "Fault manager configuration.  Select up to 4 actions for each fault." VALUE 0x80001B96 RecordLayout_7 0 CompuMethod_1 0 65535 /end CHARACTERISTIC
/begin CHARACTERISTIC FaultManager.Inj2Open.Test "Fault manager configuration.  Select up to 4 actions for each fault." VALUE 0x80001B98 RecordLayout_7 0 CompuMethod_90 0 65535 /end CHARACTERISTIC
/begin CHARACTERISTIC FaultManager.Inj2Open.Faulty_Samples__X_ "Fault manager configuration.  Select up to 4 actions for each fault." VALUE 0x80001B9A RecordLayout_7 0 CompuMethod_1 0 65535 /end CHARACTERISTIC
/begin CHARACTERISTIC FaultManager.Inj2Open.Total_Samples__Y_ "Fault manager configuration.  Select up to 4 actions for each fault." VALUE 0x80001B9C RecordLayout_7 0 CompuMethod_1 0 65535 /end CHARACTERISTIC
/begin CHARACTERISTIC FaultManager.Inj2Open.Action_1 "Fault manager configuration.  Select up to 4 actions for each fault." VALUE 0x80001B9E RecordLayout_7 0 CompuMethod_91 0 65535 /end CHARACTERISTIC
/begin CHARACTERISTIC FaultManager.Inj2Open.Action_1_Condition "Fault manager configuration.  Select up to 4 actions for each fault." VALUE 0x80001BA0 RecordLayout_7 0 CompuMethod_92 0 65535 /end CHARACTERISTIC
/begin CHARACTERISTIC FaultManager.Inj2Open.Action_2 "Fault manager configuration.  Select up to 4 actions for each fault." VALUE 0x80001BA2 RecordLayout_7 0 CompuMethod_91 0 65535 /end CHARACTERISTIC
/begin CHARACTERISTIC FaultManager.Inj2Open.Action_2_Condition "Fault manager configuration.  Select up to 4 actions for each fault." VALUE 0x80001BA4 RecordLayout_7 0 CompuMethod_92 0 65535 /end CHARACTERISTIC
/begin CHARACTERISTIC FaultManager.Inj2Open.Action_3 "Fault manager configuration.  Select up to 4 actions for each fault." VALUE 0x80001BA6 RecordLayout_7 0 CompuMethod_91 0 65535 /end CHARACTERISTIC
/begin CHARACTERISTIC FaultManager.Inj2Open.Action_3_Condition "Fault manager configuration.  Select up to 4 actions for each fault." VALUE 0x80001BA8 RecordLayout_7 0 CompuMethod_92 0 65535 /end CHARACTERISTIC
/begin CHARACTERISTIC FaultManager.Inj2Open.Action_4 "Fault manager configuration.  Select up to 4 actions for each fault." VALUE 0x80001BAA RecordLayout_7 0 CompuMethod_91 0 65535 /end CHARACTERISTIC
/begin CHARACTERISTIC FaultManager.Inj2Open.Action_4_Condition "Fault manager configuration.  Select up to 4 actions for each fault." VALUE 0x80001BAC RecordLayout_7 0 CompuMethod_92 0 65535 /end CHARACTERISTIC
/begin CHARACTERISTIC FaultManager.MAFRangeHigh.Mode "Fault manager configuration.  Select up to 4 actions for each fault." VALUE 0x80001BAE RecordLayout_7 0 CompuMethod_89 0 65535 /end CHARACTERISTIC
/begin CHARACTERISTIC FaultManager.MAFRangeHigh.ID "Fault manager configuration.  Select up to 4 actions for each fault." VALUE 0x80001BB0 RecordLayout_7 0 CompuMethod_1 0 65535 /end CHARACTERISTIC
/begin CHARACTERISTIC FaultManager.MAFRangeHigh.Test "Fault manager configuration.  Select up to 4 actions for each fault." VALUE 0x80001BB2 RecordLayout_7 0 CompuMethod_90 0 65535 /end CHARACTERISTIC
/begin CHARACTERISTIC FaultManager.MAFRangeHigh.Faulty_Samples__X_ "Fault manager configuration.  Select up to 4 actions for each fault." VALUE 0x80001BB4 RecordLayout_7 0 CompuMethod_1 0 65535 /end CHARACTERISTIC
/begin CHARACTERISTIC FaultManager.MAFRangeHigh.Total_Samples__Y_ "Fault manager configuration.  Select up to 4 actions for each fault." VALUE 0x80001BB6 RecordLayout_7 0 CompuMethod_1 0 65535 /end CHARACTERISTIC
/begin CHARACTERISTIC FaultManager.MAFRangeHigh.Action_1 "Fault manager configuration.  Select up to 4 actions for each fault." VALUE 0x80001BB8 RecordLayout_7 0 CompuMethod_91 0 65535 /end CHARACTERISTIC
/begin CHARACTERISTIC FaultManager.MAFRangeHigh.Action_1_Condition "Fault manager configuration.  Select up to 4 actions for each fault." VALUE 0x80001BBA RecordLayout_7 0 CompuMethod_92 0 65535 /end CHARACTERISTIC
/begin CHARACTERISTIC FaultManager.MAFRangeHigh.Action_2 "Fault manager configuration.  Select up to 4 actions for each fault." VALUE 0x80001BBC RecordLayout_7 0 CompuMethod_91 0 65535 /end CHARACTERISTIC
/begin CHARACTERISTIC FaultManager.MAFRangeHigh.Action_2_Condition "Fault manager configuration.  Select up to 4 actions for each fault." VALUE 0x80001BBE RecordLayout_7 0 CompuMethod_92 0 65535 /end CHARACTERISTIC
/begin CHARACTERISTIC FaultManager.MAFRangeHigh.Action_3 "Fault manager configuration.  Select up to 4 actions for each fault." VALUE 0x80001BC0 RecordLayout_7 0 CompuMethod_91 0 65535 /end CHARACTERISTIC
/begin CHARACTERISTIC FaultManager.MAFRangeHigh.Action_3_Condition "Fault manager configuration.  Select up to 4 actions for each fault." VALUE 0x80001BC2 RecordLayout_7 0 CompuMethod_92 0 65535 /end CHARACTERISTIC
/begin CHARACTERISTIC FaultManager.MAFRangeHigh.Action_4 "Fault manager configuration.  Select up to 4 actions for each fault." VALUE 0x80001BC4 RecordLayout_7 0 CompuMethod_91 0 65535 /end CHARACTERISTIC
/begin CHARACTERISTIC FaultManager.MAFRangeHigh.Action_4_Condition "Fault manager configuration.  Select up to 4 actions for each fault." VALUE 0x80001BC6 RecordLayout_7 0 CompuMethod_92 0 65535 /end CHARACTERISTIC
/begin CHARACTERISTIC FaultManager.MAFRangeLow.Mode "Fault manager configuration.  Select up to 4 actions for each fault." VALUE 0x80001BC8 RecordLayout_7 0 CompuMethod_89 0 65535 /end CHARACTERISTIC
/begin CHARACTERISTIC FaultManager.MAFRangeLow.ID "Fault manager configuration.  Select up to 4 actions for each fault." VALUE 0x80001BCA RecordLayout_7 0 CompuMethod_1 0 65535 /end CHARACTERISTIC
/begin CHARACTERISTIC FaultManager.MAFRangeLow.Test "Fault manager configuration.  Select up to 4 actions for each fault." VALUE 0x80001BCC RecordLayout_7 0 CompuMethod_90 0 65535 /end CHARACTERISTIC
/begin CHARACTERISTIC FaultManager.MAFRangeLow.Faulty_Samples__X_ "Fault manager configuration.  Select up to 4 actions for each fault." VALUE 0x80001BCE RecordLayout_7 0 CompuMethod_1 0 65535 /end CHARACTERISTIC
/begin CHARACTERISTIC FaultManager.MAFRangeLow.Total_Samples__Y_ "Fault manager configuration.  Select up to 4 actions for each fault." VALUE 0x80001BD0 RecordLayout_7 0 CompuMethod_1 0 65535 /end CHARACTERISTIC
/begin CHARACTERISTIC FaultManager.MAFRangeLow.Action_1 "Fault manager configuration.  Select up to 4 actions for each fault." VALUE 0x80001BD2 RecordLayout_7 0 CompuMethod_91 0 65535 /end CHARACTERISTIC
/begin CHARACTERISTIC FaultManager.MAFRangeLow.Action_1_Condition "Fault manager configuration.  Select up to 4 actions for each fault." VALUE 0x80001BD4 RecordLayout_7 0 CompuMethod_92 0 65535 /end CHARACTERISTIC
/begin CHARACTERISTIC FaultManager.MAFRangeLow.Action_2 "Fault manager configuration.  Select up to 4 actions for each fault." VALUE 0x80001BD6 RecordLayout_7 0 CompuMethod_91 0 65535 /end CHARACTERISTIC
/begin CHARACTERISTIC FaultManager.MAFRangeLow.Action_2_Condition "Fault manager configuration.  Select up to 4 actions for each fault." VALUE 0x80001BD8 RecordLayout_7 0 CompuMethod_92 0 65535 /end CHARACTERISTIC
/begin CHARACTERISTIC FaultManager.MAFRangeLow.Action_3 "Fault manager configuration.  Select up to 4 actions for each fault." VALUE 0x80001BDA RecordLayout_7 0 CompuMethod_91 0 65535 /end CHARACTERISTIC
/begin CHARACTERISTIC FaultManager.MAFRangeLow.Action_3_Condition "Fault manager configuration.  Select up to 4 actions for each fault." VALUE 0x80001BDC RecordLayout_7 0 CompuMethod_92 0 65535 /end CHARACTERISTIC
/begin CHARACTERISTIC FaultManager.MAFRangeLow.Action_4 "Fault manager configuration.  Select up to 4 actions for each fault." VALUE 0x80001BDE RecordLayout_7 0 CompuMethod_91 0 65535 /end CHARACTERISTIC
/begin CHARACTERISTIC FaultManager.MAFRangeLow.Action_4_Condition "Fault manager configuration.  Select up to 4 actions for each fault." VALUE 0x80001BE0 RecordLayout_7 0 CompuMethod_92 0 65535 /end CHARACTERISTIC
/begin CHARACTERISTIC FaultManager.MAPRangeHigh.Mode "Fault manager configuration.  Select up to 4 actions for each fault." VALUE 0x80001BE2 RecordLayout_7 0 CompuMethod_89 0 65535 /end CHARACTERISTIC
/begin CHARACTERISTIC FaultManager.MAPRangeHigh.ID "Fault manager configuration.  Select up to 4 actions for each fault." VALUE 0x80001BE4 RecordLayout_7 0 CompuMethod_1 0 65535 /end CHARACTERISTIC
/begin CHARACTERISTIC FaultManager.MAPRangeHigh.Test "Fault manager configuration.  Select up to 4 actions for each fault." VALUE 0x80001BE6 RecordLayout_7 0 CompuMethod_90 0 65535 /end CHARACTERISTIC
/begin CHARACTERISTIC FaultManager.MAPRangeHigh.Faulty_Samples__X_ "Fault manager configuration.  Select up to 4 actions for each fault." VALUE 0x80001BE8 RecordLayout_7 0 CompuMethod_1 0 65535 /end CHARACTERISTIC
/begin CHARACTERISTIC MatlabVersionTxt "MATLAB version used to build the application." ASCII 0x400005F2 RecordLayout_2 0 CompuMethod_2 0 255 NUMBER 80 MATRIX_DIM 80 1 1 READ_ONLY /end CHARACTERISTIC
/begin CHARACTERISTIC MotoHawkBuildGUID "GUID identifying the MotoHawk build session" ASCII 0x40000696 RecordLayout_2 0 CompuMethod_2 0 255 NUMBER 80 MATRIX_DIM 80 1 1 READ_ONLY /end CHARACTERISTIC
/begin CHARACTERISTIC MotoHawkModelGUID "GUID identifying the MotoHawk model" ASCII 0x400006E6 RecordLayout_2 0 CompuMethod_2 0 255 NUMBER 80 MATRIX_DIM 80 1 1 READ_ONLY /end CHARACTERISTIC
/begin CHARACTERISTIC MotoHawkModelName "Simulink model name used for the MotoHawk build" ASCII 0x40000736 RecordLayout_2 0 CompuMethod_2 0 255 NUMBER 80 MATRIX_DIM 80 1 1 READ_ONLY /end CHARACTERISTIC
/begin CHARACTERISTIC MotoHawkTokenGUID "GUID identifying the token inserted during the build.  May be empty if no token was available" ASCII 0x4000078A RecordLayout_2 0 CompuMethod_2 0 255 NUMBER 80 MATRIX_DIM 80 1 1 READ_ONLY /end CHARACTERISTIC
/begin CHARACTERISTIC MotoHawkVersionTxt "MotoHawk version used to build the application." ASCII 0x400007DA RecordLayout_2 0 CompuMethod_2 0 255 NUMBER 50 MATRIX_DIM 50 1 1 READ_ONLY /end CHARACTERISTIC
/begin CHARACTERISTIC PartNumber "" ASCII 0x400008A0 RecordLayout_2 0 CompuMethod_2 0 255 NUMBER 40 MATRIX_DIM 40 1 1 READ_ONLY /end CHARACTERISTIC
/begin CHARACTERISTIC PasswordTxt "Password protection for this calibration" ASCII 0x800032B9 RecordLayout_2 0 CompuMethod_2 0 255 NUMBER 33 MATRIX_DIM 33 1 1 /end CHARACTERISTIC
/begin CHARACTERISTIC Torque_Filter "Filter time constant" VALUE 0x80003E62 RecordLayout_4 0 CompuMethod_54 -1E+17 1E+17 /end CHARACTERISTIC
/*~~~~~~~~~ 6.3.106 RECORD_LAYOUTs ~~~~~~~~~*/
/begin RECORD_LAYOUT RecordLayout_1 FNC_VALUES 1 UBYTE ROW_DIR DIRECT /end RECORD_LAYOUT
/begin RECORD_LAYOUT RecordLayout_2 FNC_VALUES 1 UBYTE ROW_DIR DIRECT /end RECORD_LAYOUT
/begin RECORD_LAYOUT RecordLayout_3 FNC_VALUES 1 ULONG ROW_DIR DIRECT /end RECORD_LAYOUT
/begin RECORD_LAYOUT RecordLayout_4 FNC_VALUES 1 FLOAT32_IEEE ROW_DIR DIRECT /end RECORD_LAYOUT
/begin RECORD_LAYOUT RecordLayout_7 FNC_VALUES 1 UWORD ROW_DIR DIRECT /end RECORD_LAYOUT
/*~~~~~~~~~ 6.3.31 COMPU_METHODs ~~~~~~~~~*/
/begin COMPU_METHOD CompuMethod_1 "" RAT_FUNC "%3.0" "" COEFFS 0 1 0 0 0 1 /end COMPU_METHOD
/begin COMPU_METHOD CompuMethod_2 "" RAT_FUNC "%6.2" "" COEFFS 0 1 0 0 0 1 /end COMPU_METHOD
/begin COMPU_METHOD CompuMethod_3 "" RAT_FUNC "%6.2" "ID" COEFFS 0 1 0 0 0 1 /end COMPU_METHOD
/begin COMPU_METHOD CompuMethod_4 "" TAB_VERB "%1.0" "" COMPU_TAB_REF CompuVtab_1 /end COMPU_METHOD
/begin COMPU_METHOD CompuMethod_33 "" RAT_FUNC "%8.0" "" COEFFS 0 1 0 0 0 1 /end COMPU_METHOD
/begin COMPU_METHOD CompuMethod_38 "" RAT_FUNC "%1.0" "" COEFFS 0 1 0 0 0 1 /end COMPU_METHOD
/begin COMPU_METHOD CompuMethod_54 "" RAT_FUNC "%6.2" "sec" COEFFS 0 1 0 0 0 1 /end COMPU_METHOD
/begin COMPU_METHOD CompuMethod_87 "" TAB_VERB "%3.0" "" COMPU_TAB_REF CompuVtab_28 /end COMPU_METHOD
/begin COMPU_METHOD CompuMethod_88 "" TAB_VERB "%3.0" "" COMPU_TAB_REF CompuVtab_29 /end COMPU_METHOD
/begin COMPU_METHOD CompuMethod_89 "" TAB_VERB "%3.0" "" COMPU_TAB_REF CompuVtab_30 /end COMPU_METHOD
/begin COMPU_METHOD CompuMethod_90 "" TAB_VERB "%3.0" "" COMPU_TAB_REF CompuVtab_31 /end COMPU_METHOD
/begin COMPU_METHOD CompuMethod_91 "" TAB_VERB "%3.0" "" COMPU_TAB_REF CompuVtab_32 /end COMPU_METHOD
/begin COMPU_METHOD CompuMethod_92 "" TAB_VERB "%3.0" "" COMPU_TAB_REF CompuVtab_33 /end COMPU_METHOD
/begin COMPU_METHOD CompuMethod_128 "" TAB_VERB "%3.0" "" COMPU_TAB_REF CompuVtab_51 /end COMPU_METHOD
/begin COMPU_METHOD CompuMethod_129 "" RAT_FUNC "%8.0" "seconds" COEFFS 0 1 0 0 0 1 /end COMPU_METHOD
/begin COMPU_METHOD CompuMethod_160 "" RAT_FUNC "%5.0" "MHz" COEFFS 0 1 0 0 0 1E-06 /end COMPU_METHOD
/begin COMPU_METHOD CompuMethod_165 "" TAB_VERB "%1.0" "" COMPU_TAB_REF CompuVtab_67 /end COMPU_METHOD
/*~~~~~~~~~ 6.3.34 COMPU_VTABs ~~~~~~~~~*/
/begin COMPU_VTAB CompuVtab_1 "" TAB_VERB 2 0 "Pass-Through" 1 "Override" /end COMPU_VTAB
/begin COMPU_VTAB CompuVtab_28 "" TAB_VERB 76 0 "CAN_Timeout_112" 1 "CAN_Timeout_Phoenix_1" 2 "CAN_Timeout_Phoenix_2" 3 "CAN_Timeout_Phoenix_3" 4 "CAN_Timeout_Phoenix_4" 5 "CamEdgesFault" 6 "CamSyncFault" 7 "CrankEdgesFault" 8 "CrankSyncFault" 9 "Drive_Hot" 10 "Drive_Warm" 11 "ECTOverTempFault" 12 "ECTRangeHigh" 13 "ECTRangeLow" 14 "ECTSevereOverTempFault" 15 "EGRSenseRangeHigh" 16 "EGRSenseRangeLow" 17 "EST1_Open" 18 "EST1_Short" 19 "EST2_Open" 20 "EST2_Short" 21 "ETCSpringTest" 22 "ETC_Open_Fault" 23 "ETC_Sticking" 24 "FuelAdaptRangeHi" 25 "FuelAdaptRangeLow" 26 "FuelPresHigh_Fault" 27 "FuelPresLow_Fault" 28 "FuelPresRangeHigh" 29 "FuelPresRangeLow" 30 "FuelSensRangeHigh" 31 "FuelSensRangeLow" 32 "HardOverspeed" 33 "IATRangeHigh" 34 "IATRangeLow" 35 "Inj1Open" 36 "Inj2Open" 37 "MAFRangeHigh" 38 "MAFRangeLow" 39 "MAPRangeHigh" 40 "MAPRangeLow" 41 "MAPTimeRangeHigh" 42 "MAPTimeRangeLow" 43 "MAP_IR_HI" 44 "MAP_IR_LO" 45 "MAP_STICKING" 46 "MediumOverspeed" 47 "Motor_Hot" 48 "Motor_Warm" 49 "NoOil_Fault" 50 "O2FailedLean" 51 "O2FailedRich" 52 "O2NotActive" 53 "O2_PostCatRangeHigh" 54 "O2_PostCatRangeLow" 55 "OilPresRangeHigh" 56 "OilPresRangeLow" 57 "SensVoltRangeHigh" 58 "SensVoltRangeLow" 59 "SoftOverspeed" 60 "SysVoltRangeHigh" 61 "SysVoltRangeLow" 62 "TPS1AdaptHiMax" 63 "TPS1AdaptHiMin" 64 "TPS1AdaptLoMax" 65 "TPS1AdaptLoMin" 66 "TPS1RangeHigh" 67 "TPS1RangeLow" 68 "TPS2AdaptHiMax" 69 "TPS2AdaptHiMin" 70 "TPS2AdaptLoMax" 71 "TPS2AdaptLoMin" 72 "TPS2RangeHigh" 73 "TPS2RangeLow" 74 "TPS_Sensors_Conflict" 75 "(None)" /end COMPU_VTAB
/begin COMPU_VTAB CompuVtab_29 "" TAB_VERB 2 0 "-" 1 "Clear All Faults" /end COMPU_VTAB
/begin COMPU_VTAB CompuVtab_30 "" TAB_VERB 6 0 "Disabled" 1 "Enabled" 2 "Sticky" 3 "Enabled - Persistent" 4 "Sticky - Persistent" 5 "Save Occurred" /end COMPU_VTAB
/begin COMPU_VTAB CompuVtab_31 "" TAB_VERB 2 0 "-" 1 "Test" /end COMPU_VTAB
/begin COMPU_VTAB CompuVtab_32 "" TAB_VERB 10 0 "CEL" 1 "CutThrottle" 2 "DelayedEngineShutdown" 3 "DisableO2Ctrl" 4 "EngineShutdown" 5 "HardRevLimit" 6 "MediumRevLimit" 7 "SoftRevLimit" 8 "Wrench_Light" 9 "(None)" /end COMPU_VTAB
/begin COMPU_VTAB CompuVtab_33 "" TAB_VERB 8 0 "(None)" 1 "Suspected" 2 "Active" 3 "Suspected or Active" 4 "Occurred" 5 "Suspected or Occurred" 6 "Active or Occurred" 7 "Suspected or Active or Occurred" /end COMPU_VTAB
/begin COMPU_VTAB CompuVtab_51 "" TAB_VERB 6 0 "Calibratable Development Module" 1 "Non-Calibratable Production Module" 2 "Software Dev Module (with RAM overlay only)" 3 "Software Dev Module (with Trace Pod & RAM)" 4 "Calibratable Development Module with Censorship disabled" 5 "Non-Calibratable Production Module with Censorship disabled" /end COMPU_VTAB
/begin COMPU_VTAB CompuVtab_67 "" TAB_VERB 40 0 "TPU Mask Undefined" 1 "60-6" 2 "GM24Xe" 3 "GM24Xe on Cam" 4 "N-1/N-2 [Half Moon Cam]" 5 "NX Encoder" 6 "NX Encoder on Cam" 7 "30-5 on Cnk" 8 "Hyundai 60" 9 "X Plus 1 on Cnk with ToothCam" 10 "X Shift 1 on Cnk" 11 "N Encoder" 12 "N-1/N-2 [Tooth Cam]" 13 "ISDL" 14 "X Pulse Width on Cam" 15 "X Pulse Width on Cnk" 16 "1 Pulse on Cnk" 17 "1 Pulse on Cam" 18 "N-1/N-2 Dual Redundancy" 19 "N-1/N-2 Variable Cam" 20 "N-1/N-2 [Duramax CAM] [Multiplexed EST (1,2, or 4,5,6,7,8) (9,10,11 or 13,14,15)]" 21 "X Plus 1 on Cnk + MuxPSP on EST > 9" 22 "NX Encoder with Hyundai 4 Tooth CAM with one wide" 23 "NX Encoder with 360Deg CAM Providing Crank Sync" 24 "NissanZ 36-6 Encoder, sync on custom CAM" 25 "36-1 Encoder, sync on custom Coyote CAM" 26 "N Groups of 4 teeth - 2, sync on CAM" 27 "NissanZ 36-6 Encoder, sync on 6Tooth 2Missing Plus2 Variable CAM" 28 "EVO9 2X Encoder with 1X_PLUS1 CAM on Exhaust and 4X Variable CAM on Intake" 29 "N-1/N-2 Variable Cam with Windowed Sync" 30 "36M4 (2x18 teeth sectors with 2 missing) and Kohki Cam" 31 "N-3/N-4 [ToothCam]" 32 "N-3/N-4 [Plus1Cam (X+1)]" 33 "Hyundai 60 with EncoderSynthesizer variant on TPUC" 34 "N-1/N-2 [Half Moon Cam]" 35 "X Plus 1 on Cnk with X Plus 1 Cam" 36 "X Plus 1 on Cnk with X Plus 1 Cam with Encoder Synthesizer" 37 "N-1/N-2 [XPlus1 Cam]" 38 "X Shift 1 Retarded [ToothCam]" 39 "N-1/N-2 [Tooth Cam] with MuxPSP" /end COMPU_VTAB
/*~~~~~~~~~ 6.3.65 FUNCTIONs ~~~~~~~~~*/
/begin FUNCTION Project_Config "" /begin DEF_CHARACTERISTIC project_id ProductID /end DEF_CHARACTERISTIC /end FUNCTION
/begin FUNCTION System_Config "" /begin DEF_CHARACTERISTIC FriendlyName PasswordTxt /end DEF_CHARACTERISTIC /begin SUB_FUNCTION Project_Config Trigger_Config Communication_Config /end SUB_FUNCTION /end FUNCTION
/begin FUNCTION System ""
 /begin SUB_FUNCTION System_Config Version Status Debug CCP Performance I_O_Pins Main_Power_Relay NonVolatile_Storage /end SUB_FUNCTION
/end FUNCTION
/begin FUNCTION Version ""
 /begin DEF_CHARACTERISTIC SwIdTxt CalIdTxt SwRevisionTxt CompilerVersion ControlCoreSDKRelease MatlabVersionTxt MotoHawkBuildGUID MotoHawkModelGUID MotoHawkModelName MotoHawkTokenGUID MotoHawkVersionTxt /end DEF_CHARACTERISTIC
 /begin OUT_MEASUREMENT table_0_rev table_1_rev table_2_rev KeyRev EriRev table_3_rev table_4_rev table_5_rev table_6_rev table_7_rev MotProgRev ApplicationCompatibilityArr LinkStatus MotoHawkModelSecondsInUse SystemFrequency TPUMaskType TPUMaskVers Unused /end OUT_MEASUREMENT
/end FUNCTION
/begin FUNCTION Module_Config "" /begin DEF_CHARACTERISTIC SerialNumber ModelNumber PartNumber /end DEF_CHARACTERISTIC
 /begin OUT_MEASUREMENT BootVerMaj BootVerMin EcuHwMaj EcuHwMin ConfigVerMaj ConfigVerMin ModuleCapability /end OUT_MEASUREMENT
/end FUNCTION
/begin FUNCTION Status "" /begin SUB_FUNCTION Module_Config OS Framework /end SUB_FUNCTION /end FUNCTION
/begin FUNCTION AD_Input1_En_Ovr_Override "" /begin DEF_CHARACTERISTIC AD_Input1_En_Ovr_new AD_Input1_En_Ovr_ovr /end DEF_CHARACTERISTIC /end FUNCTION
/begin FUNCTION Phoenix "" /begin DEF_CHARACTERISTIC Torque_Filter /end DEF_CHARACTERISTIC
 /begin OUT_MEASUREMENT AD_Input1_En_Prb AD_Input1_Vin_Prb AD_Input2_En_Prb AD_Input2_Vin_Prb An_PosSense1_Prb An_PosSense2_Prb Bus_HVIL_Status_Prb Control_Mode_Prb CtrlBoard_Temp_Prb DigPos_Sens2_Prb DigPos_Sens3_Prb DigPos_Sens4_Prb DigPos_Sens5_Prb DPos_Sens1_Prb Drive_Temp_Prb Est_Absolute_Torque_Prb Est_Relative_Torque_Prb Estimating_VBATT_Lv_Prb Generating_Prb GeneratingTq_Curve_Prb HVBus_Voltage_Prb Keyed_Voltage_Prb Motor_Estimated_HP Motor_Estimated_KW Motor_Speed_Prb Motor_Temp_Prb MotoringTq_Curve_Prb NegativeTq_Prb Phoenix_Fault_Prb PWMOutput_State_Prb Run_Enable_Prb Status1_Age_Count_Prb Status2_Age_Count_Prb Status3_Age_Count_Prb Status4_Age_Count_Prb ThreePhase_HVIL_Status_Prb TqLimiting_Reason_Prb XDRP_Internal_Meas_Prb XDRP_State_Prb /end OUT_MEASUREMENT
 /begin SUB_FUNCTION AD_Input1_En_Ovr_Override AD_Input1_Vin_Ovr_Override AD_Input2_En_Ovr_Override AD_Input2_Vin_Ovr_Override An_PosSense1_Ovr_Override An_PosSense2_Ovr_Override Bus_HVIL_Status_Ovr_Override Control_Mode_Ovr_Override CtrlBoard_Temp_Ovr_Override DigPos_Sens2_Ovr_Override DigPos_Sens3_Ovr_Override DigPos_Sens4_Ovr_Override DigPos_Sens5_Ovr_Override DPos_Sens1_Ovr_Override Drive_Temp_Ovr_Override Est_Absolute_Torque_Ovr_Override Est_Relative_Torque_Ovr_Override Estimating_VBATT_Lv_Ovr_Override Generating_Ovr_Override GeneratingTq_Curve_Ovr_Override HVBus_Voltage_Ovr_Override Keyed_Voltage_Ovr_Override Motor_Speed_Ovr_Override Motor_Temp_Ovr_Override MotoringTq_Curve_Ovr_Override NegativeTq_Ovr_Override Phoenix_Fault_Ovr_Override PWMOutput_State_Ovr_Override Run_Enable_Ovr_Override Status1_Age_Count_Ovr_Override Status2_Age_Count_Ovr_Override Status3_Age_Count_Ovr_Override Status4_Age_Count_Ovr_Override ThreePhase_HVIL_Status_Ovr_Override TqLimiting_Reason_Ovr_Override XDRP_Internal_Meas_Ovr_Override XDRP_State_Ovr_Override /end SUB_FUNCTION
/end FUNCTION
/begin FUNCTION CAN_Inputs "" /begin SUB_FUNCTION Phoenix _112 /end SUB_FUNCTION /end FUNCTION
/begin FUNCTION Inputs ""
 /begin SUB_FUNCTION CAN_Inputs PotentiometerSensors EngineSpeed NonLinearSensors LinearSensors Digital /end SUB_FUNCTION
/end FUNCTION
/begin FUNCTION Foreground "" /begin SUB_FUNCTION Inputs Control Outputs /end SUB_FUNCTION /end FUNCTION
/begin FUNCTION BaseEngineController_A02 ""
 /begin DEF_CHARACTERISTIC FaultCommand FaultManager.CAN_Timeout_112.Mode FaultManager.CAN_Timeout_112.ID FaultManager.CAN_Timeout_112.Test FaultManager.CAN_Timeout_112.Faulty_Samples__X_ FaultManager.CAN_Timeout_112.Total_Samples__Y_ FaultManager.CAN_Timeout_112.Action_1 FaultManager.CAN_Timeout_112.Action_1_Condition FaultManager.CAN_Timeout_112.Action_2 FaultManager.CAN_Timeout_112.Action_2_Condition FaultManager.CAN_Timeout_112.Action_3 FaultManager.CAN_Timeout_112.Action_3_Condition FaultManager.CAN_Timeout_112.Action_4 FaultManager.CAN_Timeout_112.Action_4_Condition FaultManager.CAN_Timeout_Phoenix_1.Mode FaultManager.CAN_Timeout_Phoenix_1.ID FaultManager.CAN_Timeout_Phoenix_1.Test FaultManager.CAN_Timeout_Phoenix_1.Faulty_Samples__X_ FaultManager.CAN_Timeout_Phoenix_1.Total_Samples__Y_ FaultManager.CAN_Timeout_Phoenix_1.Action_1 FaultManager.CAN_Timeout_Phoenix_1.Action_1_Condition FaultManager.CAN_Timeout_Phoenix_1.Action_2 FaultManager.CAN_Timeout_Phoenix_1.Action_2_Condition FaultManager.CAN_Timeout_Phoenix_1.Action_3 FaultManager.CAN_Timeout_Phoenix_1.Action_3_Condition FaultManager.CAN_Timeout_Phoenix_1.Action_4 FaultManager.CAN_Timeout_Phoenix_1.Action_4_Condition FaultManager.CAN_Timeout_Phoenix_2.Mode FaultManager.CAN_Timeout_Phoenix_2.ID FaultManager.CAN_Timeout_Phoenix_2.Test FaultManager.CAN_Timeout_Phoenix_2.Faulty_Samples__X_ FaultManager.CAN_Timeout_Phoenix_2.Total_Samples__Y_ FaultManager.CAN_Timeout_Phoenix_2.Action_1 FaultManager.CAN_Timeout_Phoenix_2.Action_1_Condition FaultManager.CAN_Timeout_Phoenix_2.Action_2 FaultManager.CAN_Timeout_Phoenix_2.Action_2_Condition FaultManager.CAN_Timeout_Phoenix_2.Action_3 FaultManager.CAN_Timeout_Phoenix_2.Action_3_Condition FaultManager.CAN_Timeout_Phoenix_2.Action_4 FaultManager.CAN_Timeout_Phoenix_2.Action_4_Condition FaultManager.CAN_Timeout_Phoenix_3.Mode FaultManager.CAN_Timeout_Phoenix_3.ID FaultManager.CAN_Timeout_Phoenix_3.Test FaultManager.CAN_Timeout_Phoenix_3.Faulty_Samples__X_ FaultManager.CAN_Timeout_Phoenix_3.Total_Samples__Y_ FaultManager.CAN_Timeout_Phoenix_3.Action_1 FaultManager.CAN_Timeout_Phoenix_3.Action_1_Condition FaultManager.CAN_Timeout_Phoenix_3.Action_2 FaultManager.CAN_Timeout_Phoenix_3.Action_2_Condition FaultManager.CAN_Timeout_Phoenix_3.Action_3 FaultManager.CAN_Timeout_Phoenix_3.Action_3_Condition FaultManager.CAN_Timeout_Phoenix_3.Action_4 FaultManager.CAN_Timeout_Phoenix_3.Action_4_Condition FaultManager.CAN_Timeout_Phoenix_4.Mode FaultManager.CAN_Timeout_Phoenix_4.ID FaultManager.CAN_Timeout_Phoenix_4.Test FaultManager.CAN_Timeout_Phoenix_4.Faulty_Samples__X_ FaultManager.CAN_Timeout_Phoenix_4.Total_Samples__Y_ FaultManager.CAN_Timeout_Phoenix_4.Action_1 FaultManager.CAN_Timeout_Phoenix_4.Action_1_Condition FaultManager.CAN_Timeout_Phoenix_4.Action_2 FaultManager.CAN_Timeout_Phoenix_4.Action_2_Condition FaultManager.CAN_Timeout_Phoenix_4.Action_3 FaultManager.CAN_Timeout_Phoenix_4.Action_3_Condition FaultManager.CAN_Timeout_Phoenix_4.Action_4 FaultManager.CAN_Timeout_Phoenix_4.Action_4_Condition FaultManager.CamEdgesFault.Mode FaultManager.CamEdgesFault.ID FaultManager.CamEdgesFault.Test FaultManager.CamEdgesFault.Faulty_Samples__X_ FaultManager.CamEdgesFault.Total_Samples__Y_ FaultManager.CamEdgesFault.Action_1 FaultManager.CamEdgesFault.Action_1_Condition FaultManager.CamEdgesFault.Action_2 FaultManager.CamEdgesFault.Action_2_Condition FaultManager.CamEdgesFault.Action_3 FaultManager.CamEdgesFault.Action_3_Condition FaultManager.CamEdgesFault.Action_4 FaultManager.CamEdgesFault.Action_4_Condition FaultManager.CamSyncFault.Mode FaultManager.CamSyncFault.ID FaultManager.CamSyncFault.Test FaultManager.CamSyncFault.Faulty_Samples__X_ FaultManager.CamSyncFault.Total_Samples__Y_ FaultManager.CamSyncFault.Action_1 FaultManager.CamSyncFault.Action_1_Condition FaultManager.CamSyncFault.Action_2 FaultManager.CamSyncFault.Action_2_Condition FaultManager.CamSyncFault.Action_3 FaultManager.CamSyncFault.Action_3_Condition FaultManager.CamSyncFault.Action_4 FaultManager.CamSyncFault.Action_4_Condition FaultManager.CrankEdgesFault.Mode FaultManager.CrankEdgesFault.ID FaultManager.CrankEdgesFault.Test FaultManager.CrankEdgesFault.Faulty_Samples__X_ FaultManager.CrankEdgesFault.Total_Samples__Y_ FaultManager.CrankEdgesFault.Action_1 FaultManager.CrankEdgesFault.Action_1_Condition FaultManager.CrankEdgesFault.Action_2 FaultManager.CrankEdgesFault.Action_2_Condition FaultManager.CrankEdgesFault.Action_3 FaultManager.CrankEdgesFault.Action_3_Condition FaultManager.CrankEdgesFault.Action_4 FaultManager.CrankEdgesFault.Action_4_Condition FaultManager.CrankSyncFault.Mode FaultManager.CrankSyncFault.ID FaultManager.CrankSyncFault.Test FaultManager.CrankSyncFault.Faulty_Samples__X_ FaultManager.CrankSyncFault.Total_Samples__Y_ FaultManager.CrankSyncFault.Action_1 FaultManager.CrankSyncFault.Action_1_Condition FaultManager.CrankSyncFault.Action_2 FaultManager.CrankSyncFault.Action_2_Condition FaultManager.CrankSyncFault.Action_3 FaultManager.CrankSyncFault.Action_3_Condition FaultManager.CrankSyncFault.Action_4 FaultManager.CrankSyncFault.Action_4_Condition FaultManager.Drive_Hot.Mode FaultManager.Drive_Hot.ID FaultManager.Drive_Hot.Test FaultManager.Drive_Hot.Faulty_Samples__X_ FaultManager.Drive_Hot.Total_Samples__Y_ FaultManager.Drive_Hot.Action_1 FaultManager.Drive_Hot.Action_1_Condition FaultManager.Drive_Hot.Action_2 FaultManager.Drive_Hot.Action_2_Condition FaultManager.Drive_Hot.Action_3 FaultManager.Drive_Hot.Action_3_Condition FaultManager.Drive_Hot.Action_4 FaultManager.Drive_Hot.Action_4_Condition FaultManager.Drive_Warm.Mode FaultManager.Drive_Warm.ID FaultManager.Drive_Warm.Test FaultManager.Drive_Warm.Faulty_Samples__X_ FaultManager.Drive_Warm.Total_Samples__Y_ FaultManager.Drive_Warm.Action_1 FaultManager.Drive_Warm.Action_1_Condition FaultManager.Drive_Warm.Action_2 FaultManager.Drive_Warm.Action_2_Condition FaultManager.Drive_Warm.Action_3 FaultManager.Drive_Warm.Action_3_Condition FaultManager.Drive_Warm.Action_4 FaultManager.Drive_Warm.Action_4_Condition FaultManager.ECTOverTempFault.Mode FaultManager.ECTOverTempFault.ID FaultManager.ECTOverTempFault.Test FaultManager.ECTOverTempFault.Faulty_Samples__X_ FaultManager.ECTOverTempFault.Total_Samples__Y_ FaultManager.ECTOverTempFault.Action_1 FaultManager.ECTOverTempFault.Action_1_Condition FaultManager.ECTOverTempFault.Action_2 FaultManager.ECTOverTempFault.Action_2_Condition FaultManager.ECTOverTempFault.Action_3 FaultManager.ECTOverTempFault.Action_3_Condition FaultManager.ECTOverTempFault.Action_4 FaultManager.ECTOverTempFault.Action_4_Condition FaultManager.ECTRangeHigh.Mode FaultManager.ECTRangeHigh.ID FaultManager.ECTRangeHigh.Test FaultManager.ECTRangeHigh.Faulty_Samples__X_ FaultManager.ECTRangeHigh.Total_Samples__Y_ FaultManager.ECTRangeHigh.Action_1 FaultManager.ECTRangeHigh.Action_1_Condition FaultManager.ECTRangeHigh.Action_2 FaultManager.ECTRangeHigh.Action_2_Condition FaultManager.ECTRangeHigh.Action_3 FaultManager.ECTRangeHigh.Action_3_Condition FaultManager.ECTRangeHigh.Action_4 FaultManager.ECTRangeHigh.Action_4_Condition FaultManager.ECTRangeLow.Mode FaultManager.ECTRangeLow.ID FaultManager.ECTRangeLow.Test FaultManager.ECTRangeLow.Faulty_Samples__X_ FaultManager.ECTRangeLow.Total_Samples__Y_ FaultManager.ECTRangeLow.Action_1 FaultManager.ECTRangeLow.Action_1_Condition FaultManager.ECTRangeLow.Action_2 FaultManager.ECTRangeLow.Action_2_Condition FaultManager.ECTRangeLow.Action_3 FaultManager.ECTRangeLow.Action_3_Condition FaultManager.ECTRangeLow.Action_4 FaultManager.ECTRangeLow.Action_4_Condition FaultManager.ECTSevereOverTempFault.Mode FaultManager.ECTSevereOverTempFault.ID FaultManager.ECTSevereOverTempFault.Test FaultManager.ECTSevereOverTempFault.Faulty_Samples__X_ FaultManager.ECTSevereOverTempFault.Total_Samples__Y_ FaultManager.ECTSevereOverTempFault.Action_1 FaultManager.ECTSevereOverTempFault.Action_1_Condition FaultManager.ECTSevereOverTempFault.Action_2 FaultManager.ECTSevereOverTempFault.Action_2_Condition FaultManager.ECTSevereOverTempFault.Action_3 FaultManager.ECTSevereOverTempFault.Action_3_Condition FaultManager.ECTSevereOverTempFault.Action_4 FaultManager.ECTSevereOverTempFault.Action_4_Condition FaultManager.EGRSenseRangeHigh.Mode FaultManager.EGRSenseRangeHigh.ID FaultManager.EGRSenseRangeHigh.Test FaultManager.EGRSenseRangeHigh.Faulty_Samples__X_ FaultManager.EGRSenseRangeHigh.Total_Samples__Y_ FaultManager.EGRSenseRangeHigh.Action_1 FaultManager.EGRSenseRangeHigh.Action_1_Condition FaultManager.EGRSenseRangeHigh.Action_2 FaultManager.EGRSenseRangeHigh.Action_2_Condition FaultManager.EGRSenseRangeHigh.Action_3 FaultManager.EGRSenseRangeHigh.Action_3_Condition FaultManager.EGRSenseRangeHigh.Action_4 FaultManager.EGRSenseRangeHigh.Action_4_Condition FaultManager.EGRSenseRangeLow.Mode FaultManager.EGRSenseRangeLow.ID FaultManager.EGRSenseRangeLow.Test FaultManager.EGRSenseRangeLow.Faulty_Samples__X_ FaultManager.EGRSenseRangeLow.Total_Samples__Y_ FaultManager.EGRSenseRangeLow.Action_1 FaultManager.EGRSenseRangeLow.Action_1_Condition FaultManager.EGRSenseRangeLow.Action_2 FaultManager.EGRSenseRangeLow.Action_2_Condition FaultManager.EGRSenseRangeLow.Action_3 FaultManager.EGRSenseRangeLow.Action_3_Condition FaultManager.EGRSenseRangeLow.Action_4 FaultManager.EGRSenseRangeLow.Action_4_Condition FaultManager.EST1_Open.Mode FaultManager.EST1_Open.ID FaultManager.EST1_Open.Test FaultManager.EST1_Open.Faulty_Samples__X_ FaultManager.EST1_Open.Total_Samples__Y_ FaultManager.EST1_Open.Action_1 FaultManager.EST1_Open.Action_1_Condition FaultManager.EST1_Open.Action_2 FaultManager.EST1_Open.Action_2_Condition FaultManager.EST1_Open.Action_3 FaultManager.EST1_Open.Action_3_Condition FaultManager.EST1_Open.Action_4 FaultManager.EST1_Open.Action_4_Condition FaultManager.EST1_Short.Mode FaultManager.EST1_Short.ID FaultManager.EST1_Short.Test FaultManager.EST1_Short.Faulty_Samples__X_ FaultManager.EST1_Short.Total_Samples__Y_ FaultManager.EST1_Short.Action_1 FaultManager.EST1_Short.Action_1_Condition FaultManager.EST1_Short.Action_2 FaultManager.EST1_Short.Action_2_Condition FaultManager.EST1_Short.Action_3 FaultManager.EST1_Short.Action_3_Condition FaultManager.EST1_Short.Action_4 FaultManager.EST1_Short.Action_4_Condition FaultManager.EST2_Open.Mode FaultManager.EST2_Open.ID FaultManager.EST2_Open.Test FaultManager.EST2_Open.Faulty_Samples__X_ FaultManager.EST2_Open.Total_Samples__Y_ FaultManager.EST2_Open.Action_1 FaultManager.EST2_Open.Action_1_Condition FaultManager.EST2_Open.Action_2 FaultManager.EST2_Open.Action_2_Condition FaultManager.EST2_Open.Action_3 FaultManager.EST2_Open.Action_3_Condition FaultManager.EST2_Open.Action_4 FaultManager.EST2_Open.Action_4_Condition FaultManager.EST2_Short.Mode FaultManager.EST2_Short.ID FaultManager.EST2_Short.Test FaultManager.EST2_Short.Faulty_Samples__X_ FaultManager.EST2_Short.Total_Samples__Y_ FaultManager.EST2_Short.Action_1 FaultManager.EST2_Short.Action_1_Condition FaultManager.EST2_Short.Action_2 FaultManager.EST2_Short.Action_2_Condition FaultManager.EST2_Short.Action_3 FaultManager.EST2_Short.Action_3_Condition FaultManager.EST2_Short.Action_4 FaultManager.EST2_Short.Action_4_Condition FaultManager.ETCSpringTest.Mode FaultManager.ETCSpringTest.ID FaultManager.ETCSpringTest.Test FaultManager.ETCSpringTest.Faulty_Samples__X_ FaultManager.ETCSpringTest.Total_Samples__Y_ FaultManager.ETCSpringTest.Action_1 FaultManager.ETCSpringTest.Action_1_Condition FaultManager.ETCSpringTest.Action_2 FaultManager.ETCSpringTest.Action_2_Condition FaultManager.ETCSpringTest.Action_3 FaultManager.ETCSpringTest.Action_3_Condition FaultManager.ETCSpringTest.Action_4 FaultManager.ETCSpringTest.Action_4_Condition FaultManager.ETC_Open_Fault.Mode FaultManager.ETC_Open_Fault.ID FaultManager.ETC_Open_Fault.Test FaultManager.ETC_Open_Fault.Faulty_Samples__X_ FaultManager.ETC_Open_Fault.Total_Samples__Y_ FaultManager.ETC_Open_Fault.Action_1 FaultManager.ETC_Open_Fault.Action_1_Condition FaultManager.ETC_Open_Fault.Action_2 FaultManager.ETC_Open_Fault.Action_2_Condition FaultManager.ETC_Open_Fault.Action_3 FaultManager.ETC_Open_Fault.Action_3_Condition FaultManager.ETC_Open_Fault.Action_4 FaultManager.ETC_Open_Fault.Action_4_Condition FaultManager.ETC_Sticking.Mode FaultManager.ETC_Sticking.ID FaultManager.ETC_Sticking.Test FaultManager.ETC_Sticking.Faulty_Samples__X_ FaultManager.ETC_Sticking.Total_Samples__Y_ FaultManager.ETC_Sticking.Action_1 FaultManager.ETC_Sticking.Action_1_Condition FaultManager.ETC_Sticking.Action_2 FaultManager.ETC_Sticking.Action_2_Condition FaultManager.ETC_Sticking.Action_3 FaultManager.ETC_Sticking.Action_3_Condition FaultManager.ETC_Sticking.Action_4 FaultManager.ETC_Sticking.Action_4_Condition FaultManager.FuelAdaptRangeHi.Mode FaultManager.FuelAdaptRangeHi.ID FaultManager.FuelAdaptRangeHi.Test FaultManager.FuelAdaptRangeHi.Faulty_Samples__X_ FaultManager.FuelAdaptRangeHi.Total_Samples__Y_ FaultManager.FuelAdaptRangeHi.Action_1 FaultManager.FuelAdaptRangeHi.Action_1_Condition FaultManager.FuelAdaptRangeHi.Action_2 FaultManager.FuelAdaptRangeHi.Action_2_Condition FaultManager.FuelAdaptRangeHi.Action_3 FaultManager.FuelAdaptRangeHi.Action_3_Condition FaultManager.FuelAdaptRangeHi.Action_4 FaultManager.FuelAdaptRangeHi.Action_4_Condition FaultManager.FuelAdaptRangeLow.Mode FaultManager.FuelAdaptRangeLow.ID FaultManager.FuelAdaptRangeLow.Test FaultManager.FuelAdaptRangeLow.Faulty_Samples__X_ FaultManager.FuelAdaptRangeLow.Total_Samples__Y_ FaultManager.FuelAdaptRangeLow.Action_1 FaultManager.FuelAdaptRangeLow.Action_1_Condition FaultManager.FuelAdaptRangeLow.Action_2 FaultManager.FuelAdaptRangeLow.Action_2_Condition FaultManager.FuelAdaptRangeLow.Action_3 FaultManager.FuelAdaptRangeLow.Action_3_Condition FaultManager.FuelAdaptRangeLow.Action_4 FaultManager.FuelAdaptRangeLow.Action_4_Condition FaultManager.FuelPresHigh_Fault.Mode FaultManager.FuelPresHigh_Fault.ID FaultManager.FuelPresHigh_Fault.Test FaultManager.FuelPresHigh_Fault.Faulty_Samples__X_ FaultManager.FuelPresHigh_Fault.Total_Samples__Y_ FaultManager.FuelPresHigh_Fault.Action_1 FaultManager.FuelPresHigh_Fault.Action_1_Condition FaultManager.FuelPresHigh_Fault.Action_2 FaultManager.FuelPresHigh_Fault.Action_2_Condition FaultManager.FuelPresHigh_Fault.Action_3 FaultManager.FuelPresHigh_Fault.Action_3_Condition FaultManager.FuelPresHigh_Fault.Action_4 FaultManager.FuelPresHigh_Fault.Action_4_Condition FaultManager.FuelPresLow_Fault.Mode FaultManager.FuelPresLow_Fault.ID FaultManager.FuelPresLow_Fault.Test FaultManager.FuelPresLow_Fault.Faulty_Samples__X_ FaultManager.FuelPresLow_Fault.Total_Samples__Y_ FaultManager.FuelPresLow_Fault.Action_1 FaultManager.FuelPresLow_Fault.Action_1_Condition FaultManager.FuelPresLow_Fault.Action_2 FaultManager.FuelPresLow_Fault.Action_2_Condition FaultManager.FuelPresLow_Fault.Action_3 FaultManager.FuelPresLow_Fault.Action_3_Condition FaultManager.FuelPresLow_Fault.Action_4 FaultManager.FuelPresLow_Fault.Action_4_Condition FaultManager.FuelPresRangeHigh.Mode FaultManager.FuelPresRangeHigh.ID FaultManager.FuelPresRangeHigh.Test FaultManager.FuelPresRangeHigh.Faulty_Samples__X_ FaultManager.FuelPresRangeHigh.Total_Samples__Y_ FaultManager.FuelPresRangeHigh.Action_1 FaultManager.FuelPresRangeHigh.Action_1_Condition FaultManager.FuelPresRangeHigh.Action_2 FaultManager.FuelPresRangeHigh.Action_2_Condition FaultManager.FuelPresRangeHigh.Action_3 FaultManager.FuelPresRangeHigh.Action_3_Condition FaultManager.FuelPresRangeHigh.Action_4 FaultManager.FuelPresRangeHigh.Action_4_Condition FaultManager.FuelPresRangeLow.Mode FaultManager.FuelPresRangeLow.ID FaultManager.FuelPresRangeLow.Test FaultManager.FuelPresRangeLow.Faulty_Samples__X_ FaultManager.FuelPresRangeLow.Total_Samples__Y_ FaultManager.FuelPresRangeLow.Action_1 FaultManager.FuelPresRangeLow.Action_1_Condition FaultManager.FuelPresRangeLow.Action_2 FaultManager.FuelPresRangeLow.Action_2_Condition FaultManager.FuelPresRangeLow.Action_3 FaultManager.FuelPresRangeLow.Action_3_Condition FaultManager.FuelPresRangeLow.Action_4 FaultManager.FuelPresRangeLow.Action_4_Condition FaultManager.FuelSensRangeHigh.Mode FaultManager.FuelSensRangeHigh.ID FaultManager.FuelSensRangeHigh.Test FaultManager.FuelSensRangeHigh.Faulty_Samples__X_ FaultManager.FuelSensRangeHigh.Total_Samples__Y_ FaultManager.FuelSensRangeHigh.Action_1 FaultManager.FuelSensRangeHigh.Action_1_Condition FaultManager.FuelSensRangeHigh.Action_2 FaultManager.FuelSensRangeHigh.Action_2_Condition FaultManager.FuelSensRangeHigh.Action_3 FaultManager.FuelSensRangeHigh.Action_3_Condition FaultManager.FuelSensRangeHigh.Action_4 FaultManager.FuelSensRangeHigh.Action_4_Condition FaultManager.FuelSensRangeLow.Mode FaultManager.FuelSensRangeLow.ID FaultManager.FuelSensRangeLow.Test FaultManager.FuelSensRangeLow.Faulty_Samples__X_ FaultManager.FuelSensRangeLow.Total_Samples__Y_ FaultManager.FuelSensRangeLow.Action_1 FaultManager.FuelSensRangeLow.Action_1_Condition FaultManager.FuelSensRangeLow.Action_2 FaultManager.FuelSensRangeLow.Action_2_Condition FaultManager.FuelSensRangeLow.Action_3 FaultManager.FuelSensRangeLow.Action_3_Condition FaultManager.FuelSensRangeLow.Action_4 FaultManager.FuelSensRangeLow.Action_4_Condition FaultManager.HardOverspeed.Mode FaultManager.HardOverspeed.ID FaultManager.HardOverspeed.Test FaultManager.HardOverspeed.Faulty_Samples__X_ FaultManager.HardOverspeed.Total_Samples__Y_ FaultManager.HardOverspeed.Action_1 FaultManager.HardOverspeed.Action_1_Condition FaultManager.HardOverspeed.Action_2 FaultManager.HardOverspeed.Action_2_Condition FaultManager.HardOverspeed.Action_3 FaultManager.HardOverspeed.Action_3_Condition FaultManager.HardOverspeed.Action_4 FaultManager.HardOverspeed.Action_4_Condition FaultManager.IATRangeHigh.Mode FaultManager.IATRangeHigh.ID FaultManager.IATRangeHigh.Test FaultManager.IATRangeHigh.Faulty_Samples__X_ FaultManager.IATRangeHigh.Total_Samples__Y_ FaultManager.IATRangeHigh.Action_1 FaultManager.IATRangeHigh.Action_1_Condition FaultManager.IATRangeHigh.Action_2 FaultManager.IATRangeHigh.Action_2_Condition FaultManager.IATRangeHigh.Action_3 FaultManager.IATRangeHigh.Action_3_Condition FaultManager.IATRangeHigh.Action_4 FaultManager.IATRangeHigh.Action_4_Condition FaultManager.IATRangeLow.Mode FaultManager.IATRangeLow.ID FaultManager.IATRangeLow.Test FaultManager.IATRangeLow.Faulty_Samples__X_ FaultManager.IATRangeLow.Total_Samples__Y_ FaultManager.IATRangeLow.Action_1 FaultManager.IATRangeLow.Action_1_Condition FaultManager.IATRangeLow.Action_2 FaultManager.IATRangeLow.Action_2_Condition FaultManager.IATRangeLow.Action_3 FaultManager.IATRangeLow.Action_3_Condition FaultManager.IATRangeLow.Action_4 FaultManager.IATRangeLow.Action_4_Condition FaultManager.Inj1Open.Mode FaultManager.Inj1Open.ID FaultManager.Inj1Open.Test FaultManager.Inj1Open.Faulty_Samples__X_ FaultManager.Inj1Open.Total_Samples__Y_ FaultManager.Inj1Open.Action_1 FaultManager.Inj1Open.Action_1_Condition FaultManager.Inj1Open.Action_2 FaultManager.Inj1Open.Action_2_Condition FaultManager.Inj1Open.Action_3 FaultManager.Inj1Open.Action_3_Condition FaultManager.Inj1Open.Action_4 FaultManager.Inj1Open.Action_4_Condition FaultManager.Inj2Open.Mode FaultManager.Inj2Open.ID FaultManager.Inj2Open.Test FaultManager.Inj2Open.Faulty_Samples__X_ FaultManager.Inj2Open.Total_Samples__Y_ FaultManager.Inj2Open.Action_1 FaultManager.Inj2Open.Action_1_Condition FaultManager.Inj2Open.Action_2 FaultManager.Inj2Open.Action_2_Condition FaultManager.Inj2Open.Action_3 FaultManager.Inj2Open.Action_3_Condition FaultManager.Inj2Open.Action_4 FaultManager.Inj2Open.Action_4_Condition FaultManager.MAFRangeHigh.Mode FaultManager.MAFRangeHigh.ID FaultManager.MAFRangeHigh.Test FaultManager.MAFRangeHigh.Faulty_Samples__X_ FaultManager.MAFRangeHigh.Total_Samples__Y_ FaultManager.MAFRangeHigh.Action_1 FaultManager.MAFRangeHigh.Action_1_Condition FaultManager.MAFRangeHigh.Action_2 FaultManager.MAFRangeHigh.Action_2_Condition FaultManager.MAFRangeHigh.Action_3 FaultManager.MAFRangeHigh.Action_3_Condition FaultManager.MAFRangeHigh.Action_4 FaultManager.MAFRangeHigh.Action_4_Condition FaultManager.MAFRangeLow.Mode FaultManager.MAFRangeLow.ID FaultManager.MAFRangeLow.Test FaultManager.MAFRangeLow.Faulty_Samples__X_ FaultManager.MAFRangeLow.Total_Samples__Y_ FaultManager.MAFRangeLow.Action_1 FaultManager.MAFRangeLow.Action_1_Condition FaultManager.MAFRangeLow.Action_2 FaultManager.MAFRangeLow.Action_2_Condition FaultManager.MAFRangeLow.Action_3 FaultManager.MAFRangeLow.Action_3_Condition FaultManager.MAFRangeLow.Action_4 FaultManager.MAFRangeLow.Action_4_Condition FaultManager.MAPRangeHigh.Mode FaultManager.MAPRangeHigh.ID FaultManager.MAPRangeHigh.Test FaultManager.MAPRangeHigh.Faulty_Samples__X_ /end DEF_CHARACTERISTIC
 /begin OUT_MEASUREMENT FaultMarquees.FaultMarquees.Current_Suspected FaultMarquees.FaultMarquees.Current_Active FaultMarquees.FaultMarquees.Current_Occurred /end OUT_MEASUREMENT
 /begin SUB_FUNCTION Foreground Action_Reasons /end SUB_FUNCTION
/end FUNCTION
/end MODULE
/end PROJECT
