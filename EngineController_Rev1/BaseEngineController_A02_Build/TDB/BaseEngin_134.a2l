ASAP2_VERSION 1 51
/begin PROJECT Project ""
/begin MODULE BaseEngin_134 ""
/begin MOD_COMMON /* MOD_COMMON Comment */ "" BYTE_ORDER MSB_FIRST ALIGNMENT_BYTE 1 ALIGNMENT_FLOAT32_IEEE 1 ALIGNMENT_FLOAT64_IEEE 1 ALIGNMENT_LONG 1 ALIGNMENT_WORD 1 /end MOD_COMMON
/begin MEASUREMENT Fuel_Economy_Filtered "" FLOAT32_IEEE CompuMethod_2 1 0 -1E+17 1E+17 ECU_ADDRESS 0x4000045C MATRIX_DIM 8 1 1 /end MEASUREMENT
/begin MEASUREMENT Fuel_Economy_Inst "" FLOAT32_IEEE CompuMethod_2 1 0 -1E+17 1E+17 ECU_ADDRESS 0x4000047C MATRIX_DIM 8 1 1 /end MEASUREMENT
/begin MEASUREMENT FuelDeltaPress "Fuel Delta Pressure - across the fuel injector" FLOAT32_IEEE CompuMethod_19 1 0 -1E+17 1E+17 ECU_ADDRESS 0x400004A5 /end MEASUREMENT
/begin MEASUREMENT FuelDeltaPressure "Fuel pressure across injector (rail - manifold)" FLOAT32_IEEE CompuMethod_19 1 0 -1E+17 1E+17 ECU_ADDRESS 0x400004A9 /end MEASUREMENT
/begin MEASUREMENT FUELP "Display output in engineering units" UBYTE CompuMethod_42 1 0 0 1 ECU_ADDRESS 0x400004B5 /end MEASUREMENT
/begin MEASUREMENT FuelPres "Final value after Linear Sensor Characterization" FLOAT32_IEEE CompuMethod_97 1 0 -1E+17 1E+17 ECU_ADDRESS 0x400004B6 /end MEASUREMENT
/begin MEASUREMENT FuelPresADC "Singal measured directly from sensor" UWORD CompuMethod_58 1 0 0 65535 ECU_ADDRESS 0x400004BA /end MEASUREMENT
/begin MEASUREMENT FuelPresRaw "After conversion to engineering units, before range checking" FLOAT32_IEEE CompuMethod_97 1 0 -1E+17 1E+17 ECU_ADDRESS 0x400004BC /end MEASUREMENT
/begin MEASUREMENT FuelSens "Final value after Linear Sensor Characterization" FLOAT32_IEEE CompuMethod_5 1 0 -1E+17 1E+17 ECU_ADDRESS 0x400004C4 /end MEASUREMENT
/begin MEASUREMENT FuelSensADC "Singal measured directly from sensor" FLOAT32_IEEE CompuMethod_81 1 0 -1E+17 1E+17 ECU_ADDRESS 0x400004C8 /end MEASUREMENT
/begin MEASUREMENT FuelSensRaw "After conversion to engineering units, before range checking" FLOAT32_IEEE CompuMethod_5 1 0 -1E+17 1E+17 ECU_ADDRESS 0x400004CC /end MEASUREMENT
/begin MEASUREMENT IAT "Final value after Linear Sensor Characterization" FLOAT32_IEEE CompuMethod_57 1 0 -1E+17 1E+17 ECU_ADDRESS 0x400004ED /end MEASUREMENT
/begin MEASUREMENT IAT_KeyUp "" FLOAT32_IEEE CompuMethod_57 1 0 -1E+17 1E+17 ECU_ADDRESS 0x400004F1 /end MEASUREMENT
/begin MEASUREMENT IAT05Idx "" UWORD CompuMethod_11 1 0 0 127.998 ECU_ADDRESS 0x400004FD /end MEASUREMENT
/begin MEASUREMENT IAT05In "" FLOAT32_IEEE CompuMethod_2 1 0 -1E+17 1E+17 ECU_ADDRESS 0x400004FF /end MEASUREMENT
/begin MEASUREMENT IAT17Idx "" UWORD CompuMethod_11 1 0 0 127.998 ECU_ADDRESS 0x40000503 /end MEASUREMENT
/begin MEASUREMENT IAT17In "" FLOAT32_IEEE CompuMethod_2 1 0 -1E+17 1E+17 ECU_ADDRESS 0x40000505 /end MEASUREMENT
/begin MEASUREMENT IATADC "Signal measured directly from sensor" UWORD CompuMethod_58 1 0 0 65535 ECU_ADDRESS 0x40000509 /end MEASUREMENT
/begin MEASUREMENT IATIdx "Look up table to allownon-linear characterization of sensors" UWORD CompuMethod_11 1 0 0 127.998 ECU_ADDRESS 0x4000050B /end MEASUREMENT
/begin MEASUREMENT IATRaw "After conversion to engineering units, before range checking" FLOAT32_IEEE CompuMethod_57 1 0 -1E+17 1E+17 ECU_ADDRESS 0x4000050D /end MEASUREMENT
/begin MEASUREMENT IndLoadNom05Idx "" UWORD CompuMethod_11 1 0 0 127.998 ECU_ADDRESS 0x4000051E /end MEASUREMENT
/begin MEASUREMENT IndLoadNom05In "" FLOAT32_IEEE CompuMethod_2 1 0 -1E+17 1E+17 ECU_ADDRESS 0x40000520 /end MEASUREMENT
/begin MEASUREMENT IndLoadNom09Idx "" UWORD CompuMethod_11 1 0 0 127.998 ECU_ADDRESS 0x40000524 /end MEASUREMENT
/begin MEASUREMENT IndLoadNom09In "" FLOAT32_IEEE CompuMethod_2 1 0 -1E+17 1E+17 ECU_ADDRESS 0x40000526 /end MEASUREMENT
/begin MEASUREMENT IndLoadNom17Idx "" UWORD CompuMethod_11 1 0 0 127.998 ECU_ADDRESS 0x4000052A /end MEASUREMENT
/begin MEASUREMENT IndLoadNom17In "" FLOAT32_IEEE CompuMethod_2 1 0 -1E+17 1E+17 ECU_ADDRESS 0x4000052C /end MEASUREMENT
/begin MEASUREMENT IndPower "" FLOAT32_IEEE CompuMethod_109 1 0 -1E+17 1E+17 ECU_ADDRESS 0x40000530 /end MEASUREMENT
/begin MEASUREMENT IndPower05Idx "" UWORD CompuMethod_11 1 0 0 127.998 ECU_ADDRESS 0x40000534 /end MEASUREMENT
/begin MEASUREMENT IndPower05In "" FLOAT32_IEEE CompuMethod_2 1 0 -1E+17 1E+17 ECU_ADDRESS 0x40000536 /end MEASUREMENT
/begin MEASUREMENT IndWork "" FLOAT32_IEEE CompuMethod_110 1 0 -1E+17 1E+17 ECU_ADDRESS 0x4000053A /end MEASUREMENT
/begin MEASUREMENT InjDeltaPress09Idx "" UWORD CompuMethod_11 1 0 0 127.998 ECU_ADDRESS 0x4000053F /end MEASUREMENT
/begin MEASUREMENT InjDeltaPress09In "" FLOAT32_IEEE CompuMethod_2 1 0 -1E+17 1E+17 ECU_ADDRESS 0x40000541 /end MEASUREMENT
/begin MEASUREMENT LeanSwPtDelta "If actual O2 reaches this point, switch the target to the RichTargetDelta" FLOAT32_IEEE CompuMethod_119 1 0 -1E+17 1E+17 ECU_ADDRESS 0x40000594 /end MEASUREMENT
/begin MEASUREMENT LeanTargetDelta "Target on the lean side for perturbation." FLOAT32_IEEE CompuMethod_119 1 0 -1E+17 1E+17 ECU_ADDRESS 0x40000598 /end MEASUREMENT
/begin MEASUREMENT LiquidO2Control_DTerm "Closed-loop O2 control D-Term, for bank" FLOAT32_IEEE CompuMethod_8 1 0 -1E+17 1E+17 ECU_ADDRESS 0x4000059D /end MEASUREMENT
/begin MEASUREMENT LiquidO2Control_ErrorTerm "Closed-loop O2 control error-term, for bank" FLOAT32_IEEE CompuMethod_8 1 0 -1E+17 1E+17 ECU_ADDRESS 0x400005A1 /end MEASUREMENT
/begin MEASUREMENT LiquidO2Control_ITerm "Closed-loop O2 control I-Term" FLOAT32_IEEE CompuMethod_8 1 0 -1E+17 1E+17 ECU_ADDRESS 0x400005A5 /end MEASUREMENT
/begin MEASUREMENT LiquidO2Control_PTerm "Closed-loop O2 control P-Term" FLOAT32_IEEE CompuMethod_8 1 0 -1E+17 1E+17 ECU_ADDRESS 0x400005A9 /end MEASUREMENT
/begin MEASUREMENT MAF "Final value after Linear Sensor Characterization" FLOAT32_IEEE CompuMethod_7 1 0 -1E+17 1E+17 ECU_ADDRESS 0x400005B6 /end MEASUREMENT
/begin MEASUREMENT MAFADC "Signal measured directly from sensor" FLOAT32_IEEE CompuMethod_81 1 0 -1E+17 1E+17 ECU_ADDRESS 0x400005C0 /end MEASUREMENT
/begin MEASUREMENT MAFIdx "Look up table to allownon-linear characterization of sensors" UWORD CompuMethod_11 1 0 0 127.998 ECU_ADDRESS 0x400005C4 /end MEASUREMENT
/begin MEASUREMENT MAFPort05Idx "" UWORD CompuMethod_11 1 0 0 127.998 ECU_ADDRESS 0x400005CA /end MEASUREMENT
/begin MEASUREMENT MAFPort05In "" FLOAT32_IEEE CompuMethod_2 1 0 -1E+17 1E+17 ECU_ADDRESS 0x400005CC /end MEASUREMENT
/begin MEASUREMENT MAFRaw "After conversion to engineering units, before range checking" FLOAT32_IEEE CompuMethod_7 1 0 -1E+17 1E+17 ECU_ADDRESS 0x400005D4 /end MEASUREMENT
/begin MEASUREMENT MAP "Final value after Linear Sensor Characterization" FLOAT32_IEEE CompuMethod_19 1 0 -1E+17 1E+17 ECU_ADDRESS 0x400005DC /end MEASUREMENT
/begin MEASUREMENT MAPADC "Singal measured directly from sensor" FLOAT32_IEEE CompuMethod_59 1 0 -1E+17 1E+17 ECU_ADDRESS 0x400005E0 /end MEASUREMENT
/begin MEASUREMENT MAPRaw "After conversion to engineering units, before range checking" FLOAT32_IEEE CompuMethod_19 1 0 -1E+17 1E+17 ECU_ADDRESS 0x400005E4 /end MEASUREMENT
/begin MEASUREMENT MAPTime "Final value after Linear Sensor Characterization" FLOAT32_IEEE CompuMethod_19 1 0 -1E+17 1E+17 ECU_ADDRESS 0x400005E8 /end MEASUREMENT
/begin MEASUREMENT MAPTimeADC "Singal measured directly from sensor" UWORD CompuMethod_58 1 0 0 65535 ECU_ADDRESS 0x400005EC /end MEASUREMENT
/begin MEASUREMENT MAPTimeRaw "After conversion to engineering units, before range checking" FLOAT32_IEEE CompuMethod_19 1 0 -1E+17 1E+17 ECU_ADDRESS 0x400005EE /end MEASUREMENT
/begin MEASUREMENT MaxGovDGainErrorMult "" FLOAT32_IEEE CompuMethod_8 1 0 -1E+17 1E+17 ECU_ADDRESS 0x4000064A /end MEASUREMENT
/begin MEASUREMENT MaxGovDTerm "" FLOAT32_IEEE CompuMethod_2 1 0 -1E+17 1E+17 ECU_ADDRESS 0x4000064E /end MEASUREMENT
/begin MEASUREMENT MaxGovError "" FLOAT32_IEEE CompuMethod_2 1 0 -1E+17 1E+17 ECU_ADDRESS 0x40000652 /end MEASUREMENT
/begin MEASUREMENT MaxGovETCMode "" UBYTE CompuMethod_123 1 0 0 1 ECU_ADDRESS 0x40000656 /end MEASUREMENT
/begin MEASUREMENT MaxGovHold "" SBYTE CompuMethod_124 1 0 -128 127 ECU_ADDRESS 0x40000657 /end MEASUREMENT
/begin MEASUREMENT MaxGovIC "" FLOAT32_IEEE CompuMethod_2 1 0 -1E+17 1E+17 ECU_ADDRESS 0x40000658 /end MEASUREMENT
/begin MEASUREMENT MaxGovIGainErrorMult "" FLOAT32_IEEE CompuMethod_8 1 0 -1E+17 1E+17 ECU_ADDRESS 0x4000065C /end MEASUREMENT
/begin MEASUREMENT MaxGovITerm "" FLOAT32_IEEE CompuMethod_2 1 0 -1E+17 1E+17 ECU_ADDRESS 0x40000660 /end MEASUREMENT
/begin MEASUREMENT MaxGovOutput "" FLOAT32_IEEE CompuMethod_2 1 0 -1E+17 1E+17 ECU_ADDRESS 0x40000664 /end MEASUREMENT
/begin MEASUREMENT MaxGovPGainErrorMult "" FLOAT32_IEEE CompuMethod_8 1 0 -1E+17 1E+17 ECU_ADDRESS 0x40000668 /end MEASUREMENT
/begin MEASUREMENT MaxGovPreloadITerm "Preload for Max Gov PID ITerm based on engine acceleration rate upon entry into max gov." FLOAT32_IEEE CompuMethod_5 1 0 -1E+17 1E+17 ECU_ADDRESS 0x4000066C /end MEASUREMENT
/begin MEASUREMENT MaxGovPTerm "" FLOAT32_IEEE CompuMethod_2 1 0 -1E+17 1E+17 ECU_ADDRESS 0x40000670 /end MEASUREMENT
/begin MEASUREMENT MaxGovReset "" SBYTE CompuMethod_125 1 0 -128 127 ECU_ADDRESS 0x40000674 /end MEASUREMENT
/begin MEASUREMENT MaxGovRPMSetpoint "RPMSetpoint of Max Gov controller." FLOAT32_IEEE CompuMethod_26 1 0 -1E+17 1E+17 ECU_ADDRESS 0x40000675 /end MEASUREMENT
/begin MEASUREMENT MaxGovSpeedErrorIdx "" UWORD CompuMethod_11 1 0 0 127.998 ECU_ADDRESS 0x40000679 /end MEASUREMENT
/begin MEASUREMENT MaxGovSpeedErrorIn "" FLOAT32_IEEE CompuMethod_26 1 0 -1E+17 1E+17 ECU_ADDRESS 0x4000067B /end MEASUREMENT
/begin MEASUREMENT MaxGovState "" UBYTE CompuMethod_55 1 0 0 1 ECU_ADDRESS 0x4000067F /end MEASUREMENT
/begin MEASUREMENT MaxSparkLimit "Maximum allowable spark advance." FLOAT32_IEEE CompuMethod_43 1 0 -1E+17 1E+17 ECU_ADDRESS 0x40000680 /end MEASUREMENT
/begin MEASUREMENT MinGovClntRPMSetPt "RPM setpoint based on ECT." FLOAT32_IEEE CompuMethod_26 1 0 -1E+17 1E+17 ECU_ADDRESS 0x40000684 /end MEASUREMENT
/begin MEASUREMENT MinGovRPMSetPt "" FLOAT32_IEEE CompuMethod_2 1 0 -1E+17 1E+17 ECU_ADDRESS 0x40000689 /end MEASUREMENT
/begin MEASUREMENT MinOilPressure_Fault "Minimum oil pressure based on RPM - engine faults and shuts down below this" FLOAT32_IEEE CompuMethod_126 1 0 -1E+17 1E+17 ECU_ADDRESS 0x4000068D /end MEASUREMENT
/begin MEASUREMENT MinOilPressure_Warn "Minimum oil pressure based on RPM - indicator light comes on below this" FLOAT32_IEEE CompuMethod_126 1 0 -1E+17 1E+17 ECU_ADDRESS 0x40000691 /end MEASUREMENT
/begin MEASUREMENT MotoringDetectionFlag "" UBYTE CompuMethod_38 1 0 0 1 ECU_ADDRESS 0x40000824 /end MEASUREMENT
/begin MEASUREMENT MotoringDetectionTime "" FLOAT32_IEEE CompuMethod_2 1 0 -1E+17 1E+17 ECU_ADDRESS 0x40000825 /end MEASUREMENT
/begin MEASUREMENT NECCT "Normalized effective combustion chamber temperature" FLOAT32_IEEE CompuMethod_47 1 0 -1E+17 1E+17 ECU_ADDRESS 0x4000082E /end MEASUREMENT
/begin MEASUREMENT NECCT09Idx "" UWORD CompuMethod_11 1 0 0 127.998 ECU_ADDRESS 0x40000832 /end MEASUREMENT
/begin MEASUREMENT NECCT09In "" FLOAT32_IEEE CompuMethod_2 1 0 -1E+17 1E+17 ECU_ADDRESS 0x40000834 /end MEASUREMENT
/begin MEASUREMENT NextCylinderToInject "Debug Variable" UBYTE CompuMethod_1 1 0 0 0 ECU_ADDRESS 0x4000083C /end MEASUREMENT
/begin MEASUREMENT NextCylinderToSpark "Debug Variable" UBYTE CompuMethod_1 1 0 0 0 ECU_ADDRESS 0x4000083D /end MEASUREMENT
/begin MEASUREMENT NextInjectorAngle "Debug Variable" FLOAT32_IEEE CompuMethod_2 1 0 0 0 ECU_ADDRESS 0x4000083E /end MEASUREMENT
/begin MEASUREMENT NextSparkAngle "Debug Variable" FLOAT32_IEEE CompuMethod_2 1 0 0 0 ECU_ADDRESS 0x40000842 /end MEASUREMENT
/begin MEASUREMENT NonVolatileCRC "Calculated NonVolatile CRC" ULONG CompuMethod_38 1 0 0 65535 ECU_ADDRESS 0x40000846 /end MEASUREMENT
/begin MEASUREMENT NonVolatileFormatID "Unique identifier of the NonVolatile memory format.  Used to validate whether stored variables are in the correct form for the program" ULONG CompuMethod_33 1 0 0 4294970000 ECU_ADDRESS 0x4000084A /end MEASUREMENT
/begin MEASUREMENT NonVolatileStatus "Indicates how NonVolatile memory was loaded" UBYTE CompuMethod_132 1 0 0 6 ECU_ADDRESS 0x4000084E /end MEASUREMENT
/begin MEASUREMENT O2_PostCat "Final value after Linear Sensor Characterization" FLOAT32_IEEE CompuMethod_119 1 0 -1E+17 1E+17 ECU_ADDRESS 0x4000084F /end MEASUREMENT
/begin MEASUREMENT O2_PostCatADC "Signal measured directly from sensor" UWORD CompuMethod_58 1 0 0 65535 ECU_ADDRESS 0x40000853 /end MEASUREMENT
/begin MEASUREMENT O2_PostCatIdx "Look up table to allownon-linear characterization of sensors" UWORD CompuMethod_11 1 0 0 127.998 ECU_ADDRESS 0x40000855 /end MEASUREMENT
/begin MEASUREMENT O2_PostCatRaw "After conversion to engineering units, before range checking" FLOAT32_IEEE CompuMethod_119 1 0 -1E+17 1E+17 ECU_ADDRESS 0x40000857 /end MEASUREMENT
/begin MEASUREMENT O2LeanTime "" FLOAT32_IEEE CompuMethod_2 1 0 -1E+17 1E+17 ECU_ADDRESS 0x40000867 /end MEASUREMENT
/begin MEASUREMENT O2MAFErrGainMult "O2 PID controller system gain based on MAF port." FLOAT32_IEEE CompuMethod_24 1 0 -1E+17 1E+17 ECU_ADDRESS 0x4000086B /end MEASUREMENT
/begin MEASUREMENT O2NECCTErrGainMult "O2 PID controller system gain based on NECCT." FLOAT32_IEEE CompuMethod_24 1 0 -1E+17 1E+17 ECU_ADDRESS 0x4000086F /end MEASUREMENT
/begin MEASUREMENT O2NotActiveTime "" FLOAT32_IEEE CompuMethod_2 1 0 -1E+17 1E+17 ECU_ADDRESS 0x40000873 /end MEASUREMENT
/begin MEASUREMENT O2RichTime "" FLOAT32_IEEE CompuMethod_2 1 0 -1E+17 1E+17 ECU_ADDRESS 0x40000877 /end MEASUREMENT
/begin MEASUREMENT O2TargetEquivRatio "Current target equivalence ratio for closed-loop O2 control." FLOAT32_IEEE CompuMethod_138 1 0 -1E+17 1E+17 ECU_ADDRESS 0x40000880 /end MEASUREMENT
/begin MEASUREMENT OILP "Display output in engineering units" UBYTE CompuMethod_42 1 0 0 1 ECU_ADDRESS 0x40000889 /end MEASUREMENT
/begin MEASUREMENT OilPres "Final value after Linear Sensor Characterization" FLOAT32_IEEE CompuMethod_126 1 0 -1E+17 1E+17 ECU_ADDRESS 0x4000088A /end MEASUREMENT
/begin MEASUREMENT OilPresADC "Singal measured directly from sensor" UWORD CompuMethod_58 1 0 0 65535 ECU_ADDRESS 0x4000088E /end MEASUREMENT
/begin MEASUREMENT OilPresRaw "After conversion to engineering units, before range checking" FLOAT32_IEEE CompuMethod_126 1 0 -1E+17 1E+17 ECU_ADDRESS 0x40000890 /end MEASUREMENT
/begin MEASUREMENT oneshot_create_ONESHOT "Debug Variable" UBYTE CompuMethod_9 1 0 0 0 ECU_ADDRESS 0x40000898 /end MEASUREMENT
/begin MEASUREMENT ONTSE "" FLOAT32_IEEE CompuMethod_2 1 0 -1E+17 1E+17 ECU_ADDRESS 0x40000899 /end MEASUREMENT
/begin MEASUREMENT Oxygen_Heater "Display output in engineering units" UBYTE CompuMethod_42 1 0 0 1 ECU_ADDRESS 0x4000089F /end MEASUREMENT
/begin MEASUREMENT PostO2Delag "" FLOAT32_IEEE CompuMethod_2 1 0 -1E+17 1E+17 ECU_ADDRESS 0x400008D6 /end MEASUREMENT
/begin MEASUREMENT PreO2Delag "" FLOAT32_IEEE CompuMethod_2 1 0 -1E+17 1E+17 ECU_ADDRESS 0x400008DA /end MEASUREMENT
/begin MEASUREMENT pwm_create_ETCPin_PWMOutput "Debug Variable" UBYTE CompuMethod_9 1 0 0 0 ECU_ADDRESS 0x400008E8 /end MEASUREMENT
/begin MEASUREMENT pwm_set_ETCPin_PWMOutput "Debug Variable" UBYTE CompuMethod_9 1 0 0 0 ECU_ADDRESS 0x400008E9 /end MEASUREMENT
/begin MEASUREMENT resource_allocation "Debug Variable" UBYTE CompuMethod_9 1 0 0 0 ECU_ADDRESS 0x400008EE /end MEASUREMENT
/begin MEASUREMENT RevLimiterState "" UBYTE CompuMethod_145 1 0 0 255 ECU_ADDRESS 0x400008EF /end MEASUREMENT
/begin MEASUREMENT RichSwPtDelta "If actual O2 reaches this point, switch the target to the LeanTargetDelta" FLOAT32_IEEE CompuMethod_119 1 0 -1E+17 1E+17 ECU_ADDRESS 0x400008F0 /end MEASUREMENT
/begin MEASUREMENT RichTargetDelta "Target on the rich side for perturbation." FLOAT32_IEEE CompuMethod_119 1 0 -1E+17 1E+17 ECU_ADDRESS 0x400008F4 /end MEASUREMENT
/begin MEASUREMENT RPM05Idx "" UWORD CompuMethod_11 1 0 0 127.998 ECU_ADDRESS 0x40000900 /end MEASUREMENT
/begin MEASUREMENT RPM05In "" FLOAT32_IEEE CompuMethod_2 1 0 -1E+17 1E+17 ECU_ADDRESS 0x40000902 /end MEASUREMENT
/begin MEASUREMENT RPM09Idx "" UWORD CompuMethod_11 1 0 0 127.998 ECU_ADDRESS 0x40000906 /end MEASUREMENT
/begin MEASUREMENT RPM09In "" FLOAT32_IEEE CompuMethod_2 1 0 -1E+17 1E+17 ECU_ADDRESS 0x40000908 /end MEASUREMENT
/begin MEASUREMENT RPM17Idx "" UWORD CompuMethod_11 1 0 0 127.998 ECU_ADDRESS 0x4000090C /end MEASUREMENT
/begin MEASUREMENT RPM17In "" FLOAT32_IEEE CompuMethod_2 1 0 -1E+17 1E+17 ECU_ADDRESS 0x4000090E /end MEASUREMENT
/begin MEASUREMENT RPMFalling "Indicates whether the RPM is falling" UBYTE CompuMethod_147 1 0 0 1 ECU_ADDRESS 0x40000919 /end MEASUREMENT
/begin MEASUREMENT SensVolt "Final value after Linear Sensor Characterization" FLOAT32_IEEE CompuMethod_150 1 0 -1E+17 1E+17 ECU_ADDRESS 0x4000092E /end MEASUREMENT
/begin MEASUREMENT SensVoltADC "Singal measured directly from sensor" UWORD CompuMethod_58 1 0 0 65535 ECU_ADDRESS 0x40000932 /end MEASUREMENT
/begin MEASUREMENT SensVoltRaw "After conversion to engineering units, before range checking" FLOAT32_IEEE CompuMethod_150 1 0 -1E+17 1E+17 ECU_ADDRESS 0x40000934 /end MEASUREMENT
/begin MEASUREMENT SpkMinGovDGainErrorMult "" FLOAT32_IEEE CompuMethod_8 1 0 -1E+17 1E+17 ECU_ADDRESS 0x40000953 /end MEASUREMENT
/begin MEASUREMENT SpkMinGovDTerm "PID Derivative Term" FLOAT32_IEEE CompuMethod_63 1 0 -1E+17 1E+17 ECU_ADDRESS 0x40000957 /end MEASUREMENT
/begin MEASUREMENT SpkMinGovError "PID Error Term" FLOAT32_IEEE CompuMethod_63 1 0 -1E+17 1E+17 ECU_ADDRESS 0x4000095B /end MEASUREMENT
/begin MEASUREMENT SpkMinGovPGainErrorMult "" FLOAT32_IEEE CompuMethod_8 1 0 -1E+17 1E+17 ECU_ADDRESS 0x40000963 /end MEASUREMENT
/begin MEASUREMENT SpkMinGovPTerm "PID Proportional Term" FLOAT32_IEEE CompuMethod_63 1 0 -1E+17 1E+17 ECU_ADDRESS 0x40000967 /end MEASUREMENT
/begin MEASUREMENT SpkMinGovSpeedErrorIdx "" UWORD CompuMethod_11 1 0 0 127.998 ECU_ADDRESS 0x4000096B /end MEASUREMENT
/begin MEASUREMENT SpkMinGovSpeedErrorIn "" FLOAT32_IEEE CompuMethod_2 1 0 -1E+17 1E+17 ECU_ADDRESS 0x4000096D /end MEASUREMENT
/begin MEASUREMENT SSEngOpr "Steady-State Engine Operation" UBYTE CompuMethod_157 1 0 0 1 ECU_ADDRESS 0x40000971 /end MEASUREMENT
/begin MEASUREMENT StableEngine_Prb "" UBYTE CompuMethod_38 1 0 0 1 ECU_ADDRESS 0x40000984 /end MEASUREMENT
/begin MEASUREMENT StableLoad_Prb "" UBYTE CompuMethod_38 1 0 0 1 ECU_ADDRESS 0x40000985 /end MEASUREMENT
/begin MEASUREMENT StableLoad_t_Prb "" UBYTE CompuMethod_38 1 0 0 1 ECU_ADDRESS 0x40000986 /end MEASUREMENT
/begin MEASUREMENT StableRPM_Prb "" UBYTE CompuMethod_38 1 0 0 1 ECU_ADDRESS 0x40000987 /end MEASUREMENT
/begin MEASUREMENT StableRPM_t_Prb "" UBYTE CompuMethod_38 1 0 0 1 ECU_ADDRESS 0x40000988 /end MEASUREMENT
/begin MEASUREMENT SysVolt "Final value after Linear Sensor Characterization" FLOAT32_IEEE CompuMethod_150 1 0 -1E+17 1E+17 ECU_ADDRESS 0x4000099E /end MEASUREMENT
/begin MEASUREMENT SysVolt09Idx "" UWORD CompuMethod_11 1 0 0 127.998 ECU_ADDRESS 0x400009A2 /end MEASUREMENT
/begin MEASUREMENT SysVolt09In "" FLOAT32_IEEE CompuMethod_2 1 0 -1E+17 1E+17 ECU_ADDRESS 0x400009A4 /end MEASUREMENT
/begin MEASUREMENT SysVoltADC "Singal measured directly from sensor" UWORD CompuMethod_58 1 0 0 65535 ECU_ADDRESS 0x400009A8 /end MEASUREMENT
/begin MEASUREMENT SysVoltRaw "After conversion to engineering units, before range checking" FLOAT32_IEEE CompuMethod_150 1 0 -1E+17 1E+17 ECU_ADDRESS 0x400009AA /end MEASUREMENT
/begin MEASUREMENT TimeSinceKeyOn "" FLOAT32_IEEE CompuMethod_2 1 0 -1E+17 1E+17 ECU_ADDRESS 0x400009B8 /end MEASUREMENT
/begin MEASUREMENT TimeSinceRun "" FLOAT32_IEEE CompuMethod_2 1 0 -1E+17 1E+17 ECU_ADDRESS 0x400009BC /end MEASUREMENT
/begin MEASUREMENT TimeSinceStall "Indicates time since entering Stall State - saturates and disables at 2000 seconds" FLOAT32_IEEE CompuMethod_21 1 0 -1E+17 1E+17 ECU_ADDRESS 0x400009C6 /end MEASUREMENT
/begin MEASUREMENT TotalSparkAdv "" FLOAT32_IEEE CompuMethod_2 1 0 -1E+17 1E+17 ECU_ADDRESS 0x400009EE /end MEASUREMENT
/begin MEASUREMENT TPS09Idx "" UWORD CompuMethod_11 1 0 0 127.998 ECU_ADDRESS 0x400009F2 /end MEASUREMENT
/begin MEASUREMENT TPS09In "" FLOAT32_IEEE CompuMethod_2 1 0 -1E+17 1E+17 ECU_ADDRESS 0x400009F4 /end MEASUREMENT
/begin MEASUREMENT TPS1Adapt_Hi "" FLOAT32_IEEE CompuMethod_2 1 0 -1E+17 1E+17 ECU_ADDRESS 0x400009F8 /end MEASUREMENT
/begin MEASUREMENT TPS1Adapt_Low "" FLOAT32_IEEE CompuMethod_2 1 0 -1E+17 1E+17 ECU_ADDRESS 0x400009FC /end MEASUREMENT
/begin MEASUREMENT TPS1ADC "" FLOAT32_IEEE CompuMethod_2 1 0 -1E+17 1E+17 ECU_ADDRESS 0x40000A00 /end MEASUREMENT
/begin MEASUREMENT TPS1Percent "" FLOAT32_IEEE CompuMethod_2 1 0 -1E+17 1E+17 ECU_ADDRESS 0x40000A04 /end MEASUREMENT
/begin MEASUREMENT TPS1PercentRaw "" FLOAT32_IEEE CompuMethod_2 1 0 -1E+17 1E+17 ECU_ADDRESS 0x40000A08 /end MEASUREMENT
/begin MEASUREMENT TPS2Adapt_Hi "" FLOAT32_IEEE CompuMethod_2 1 0 -1E+17 1E+17 ECU_ADDRESS 0x40000A0C /end MEASUREMENT
/begin MEASUREMENT TPS2Adapt_Low "" FLOAT32_IEEE CompuMethod_2 1 0 -1E+17 1E+17 ECU_ADDRESS 0x40000A10 /end MEASUREMENT
/begin MEASUREMENT TPS2ADC "" FLOAT32_IEEE CompuMethod_2 1 0 -1E+17 1E+17 ECU_ADDRESS 0x40000A14 /end MEASUREMENT
/begin MEASUREMENT TPS2Percent "" FLOAT32_IEEE CompuMethod_2 1 0 -1E+17 1E+17 ECU_ADDRESS 0x40000A18 /end MEASUREMENT
/begin MEASUREMENT TPS2PercentRaw "" FLOAT32_IEEE CompuMethod_2 1 0 -1E+17 1E+17 ECU_ADDRESS 0x40000A1C /end MEASUREMENT
/begin MEASUREMENT TPSRequestLookupAirOfst "" FLOAT32_IEEE CompuMethod_2 1 0 -1E+17 1E+17 ECU_ADDRESS 0x40000A20 /end MEASUREMENT
/begin MEASUREMENT WarmUpO2AdaptEnabled "Indicates whether FuelFlowComp map adapting is enabled due to WarmUp" UBYTE CompuMethod_22 1 0 0 1 ECU_ADDRESS 0x40000A4C /end MEASUREMENT
/begin CHARACTERISTIC Fuel_Cyl2_offset "Provide lock and relative offset to input signal." VALUE 0x80001FBD RecordLayout_4 0 CompuMethod_12 -1E+17 1E+17 /end CHARACTERISTIC
/begin CHARACTERISTIC Fuel_Cyl2_ovr "Provide lock and relative offset to input signal." VALUE 0x80001FC1 RecordLayout_1 0 CompuMethod_95 0 1 /end CHARACTERISTIC
/begin CHARACTERISTIC Fuel_Cyl3_offset "Provide lock and relative offset to input signal." VALUE 0x80001FC2 RecordLayout_4 0 CompuMethod_12 -1E+17 1E+17 /end CHARACTERISTIC
/begin CHARACTERISTIC Fuel_Cyl3_ovr "Provide lock and relative offset to input signal." VALUE 0x80001FC6 RecordLayout_1 0 CompuMethod_95 0 1 /end CHARACTERISTIC
/begin CHARACTERISTIC Fuel_Cyl4_offset "Provide lock and relative offset to input signal." VALUE 0x80001FC7 RecordLayout_4 0 CompuMethod_12 -1E+17 1E+17 /end CHARACTERISTIC
/begin CHARACTERISTIC Fuel_Cyl4_ovr "Provide lock and relative offset to input signal." VALUE 0x80001FCB RecordLayout_1 0 CompuMethod_95 0 1 /end CHARACTERISTIC
/begin CHARACTERISTIC Fuel_Cyl5_offset "Provide lock and relative offset to input signal." VALUE 0x80001FCC RecordLayout_4 0 CompuMethod_12 -1E+17 1E+17 /end CHARACTERISTIC
/begin CHARACTERISTIC Fuel_Cyl5_ovr "Provide lock and relative offset to input signal." VALUE 0x80001FD0 RecordLayout_1 0 CompuMethod_95 0 1 /end CHARACTERISTIC
/begin CHARACTERISTIC Fuel_Cyl6_offset "Provide lock and relative offset to input signal." VALUE 0x80001FD1 RecordLayout_4 0 CompuMethod_12 -1E+17 1E+17 /end CHARACTERISTIC
/begin CHARACTERISTIC Fuel_Cyl6_ovr "Provide lock and relative offset to input signal." VALUE 0x80001FD5 RecordLayout_1 0 CompuMethod_95 0 1 /end CHARACTERISTIC
/begin CHARACTERISTIC Fuel_Cyl7_offset "Provide lock and relative offset to input signal." VALUE 0x80001FD6 RecordLayout_4 0 CompuMethod_12 -1E+17 1E+17 /end CHARACTERISTIC
/begin CHARACTERISTIC Fuel_Cyl7_ovr "Provide lock and relative offset to input signal." VALUE 0x80001FDA RecordLayout_1 0 CompuMethod_95 0 1 /end CHARACTERISTIC
/begin CHARACTERISTIC Fuel_Cyl8_offset "Provide lock and relative offset to input signal." VALUE 0x80001FDB RecordLayout_4 0 CompuMethod_12 -1E+17 1E+17 /end CHARACTERISTIC
/begin CHARACTERISTIC Fuel_Cyl8_ovr "Provide lock and relative offset to input signal." VALUE 0x80001FDF RecordLayout_1 0 CompuMethod_95 0 1 /end CHARACTERISTIC
/begin CHARACTERISTIC Fuel_Global_offset "Provide lock and relative offset to input signal." VALUE 0x80001FE0 RecordLayout_4 0 CompuMethod_12 -1E+17 1E+17 /end CHARACTERISTIC
/begin CHARACTERISTIC Fuel_Global_ovr "Provide lock and relative offset to input signal." VALUE 0x80001FE4 RecordLayout_1 0 CompuMethod_95 0 1 /end CHARACTERISTIC
/begin CHARACTERISTIC FuelAdaptErrorLwrLim "Lower Limit Value" VALUE 0x80001FEA RecordLayout_4 0 CompuMethod_23 -1E+17 1E+17 /end CHARACTERISTIC
/begin CHARACTERISTIC FuelAdaptErrorUprLim "Upper Limit Value" VALUE 0x80001FEE RecordLayout_4 0 CompuMethod_23 -1E+17 1E+17 /end CHARACTERISTIC
/begin CHARACTERISTIC FuelEconomy_FilterC "Time constant for fuel economy filter" VALUE 0x80002016 RecordLayout_4 0 CompuMethod_96 0.001 100 /end CHARACTERISTIC
/begin CHARACTERISTIC FuelFlowCompMaxValue "Maximum value that can be adapted into the FuelFlowCompMap" VALUE 0x800022A2 RecordLayout_4 0 CompuMethod_8 0 2 /end CHARACTERISTIC
/begin CHARACTERISTIC FuelFlowCompMinValue "Minimum value that can be adapted into the FuelFlowCompMap" VALUE 0x800022A6 RecordLayout_4 0 CompuMethod_8 0 2 /end CHARACTERISTIC
/begin CHARACTERISTIC FUELP_new "Override actuator, in engineering units" VALUE 0x800022AA RecordLayout_1 0 CompuMethod_42 0 1 /end CHARACTERISTIC
/begin CHARACTERISTIC FUELP_ovr "" VALUE 0x800022AB RecordLayout_1 0 CompuMethod_4 0 1 /end CHARACTERISTIC
/begin CHARACTERISTIC FUELP_Polarity "Inverts the output of the actuator relative to the desired command - 0 = High True    1 = Low True" VALUE 0x800022AC RecordLayout_1 0 CompuMethod_42 0 1 /end CHARACTERISTIC
/begin CHARACTERISTIC FuelPres_DeltaTarget "Target fuel pressure delta across injector (rail - manifold)" VALUE 0x800022AD RecordLayout_4 0 CompuMethod_19 -1E+17 1E+17 /end CHARACTERISTIC
/begin CHARACTERISTIC FuelPres_DeltaTolerance "Target fuel pressure delta across injector (rail - manifold)" VALUE 0x800022B1 RecordLayout_4 0 CompuMethod_19 -1E+17 1E+17 /end CHARACTERISTIC
/begin CHARACTERISTIC FuelPres_FaultTimer "Number of seconds that fuel pressure must be out of spec for fault" VALUE 0x800022B5 RecordLayout_4 0 CompuMethod_21 0 1E+17 /end CHARACTERISTIC
/begin CHARACTERISTIC FuelPres_new "Override result of linear sensor characterization, in engineering units" VALUE 0x800022B9 RecordLayout_4 0 CompuMethod_98 -1E+17 1E+17 /end CHARACTERISTIC
/begin CHARACTERISTIC FuelPres_ovr "" VALUE 0x800022BD RecordLayout_1 0 CompuMethod_4 0 1 /end CHARACTERISTIC
/begin CHARACTERISTIC FuelPresDfltValue "This is the initial default value should the sensor be in fault on key-up.  Otherwise the sensors outputs the last value prior to faulting" VALUE 0x800022BE RecordLayout_4 0 CompuMethod_98 -1E+17 1E+17 /end CHARACTERISTIC
/begin CHARACTERISTIC FuelPresFilterConst "Filter time constant" VALUE 0x800022C2 RecordLayout_4 0 CompuMethod_54 -1E+17 1E+17 /end CHARACTERISTIC
/begin CHARACTERISTIC FuelPresGain "Scaling from A/D counts to engineering units" VALUE 0x800022C6 RecordLayout_4 0 CompuMethod_99 -1E+17 1E+17 /end CHARACTERISTIC
/begin CHARACTERISTIC FuelPresInputHiFltPos "Maximum allowable input, indicating short or open circuit" VALUE 0x800022CA RecordLayout_4 0 CompuMethod_59 -1E+17 1E+17 /end CHARACTERISTIC
/begin CHARACTERISTIC FuelPresInputLoFltPos "Minimum allowable input, indicating short or open circuit" VALUE 0x800022CE RecordLayout_4 0 CompuMethod_59 -1E+17 1E+17 /end CHARACTERISTIC
/begin CHARACTERISTIC FuelPresOfst "Offset after gain in engineering units" VALUE 0x800022D2 RecordLayout_4 0 CompuMethod_98 -1E+17 1E+17 /end CHARACTERISTIC
/begin CHARACTERISTIC FuelSens_new "Override result of linear sensor characterization, in engineering units" VALUE 0x800022DF RecordLayout_4 0 CompuMethod_5 -1E+17 1E+17 /end CHARACTERISTIC
/begin CHARACTERISTIC FuelSens_ovr "" VALUE 0x800022E3 RecordLayout_1 0 CompuMethod_4 0 1 /end CHARACTERISTIC
/begin CHARACTERISTIC FuelSensDfltValue "This is the initial default value should the sensor be in fault on key-up.  Otherwise the sensors outputs the last value prior to faulting" VALUE 0x800022E4 RecordLayout_4 0 CompuMethod_5 -1E+17 1E+17 /end CHARACTERISTIC
/begin CHARACTERISTIC FuelSensFilterConst "Filter time constant" VALUE 0x800022E8 RecordLayout_4 0 CompuMethod_54 -1E+17 1E+17 /end CHARACTERISTIC
/begin CHARACTERISTIC FuelSensGain "Scaling from A/D counts to engineering units" VALUE 0x800022EC RecordLayout_4 0 CompuMethod_65 -1E+17 1E+17 /end CHARACTERISTIC
/begin CHARACTERISTIC FuelSensInputHiFltPos "Maximum allowable input, indicating short or open circuit" VALUE 0x800022F0 RecordLayout_4 0 CompuMethod_81 -1E+17 1E+17 /end CHARACTERISTIC
/begin CHARACTERISTIC FuelSensInputLoFltPos "Minimum allowable input, indicating short or open circuit" VALUE 0x800022F4 RecordLayout_4 0 CompuMethod_81 -1E+17 1E+17 /end CHARACTERISTIC
/begin CHARACTERISTIC FuelSensOfst "Offset after gain in engineering units" VALUE 0x800022F8 RecordLayout_4 0 CompuMethod_5 -1E+17 1E+17 /end CHARACTERISTIC
/begin CHARACTERISTIC FuelSensorPin_AliasProtect "Frequency input alias detection for FuelSensorPin" VALUE 0x800022FE RecordLayout_1 0 CompuMethod_102 0 1 /end CHARACTERISTIC
/begin CHARACTERISTIC FuelSensorPin_EdgeDetect "Frequency input edge trigger for FuelSensorPin" VALUE 0x800022FF RecordLayout_1 0 CompuMethod_68 0 1 /end CHARACTERISTIC
/begin CHARACTERISTIC FuelSensorPin_Interface "Frequency input signal interface for FuelSensorPin" VALUE 0x80002300 RecordLayout_1 0 CompuMethod_103 0 1 /end CHARACTERISTIC
/begin CHARACTERISTIC FuelSensorPin_MinFrequency "Minimum expected input frequency for FuelSensorPin" VALUE 0x80002301 RecordLayout_3 0 CompuMethod_104 0.01 10000 /end CHARACTERISTIC
/begin CHARACTERISTIC Gain1 "Gain 1 For Moving Average Filter" VALUE 0x80002305 RecordLayout_4 0 CompuMethod_2 -1E+17 1E+17 /end CHARACTERISTIC
/begin CHARACTERISTIC Gain2 "Gain 2 For Moving Average Filter" VALUE 0x80002309 RecordLayout_4 0 CompuMethod_2 -1E+17 1E+17 /end CHARACTERISTIC
/begin CHARACTERISTIC Gain3 "Gain 3 For Moving Average Filter" VALUE 0x8000230D RecordLayout_4 0 CompuMethod_2 -1E+17 1E+17 /end CHARACTERISTIC
/begin CHARACTERISTIC Gain4 "Gain 4 For Moving Average Filter" VALUE 0x80002311 RecordLayout_4 0 CompuMethod_2 -1E+17 1E+17 /end CHARACTERISTIC
/begin CHARACTERISTIC Generating_Ovr_new "" VALUE 0x8000231D RecordLayout_4 0 CompuMethod_2 -1E+17 1E+17 /end CHARACTERISTIC
/begin CHARACTERISTIC Generating_Ovr_ovr "" VALUE 0x80002321 RecordLayout_1 0 CompuMethod_4 0 1 /end CHARACTERISTIC
/begin CHARACTERISTIC Generating_Torque_Lim_Ovr_new "" VALUE 0x80002322 RecordLayout_4 0 CompuMethod_2 -1E+17 1E+17 /end CHARACTERISTIC
/begin CHARACTERISTIC Generating_Torque_Lim_Ovr_ovr "" VALUE 0x80002326 RecordLayout_1 0 CompuMethod_4 0 1 /end CHARACTERISTIC
/begin CHARACTERISTIC Generating_Tq_Curve_Ovr_new "" VALUE 0x80002327 RecordLayout_4 0 CompuMethod_2 -1E+17 1E+17 /end CHARACTERISTIC
/begin CHARACTERISTIC Generating_Tq_Curve_Ovr_ovr "" VALUE 0x8000232B RecordLayout_1 0 CompuMethod_4 0 1 /end CHARACTERISTIC
/begin CHARACTERISTIC GeneratingTq_Curve_Ovr_new "" VALUE 0x8000232C RecordLayout_4 0 CompuMethod_2 -1E+17 1E+17 /end CHARACTERISTIC
/begin CHARACTERISTIC GeneratingTq_Curve_Ovr_ovr "" VALUE 0x80002330 RecordLayout_1 0 CompuMethod_4 0 1 /end CHARACTERISTIC
/begin CHARACTERISTIC Genset_Enable_Ovr_new "" VALUE 0x80002331 RecordLayout_1 0 CompuMethod_38 0 1 /end CHARACTERISTIC
/begin CHARACTERISTIC Genset_Enable_Ovr_ovr "" VALUE 0x80002332 RecordLayout_1 0 CompuMethod_4 0 1 /end CHARACTERISTIC
/begin CHARACTERISTIC Genset_Load_Ovr_new "" VALUE 0x80002333 RecordLayout_4 0 CompuMethod_2 -1E+17 1E+17 /end CHARACTERISTIC
/begin CHARACTERISTIC Genset_Load_Ovr_ovr "" VALUE 0x80002337 RecordLayout_1 0 CompuMethod_4 0 1 /end CHARACTERISTIC
/begin CHARACTERISTIC HardCycle1Cyl1 "" VALUE 0x80002338 RecordLayout_6 0 CompuMethod_105 -128 127 /end CHARACTERISTIC
/begin CHARACTERISTIC HardCycle1Cyl2 "" VALUE 0x80002339 RecordLayout_6 0 CompuMethod_105 -128 127 /end CHARACTERISTIC
/begin CHARACTERISTIC HardCycle1Cyl3 "" VALUE 0x8000233A RecordLayout_6 0 CompuMethod_105 -128 127 /end CHARACTERISTIC
/begin CHARACTERISTIC HardCycle1Cyl4 "" VALUE 0x8000233B RecordLayout_6 0 CompuMethod_105 -128 127 /end CHARACTERISTIC
/begin CHARACTERISTIC HardCycle1Cyl5 "" VALUE 0x8000233C RecordLayout_6 0 CompuMethod_105 -128 127 /end CHARACTERISTIC
/begin CHARACTERISTIC HardCycle1Cyl6 "" VALUE 0x8000233D RecordLayout_6 0 CompuMethod_105 -128 127 /end CHARACTERISTIC
/begin CHARACTERISTIC HardCycle1Cyl7 "" VALUE 0x8000233E RecordLayout_6 0 CompuMethod_105 -128 127 /end CHARACTERISTIC
/begin CHARACTERISTIC HardCycle1Cyl8 "" VALUE 0x8000233F RecordLayout_6 0 CompuMethod_105 -128 127 /end CHARACTERISTIC
/begin CHARACTERISTIC HardCycle2Cyl1 "" VALUE 0x80002340 RecordLayout_6 0 CompuMethod_105 -128 127 /end CHARACTERISTIC
/begin CHARACTERISTIC HardCycle2Cyl2 "" VALUE 0x80002341 RecordLayout_6 0 CompuMethod_105 -128 127 /end CHARACTERISTIC
/begin CHARACTERISTIC HardCycle2Cyl3 "" VALUE 0x80002342 RecordLayout_6 0 CompuMethod_105 -128 127 /end CHARACTERISTIC
/begin CHARACTERISTIC HardCycle2Cyl4 "" VALUE 0x80002343 RecordLayout_6 0 CompuMethod_105 -128 127 /end CHARACTERISTIC
/begin CHARACTERISTIC HardCycle2Cyl5 "" VALUE 0x80002344 RecordLayout_6 0 CompuMethod_105 -128 127 /end CHARACTERISTIC
/begin CHARACTERISTIC HardCycle2Cyl6 "" VALUE 0x80002345 RecordLayout_6 0 CompuMethod_105 -128 127 /end CHARACTERISTIC
/begin CHARACTERISTIC HardCycle2Cyl7 "" VALUE 0x80002346 RecordLayout_6 0 CompuMethod_105 -128 127 /end CHARACTERISTIC
/begin CHARACTERISTIC HardCycle2Cyl8 "" VALUE 0x80002347 RecordLayout_6 0 CompuMethod_105 -128 127 /end CHARACTERISTIC
/begin CHARACTERISTIC HardCycle3Cyl1 "" VALUE 0x80002348 RecordLayout_6 0 CompuMethod_105 -128 127 /end CHARACTERISTIC
/begin CHARACTERISTIC HardCycle3Cyl2 "" VALUE 0x80002349 RecordLayout_6 0 CompuMethod_105 -128 127 /end CHARACTERISTIC
/begin CHARACTERISTIC HardCycle3Cyl3 "" VALUE 0x8000234A RecordLayout_6 0 CompuMethod_105 -128 127 /end CHARACTERISTIC
/begin CHARACTERISTIC HardCycle3Cyl4 "" VALUE 0x8000234B RecordLayout_6 0 CompuMethod_105 -128 127 /end CHARACTERISTIC
/begin CHARACTERISTIC HardCycle3Cyl5 "" VALUE 0x8000234C RecordLayout_6 0 CompuMethod_105 -128 127 /end CHARACTERISTIC
/begin CHARACTERISTIC HardCycle3Cyl6 "" VALUE 0x8000234D RecordLayout_6 0 CompuMethod_105 -128 127 /end CHARACTERISTIC
/begin CHARACTERISTIC HardCycle3Cyl7 "" VALUE 0x8000234E RecordLayout_6 0 CompuMethod_105 -128 127 /end CHARACTERISTIC
/begin CHARACTERISTIC HardCycle3Cyl8 "" VALUE 0x8000234F RecordLayout_6 0 CompuMethod_105 -128 127 /end CHARACTERISTIC
/begin CHARACTERISTIC HardCycle4Cyl1 "" VALUE 0x80002350 RecordLayout_6 0 CompuMethod_105 -128 127 /end CHARACTERISTIC
/begin CHARACTERISTIC HardCycle4Cyl2 "" VALUE 0x80002351 RecordLayout_6 0 CompuMethod_105 -128 127 /end CHARACTERISTIC
/begin CHARACTERISTIC HardCycle4Cyl3 "" VALUE 0x80002352 RecordLayout_6 0 CompuMethod_105 -128 127 /end CHARACTERISTIC
/begin CHARACTERISTIC HardCycle4Cyl4 "" VALUE 0x80002353 RecordLayout_6 0 CompuMethod_105 -128 127 /end CHARACTERISTIC
/begin CHARACTERISTIC HardCycle4Cyl5 "" VALUE 0x80002354 RecordLayout_6 0 CompuMethod_105 -128 127 /end CHARACTERISTIC
/begin CHARACTERISTIC HardCycle4Cyl6 "" VALUE 0x80002355 RecordLayout_6 0 CompuMethod_105 -128 127 /end CHARACTERISTIC
/begin CHARACTERISTIC HardCycle4Cyl7 "" VALUE 0x80002356 RecordLayout_6 0 CompuMethod_105 -128 127 /end CHARACTERISTIC
/begin CHARACTERISTIC HardCycle4Cyl8 "" VALUE 0x80002357 RecordLayout_6 0 CompuMethod_105 -128 127 /end CHARACTERISTIC
/begin CHARACTERISTIC HVBus_Voltage_Ovr_new "" VALUE 0x8000235E RecordLayout_4 0 CompuMethod_2 -1E+17 1E+17 /end CHARACTERISTIC
/begin CHARACTERISTIC HVBus_Voltage_Ovr_ovr "" VALUE 0x80002362 RecordLayout_1 0 CompuMethod_4 0 1 /end CHARACTERISTIC
/begin CHARACTERISTIC IAT_KeyUp_Count "Number of samples to average at key-up to produce signal value" VALUE 0x80002363 RecordLayout_6 0 CompuMethod_1 -128 127 /end CHARACTERISTIC
/begin CHARACTERISTIC IAT_new "Override result of linear sensor characterization, in engineering units" VALUE 0x80002364 RecordLayout_4 0 CompuMethod_57 -1E+17 1E+17 /end CHARACTERISTIC
/begin CHARACTERISTIC IAT_ovr "" VALUE 0x80002368 RecordLayout_1 0 CompuMethod_4 0 1 /end CHARACTERISTIC
/begin CHARACTERISTIC IATDefault "This is the initial default value should the sensor be in fault on key-up.  Otherwise the sensors outputs the last value prior to faulting" VALUE 0x80002519 RecordLayout_4 0 CompuMethod_57 -1E+17 1E+17 /end CHARACTERISTIC
/begin CHARACTERISTIC IATFiltConst "Filter time constant" VALUE 0x8000251D RecordLayout_4 0 CompuMethod_54 -1E+17 1E+17 /end CHARACTERISTIC
/begin CHARACTERISTIC IATMax "Maximum allowable input, indicating short or open circuit" VALUE 0x800025BD RecordLayout_4 0 CompuMethod_59 -1E+17 1E+17 /end CHARACTERISTIC
/begin CHARACTERISTIC IATMin "Minimum allowable input, indicating short or open circuit" VALUE 0x800025C1 RecordLayout_4 0 CompuMethod_59 -1E+17 1E+17 /end CHARACTERISTIC
/begin CHARACTERISTIC IATTbl "Look up table to allownon-linear characterization of sensors" CURVE 0x800025C8 RecordLayout_4 0 CompuMethod_57 -1E+17 1E+17
 /begin AXIS_DESCR COM_AXIS IATADC CompuMethod_59 39 -1E+17 1E+17 AXIS_PTS_REF IATIdxArr /end AXIS_DESCR
/end CHARACTERISTIC
/begin CHARACTERISTIC IdleEntryAirRampInFiltC "Decays TPS Setpoint from Crank TPS to Run State base value at this rate." VALUE 0x80002668 RecordLayout_4 0 CompuMethod_54 0.005 1E+17 /end CHARACTERISTIC
/begin CHARACTERISTIC IndWorkMax "Maximum Indicated Work" VALUE 0x8000272A RecordLayout_4 0 CompuMethod_110 -1E+17 1E+17 /end CHARACTERISTIC
/begin CHARACTERISTIC InGearRPMCtrlEntryFiltC "Sets decay rate of RPM setpoint from entry RPM." VALUE 0x80002732 RecordLayout_4 0 CompuMethod_54 0.005 1E+17 /end CHARACTERISTIC
/begin CHARACTERISTIC InjEnable_new "" VAL_BLK 0x8000278E RecordLayout_1 0 CompuMethod_38 0 1 MATRIX_DIM 8 1 1 /end CHARACTERISTIC
/begin CHARACTERISTIC InjEnable_ovr "" VALUE 0x80002796 RecordLayout_1 0 CompuMethod_4 0 1 /end CHARACTERISTIC
/begin CHARACTERISTIC Inverter_Temp_Ovr_new "" VALUE 0x8000289D RecordLayout_4 0 CompuMethod_2 -1E+17 1E+17 /end CHARACTERISTIC
/begin CHARACTERISTIC Inverter_Temp_Ovr_ovr "" VALUE 0x800028A1 RecordLayout_1 0 CompuMethod_4 0 1 /end CHARACTERISTIC
/begin CHARACTERISTIC Keyed_Voltage_Ovr_new "" VALUE 0x800028A2 RecordLayout_4 0 CompuMethod_2 -1E+17 1E+17 /end CHARACTERISTIC
/begin CHARACTERISTIC Keyed_Voltage_Ovr_ovr "" VALUE 0x800028A6 RecordLayout_1 0 CompuMethod_4 0 1 /end CHARACTERISTIC
/begin CHARACTERISTIC LeanSwPtDeltaMap "If actual O2 reaches this point, switch the target to the RichTargetDelta" MAP 0x800028A7 RecordLayout_4 0 CompuMethod_119 -1E+17 1E+17
 /begin AXIS_DESCR COM_AXIS RPM09In CompuMethod_2 9 -1E+17 1E+17 AXIS_PTS_REF RPM09IdxArr /end AXIS_DESCR
 /begin AXIS_DESCR COM_AXIS IndLoadNom09In CompuMethod_2 9 -1E+17 1E+17 AXIS_PTS_REF IndLoadNom09IdxArr /end AXIS_DESCR
/end CHARACTERISTIC
/begin CHARACTERISTIC LeanTargetDeltaMap "Target on the lean side for perturbation." MAP 0x800029EB RecordLayout_4 0 CompuMethod_119 -1E+17 1E+17
 /begin AXIS_DESCR COM_AXIS RPM09In CompuMethod_2 9 -1E+17 1E+17 AXIS_PTS_REF RPM09IdxArr /end AXIS_DESCR
 /begin AXIS_DESCR COM_AXIS IndLoadNom09In CompuMethod_2 9 -1E+17 1E+17 AXIS_PTS_REF IndLoadNom09IdxArr /end AXIS_DESCR
/end CHARACTERISTIC
/begin CHARACTERISTIC Load_On_Ovr_new "" VALUE 0x80002B33 RecordLayout_1 0 CompuMethod_38 0 1 /end CHARACTERISTIC
/begin CHARACTERISTIC Load_On_Ovr_ovr "" VALUE 0x80002B34 RecordLayout_1 0 CompuMethod_4 0 1 /end CHARACTERISTIC
/begin CHARACTERISTIC Load_RPM_Ovr_new "" VALUE 0x80002B35 RecordLayout_4 0 CompuMethod_2 -1E+17 1E+17 /end CHARACTERISTIC
/begin CHARACTERISTIC Load_RPM_Ovr_ovr "" VALUE 0x80002B39 RecordLayout_1 0 CompuMethod_4 0 1 /end CHARACTERISTIC
/begin CHARACTERISTIC Load_Throttle_Ovr_new "" VALUE 0x80002B3A RecordLayout_4 0 CompuMethod_2 -1E+17 1E+17 /end CHARACTERISTIC
/begin CHARACTERISTIC Load_Throttle_Ovr_ovr "" VALUE 0x80002B3E RecordLayout_1 0 CompuMethod_4 0 1 /end CHARACTERISTIC
/begin CHARACTERISTIC MAF_new "Override result of linear sensor characterization, in engineering units" VALUE 0x80002B3F RecordLayout_4 0 CompuMethod_7 -1E+17 1E+17 /end CHARACTERISTIC
/begin CHARACTERISTIC MAF_ovr "" VALUE 0x80002B43 RecordLayout_1 0 CompuMethod_4 0 1 /end CHARACTERISTIC
/begin CHARACTERISTIC MAF_Pin_AliasProtect "Frequency input alias detection for MAF_Pin" VALUE 0x80002B46 RecordLayout_1 0 CompuMethod_102 0 1 /end CHARACTERISTIC
/begin CHARACTERISTIC MAF_Pin_EdgeDetect "Frequency input edge trigger for MAF_Pin" VALUE 0x80002B47 RecordLayout_1 0 CompuMethod_68 0 1 /end CHARACTERISTIC
/begin CHARACTERISTIC MAF_Pin_Interface "Frequency input signal interface for MAF_Pin" VALUE 0x80002B48 RecordLayout_1 0 CompuMethod_103 0 1 /end CHARACTERISTIC
/begin CHARACTERISTIC MAF_Pin_MinFrequency "Minimum expected input frequency for MAF_Pin" VALUE 0x80002B49 RecordLayout_3 0 CompuMethod_104 0.01 10000 /end CHARACTERISTIC
/begin CHARACTERISTIC MAFDefault "This is the initial default value should the sensor be in fault on key-up.  Otherwise the sensors outputs the last value prior to faulting" VALUE 0x80002B72 RecordLayout_4 0 CompuMethod_7 -1E+17 1E+17 /end CHARACTERISTIC
/begin CHARACTERISTIC MAFFiltConst "Filter time constant" VALUE 0x80002B76 RecordLayout_4 0 CompuMethod_54 -1E+17 1E+17 /end CHARACTERISTIC
/begin CHARACTERISTIC MAFMax "Maximum allowable input, indicating short or open circuit" VALUE 0x80002C1A RecordLayout_4 0 CompuMethod_81 -1E+17 1E+17 /end CHARACTERISTIC
/begin CHARACTERISTIC MAFMin "Minimum allowable input, indicating short or open circuit" VALUE 0x80002C1E RecordLayout_4 0 CompuMethod_81 -1E+17 1E+17 /end CHARACTERISTIC
/begin CHARACTERISTIC MAFTbl "Look up table to allownon-linear characterization of sensors" CURVE 0x80002C36 RecordLayout_4 0 CompuMethod_7 -1E+17 1E+17
 /begin AXIS_DESCR COM_AXIS MAFADC CompuMethod_81 40 -1E+17 1E+17 AXIS_PTS_REF MAFIdxArr /end AXIS_DESCR
/end CHARACTERISTIC
/begin CHARACTERISTIC MakeUp_EOI_new "" VALUE 0x80002CD6 RecordLayout_4 0 CompuMethod_2 -1E+17 1E+17 /end CHARACTERISTIC
/begin CHARACTERISTIC MakeUp_EOI_ovr "" VALUE 0x80002CDA RecordLayout_1 0 CompuMethod_4 0 1 /end CHARACTERISTIC
/begin CHARACTERISTIC MAP_IR_HI "In-range MAP fault logic. Maximum value that MAP should not exceed with closed throttle and engine running" VALUE 0x80002E1F RecordLayout_4 0 CompuMethod_19 0 1E+17 /end CHARACTERISTIC
/begin CHARACTERISTIC MAP_IR_LO "In-range MAP fault logic. Minimum value that MAP should not be less than with open throttle and engine running" VALUE 0x80002E23 RecordLayout_4 0 CompuMethod_19 0 1E+17 /end CHARACTERISTIC
/begin CHARACTERISTIC MAP_IR_TPS_CL "In-range MAP fault logic.  Maximum throttle position, below which MAP should be less than MAP_IR_HI" VALUE 0x80002E27 RecordLayout_4 0 CompuMethod_5 0 1E+17 /end CHARACTERISTIC
/begin CHARACTERISTIC MAP_IR_TPS_OP "In-range MAP fault logic.  Minimum throttle position, above which MAP should be greater than MAP_IR_LO" VALUE 0x80002E2B RecordLayout_4 0 CompuMethod_5 0 1E+17 /end CHARACTERISTIC
/begin CHARACTERISTIC MAP_new "Override result of linear sensor characterization, in engineering units" VALUE 0x80002E2F RecordLayout_4 0 CompuMethod_19 -1E+17 1E+17 /end CHARACTERISTIC
/begin CHARACTERISTIC MAP_ovr "" VALUE 0x80002E33 RecordLayout_1 0 CompuMethod_4 0 1 /end CHARACTERISTIC
/begin CHARACTERISTIC MAP_STUCK "In-range MAP fault logic.  Minimum difference between MAP and BARO with throttle closed. If less than this, a fault exists" VALUE 0x80002E34 RecordLayout_4 0 CompuMethod_19 0 1E+17 /end CHARACTERISTIC
/begin CHARACTERISTIC MAP_TPS_STUCK "In-range MAP fault logic.  Maximum throttle position, below_which MAP should be less than BARO" VALUE 0x80002E38 RecordLayout_4 0 CompuMethod_5 0 1E+17 /end CHARACTERISTIC
/begin CHARACTERISTIC MAPDfltValue "This is the initial default value should the sensor be in fault on key-up.  Otherwise the sensors outputs the last value prior to faulting" VALUE 0x80002E3C RecordLayout_4 0 CompuMethod_19 -1E+17 1E+17 /end CHARACTERISTIC
/begin CHARACTERISTIC MAPFilterConst "Filter time constant" VALUE 0x80002E40 RecordLayout_4 0 CompuMethod_54 -1E+17 1E+17 /end CHARACTERISTIC
/begin CHARACTERISTIC MAPGain "Scaling from A/D counts to engineering units" VALUE 0x80002E44 RecordLayout_4 0 CompuMethod_121 -1E+17 1E+17 /end CHARACTERISTIC
/begin CHARACTERISTIC MAPInputHiFltPos "Maximum allowable input, indicating short or open circuit" VALUE 0x80002E48 RecordLayout_4 0 CompuMethod_59 -1E+17 1E+17 /end CHARACTERISTIC
/begin CHARACTERISTIC MAPInputLoFltPos "Minimum allowable input, indicating short or open circuit" VALUE 0x80002E4C RecordLayout_4 0 CompuMethod_59 -1E+17 1E+17 /end CHARACTERISTIC
/begin CHARACTERISTIC MAPOfst "Offset after gain in engineering units" VALUE 0x80002E50 RecordLayout_4 0 CompuMethod_19 -1E+17 1E+17 /end CHARACTERISTIC
/begin CHARACTERISTIC MAPTime_new "Override result of linear sensor characterization, in engineering units" VALUE 0x80002E57 RecordLayout_4 0 CompuMethod_19 -1E+17 1E+17 /end CHARACTERISTIC
/begin CHARACTERISTIC MAPTime_ovr "" VALUE 0x80002E5B RecordLayout_1 0 CompuMethod_4 0 1 /end CHARACTERISTIC
/begin CHARACTERISTIC MAPTimeDfltValue "This is the initial default value should the sensor be in fault on key-up.  Otherwise the sensors outputs the last value prior to faulting" VALUE 0x80002E5C RecordLayout_4 0 CompuMethod_19 -1E+17 1E+17 /end CHARACTERISTIC
/begin CHARACTERISTIC MAPTimeFilterConst "Filter time constant" VALUE 0x80002E60 RecordLayout_4 0 CompuMethod_54 -1E+17 1E+17 /end CHARACTERISTIC
/begin CHARACTERISTIC MAPTimeGain "Scaling from A/D counts to engineering units" VALUE 0x80002E64 RecordLayout_4 0 CompuMethod_121 -1E+17 1E+17 /end CHARACTERISTIC
/begin CHARACTERISTIC MAPTimeInputHiFltPos "Maximum allowable input, indicating short or open circuit" VALUE 0x80002E68 RecordLayout_4 0 CompuMethod_59 -1E+17 1E+17 /end CHARACTERISTIC
/begin CHARACTERISTIC MAPTimeInputLoFltPos "Minimum allowable input, indicating short or open circuit" VALUE 0x80002E6C RecordLayout_4 0 CompuMethod_59 -1E+17 1E+17 /end CHARACTERISTIC
/begin CHARACTERISTIC MAPTimeOfst "Offset after gain in engineering units" VALUE 0x80002E70 RecordLayout_4 0 CompuMethod_19 -1E+17 1E+17 /end CHARACTERISTIC
/begin CHARACTERISTIC MaxGov "" VALUE 0x80002E9C RecordLayout_4 0 CompuMethod_2 -1E+17 1E+17 /end CHARACTERISTIC
/begin CHARACTERISTIC MaxGovDGain "Base D-gain for the max. governor controller." VALUE 0x80002EA0 RecordLayout_4 0 CompuMethod_8 -1E+17 1E+17 /end CHARACTERISTIC
/begin CHARACTERISTIC MaxGovDGainErrorMultTbl "" CURVE 0x80002EA4 RecordLayout_4 0 CompuMethod_8 -1E+17 1E+17
 /begin AXIS_DESCR COM_AXIS MaxGovSpeedErrorIn CompuMethod_26 9 -1E+17 1E+17 AXIS_PTS_REF MaxGovSpeedErrorIdxArr /end AXIS_DESCR
/end CHARACTERISTIC
/begin CHARACTERISTIC MaxGovDisable "Max governor manual disable" VALUE 0x80002EC8 RecordLayout_1 0 CompuMethod_122 0 1 /end CHARACTERISTIC
/begin CHARACTERISTIC MaxGovErrorGain "Error gain for the max governor controller. This gain is applied to the RPM error term before it is used to calculate the P, I and D terms." VALUE 0x80002EC9 RecordLayout_4 0 CompuMethod_8 -1E+17 1E+17 /end CHARACTERISTIC
/begin CHARACTERISTIC MaxGovIGain "Base I-gain for the max. governor controller." VALUE 0x80002ECD RecordLayout_4 0 CompuMethod_8 -1E+17 1E+17 /end CHARACTERISTIC
/begin CHARACTERISTIC MaxGovIGainErrorMultTbl "" CURVE 0x80002ED1 RecordLayout_4 0 CompuMethod_8 -1E+17 1E+17
 /begin AXIS_DESCR COM_AXIS MaxGovSpeedErrorIn CompuMethod_26 9 -1E+17 1E+17 AXIS_PTS_REF MaxGovSpeedErrorIdxArr /end AXIS_DESCR
/end CHARACTERISTIC
/begin CHARACTERISTIC MaxGovInGearLowerLim "Max Gov RPM setpoint when in gear." VALUE 0x80002EF5 RecordLayout_4 0 CompuMethod_26 0 1E+17 /end CHARACTERISTIC
/begin CHARACTERISTIC MaxGovInGearRPMSetPt "Max Gov RPM setpoint when in gear." VALUE 0x80002EF9 RecordLayout_4 0 CompuMethod_26 0 1E+17 /end CHARACTERISTIC
/begin CHARACTERISTIC MaxGovInGearRPMThresh "When in-gear, RPM has to pass the base RPM setpoint minus this calibration. to start the I term preload and ramp-in." VALUE 0x80002EFD RecordLayout_4 0 CompuMethod_26 0 1E+17 /end CHARACTERISTIC
/begin CHARACTERISTIC MaxGovInGearSetPt "Max Gov RPM setpoint when in gear." VALUE 0x80002F01 RecordLayout_4 0 CompuMethod_26 0 1E+17 /end CHARACTERISTIC
/begin CHARACTERISTIC MaxGovInGearUpperLim "Max Gov RPM setpoint when in gear." VALUE 0x80002F05 RecordLayout_4 0 CompuMethod_26 0 1E+17 /end CHARACTERISTIC
/begin CHARACTERISTIC MaxGovITermLowerLimit "Lower limit on max governor I-term value." VALUE 0x80002F09 RecordLayout_4 0 CompuMethod_5 -1E+17 1E+17 /end CHARACTERISTIC
/begin CHARACTERISTIC MaxGovITermUpperLimit "Upper limit on max governor I-term value." VALUE 0x80002F0D RecordLayout_4 0 CompuMethod_5 -1E+17 1E+17 /end CHARACTERISTIC
/begin CHARACTERISTIC MaxGovNtrlLowerLim "Max Gov RPM setpoint when in gear." VALUE 0x80002F11 RecordLayout_4 0 CompuMethod_26 0 1E+17 /end CHARACTERISTIC
/begin CHARACTERISTIC MaxGovNtrlRPMSetPt "Max Gov RPM setpoint when in neutral." VALUE 0x80002F15 RecordLayout_4 0 CompuMethod_26 0 1E+17 /end CHARACTERISTIC
/begin CHARACTERISTIC MaxGovNtrlRPMThresh "When in neutral, RPM has to pass the base RPM setpoint minus this calibration. to start the I term preload and ramp-in." VALUE 0x80002F19 RecordLayout_4 0 CompuMethod_26 0 1E+17 /end CHARACTERISTIC
/begin CHARACTERISTIC MaxGovNtrlSetPt "Max Gov RPM setpoint when in gear." VALUE 0x80002F1D RecordLayout_4 0 CompuMethod_26 0 1E+17 /end CHARACTERISTIC
/begin CHARACTERISTIC MaxGovNtrlUpperLim "Max Gov RPM setpoint when in gear." VALUE 0x80002F21 RecordLayout_4 0 CompuMethod_26 0 1E+17 /end CHARACTERISTIC
/begin CHARACTERISTIC MaxGovPGain "Base P-gain for the max. governor controller." VALUE 0x80002F25 RecordLayout_4 0 CompuMethod_8 -1E+17 1E+17 /end CHARACTERISTIC
/begin CHARACTERISTIC MaxGovPGainErrorMultTbl "" CURVE 0x80002F29 RecordLayout_4 0 CompuMethod_8 -1E+17 1E+17
 /begin AXIS_DESCR COM_AXIS MaxGovSpeedErrorIn CompuMethod_26 9 -1E+17 1E+17 AXIS_PTS_REF MaxGovSpeedErrorIdxArr /end AXIS_DESCR
/end CHARACTERISTIC
/begin CHARACTERISTIC MaxGovPIDOutLowerLimit "Lower limit on max governor PID Output." VALUE 0x80002F4D RecordLayout_4 0 CompuMethod_5 -1E+17 1E+17 /end CHARACTERISTIC
/begin CHARACTERISTIC MaxGovPIDOutUpperLimit "Upper limit on max governor PID Output." VALUE 0x80002F51 RecordLayout_4 0 CompuMethod_5 -1E+17 1E+17 /end CHARACTERISTIC
/begin CHARACTERISTIC MaxGovPreloadITermTbl "Preload for Max Gov PID ITerm based on engine acceleration rate upon entry into max gov." CURVE 0x80002F55 RecordLayout_4 0 CompuMethod_5 -1E+17 1E+17
 /begin AXIS_DESCR COM_AXIS RPMAccel17In CompuMethod_2 17 -1E+17 1E+17 AXIS_PTS_REF RPMAccel17IdxArr /end AXIS_DESCR
/end CHARACTERISTIC
/begin CHARACTERISTIC MaxGovRPMCtrlEntryFiltC "Filter rate at which Max Gov setup is increased to MaxGovBaseRPMSetpoint." VALUE 0x80002F99 RecordLayout_4 0 CompuMethod_54 0.005 1E+17 /end CHARACTERISTIC
/begin CHARACTERISTIC MaxGovTPSHyst "Hysterisis around max gov TPS entry criteria." VALUE 0x80002FC1 RecordLayout_4 0 CompuMethod_5 0 1E+17 /end CHARACTERISTIC
/begin CHARACTERISTIC MaxIndEngPwr "Maximum indicated engine power" VALUE 0x80002FC5 RecordLayout_4 0 CompuMethod_109 1 1000 /end CHARACTERISTIC
/begin CHARACTERISTIC MaxSparkLimitOffIdle "Max. spark limit on the delivered spark advance, when not in idle control." VALUE 0x80002FC9 RecordLayout_4 0 CompuMethod_43 -1E+17 1E+17 /end CHARACTERISTIC
/begin CHARACTERISTIC MaxSparkLimitTbl "Maximum allowable spark advance." CURVE 0x80002FCD RecordLayout_4 0 CompuMethod_43 -1E+17 1E+17
 /begin AXIS_DESCR COM_AXIS IndLoadNom09In CompuMethod_2 9 -1E+17 1E+17 AXIS_PTS_REF IndLoadNom09IdxArr /end AXIS_DESCR
/end CHARACTERISTIC
/begin CHARACTERISTIC Mech_PW_new "" VAL_BLK 0x80002FF1 RecordLayout_4 0 CompuMethod_2 -1E+17 1E+17 MATRIX_DIM 8 1 1 /end CHARACTERISTIC
/begin CHARACTERISTIC Mech_PW_ovr "" VALUE 0x80003011 RecordLayout_1 0 CompuMethod_4 0 1 /end CHARACTERISTIC
/begin CHARACTERISTIC MediumCycle1Cyl1 "" VALUE 0x80003012 RecordLayout_6 0 CompuMethod_105 -128 127 /end CHARACTERISTIC
/begin CHARACTERISTIC MediumCycle1Cyl2 "" VALUE 0x80003013 RecordLayout_6 0 CompuMethod_105 -128 127 /end CHARACTERISTIC
/begin CHARACTERISTIC MediumCycle1Cyl3 "" VALUE 0x80003014 RecordLayout_6 0 CompuMethod_105 -128 127 /end CHARACTERISTIC
/begin CHARACTERISTIC MediumCycle1Cyl4 "" VALUE 0x80003015 RecordLayout_6 0 CompuMethod_105 -128 127 /end CHARACTERISTIC
/begin CHARACTERISTIC MediumCycle1Cyl5 "" VALUE 0x80003016 RecordLayout_6 0 CompuMethod_105 -128 127 /end CHARACTERISTIC
/begin CHARACTERISTIC MediumCycle1Cyl6 "" VALUE 0x80003017 RecordLayout_6 0 CompuMethod_105 -128 127 /end CHARACTERISTIC
/begin CHARACTERISTIC MediumCycle1Cyl7 "" VALUE 0x80003018 RecordLayout_6 0 CompuMethod_105 -128 127 /end CHARACTERISTIC
/begin CHARACTERISTIC MediumCycle1Cyl8 "" VALUE 0x80003019 RecordLayout_6 0 CompuMethod_105 -128 127 /end CHARACTERISTIC
/begin CHARACTERISTIC MediumCycle2Cyl1 "" VALUE 0x8000301A RecordLayout_6 0 CompuMethod_105 -128 127 /end CHARACTERISTIC
/begin CHARACTERISTIC MediumCycle2Cyl2 "" VALUE 0x8000301B RecordLayout_6 0 CompuMethod_105 -128 127 /end CHARACTERISTIC
/begin CHARACTERISTIC MediumCycle2Cyl3 "" VALUE 0x8000301C RecordLayout_6 0 CompuMethod_105 -128 127 /end CHARACTERISTIC
/begin CHARACTERISTIC MediumCycle2Cyl4 "" VALUE 0x8000301D RecordLayout_6 0 CompuMethod_105 -128 127 /end CHARACTERISTIC
/begin CHARACTERISTIC MediumCycle2Cyl5 "" VALUE 0x8000301E RecordLayout_6 0 CompuMethod_105 -128 127 /end CHARACTERISTIC
/begin CHARACTERISTIC MediumCycle2Cyl6 "" VALUE 0x8000301F RecordLayout_6 0 CompuMethod_105 -128 127 /end CHARACTERISTIC
/begin CHARACTERISTIC MediumCycle2Cyl7 "" VALUE 0x80003020 RecordLayout_6 0 CompuMethod_105 -128 127 /end CHARACTERISTIC
/begin CHARACTERISTIC MediumCycle2Cyl8 "" VALUE 0x80003021 RecordLayout_6 0 CompuMethod_105 -128 127 /end CHARACTERISTIC
/begin CHARACTERISTIC MediumCycle3Cyl1 "" VALUE 0x80003022 RecordLayout_6 0 CompuMethod_105 -128 127 /end CHARACTERISTIC
/begin CHARACTERISTIC MediumCycle3Cyl2 "" VALUE 0x80003023 RecordLayout_6 0 CompuMethod_105 -128 127 /end CHARACTERISTIC
/begin CHARACTERISTIC MediumCycle3Cyl3 "" VALUE 0x80003024 RecordLayout_6 0 CompuMethod_105 -128 127 /end CHARACTERISTIC
/begin CHARACTERISTIC MediumCycle3Cyl4 "" VALUE 0x80003025 RecordLayout_6 0 CompuMethod_105 -128 127 /end CHARACTERISTIC
/begin CHARACTERISTIC MediumCycle3Cyl5 "" VALUE 0x80003026 RecordLayout_6 0 CompuMethod_105 -128 127 /end CHARACTERISTIC
/begin CHARACTERISTIC MediumCycle3Cyl6 "" VALUE 0x80003027 RecordLayout_6 0 CompuMethod_105 -128 127 /end CHARACTERISTIC
/begin CHARACTERISTIC MediumCycle3Cyl7 "" VALUE 0x80003028 RecordLayout_6 0 CompuMethod_105 -128 127 /end CHARACTERISTIC
/begin CHARACTERISTIC MediumCycle3Cyl8 "" VALUE 0x80003029 RecordLayout_6 0 CompuMethod_105 -128 127 /end CHARACTERISTIC
/begin CHARACTERISTIC MediumCycle4Cyl1 "" VALUE 0x8000302A RecordLayout_6 0 CompuMethod_105 -128 127 /end CHARACTERISTIC
/begin CHARACTERISTIC MediumCycle4Cyl2 "" VALUE 0x8000302B RecordLayout_6 0 CompuMethod_105 -128 127 /end CHARACTERISTIC
/begin CHARACTERISTIC MediumCycle4Cyl3 "" VALUE 0x8000302C RecordLayout_6 0 CompuMethod_105 -128 127 /end CHARACTERISTIC
/begin CHARACTERISTIC MediumCycle4Cyl4 "" VALUE 0x8000302D RecordLayout_6 0 CompuMethod_105 -128 127 /end CHARACTERISTIC
/begin CHARACTERISTIC MediumCycle4Cyl5 "" VALUE 0x8000302E RecordLayout_6 0 CompuMethod_105 -128 127 /end CHARACTERISTIC
/begin CHARACTERISTIC MediumCycle4Cyl6 "" VALUE 0x8000302F RecordLayout_6 0 CompuMethod_105 -128 127 /end CHARACTERISTIC
/begin CHARACTERISTIC MediumCycle4Cyl7 "" VALUE 0x80003030 RecordLayout_6 0 CompuMethod_105 -128 127 /end CHARACTERISTIC
/begin CHARACTERISTIC MediumCycle4Cyl8 "" VALUE 0x80003031 RecordLayout_6 0 CompuMethod_105 -128 127 /end CHARACTERISTIC
/begin CHARACTERISTIC MinGovClntRPMSetPtTbl "RPM setpoint based on ECT." CURVE 0x8000303E RecordLayout_4 0 CompuMethod_26 -1E+17 1E+17
 /begin AXIS_DESCR COM_AXIS ECT05In CompuMethod_2 5 -1E+17 1E+17 AXIS_PTS_REF ECT05IdxArr /end AXIS_DESCR
/end CHARACTERISTIC
/begin CHARACTERISTIC MinOilPressure_FaultTbl "Minimum oil pressure based on RPM - engine faults and shuts down below this" CURVE 0x8000305E RecordLayout_4 0 CompuMethod_126 -1E+17 1E+17
 /begin AXIS_DESCR COM_AXIS RPM09In CompuMethod_2 9 -1E+17 1E+17 AXIS_PTS_REF RPM09IdxArr /end AXIS_DESCR
/end CHARACTERISTIC
/begin CHARACTERISTIC MinOilPressure_WarnTbl "Minimum oil pressure based on RPM - indicator light comes on below this" CURVE 0x80003082 RecordLayout_4 0 CompuMethod_126 -1E+17 1E+17
 /begin AXIS_DESCR COM_AXIS RPM09In CompuMethod_2 9 -1E+17 1E+17 AXIS_PTS_REF RPM09IdxArr /end AXIS_DESCR
/end CHARACTERISTIC
/begin CHARACTERISTIC MinSparkLimit "Min. spark limit on the delivered spark advance." VALUE 0x800030A6 RecordLayout_4 0 CompuMethod_43 -1E+17 1E+17 /end CHARACTERISTIC
/begin CHARACTERISTIC Motor_Speed_Ovr_new "" VALUE 0x800030AF RecordLayout_4 0 CompuMethod_2 -1E+17 1E+17 /end CHARACTERISTIC
/begin CHARACTERISTIC Motor_Speed_Ovr_ovr "" VALUE 0x800030B3 RecordLayout_1 0 CompuMethod_4 0 1 /end CHARACTERISTIC
/begin CHARACTERISTIC Motor_Temp_Offset "" VALUE 0x800030B4 RecordLayout_4 0 CompuMethod_2 -1E+17 1E+17 /end CHARACTERISTIC
/begin CHARACTERISTIC Motor_Temp_Ovr_new "" VALUE 0x800030B8 RecordLayout_4 0 CompuMethod_2 -1E+17 1E+17 /end CHARACTERISTIC
/begin CHARACTERISTIC Motor_Temp_Ovr_ovr "" VALUE 0x800030BC RecordLayout_1 0 CompuMethod_4 0 1 /end CHARACTERISTIC
/begin CHARACTERISTIC Motoring_Torque_Lim_Ovr_new "" VALUE 0x800030C1 RecordLayout_4 0 CompuMethod_2 -1E+17 1E+17 /end CHARACTERISTIC
/begin CHARACTERISTIC Motoring_Torque_Lim_Ovr_ovr "" VALUE 0x800030C5 RecordLayout_1 0 CompuMethod_4 0 1 /end CHARACTERISTIC
/begin CHARACTERISTIC Motoring_Tq_Curve_Ovr_new "" VALUE 0x800030C6 RecordLayout_4 0 CompuMethod_2 -1E+17 1E+17 /end CHARACTERISTIC
/begin CHARACTERISTIC Motoring_Tq_Curve_Ovr_ovr "" VALUE 0x800030CA RecordLayout_1 0 CompuMethod_4 0 1 /end CHARACTERISTIC
/begin CHARACTERISTIC MotoringDeltaRPMLimit "This is the amount RPM must be above the Setpoint RPM to set a Motorin Flag." VALUE 0x800030CB RecordLayout_4 0 CompuMethod_26 -1E+17 1E+17 /end CHARACTERISTIC
/begin CHARACTERISTIC MotoringDtctTimerLimit "Amount of time engine speed has to be above the min gov. rpm set pt to set motoring flag." VALUE 0x800030CF RecordLayout_4 0 CompuMethod_54 0 100 /end CHARACTERISTIC
/begin CHARACTERISTIC MotoringTq_Curve_Ovr_new "" VALUE 0x800030D3 RecordLayout_4 0 CompuMethod_2 -1E+17 1E+17 /end CHARACTERISTIC
/begin CHARACTERISTIC MotoringTq_Curve_Ovr_ovr "" VALUE 0x800030D7 RecordLayout_1 0 CompuMethod_4 0 1 /end CHARACTERISTIC
/begin CHARACTERISTIC MPRD_new "Directly Override Main Power Relay" VALUE 0x800030D8 RecordLayout_1 0 CompuMethod_130 0 1 /end CHARACTERISTIC
/begin CHARACTERISTIC MPRD_ovr "" VALUE 0x800030D9 RecordLayout_1 0 CompuMethod_4 0 1 /end CHARACTERISTIC
/begin CHARACTERISTIC NegativeTq_Ovr_new "" VALUE 0x800030FE RecordLayout_4 0 CompuMethod_2 -1E+17 1E+17 /end CHARACTERISTIC
/begin CHARACTERISTIC NegativeTq_Ovr_ovr "" VALUE 0x80003102 RecordLayout_1 0 CompuMethod_4 0 1 /end CHARACTERISTIC
/begin CHARACTERISTIC NonVolatileRestoreOnFirstStartup "Selects whether to restore from factory defaults the first time an application boots" VALUE 0x80003103 RecordLayout_1 0 CompuMethod_131 0 1 /end CHARACTERISTIC
/begin CHARACTERISTIC NonVolatileRestoreOnStartup "Selects whether to restore from factory defaults on next startup" VALUE 0x80003104 RecordLayout_1 0 CompuMethod_131 0 1 /end CHARACTERISTIC
/begin CHARACTERISTIC NoOilPres_FaultTime "After no oil pressure for this long the NoOilFault becomes active." VALUE 0x80003105 RecordLayout_4 0 CompuMethod_21 0 1E+17 /end CHARACTERISTIC
/begin CHARACTERISTIC O2_PostCat_new "Override result of linear sensor characterization, in engineering units" VALUE 0x8000310B RecordLayout_4 0 CompuMethod_133 -1E+17 1E+17 /end CHARACTERISTIC
/begin CHARACTERISTIC O2_PostCat_ovr "" VALUE 0x8000310F RecordLayout_1 0 CompuMethod_4 0 1 /end CHARACTERISTIC
/begin CHARACTERISTIC O2_PostCatDefault "This is the initial default value should the sensor be in fault on key-up.  Otherwise the sensors outputs the last value prior to faulting" VALUE 0x80003110 RecordLayout_4 0 CompuMethod_133 -1E+17 1E+17 /end CHARACTERISTIC
/begin CHARACTERISTIC O2_PostCatFiltConst "Filter time constant" VALUE 0x80003114 RecordLayout_4 0 CompuMethod_54 -1E+17 1E+17 /end CHARACTERISTIC
/begin CHARACTERISTIC O2_PostCatMax "Maximum allowable input, indicating short or open circuit" VALUE 0x80003168 RecordLayout_4 0 CompuMethod_59 -1E+17 1E+17 /end CHARACTERISTIC
/begin CHARACTERISTIC O2_PostCatMin "Minimum allowable input, indicating short or open circuit" VALUE 0x8000316C RecordLayout_4 0 CompuMethod_59 -1E+17 1E+17 /end CHARACTERISTIC
/begin CHARACTERISTIC O2_PostCatTbl "Look up table to allownon-linear characterization of sensors" CURVE 0x80003170 RecordLayout_4 0 CompuMethod_134 -1E+17 1E+17
 /begin AXIS_DESCR COM_AXIS O2_PostCatADC CompuMethod_59 20 -1E+17 1E+17 AXIS_PTS_REF O2_PostCatIdxArr /end AXIS_DESCR
/end CHARACTERISTIC
/begin CHARACTERISTIC O2ActiveTimeThresh "Time limit O2 feedback can sit between rich and lean switch points before flagging O2NotActive fault" VALUE 0x800031C0 RecordLayout_4 0 CompuMethod_21 -1E+17 1E+17 /end CHARACTERISTIC
/begin CHARACTERISTIC O2CtrlAdaptDelayTime "O2 Control must be enabled for this amount of time before fuel adaption is enabled" VALUE 0x800031C5 RecordLayout_4 0 CompuMethod_21 0 1E+17 /end CHARACTERISTIC
/begin CHARACTERISTIC O2CtrlDGain "Base D-gain for the gaseous closed loop O2 controller." VALUE 0x800031C9 RecordLayout_4 0 CompuMethod_136 -1E+17 1E+17 /end CHARACTERISTIC
/begin CHARACTERISTIC O2CtrlIGain "Base I-gain for the gaseous closed loop O2 controller." VALUE 0x800031CD RecordLayout_4 0 CompuMethod_136 -1E+17 1E+17 /end CHARACTERISTIC
/begin CHARACTERISTIC O2CtrlPGain "Base P-gain for the gaseous closed loop O2 controller." VALUE 0x800031D1 RecordLayout_4 0 CompuMethod_136 -1E+17 1E+17 /end CHARACTERISTIC
/begin CHARACTERISTIC O2CtrlPIDOutLowerLimit "Lower limit on gaseous closed loop O2 PID Output." VALUE 0x800031D5 RecordLayout_4 0 CompuMethod_136 -1E+17 1E+17 /end CHARACTERISTIC
/begin CHARACTERISTIC O2CtrlPIDOutUpperLimit "Upper limit on gaseous closed loop O2 PID Output." VALUE 0x800031D9 RecordLayout_4 0 CompuMethod_136 -1E+17 1E+17 /end CHARACTERISTIC
/begin CHARACTERISTIC O2DelagFilterConst "First-order filter time constant of the pre-catalyst O2 signal." VALUE 0x800031DD RecordLayout_4 0 CompuMethod_21 -1E+17 1E+17 /end CHARACTERISTIC
/begin CHARACTERISTIC O2ITermLowerLimit "Lower limit on gaseous closed loop O2 I Term." VALUE 0x80003206 RecordLayout_4 0 CompuMethod_136 -1E+17 1E+17 /end CHARACTERISTIC
/begin CHARACTERISTIC O2ITermUpperLimit "Upper limit on gaseous closed loop O2 I Term." VALUE 0x8000320A RecordLayout_4 0 CompuMethod_136 -1E+17 1E+17 /end CHARACTERISTIC
/begin CHARACTERISTIC O2LeanTimeThresh "Time limit the O2 feedback can sit below the lean switch point before flagging O2FailedLean fault" VALUE 0x8000320E RecordLayout_4 0 CompuMethod_21 -1E+17 1E+17 /end CHARACTERISTIC
/begin CHARACTERISTIC O2MAFErrGainMultTbl "O2 PID controller system gain based on MAF port." CURVE 0x80003212 RecordLayout_4 0 CompuMethod_24 -1E+17 1E+17
 /begin AXIS_DESCR COM_AXIS MAFPort05In CompuMethod_2 5 -1E+17 1E+17 AXIS_PTS_REF MAFPort05IdxArr /end AXIS_DESCR
/end CHARACTERISTIC
/begin CHARACTERISTIC O2NECCTErrGainMultTbl "O2 PID controller system gain based on NECCT." CURVE 0x80003226 RecordLayout_4 0 CompuMethod_24 -1E+17 1E+17
 /begin AXIS_DESCR COM_AXIS NECCT09In CompuMethod_2 9 -1E+17 1E+17 AXIS_PTS_REF NECCT09IdxArr /end AXIS_DESCR
/end CHARACTERISTIC
/begin CHARACTERISTIC O2RichTimeThresh "Time limit the O2 feedback can sit abovethe rich switch point before flagging O2FailedRich fault" VALUE 0x8000324A RecordLayout_4 0 CompuMethod_21 -1E+17 1E+17 /end CHARACTERISTIC
/begin CHARACTERISTIC Oil_Pressure_Ovr_new "" VALUE 0x80003272 RecordLayout_4 0 CompuMethod_2 -1E+17 1E+17 /end CHARACTERISTIC
/begin CHARACTERISTIC Oil_Pressure_Ovr_ovr "" VALUE 0x80003276 RecordLayout_1 0 CompuMethod_4 0 1 /end CHARACTERISTIC
/begin CHARACTERISTIC OILP_new "Override actuator, in engineering units" VALUE 0x80003277 RecordLayout_1 0 CompuMethod_42 0 1 /end CHARACTERISTIC
/begin CHARACTERISTIC OILP_ovr "" VALUE 0x80003278 RecordLayout_1 0 CompuMethod_4 0 1 /end CHARACTERISTIC
/begin CHARACTERISTIC OILP_Polarity "Inverts the output of the actuator relative to the desired command - 0 = High True    1 = Low True" VALUE 0x80003279 RecordLayout_1 0 CompuMethod_42 0 1 /end CHARACTERISTIC
/begin CHARACTERISTIC OilPres_new "Override result of linear sensor characterization, in engineering units" VALUE 0x8000327A RecordLayout_4 0 CompuMethod_126 -1E+17 1E+17 /end CHARACTERISTIC
/begin CHARACTERISTIC OilPres_ovr "" VALUE 0x8000327E RecordLayout_1 0 CompuMethod_4 0 1 /end CHARACTERISTIC
/begin CHARACTERISTIC OilPresDfltValue "This is the initial default value should the sensor be in fault on key-up.  Otherwise the sensors outputs the last value prior to faulting" VALUE 0x8000327F RecordLayout_4 0 CompuMethod_126 -1E+17 1E+17 /end CHARACTERISTIC
/begin CHARACTERISTIC OilPresFilterConst "Filter time constant" VALUE 0x80003283 RecordLayout_4 0 CompuMethod_54 -1E+17 1E+17 /end CHARACTERISTIC
/begin CHARACTERISTIC OilPresGain "Scaling from A/D counts to engineering units" VALUE 0x80003287 RecordLayout_4 0 CompuMethod_139 -1E+17 1E+17 /end CHARACTERISTIC
/begin CHARACTERISTIC OilPresInputHiFltPos "Maximum allowable input, indicating short or open circuit" VALUE 0x8000328B RecordLayout_4 0 CompuMethod_59 -1E+17 1E+17 /end CHARACTERISTIC
/begin CHARACTERISTIC OilPresInputLoFltPos "Minimum allowable input, indicating short or open circuit" VALUE 0x8000328F RecordLayout_4 0 CompuMethod_59 -1E+17 1E+17 /end CHARACTERISTIC
/begin CHARACTERISTIC OilPresOfst "Offset after gain in engineering units" VALUE 0x80003293 RecordLayout_4 0 CompuMethod_126 -1E+17 1E+17 /end CHARACTERISTIC
/begin CHARACTERISTIC ONTime "The length of time for the Fuel Pump relay to be enabled at startup" VALUE 0x800032A6 RecordLayout_4 0 CompuMethod_54 0 100 /end CHARACTERISTIC
/begin CHARACTERISTIC Overheat_MaxAPP "Max APP command to allow during overheat condition" VALUE 0x800032AE RecordLayout_4 0 CompuMethod_5 -1E+17 1E+17 /end CHARACTERISTIC
/begin CHARACTERISTIC Overheat_ScaleAPP "Scale APP by this factor when overheating" VALUE 0x800032B2 RecordLayout_4 0 CompuMethod_142 -1E+17 1E+17 /end CHARACTERISTIC
/begin CHARACTERISTIC Oxygen_Heater_new "Override actuator, in engineering units" VALUE 0x800032B6 RecordLayout_1 0 CompuMethod_42 0 1 /end CHARACTERISTIC
/begin CHARACTERISTIC Oxygen_Heater_ovr "" VALUE 0x800032B7 RecordLayout_1 0 CompuMethod_4 0 1 /end CHARACTERISTIC
/begin CHARACTERISTIC Oxygen_Heater_Polarity "Inverts the output of the actuator relative to the desired command - 0 = High True    1 = Low True" VALUE 0x800032B8 RecordLayout_1 0 CompuMethod_42 0 1 /end CHARACTERISTIC
/begin CHARACTERISTIC Phoenix_Fault_Ovr_new "" VALUE 0x800032DA RecordLayout_4 0 CompuMethod_2 -1E+17 1E+17 /end CHARACTERISTIC
/begin CHARACTERISTIC Phoenix_Fault_Ovr_ovr "" VALUE 0x800032DE RecordLayout_1 0 CompuMethod_4 0 1 /end CHARACTERISTIC
/begin CHARACTERISTIC PostO2DelagFiltConst "First-order filter time constant of the post-catalyst O2 signal." VALUE 0x80003323 RecordLayout_4 0 CompuMethod_21 -1E+17 1E+17 /end CHARACTERISTIC
/begin CHARACTERISTIC PWMOutput_State_Ovr_new "" VALUE 0x80003471 RecordLayout_4 0 CompuMethod_2 -1E+17 1E+17 /end CHARACTERISTIC
/begin CHARACTERISTIC PWMOutput_State_Ovr_ovr "" VALUE 0x80003475 RecordLayout_1 0 CompuMethod_4 0 1 /end CHARACTERISTIC
/begin CHARACTERISTIC RestoreNVFactoryDefaults "Restores NonVolatile Memory to Factory Defaults" VALUE 0x80003476 RecordLayout_1 0 CompuMethod_144 0 1 /end CHARACTERISTIC
/begin CHARACTERISTIC RevLimitType "Define the type of sequence to be disable when in Rev Limit" VALUE 0x8000347B RecordLayout_6 0 CompuMethod_146 -128 127 /end CHARACTERISTIC
/begin CHARACTERISTIC RichSwPtDeltaMap "If actual O2 reaches this point, switch the target to the LeanTargetDelta" MAP 0x8000347C RecordLayout_4 0 CompuMethod_119 -1E+17 1E+17
 /begin AXIS_DESCR COM_AXIS RPM09In CompuMethod_2 9 -1E+17 1E+17 AXIS_PTS_REF RPM09IdxArr /end AXIS_DESCR
 /begin AXIS_DESCR COM_AXIS IndLoadNom09In CompuMethod_2 9 -1E+17 1E+17 AXIS_PTS_REF IndLoadNom09IdxArr /end AXIS_DESCR
/end CHARACTERISTIC
/begin CHARACTERISTIC RichTargetDeltaMap "Target on the rich side for perturbation." MAP 0x800035C0 RecordLayout_4 0 CompuMethod_119 -1E+17 1E+17
 /begin AXIS_DESCR COM_AXIS RPM09In CompuMethod_2 9 -1E+17 1E+17 AXIS_PTS_REF RPM09IdxArr /end AXIS_DESCR
 /begin AXIS_DESCR COM_AXIS IndLoadNom09In CompuMethod_2 9 -1E+17 1E+17 AXIS_PTS_REF IndLoadNom09IdxArr /end AXIS_DESCR
/end CHARACTERISTIC
/begin CHARACTERISTIC RPM_Ovr_new "" VALUE 0x80003708 RecordLayout_4 0 CompuMethod_2 -1E+17 1E+17 /end CHARACTERISTIC
/begin CHARACTERISTIC RPM_Ovr_ovr "" VALUE 0x8000370C RecordLayout_1 0 CompuMethod_4 0 1 /end CHARACTERISTIC
/begin CHARACTERISTIC RPMFallingFiltConst "Filter time constant" VALUE 0x800037CD RecordLayout_4 0 CompuMethod_54 -1E+17 1E+17 /end CHARACTERISTIC
/begin CHARACTERISTIC RPMFallingRate "The minimum rate of change in RPM that triggers RPMFalling - This should be a positive value" VALUE 0x800037D1 RecordLayout_4 0 CompuMethod_148 0 1000 /end CHARACTERISTIC
/begin CHARACTERISTIC Run_Enable_Ovr_new "" VALUE 0x800037D9 RecordLayout_4 0 CompuMethod_2 -1E+17 1E+17 /end CHARACTERISTIC
/begin CHARACTERISTIC Run_Enable_Ovr_ovr "" VALUE 0x800037DD RecordLayout_1 0 CompuMethod_4 0 1 /end CHARACTERISTIC
/begin CHARACTERISTIC Run_Request_Ovr_new "" VALUE 0x800037DE RecordLayout_4 0 CompuMethod_2 -1E+17 1E+17 /end CHARACTERISTIC
/begin CHARACTERISTIC Run_Request_Ovr_ovr "" VALUE 0x800037E2 RecordLayout_1 0 CompuMethod_4 0 1 /end CHARACTERISTIC
/begin CHARACTERISTIC SecondartSpeedLim_CenterPT_Ovr_new "" VALUE 0x800037E4 RecordLayout_4 0 CompuMethod_2 -1E+17 1E+17 /end CHARACTERISTIC
/begin CHARACTERISTIC SecondartSpeedLim_CenterPT_Ovr_ovr "" VALUE 0x800037E8 RecordLayout_1 0 CompuMethod_4 0 1 /end CHARACTERISTIC
/begin CHARACTERISTIC SecondaryVoltLim_CenterPT_Ovr_new "" VALUE 0x800037F1 RecordLayout_4 0 CompuMethod_2 -1E+17 1E+17 /end CHARACTERISTIC
/begin CHARACTERISTIC SecondaryVoltLim_CenterPT_Ovr_ovr "" VALUE 0x800037F5 RecordLayout_1 0 CompuMethod_4 0 1 /end CHARACTERISTIC
/begin CHARACTERISTIC SensVolt_new "Override result of linear sensor characterization, in engineering units" VALUE 0x800037F6 RecordLayout_4 0 CompuMethod_150 -1E+17 1E+17 /end CHARACTERISTIC
/begin CHARACTERISTIC SensVolt_ovr "" VALUE 0x800037FA RecordLayout_1 0 CompuMethod_4 0 1 /end CHARACTERISTIC
/begin CHARACTERISTIC SensVoltDfltValue "This is the initial default value should the sensor be in fault on key-up.  Otherwise the sensors outputs the last value prior to faulting" VALUE 0x800037FB RecordLayout_4 0 CompuMethod_150 -1E+17 1E+17 /end CHARACTERISTIC
/begin CHARACTERISTIC SensVoltFilterConst "Filter time constant" VALUE 0x800037FF RecordLayout_4 0 CompuMethod_54 -1E+17 1E+17 /end CHARACTERISTIC
/begin CHARACTERISTIC SensVoltGain "Scaling from A/D counts to engineering units" VALUE 0x80003803 RecordLayout_4 0 CompuMethod_151 -1E+17 1E+17 /end CHARACTERISTIC
/begin CHARACTERISTIC SensVoltInputHiFltPos "Maximum allowable input, indicating short or open circuit" VALUE 0x80003807 RecordLayout_4 0 CompuMethod_59 -1E+17 1E+17 /end CHARACTERISTIC
/begin CHARACTERISTIC SensVoltInputLoFltPos "Minimum allowable input, indicating short or open circuit" VALUE 0x8000380B RecordLayout_4 0 CompuMethod_59 -1E+17 1E+17 /end CHARACTERISTIC
/begin CHARACTERISTIC SensVoltOfst "Offset after gain in engineering units" VALUE 0x8000380F RecordLayout_4 0 CompuMethod_150 -1E+17 1E+17 /end CHARACTERISTIC
/begin CHARACTERISTIC SoftCycle1Cyl1 "" VALUE 0x80003817 RecordLayout_6 0 CompuMethod_105 -128 127 /end CHARACTERISTIC
/begin CHARACTERISTIC SoftCycle1Cyl2 "" VALUE 0x80003818 RecordLayout_6 0 CompuMethod_105 -128 127 /end CHARACTERISTIC
/begin CHARACTERISTIC SoftCycle1Cyl3 "" VALUE 0x80003819 RecordLayout_6 0 CompuMethod_105 -128 127 /end CHARACTERISTIC
/begin CHARACTERISTIC SoftCycle1Cyl4 "" VALUE 0x8000381A RecordLayout_6 0 CompuMethod_105 -128 127 /end CHARACTERISTIC
/begin CHARACTERISTIC SoftCycle1Cyl5 "" VALUE 0x8000381B RecordLayout_6 0 CompuMethod_105 -128 127 /end CHARACTERISTIC
/begin CHARACTERISTIC SoftCycle1Cyl6 "" VALUE 0x8000381C RecordLayout_6 0 CompuMethod_105 -128 127 /end CHARACTERISTIC
/begin CHARACTERISTIC SoftCycle1Cyl7 "" VALUE 0x8000381D RecordLayout_6 0 CompuMethod_105 -128 127 /end CHARACTERISTIC
/begin CHARACTERISTIC SoftCycle1Cyl8 "" VALUE 0x8000381E RecordLayout_6 0 CompuMethod_105 -128 127 /end CHARACTERISTIC
/begin CHARACTERISTIC SoftCycle2Cyl1 "" VALUE 0x8000381F RecordLayout_6 0 CompuMethod_105 -128 127 /end CHARACTERISTIC
/begin CHARACTERISTIC SoftCycle2Cyl2 "" VALUE 0x80003820 RecordLayout_6 0 CompuMethod_105 -128 127 /end CHARACTERISTIC
/begin CHARACTERISTIC SoftCycle2Cyl3 "" VALUE 0x80003821 RecordLayout_6 0 CompuMethod_105 -128 127 /end CHARACTERISTIC
/begin CHARACTERISTIC SoftCycle2Cyl4 "" VALUE 0x80003822 RecordLayout_6 0 CompuMethod_105 -128 127 /end CHARACTERISTIC
/begin CHARACTERISTIC SoftCycle2Cyl5 "" VALUE 0x80003823 RecordLayout_6 0 CompuMethod_105 -128 127 /end CHARACTERISTIC
/begin CHARACTERISTIC SoftCycle2Cyl6 "" VALUE 0x80003824 RecordLayout_6 0 CompuMethod_105 -128 127 /end CHARACTERISTIC
/begin CHARACTERISTIC SoftCycle2Cyl7 "" VALUE 0x80003825 RecordLayout_6 0 CompuMethod_105 -128 127 /end CHARACTERISTIC
/begin CHARACTERISTIC SoftCycle2Cyl8 "" VALUE 0x80003826 RecordLayout_6 0 CompuMethod_105 -128 127 /end CHARACTERISTIC
/begin CHARACTERISTIC SoftCycle3Cyl1 "" VALUE 0x80003827 RecordLayout_6 0 CompuMethod_105 -128 127 /end CHARACTERISTIC
/begin CHARACTERISTIC SoftCycle3Cyl2 "" VALUE 0x80003828 RecordLayout_6 0 CompuMethod_105 -128 127 /end CHARACTERISTIC
/begin CHARACTERISTIC SoftCycle3Cyl3 "" VALUE 0x80003829 RecordLayout_6 0 CompuMethod_105 -128 127 /end CHARACTERISTIC
/begin CHARACTERISTIC SoftCycle3Cyl4 "" VALUE 0x8000382A RecordLayout_6 0 CompuMethod_105 -128 127 /end CHARACTERISTIC
/begin CHARACTERISTIC SoftCycle3Cyl5 "" VALUE 0x8000382B RecordLayout_6 0 CompuMethod_105 -128 127 /end CHARACTERISTIC
/begin CHARACTERISTIC SoftCycle3Cyl6 "" VALUE 0x8000382C RecordLayout_6 0 CompuMethod_105 -128 127 /end CHARACTERISTIC
/begin CHARACTERISTIC SoftCycle3Cyl7 "" VALUE 0x8000382D RecordLayout_6 0 CompuMethod_105 -128 127 /end CHARACTERISTIC
/begin CHARACTERISTIC SoftCycle3Cyl8 "" VALUE 0x8000382E RecordLayout_6 0 CompuMethod_105 -128 127 /end CHARACTERISTIC
/begin CHARACTERISTIC SoftCycle4Cyl1 "" VALUE 0x8000382F RecordLayout_6 0 CompuMethod_105 -128 127 /end CHARACTERISTIC
/begin CHARACTERISTIC SoftCycle4Cyl2 "" VALUE 0x80003830 RecordLayout_6 0 CompuMethod_105 -128 127 /end CHARACTERISTIC
/begin CHARACTERISTIC SoftCycle4Cyl3 "" VALUE 0x80003831 RecordLayout_6 0 CompuMethod_105 -128 127 /end CHARACTERISTIC
/begin CHARACTERISTIC SoftCycle4Cyl4 "" VALUE 0x80003832 RecordLayout_6 0 CompuMethod_105 -128 127 /end CHARACTERISTIC
/begin CHARACTERISTIC SoftCycle4Cyl5 "" VALUE 0x80003833 RecordLayout_6 0 CompuMethod_105 -128 127 /end CHARACTERISTIC
/begin CHARACTERISTIC SoftCycle4Cyl6 "" VALUE 0x80003834 RecordLayout_6 0 CompuMethod_105 -128 127 /end CHARACTERISTIC
/begin CHARACTERISTIC SoftCycle4Cyl7 "" VALUE 0x80003835 RecordLayout_6 0 CompuMethod_105 -128 127 /end CHARACTERISTIC
/begin CHARACTERISTIC SoftCycle4Cyl8 "" VALUE 0x80003836 RecordLayout_6 0 CompuMethod_105 -128 127 /end CHARACTERISTIC
/begin CHARACTERISTIC SOI_new "" VALUE 0x80003837 RecordLayout_4 0 CompuMethod_2 -1E+17 1E+17 /end CHARACTERISTIC
/begin CHARACTERISTIC SOI_ovr "" VALUE 0x8000383B RecordLayout_1 0 CompuMethod_4 0 1 /end CHARACTERISTIC
/begin CHARACTERISTIC SparkAdv_DeltaHi "Maximum increasing spark change per 5ms" VALUE 0x8000383C RecordLayout_4 0 CompuMethod_63 0 720 /end CHARACTERISTIC
/begin CHARACTERISTIC SparkAdv_DeltaLo "Maximum decreasing spark change per 5ms" VALUE 0x80003840 RecordLayout_4 0 CompuMethod_43 0 720 /end CHARACTERISTIC
/begin CHARACTERISTIC SparkDwell_offset "" VALUE 0x80003CC8 RecordLayout_4 0 CompuMethod_2 -1E+17 1E+17 /end CHARACTERISTIC
/begin CHARACTERISTIC SparkDwell_ovr "" VALUE 0x80003CCC RecordLayout_1 0 CompuMethod_153 0 1 /end CHARACTERISTIC
/begin CHARACTERISTIC SparkStartAngle_offset "Provides a relative offset to input signal" VALUE 0x80003CDA RecordLayout_4 0 CompuMethod_43 -1E+17 1E+17 /end CHARACTERISTIC
/begin CHARACTERISTIC SparkStartAngle_ovr "Provides a relative offset to input signal" VALUE 0x80003CDE RecordLayout_1 0 CompuMethod_156 0 1 /end CHARACTERISTIC
/begin CHARACTERISTIC SparkStopAngle_offset "Provides a relative offset to input signal" VALUE 0x80003CDF RecordLayout_4 0 CompuMethod_43 -1E+17 1E+17 /end CHARACTERISTIC
/begin CHARACTERISTIC SparkStopAngle_ovr "Provides a relative offset to input signal" VALUE 0x80003CE3 RecordLayout_1 0 CompuMethod_156 0 1 /end CHARACTERISTIC
/begin CHARACTERISTIC Speed_Voltage_Torque_CMD_Ovr_new "" VALUE 0x80003CE4 RecordLayout_4 0 CompuMethod_2 -1E+17 1E+17 /end CHARACTERISTIC
/begin CHARACTERISTIC Speed_Voltage_Torque_CMD_Ovr_ovr "" VALUE 0x80003CE8 RecordLayout_1 0 CompuMethod_4 0 1 /end CHARACTERISTIC
/begin CHARACTERISTIC SpkMinGovDGain "Base D-gain for the min. governor controller." VALUE 0x80003D0D RecordLayout_4 0 CompuMethod_8 -1E+17 1E+17 /end CHARACTERISTIC
/begin CHARACTERISTIC SpkMinGovDGainErrorMultTbl "" CURVE 0x80003D11 RecordLayout_4 0 CompuMethod_8 -1E+17 1E+17
 /begin AXIS_DESCR COM_AXIS SpkMinGovSpeedErrorIn CompuMethod_2 9 -1E+17 1E+17 AXIS_PTS_REF SpkMinGovSpeedErrorIdxArr /end AXIS_DESCR
/end CHARACTERISTIC
/begin CHARACTERISTIC SpkMinGovErrorGain "Error gain for the min governor controller. This gain is applied to the RPM error term before it is used to calculate the P, I and D terms." VALUE 0x80003D35 RecordLayout_4 0 CompuMethod_8 -1E+17 1E+17 /end CHARACTERISTIC
/begin CHARACTERISTIC SpkMinGovPGain "Base P-gain for the min. governor controller." VALUE 0x80003D39 RecordLayout_4 0 CompuMethod_8 -1E+17 1E+17 /end CHARACTERISTIC
/begin CHARACTERISTIC SpkMinGovPGainErrorMultTbl "" CURVE 0x80003D3D RecordLayout_4 0 CompuMethod_8 -1E+17 1E+17
 /begin AXIS_DESCR COM_AXIS SpkMinGovSpeedErrorIn CompuMethod_2 9 -1E+17 1E+17 AXIS_PTS_REF SpkMinGovSpeedErrorIdxArr /end AXIS_DESCR
/end CHARACTERISTIC
/begin CHARACTERISTIC SpkMinGovPIDOutLowerLimit "Lower limit on spark min governor PID Output." VALUE 0x80003D61 RecordLayout_4 0 CompuMethod_63 -1E+17 1E+17 /end CHARACTERISTIC
/begin CHARACTERISTIC SpkMinGovPIDOutUpperLimit "Upper limit on spark min governor PID Output." VALUE 0x80003D65 RecordLayout_4 0 CompuMethod_63 -1E+17 1E+17 /end CHARACTERISTIC
/begin CHARACTERISTIC SSLoadDecFiltC "Filter time constant for a decreasing signal." VALUE 0x80003D91 RecordLayout_4 0 CompuMethod_54 -1E+17 1E+17 /end CHARACTERISTIC
/begin CHARACTERISTIC SSLoadIncFiltC "Filter time constant for a increasing signal." VALUE 0x80003D95 RecordLayout_4 0 CompuMethod_54 -1E+17 1E+17 /end CHARACTERISTIC
/begin CHARACTERISTIC SSLoadTol "Steady-State Load Tolerance" VALUE 0x80003D99 RecordLayout_4 0 CompuMethod_2 -1E+17 1E+17 /end CHARACTERISTIC
/begin CHARACTERISTIC SSRPMDecFiltC "Filter time constant for a decreasing signal." VALUE 0x80003D9D RecordLayout_4 0 CompuMethod_54 -1E+17 1E+17 /end CHARACTERISTIC
/begin CHARACTERISTIC SSRPMIncFiltC "Filter time constant for a increasing signal." VALUE 0x80003DA1 RecordLayout_4 0 CompuMethod_54 -1E+17 1E+17 /end CHARACTERISTIC
/begin CHARACTERISTIC SSRPMTol "Steady-State RPM Tolerance" VALUE 0x80003DA5 RecordLayout_4 0 CompuMethod_26 -1E+17 1E+17 /end CHARACTERISTIC
/begin CHARACTERISTIC StableEngine_Ovr_new "" VALUE 0x80003DA9 RecordLayout_1 0 CompuMethod_38 0 1 /end CHARACTERISTIC
/begin CHARACTERISTIC StableEngine_Ovr_ovr "" VALUE 0x80003DAA RecordLayout_1 0 CompuMethod_4 0 1 /end CHARACTERISTIC
/begin CHARACTERISTIC StableLoad_ "" VALUE 0x80003DAB RecordLayout_4 0 CompuMethod_2 -1E+17 1E+17 /end CHARACTERISTIC
/begin CHARACTERISTIC StableLoad_t "" VALUE 0x80003DAF RecordLayout_4 0 CompuMethod_2 -1E+17 1E+17 /end CHARACTERISTIC
/begin CHARACTERISTIC StableRPM_ "" VALUE 0x80003DB3 RecordLayout_4 0 CompuMethod_2 -1E+17 1E+17 /end CHARACTERISTIC
/begin CHARACTERISTIC StableRPM_t "" VALUE 0x80003DB7 RecordLayout_4 0 CompuMethod_2 -1E+17 1E+17 /end CHARACTERISTIC
/begin CHARACTERISTIC Status1_Age_Count_Ovr_new "" VALUE 0x80003DC7 RecordLayout_3 0 CompuMethod_33 0 4294970000 /end CHARACTERISTIC
/begin CHARACTERISTIC Status1_Age_Count_Ovr_ovr "" VALUE 0x80003DCB RecordLayout_1 0 CompuMethod_4 0 1 /end CHARACTERISTIC
/begin CHARACTERISTIC Status2_Age_Count_Ovr_new "" VALUE 0x80003DCC RecordLayout_3 0 CompuMethod_33 0 4294970000 /end CHARACTERISTIC
/begin CHARACTERISTIC Status2_Age_Count_Ovr_ovr "" VALUE 0x80003DD0 RecordLayout_1 0 CompuMethod_4 0 1 /end CHARACTERISTIC
/begin CHARACTERISTIC Status3_Age_Count_Ovr_new "" VALUE 0x80003DD1 RecordLayout_3 0 CompuMethod_33 0 4294970000 /end CHARACTERISTIC
/begin CHARACTERISTIC Status3_Age_Count_Ovr_ovr "" VALUE 0x80003DD5 RecordLayout_1 0 CompuMethod_4 0 1 /end CHARACTERISTIC
/begin CHARACTERISTIC Status4_Age_Count_Ovr_new "" VALUE 0x80003DD6 RecordLayout_3 0 CompuMethod_33 0 4294970000 /end CHARACTERISTIC
/begin CHARACTERISTIC Status4_Age_Count_Ovr_ovr "" VALUE 0x80003DDA RecordLayout_1 0 CompuMethod_4 0 1 /end CHARACTERISTIC
/begin CHARACTERISTIC SteadyStateECT "Steady state engine coolant temperature" VALUE 0x80003DDB RecordLayout_4 0 CompuMethod_47 0 200 /end CHARACTERISTIC
/begin CHARACTERISTIC StoreNV "Stores RAM-Shadowed memory to serial EEPROM" VALUE 0x80003DDF RecordLayout_1 0 CompuMethod_158 0 1 /end CHARACTERISTIC
/begin CHARACTERISTIC SysVolt_new "Override result of linear sensor characterization, in engineering units" VALUE 0x80003DE0 RecordLayout_4 0 CompuMethod_150 -1E+17 1E+17 /end CHARACTERISTIC
/begin CHARACTERISTIC SysVolt_ovr "" VALUE 0x80003DE4 RecordLayout_1 0 CompuMethod_4 0 1 /end CHARACTERISTIC
/begin CHARACTERISTIC SysVoltDfltValue "This is the initial default value should the sensor be in fault on key-up.  Otherwise the sensors outputs the last value prior to faulting" VALUE 0x80003E0C RecordLayout_4 0 CompuMethod_150 -1E+17 1E+17 /end CHARACTERISTIC
/begin CHARACTERISTIC SysVoltFilterConst "Filter time constant" VALUE 0x80003E10 RecordLayout_4 0 CompuMethod_54 -1E+17 1E+17 /end CHARACTERISTIC
/begin CHARACTERISTIC SysVoltGain "Scaling from A/D counts to engineering units" VALUE 0x80003E14 RecordLayout_4 0 CompuMethod_151 -1E+17 1E+17 /end CHARACTERISTIC
/begin CHARACTERISTIC SysVoltInputHiFltPos "Maximum allowable input, indicating short or open circuit" VALUE 0x80003E18 RecordLayout_4 0 CompuMethod_59 -1E+17 1E+17 /end CHARACTERISTIC
/begin CHARACTERISTIC SysVoltInputLoFltPos "Minimum allowable input, indicating short or open circuit" VALUE 0x80003E1C RecordLayout_4 0 CompuMethod_59 -1E+17 1E+17 /end CHARACTERISTIC
/begin CHARACTERISTIC SysVoltOfst "Offset after gain in engineering units" VALUE 0x80003E20 RecordLayout_4 0 CompuMethod_150 -1E+17 1E+17 /end CHARACTERISTIC
/begin CHARACTERISTIC Temp_Guage_Ovr_new "" VALUE 0x80003E25 RecordLayout_4 0 CompuMethod_2 -1E+17 1E+17 /end CHARACTERISTIC
/begin CHARACTERISTIC Temp_Guage_Ovr_ovr "" VALUE 0x80003E29 RecordLayout_1 0 CompuMethod_4 0 1 /end CHARACTERISTIC
/begin CHARACTERISTIC TempOverheat_Fault "ECT limit above which fault is set." VALUE 0x80003E2A RecordLayout_4 0 CompuMethod_47 -1E+17 1E+17 /end CHARACTERISTIC
/begin CHARACTERISTIC TempOverheat_Warn "ECT limit above which warning light comes on" VALUE 0x80003E2E RecordLayout_4 0 CompuMethod_47 -1E+17 1E+17 /end CHARACTERISTIC
/begin CHARACTERISTIC TempOverheatSevere_Fault "ECT limit above which severe overheat fault is set." VALUE 0x80003E32 RecordLayout_4 0 CompuMethod_47 -1E+17 1E+17 /end CHARACTERISTIC
/begin CHARACTERISTIC ThreePhase_HVIL_Status_Ovr_new "" VALUE 0x80003E36 RecordLayout_4 0 CompuMethod_2 -1E+17 1E+17 /end CHARACTERISTIC
/begin CHARACTERISTIC ThreePhase_HVIL_Status_Ovr_ovr "" VALUE 0x80003E3A RecordLayout_1 0 CompuMethod_4 0 1 /end CHARACTERISTIC
/begin CHARACTERISTIC TPS1_new "Override result of linear sensor characterization, in engineering units" VALUE 0x80003E8A RecordLayout_4 0 CompuMethod_5 -1E+17 1E+17 /end CHARACTERISTIC
/begin CHARACTERISTIC TPS1_ovr "" VALUE 0x80003E8E RecordLayout_1 0 CompuMethod_4 0 1 /end CHARACTERISTIC
/begin CHARACTERISTIC TPS1_TPS2_Max_Deviation "Specifies the maximum allowable deviation between the two sensors" VALUE 0x80003E8F RecordLayout_4 0 CompuMethod_163 -1E+17 1E+17 /end CHARACTERISTIC
/begin CHARACTERISTIC TPS1Adapt_Delta "Specifies the minimum deviation amount to react to." VALUE 0x80003E93 RecordLayout_4 0 CompuMethod_59 -1E+17 1E+17 /end CHARACTERISTIC
/begin CHARACTERISTIC TPS1Adapt_Hi_Max "Specifies for the maximum value of the upper adapt range." VALUE 0x80003E97 RecordLayout_4 0 CompuMethod_164 -1E+17 1E+17 /end CHARACTERISTIC
/begin CHARACTERISTIC TPS1Adapt_Hi_Min "Specifies for the minimum value of the upper adapt range." VALUE 0x80003E9B RecordLayout_4 0 CompuMethod_164 -1E+17 1E+17 /end CHARACTERISTIC
/begin CHARACTERISTIC TPS1Adapt_Low_Max "Specifies for the maximum value of the lower adapt range." VALUE 0x80003E9F RecordLayout_4 0 CompuMethod_164 -1E+17 1E+17 /end CHARACTERISTIC
/begin CHARACTERISTIC TPS1Adapt_Low_Min "Specifies for the minimum value of the lower adapt range." VALUE 0x80003EA3 RecordLayout_4 0 CompuMethod_164 -1E+17 1E+17 /end CHARACTERISTIC
/begin CHARACTERISTIC TPS1AdaptHiEnable "Enables or disables this adapt." VALUE 0x80003EA7 RecordLayout_1 0 CompuMethod_55 0 1 /end CHARACTERISTIC
/begin CHARACTERISTIC TPS1AdaptLoEnable "Enables or disables this adapt." VALUE 0x80003EA8 RecordLayout_1 0 CompuMethod_55 0 1 /end CHARACTERISTIC
/begin CHARACTERISTIC TPS1DfltValue "This is the initial default value should the sensor be in fault on key-up.  Otherwise the sensors outputs the last value prior to faulting" VALUE 0x80003EAC RecordLayout_4 0 CompuMethod_5 -1E+17 1E+17 /end CHARACTERISTIC
/begin CHARACTERISTIC TPS1FilterConst "Filter time constant" VALUE 0x80003EB0 RecordLayout_4 0 CompuMethod_54 -1E+17 1E+17 /end CHARACTERISTIC
/begin CHARACTERISTIC TPS1InputHiFltPos "Hi limit of input signal which sets fault" VALUE 0x80003EB4 RecordLayout_4 0 CompuMethod_59 -1E+17 1E+17 /end CHARACTERISTIC
/begin CHARACTERISTIC TPS1InputLoFltPos "Low limit of input signal which sets fault" VALUE 0x80003EB8 RecordLayout_4 0 CompuMethod_59 -1E+17 1E+17 /end CHARACTERISTIC
/begin CHARACTERISTIC TPS1MaxLimit "Sets the upper limit on the potentiometer range." VALUE 0x80003EBC RecordLayout_4 0 CompuMethod_5 -1E+17 1E+17 /end CHARACTERISTIC
/begin CHARACTERISTIC TPS1Rev_Polarity "1 = Reverse Polarity (Smaller voltage values indicate larger % travel)" VALUE 0x80003EC0 RecordLayout_1 0 CompuMethod_155 0 1 /end CHARACTERISTIC
/begin CHARACTERISTIC TPS2_new "Override result of linear sensor characterization, in engineering units" VALUE 0x80003EC1 RecordLayout_4 0 CompuMethod_5 -1E+17 1E+17 /end CHARACTERISTIC
/begin CHARACTERISTIC TPS2_ovr "" VALUE 0x80003EC5 RecordLayout_1 0 CompuMethod_4 0 1 /end CHARACTERISTIC
/begin CHARACTERISTIC TPS2Adapt_Delta "Specifies the minimum deviation amount to react to." VALUE 0x80003EC6 RecordLayout_4 0 CompuMethod_59 -1E+17 1E+17 /end CHARACTERISTIC
/begin CHARACTERISTIC TPS2Adapt_Hi_Max "Specifies for the maximum value of the upper adapt range." VALUE 0x80003ECA RecordLayout_4 0 CompuMethod_164 -1E+17 1E+17 /end CHARACTERISTIC
/begin CHARACTERISTIC TPS2Adapt_Hi_Min "Specifies for the minimum value of the upper adapt range." VALUE 0x80003ECE RecordLayout_4 0 CompuMethod_164 -1E+17 1E+17 /end CHARACTERISTIC
/begin CHARACTERISTIC TPS2Adapt_Low_Max "Specifies for the maximum value of the lower adapt range." VALUE 0x80003ED2 RecordLayout_4 0 CompuMethod_164 -1E+17 1E+17 /end CHARACTERISTIC
/begin CHARACTERISTIC TPS2Adapt_Low_Min "Specifies for the minimum value of the lower adapt range." VALUE 0x80003ED6 RecordLayout_4 0 CompuMethod_164 -1E+17 1E+17 /end CHARACTERISTIC
/begin CHARACTERISTIC TPS2AdaptHiEnable "Enables or disables this adapt." VALUE 0x80003EDA RecordLayout_1 0 CompuMethod_55 0 1 /end CHARACTERISTIC
/begin CHARACTERISTIC TPS2AdaptLoEnable "Enables or disables this adapt." VALUE 0x80003EDB RecordLayout_1 0 CompuMethod_55 0 1 /end CHARACTERISTIC
/begin CHARACTERISTIC TPS2DfltValue "This is the initial default value should the sensor be in fault on key-up.  Otherwise the sensors outputs the last value prior to faulting" VALUE 0x80003EDF RecordLayout_4 0 CompuMethod_5 -1E+17 1E+17 /end CHARACTERISTIC
/begin CHARACTERISTIC TPS2FilterConst "Filter time constant" VALUE 0x80003EE3 RecordLayout_4 0 CompuMethod_54 -1E+17 1E+17 /end CHARACTERISTIC
/begin CHARACTERISTIC TPS2InputHiFltPos "Hi limit of input signal which sets fault" VALUE 0x80003EE7 RecordLayout_4 0 CompuMethod_59 -1E+17 1E+17 /end CHARACTERISTIC
/begin CHARACTERISTIC TPS2InputLoFltPos "Low limit of input signal which sets fault" VALUE 0x80003EEB RecordLayout_4 0 CompuMethod_59 -1E+17 1E+17 /end CHARACTERISTIC
/begin CHARACTERISTIC TPS2MaxLimit "Sets the upper limit on the potentiometer range." VALUE 0x80003EEF RecordLayout_4 0 CompuMethod_5 -1E+17 1E+17 /end CHARACTERISTIC
/begin CHARACTERISTIC TPS2Rev_Polarity "1 = Reverse Polarity (Smaller voltage values indicate larger % travel)" VALUE 0x80003EF3 RecordLayout_1 0 CompuMethod_155 0 1 /end CHARACTERISTIC
/begin CHARACTERISTIC TqLimiting_Reason_Ovr_new "" VALUE 0x80003EF5 RecordLayout_4 0 CompuMethod_2 -1E+17 1E+17 /end CHARACTERISTIC
/begin CHARACTERISTIC TqLimiting_Reason_Ovr_ovr "" VALUE 0x80003EF9 RecordLayout_1 0 CompuMethod_4 0 1 /end CHARACTERISTIC
/begin CHARACTERISTIC Trigger_Ovr_new "" VALUE 0x80003EFA RecordLayout_1 0 CompuMethod_38 0 1 /end CHARACTERISTIC
/begin CHARACTERISTIC Trigger_Ovr_ovr "" VALUE 0x80003EFB RecordLayout_1 0 CompuMethod_4 0 1 /end CHARACTERISTIC
/begin CHARACTERISTIC VE_Adapt_Max "" VALUE 0x80003F00 RecordLayout_4 0 CompuMethod_2 -1E+17 1E+17 /end CHARACTERISTIC
/begin CHARACTERISTIC VE_Adapt_Min "" VALUE 0x80003F04 RecordLayout_4 0 CompuMethod_2 -1E+17 1E+17 /end CHARACTERISTIC
/begin CHARACTERISTIC Vehicle_Speed_Ovr_new "" VALUE 0x80003F30 RecordLayout_4 0 CompuMethod_2 -1E+17 1E+17 /end CHARACTERISTIC
/begin CHARACTERISTIC Vehicle_Speed_Ovr_ovr "" VALUE 0x80003F34 RecordLayout_1 0 CompuMethod_4 0 1 /end CHARACTERISTIC
/begin CHARACTERISTIC VETable_Ovr_new "" VALUE 0x800043B9 RecordLayout_4 0 CompuMethod_2 -1E+17 1E+17 /end CHARACTERISTIC
/begin CHARACTERISTIC VETable_Ovr_ovr "" VALUE 0x800043BD RecordLayout_1 0 CompuMethod_4 0 1 /end CHARACTERISTIC
/begin CHARACTERISTIC WarmUpTimeConst "Warm-up time constant.  Determines how quickly NECCT warms up relative to ECT." VALUE 0x800044B6 RecordLayout_4 0 CompuMethod_54 0 10000 /end CHARACTERISTIC
/begin CHARACTERISTIC Wrench_Status_Ovr_new "" VALUE 0x8000456E RecordLayout_1 0 CompuMethod_38 0 1 /end CHARACTERISTIC
/begin CHARACTERISTIC Wrench_Status_Ovr_ovr "" VALUE 0x8000456F RecordLayout_1 0 CompuMethod_4 0 1 /end CHARACTERISTIC
/begin CHARACTERISTIC XDRP_Internal_Meas_Ovr_new "" VALUE 0x80004570 RecordLayout_4 0 CompuMethod_2 -1E+17 1E+17 /end CHARACTERISTIC
/begin CHARACTERISTIC XDRP_Internal_Meas_Ovr_ovr "" VALUE 0x80004574 RecordLayout_1 0 CompuMethod_4 0 1 /end CHARACTERISTIC
/begin CHARACTERISTIC XDRP_State_Ovr_new "" VALUE 0x80004575 RecordLayout_4 0 CompuMethod_2 -1E+17 1E+17 /end CHARACTERISTIC
/begin CHARACTERISTIC XDRP_State_Ovr_ovr "" VALUE 0x80004579 RecordLayout_1 0 CompuMethod_4 0 1 /end CHARACTERISTIC
/begin CHARACTERISTIC XDRP_Supply_State_Ovr_new "" VALUE 0x8000457A RecordLayout_4 0 CompuMethod_2 -1E+17 1E+17 /end CHARACTERISTIC
/begin CHARACTERISTIC XDRP_Supply_State_Ovr_ovr "" VALUE 0x8000457E RecordLayout_1 0 CompuMethod_4 0 1 /end CHARACTERISTIC
/begin AXIS_PTS App05IdxArr "" 0x80000155 App05In RecordLayout_5 0 CompuMethod_2 5 -1E+17 1E+17 DEPOSIT ABSOLUTE /end AXIS_PTS
/begin AXIS_PTS ECT05IdxArr "" 0x80000FF9 ECT05In RecordLayout_5 0 CompuMethod_2 5 -1E+17 1E+17 DEPOSIT ABSOLUTE /end AXIS_PTS
/begin AXIS_PTS IATIdxArr "Look up table to allownon-linear characterization of sensors" 0x80002521 IATADC RecordLayout_5 0 CompuMethod_59 39 -1E+17 1E+17 DEPOSIT ABSOLUTE /end AXIS_PTS
/begin AXIS_PTS IndLoadNom05IdxArr "" 0x80002672 IndLoadNom05In RecordLayout_5 0 CompuMethod_2 5 -1E+17 1E+17 DEPOSIT ABSOLUTE /end AXIS_PTS
/begin AXIS_PTS IndLoadNom09IdxArr "" 0x80002686 IndLoadNom09In RecordLayout_5 0 CompuMethod_2 9 -1E+17 1E+17 DEPOSIT ABSOLUTE /end AXIS_PTS
/begin AXIS_PTS MAFIdxArr "Look up table to allownon-linear characterization of sensors" 0x80002B7A MAFADC RecordLayout_5 0 CompuMethod_81 40 -1E+17 1E+17 DEPOSIT ABSOLUTE /end AXIS_PTS
/begin AXIS_PTS MAFPort05IdxArr "" 0x80002C22 MAFPort05In RecordLayout_5 0 CompuMethod_2 5 -1E+17 1E+17 DEPOSIT ABSOLUTE /end AXIS_PTS
/begin AXIS_PTS MaxGovSpeedErrorIdxArr "" 0x80002F9D MaxGovSpeedErrorIn RecordLayout_5 0 CompuMethod_26 9 -1E+17 1E+17 DEPOSIT ABSOLUTE /end AXIS_PTS
/begin AXIS_PTS NECCT09IdxArr "" 0x800030DA NECCT09In RecordLayout_5 0 CompuMethod_2 9 -1E+17 1E+17 DEPOSIT ABSOLUTE /end AXIS_PTS
/begin AXIS_PTS O2_PostCatIdxArr "Look up table to allownon-linear characterization of sensors" 0x80003118 O2_PostCatADC RecordLayout_5 0 CompuMethod_59 20 -1E+17 1E+17 DEPOSIT ABSOLUTE /end AXIS_PTS
/begin AXIS_PTS RPM05IdxArr "" 0x8000370D RPM05In RecordLayout_5 0 CompuMethod_2 5 -1E+17 1E+17 DEPOSIT ABSOLUTE /end AXIS_PTS
/begin AXIS_PTS RPM09IdxArr "" 0x80003721 RPM09In RecordLayout_5 0 CompuMethod_2 9 -1E+17 1E+17 DEPOSIT ABSOLUTE /end AXIS_PTS
/begin AXIS_PTS RPMAccel17IdxArr "" 0x80003789 RPMAccel17In RecordLayout_5 0 CompuMethod_2 17 -1E+17 1E+17 DEPOSIT ABSOLUTE /end AXIS_PTS
/begin AXIS_PTS SpkMinGovSpeedErrorIdxArr "" 0x80003D69 SpkMinGovSpeedErrorIn RecordLayout_5 0 CompuMethod_2 9 -1E+17 1E+17 DEPOSIT ABSOLUTE /end AXIS_PTS
/*~~~~~~~~~ 6.3.106 RECORD_LAYOUTs ~~~~~~~~~*/
/begin RECORD_LAYOUT RecordLayout_1 FNC_VALUES 1 UBYTE ROW_DIR DIRECT /end RECORD_LAYOUT
/begin RECORD_LAYOUT RecordLayout_3 FNC_VALUES 1 ULONG ROW_DIR DIRECT /end RECORD_LAYOUT
/begin RECORD_LAYOUT RecordLayout_4 FNC_VALUES 1 FLOAT32_IEEE ROW_DIR DIRECT /end RECORD_LAYOUT
/begin RECORD_LAYOUT RecordLayout_5 AXIS_PTS_X 1 FLOAT32_IEEE /* IndexIncr */ INDEX_INCR /* Addressing */ DIRECT /end RECORD_LAYOUT
/begin RECORD_LAYOUT RecordLayout_6 FNC_VALUES 1 SBYTE ROW_DIR DIRECT /end RECORD_LAYOUT
/*~~~~~~~~~ 6.3.31 COMPU_METHODs ~~~~~~~~~*/
/begin COMPU_METHOD CompuMethod_1 "" RAT_FUNC "%3.0" "" COEFFS 0 1 0 0 0 1 /end COMPU_METHOD
/begin COMPU_METHOD CompuMethod_2 "" RAT_FUNC "%6.2" "" COEFFS 0 1 0 0 0 1 /end COMPU_METHOD
/begin COMPU_METHOD CompuMethod_4 "" TAB_VERB "%1.0" "" COMPU_TAB_REF CompuVtab_1 /end COMPU_METHOD
/begin COMPU_METHOD CompuMethod_5 "" RAT_FUNC "%6.2" "%" COEFFS 0 1 0 0 0 1 /end COMPU_METHOD
/begin COMPU_METHOD CompuMethod_7 "" RAT_FUNC "%6.2" "g/s" COEFFS 0 1 0 0 0 1 /end COMPU_METHOD
/begin COMPU_METHOD CompuMethod_8 "" RAT_FUNC "%6.2" "mult" COEFFS 0 1 0 0 0 1 /end COMPU_METHOD
/begin COMPU_METHOD CompuMethod_9 "" TAB_VERB "%6.2" "" COMPU_TAB_REF CompuVtab_3 /end COMPU_METHOD
/begin COMPU_METHOD CompuMethod_11 "" RAT_FUNC "%6.2" "idx.frac" COEFFS 0 1 0 0 0 0.00195313 /end COMPU_METHOD
/begin COMPU_METHOD CompuMethod_12 "" RAT_FUNC "%6.2" "mg" COEFFS 0 1 0 0 0 1 /end COMPU_METHOD
/begin COMPU_METHOD CompuMethod_19 "" RAT_FUNC "%6.2" "kPa" COEFFS 0 1 0 0 0 1 /end COMPU_METHOD
/begin COMPU_METHOD CompuMethod_21 "" RAT_FUNC "%6.2" "s" COEFFS 0 1 0 0 0 1 /end COMPU_METHOD
/begin COMPU_METHOD CompuMethod_22 "" TAB_VERB "%1.0" "" COMPU_TAB_REF CompuVtab_10 /end COMPU_METHOD
/begin COMPU_METHOD CompuMethod_23 "" RAT_FUNC "%5.4" "" COEFFS 0 1 0 0 0 1 /end COMPU_METHOD
/begin COMPU_METHOD CompuMethod_24 "" RAT_FUNC "%5.4" "mult" COEFFS 0 1 0 0 0 1 /end COMPU_METHOD
/begin COMPU_METHOD CompuMethod_26 "" RAT_FUNC "%6.2" "RPM" COEFFS 0 1 0 0 0 1 /end COMPU_METHOD
/begin COMPU_METHOD CompuMethod_33 "" RAT_FUNC "%8.0" "" COEFFS 0 1 0 0 0 1 /end COMPU_METHOD
/begin COMPU_METHOD CompuMethod_38 "" RAT_FUNC "%1.0" "" COEFFS 0 1 0 0 0 1 /end COMPU_METHOD
/begin COMPU_METHOD CompuMethod_42 "" RAT_FUNC "%1.0" "bool" COEFFS 0 1 0 0 0 1 /end COMPU_METHOD
/begin COMPU_METHOD CompuMethod_43 "" RAT_FUNC "%6.2" "degBTDC" COEFFS 0 1 0 0 0 1 /end COMPU_METHOD
/begin COMPU_METHOD CompuMethod_47 "" RAT_FUNC "%6.2" "degC" COEFFS 0 1 0 0 0 1 /end COMPU_METHOD
/begin COMPU_METHOD CompuMethod_54 "" RAT_FUNC "%6.2" "sec" COEFFS 0 1 0 0 0 1 /end COMPU_METHOD
/begin COMPU_METHOD CompuMethod_55 "" TAB_VERB "%1.0" "" COMPU_TAB_REF CompuVtab_2 /end COMPU_METHOD
/begin COMPU_METHOD CompuMethod_57 "" RAT_FUNC "%6.2" "C" COEFFS 0 1 0 0 0 1 /end COMPU_METHOD
/begin COMPU_METHOD CompuMethod_58 "" RAT_FUNC "%5.0" "ADC" COEFFS 0 1 0 0 0 1 /end COMPU_METHOD
/begin COMPU_METHOD CompuMethod_59 "" RAT_FUNC "%6.2" "ADC" COEFFS 0 1 0 0 0 1 /end COMPU_METHOD
/begin COMPU_METHOD CompuMethod_63 "" RAT_FUNC "%6.2" "degCA" COEFFS 0 1 0 0 0 1 /end COMPU_METHOD
/begin COMPU_METHOD CompuMethod_65 "" RAT_FUNC "%9.4" "%/ADC" COEFFS 0 1 0 0 0 1 /end COMPU_METHOD
/begin COMPU_METHOD CompuMethod_68 "" TAB_VERB "%3.0" "" COMPU_TAB_REF CompuVtab_20 /end COMPU_METHOD
/begin COMPU_METHOD CompuMethod_81 "" RAT_FUNC "%6.2" "Hz" COEFFS 0 1 0 0 0 1 /end COMPU_METHOD
/begin COMPU_METHOD CompuMethod_95 "" TAB_VERB "%1.0" "mg" COMPU_TAB_REF CompuVtab_9 /end COMPU_METHOD
/begin COMPU_METHOD CompuMethod_96 "" RAT_FUNC "%6.2" "Time const" COEFFS 0 1 0 0 0 1 /end COMPU_METHOD
/begin COMPU_METHOD CompuMethod_97 "" RAT_FUNC "%6.2" "kPaGauge" COEFFS 0 1 0 0 0 1 /end COMPU_METHOD
/begin COMPU_METHOD CompuMethod_98 "" RAT_FUNC "%6.2" "kPa Gauge" COEFFS 0 1 0 0 0 1 /end COMPU_METHOD
/begin COMPU_METHOD CompuMethod_99 "" RAT_FUNC "%9.4" "kPa Gauge/ADC" COEFFS 0 1 0 0 0 1 /end COMPU_METHOD
/begin COMPU_METHOD CompuMethod_102 "" TAB_VERB "%3.0" "" COMPU_TAB_REF CompuVtab_37 /end COMPU_METHOD
/begin COMPU_METHOD CompuMethod_103 "" TAB_VERB "%3.0" "" COMPU_TAB_REF CompuVtab_38 /end COMPU_METHOD
/begin COMPU_METHOD CompuMethod_104 "" RAT_FUNC "%7.2" "Hz" COEFFS 0 1 0 0 0 0.01 /end COMPU_METHOD
/begin COMPU_METHOD CompuMethod_105 "" TAB_VERB "%3.0" "" COMPU_TAB_REF CompuVtab_39 /end COMPU_METHOD
/begin COMPU_METHOD CompuMethod_109 "" RAT_FUNC "%6.2" "kW" COEFFS 0 1 0 0 0 1 /end COMPU_METHOD
/begin COMPU_METHOD CompuMethod_110 "" RAT_FUNC "%6.2" "kJ" COEFFS 0 1 0 0 0 1 /end COMPU_METHOD
/begin COMPU_METHOD CompuMethod_119 "" RAT_FUNC "%6.2" "EquivRatio" COEFFS 0 1 0 0 0 1 /end COMPU_METHOD
/begin COMPU_METHOD CompuMethod_121 "" RAT_FUNC "%9.4" "kPa/ADC" COEFFS 0 1 0 0 0 1 /end COMPU_METHOD
/begin COMPU_METHOD CompuMethod_122 "" TAB_VERB "%1.0" "" COMPU_TAB_REF CompuVtab_46 /end COMPU_METHOD
/begin COMPU_METHOD CompuMethod_123 "" TAB_VERB "%1.0" "" COMPU_TAB_REF CompuVtab_47 /end COMPU_METHOD
/begin COMPU_METHOD CompuMethod_124 "" TAB_VERB "%3.0" "" COMPU_TAB_REF CompuVtab_48 /end COMPU_METHOD
/begin COMPU_METHOD CompuMethod_125 "" TAB_VERB "%3.0" "" COMPU_TAB_REF CompuVtab_49 /end COMPU_METHOD
/begin COMPU_METHOD CompuMethod_126 "" RAT_FUNC "%6.2" "psi" COEFFS 0 1 0 0 0 1 /end COMPU_METHOD
/begin COMPU_METHOD CompuMethod_130 "" TAB_VERB "%1.0" "boolean" COMPU_TAB_REF CompuVtab_52 /end COMPU_METHOD
/begin COMPU_METHOD CompuMethod_131 "" TAB_VERB "%1.0" "" COMPU_TAB_REF CompuVtab_53 /end COMPU_METHOD
/begin COMPU_METHOD CompuMethod_132 "" TAB_VERB "%1.0" "" COMPU_TAB_REF CompuVtab_54 /end COMPU_METHOD
/begin COMPU_METHOD CompuMethod_133 "" RAT_FUNC "%6.2" "Equiv Ratio" COEFFS 0 1 0 0 0 1 /end COMPU_METHOD
/begin COMPU_METHOD CompuMethod_134 "" RAT_FUNC "%5.4" "Equiv Ratio" COEFFS 0 1 0 0 0 1 /end COMPU_METHOD
/begin COMPU_METHOD CompuMethod_136 "" RAT_FUNC "%8.3" "mult" COEFFS 0 1 0 0 0 1 /end COMPU_METHOD
/begin COMPU_METHOD CompuMethod_138 "" RAT_FUNC "%6.2" "ratio" COEFFS 0 1 0 0 0 1 /end COMPU_METHOD
/begin COMPU_METHOD CompuMethod_139 "" RAT_FUNC "%9.4" "psi/ADC" COEFFS 0 1 0 0 0 1 /end COMPU_METHOD
/begin COMPU_METHOD CompuMethod_142 "" RAT_FUNC "%6.2" "multiplier" COEFFS 0 1 0 0 0 1 /end COMPU_METHOD
/begin COMPU_METHOD CompuMethod_144 "" TAB_VERB "%1.0" "" COMPU_TAB_REF CompuVtab_59 /end COMPU_METHOD
/begin COMPU_METHOD CompuMethod_145 "" TAB_VERB "%3.0" "" COMPU_TAB_REF CompuVtab_60 /end COMPU_METHOD
/begin COMPU_METHOD CompuMethod_146 "" TAB_VERB "%3.0" "" COMPU_TAB_REF CompuVtab_61 /end COMPU_METHOD
/begin COMPU_METHOD CompuMethod_147 "" TAB_VERB "%1.0" "" COMPU_TAB_REF CompuVtab_62 /end COMPU_METHOD
/begin COMPU_METHOD CompuMethod_148 "" RAT_FUNC "%6.2" "RPM/sec" COEFFS 0 1 0 0 0 1 /end COMPU_METHOD
/begin COMPU_METHOD CompuMethod_150 "" RAT_FUNC "%6.2" "Volts" COEFFS 0 1 0 0 0 1 /end COMPU_METHOD
/begin COMPU_METHOD CompuMethod_151 "" RAT_FUNC "%9.4" "Volts/ADC" COEFFS 0 1 0 0 0 1 /end COMPU_METHOD
/begin COMPU_METHOD CompuMethod_153 "" TAB_VERB "%1.0" "" COMPU_TAB_REF CompuVtab_9 /end COMPU_METHOD
/begin COMPU_METHOD CompuMethod_155 "" RAT_FUNC "%1.0" "boolean" COEFFS 0 1 0 0 0 1 /end COMPU_METHOD
/begin COMPU_METHOD CompuMethod_156 "" TAB_VERB "%1.0" "degBTDC" COMPU_TAB_REF CompuVtab_9 /end COMPU_METHOD
/begin COMPU_METHOD CompuMethod_157 "" TAB_VERB "%1.0" "" COMPU_TAB_REF CompuVtab_64 /end COMPU_METHOD
/begin COMPU_METHOD CompuMethod_158 "" TAB_VERB "%1.0" "" COMPU_TAB_REF CompuVtab_65 /end COMPU_METHOD
/begin COMPU_METHOD CompuMethod_163 "" RAT_FUNC "%6.2" "Percent" COEFFS 0 1 0 0 0 1 /end COMPU_METHOD
/begin COMPU_METHOD CompuMethod_164 "" RAT_FUNC "%6.2" "ADC Counts" COEFFS 0 1 0 0 0 1 /end COMPU_METHOD
/*~~~~~~~~~ 6.3.34 COMPU_VTABs ~~~~~~~~~*/
/begin COMPU_VTAB CompuVtab_1 "" TAB_VERB 2 0 "Pass-Through" 1 "Override" /end COMPU_VTAB
/begin COMPU_VTAB CompuVtab_2 "" TAB_VERB 2 0 "Disabled" 1 "Enabled" /end COMPU_VTAB
/begin COMPU_VTAB CompuVtab_3 "" TAB_VERB 90 0 "Normal Operation" 1 "Bad Resource ID" 2 "Hardware Not Supported" 3 "Behaviour Not Supported" 4 "Bad Attribute Data" 5 "Fail On Create" 6 "Fail On Set Attributes" 7 "Resource Not Created" 8 "Missing Attribute" 9 "Behaviour Method Not Supported" 10 "A Service Failed" 11 "Failed to destroy a resource" 12 "Resource Was Created" 13 "Resource Conflict" 14 "Invalid Encoder Type" 15 "2-Strike Not Supported" 16 "720degCA Pattern Not Supported" 17 "CAM Pattern Not Supported" 18 "Unknown CAM Pattern Supplied" 19 "Engine Speed Present" 20 "Hardware Interface Not Supported" 21 "Service Already Started" 22 "Register Write Failed to verify" 23 "Register access was denied" 24 "Out of free store memory" 25 "Software Q Overrun" 26 "Hardware Q Overrun" 27 "Feature unsupported in archive" 28 "Insufficient FW resource" 29 "OS Resource conflict" 30 "Driver Mode conflict" 31 "RTC time is illegal" 32 "FFS unmounted" 33 "Access from an ISR" 34 "FFS internal" 35 "Operation timed out" 36 "Task Kernel API Usage" 37 "Operation aborted" 38 "File not Found" 39 "Invalid characters in filename" 40 "Duplicate filename" 41 "Filename is too long" 42 "Dir not empty on remove" 43 "Dir not found" 44 "Dir name invalid" 45 "Dir exists" 46 "Dir too deep" 47 "Illegal Handle" 48 "End of File" 49 "Media Full" 50 "Media Write" 51 "Media Read" 52 "Media Write Protected" 53 "File Read Only" 54 "FS Media Changed" 55 "Internal USB" 56 "Voltage too high for USB IC" 57 "Encoder not created" 64 "TPU Chan Conflict" 65 "TPU Func Unavailable" 66 "TPU Config" 67 "TPU Primative Usage" 68 "TPU Primitive Count" 69 "TPU Restricted TPU channel" 70 "TPU Not Created" 71 "TPU Self Modify constant write err" 72 "TPU Error 0x48" 73 "TPU Error 0x49" 74 "TPU Error 0x4A" 75 "TPU Error 0x4B" 76 "TPU Error 0x4C" 77 "TPU Error 0x4D" 78 "TPU Error 0x4E" 79 "TPU Error 0x4F" 80 "TPU Error 0x50" 81 "TPU Error 0x51" 82 "TPU Error 0x52" 83 "TPU Error 0x53" 84 "TPU Error 0x54" 85 "TPU Error 0x55" 86 "TPU Error 0x56" 87 "TPU Error 0x57" 88 "TPU Error 0x58" 89 "TPU Error 0x59" 90 "TPU Error 0x5A" 91 "TPU Error 0x5B" 92 "TPU Error 0x5C" 93 "TPU Error 0x5D" 94 "TPU Error 0x5E" 95 "TPU Error 0x5F" /end COMPU_VTAB
/begin COMPU_VTAB CompuVtab_9 "" TAB_VERB 2 0 "Unlocked" 1 "Locked" /end COMPU_VTAB
/begin COMPU_VTAB CompuVtab_10 "" TAB_VERB 2 0 "Not Enabled" 1 "Enabled" /end COMPU_VTAB
/begin COMPU_VTAB CompuVtab_20 "" TAB_VERB 2 0 "Rising Edge" 1 "Falling Edge" /end COMPU_VTAB
/begin COMPU_VTAB CompuVtab_37 "" TAB_VERB 2 0 "No Alias Protect" 1 "Use Alias Protect" /end COMPU_VTAB
/begin COMPU_VTAB CompuVtab_38 "" TAB_VERB 2 0 "Digital Input" 1 "VR Input" /end COMPU_VTAB
/begin COMPU_VTAB CompuVtab_39 "" TAB_VERB 2 0 "Enable" 1 "Cut" /end COMPU_VTAB
/begin COMPU_VTAB CompuVtab_46 "" TAB_VERB 2 0 "Gov Enabled" 1 "Gov Disabled" /end COMPU_VTAB
/begin COMPU_VTAB CompuVtab_47 "" TAB_VERB 2 0 "ETC Req Mode" 1 "PID Mode" /end COMPU_VTAB
/begin COMPU_VTAB CompuVtab_48 "" TAB_VERB 2 0 "Hold Off" 1 "Hold On" /end COMPU_VTAB
/begin COMPU_VTAB CompuVtab_49 "" TAB_VERB 2 0 "Reset Off" 1 "Reset On" /end COMPU_VTAB
/begin COMPU_VTAB CompuVtab_52 "" TAB_VERB 2 0 "Off" 1 "On" /end COMPU_VTAB
/begin COMPU_VTAB CompuVtab_53 "" TAB_VERB 2 0 "Load saved application values on next startup" 1 "Load factory defaults on next startup" /end COMPU_VTAB
/begin COMPU_VTAB CompuVtab_54 "" TAB_VERB 7 0 "Currently loading NV from Factory FLASH to RAM" 1 "Currently loading NV from EEPROM to RAM" 2 "Currently storing NV from RAM to EEPROM" 3 "Detected new program.  Loaded Factory Defaults from FLASH" 4 "CRC failure.  Loaded Factory Defaults from FLASH" 5 "User requested refresh from Factory Defaults in FLASH." 6 "Successful refresh of EEPROM values from last shutdown" /end COMPU_VTAB
/begin COMPU_VTAB CompuVtab_59 "" TAB_VERB 2 0 "Run" 1 "Restore To Defaults" /end COMPU_VTAB
/begin COMPU_VTAB CompuVtab_60 "" TAB_VERB 4 0 "Disabled" 1 "Soft" 2 "Medium" 3 "Hard" /end COMPU_VTAB
/begin COMPU_VTAB CompuVtab_61 "" TAB_VERB 3 0 "Cut Spark" 1 "Cut Fuel" 2 "Cut Spark and Fuel" /end COMPU_VTAB
/begin COMPU_VTAB CompuVtab_62 "" TAB_VERB 2 0 "SteadyOrRising" 1 "Falling" /end COMPU_VTAB
/begin COMPU_VTAB CompuVtab_64 "" TAB_VERB 2 0 "Transient" 1 "Steady" /end COMPU_VTAB
/begin COMPU_VTAB CompuVtab_65 "" TAB_VERB 2 0 "Run" 1 "Store To EEPROM" /end COMPU_VTAB
/begin FUNCTION Fuel_Cyl2_Override "" /begin DEF_CHARACTERISTIC Fuel_Cyl2_offset Fuel_Cyl2_ovr /end DEF_CHARACTERISTIC /end FUNCTION
/begin FUNCTION Fuel_Cyl3_Override "" /begin DEF_CHARACTERISTIC Fuel_Cyl3_offset Fuel_Cyl3_ovr /end DEF_CHARACTERISTIC /end FUNCTION
/begin FUNCTION Fuel_Cyl4_Override "" /begin DEF_CHARACTERISTIC Fuel_Cyl4_offset Fuel_Cyl4_ovr /end DEF_CHARACTERISTIC /end FUNCTION
/begin FUNCTION Fuel_Cyl5_Override "" /begin DEF_CHARACTERISTIC Fuel_Cyl5_offset Fuel_Cyl5_ovr /end DEF_CHARACTERISTIC /end FUNCTION
/begin FUNCTION Fuel_Cyl6_Override "" /begin DEF_CHARACTERISTIC Fuel_Cyl6_offset Fuel_Cyl6_ovr /end DEF_CHARACTERISTIC /end FUNCTION
/begin FUNCTION Fuel_Cyl7_Override "" /begin DEF_CHARACTERISTIC Fuel_Cyl7_offset Fuel_Cyl7_ovr /end DEF_CHARACTERISTIC /end FUNCTION
/begin FUNCTION Fuel_Cyl8_Override "" /begin DEF_CHARACTERISTIC Fuel_Cyl8_offset Fuel_Cyl8_ovr /end DEF_CHARACTERISTIC /end FUNCTION
/begin FUNCTION Fuel_Economy "" /begin OUT_MEASUREMENT Fuel_Economy_Filtered Fuel_Economy_Inst /end OUT_MEASUREMENT /begin SUB_FUNCTION First_Order_Low_Pass__Tunable_ /end SUB_FUNCTION /end FUNCTION
/begin FUNCTION Fuel_Global_Override "" /begin DEF_CHARACTERISTIC Fuel_Global_offset Fuel_Global_ovr /end DEF_CHARACTERISTIC /end FUNCTION
/begin FUNCTION Saturation__Tunable__1 "" /begin DEF_CHARACTERISTIC FuelAdaptErrorLwrLim FuelAdaptErrorUprLim /end DEF_CHARACTERISTIC /end FUNCTION
/begin FUNCTION DeltaPressureIndex "" /begin OUT_MEASUREMENT FuelDeltaPress InjDeltaPress09Idx InjDeltaPress09In /end OUT_MEASUREMENT /end FUNCTION
/begin FUNCTION Fuel_Delta_Pressure_Calculation "" /begin OUT_MEASUREMENT FuelDeltaPressure /end OUT_MEASUREMENT /end FUNCTION
/begin FUNCTION First_Order_Low_Pass__Tunable_ "" /begin DEF_CHARACTERISTIC FuelEconomy_FilterC /end DEF_CHARACTERISTIC /end FUNCTION
/begin FUNCTION Adapt_FuelFlowComp_Map "" /begin DEF_CHARACTERISTIC FuelFlowCompMaxValue FuelFlowCompMinValue /end DEF_CHARACTERISTIC /end FUNCTION
/begin FUNCTION FUELP "" /begin OUT_MEASUREMENT FUELP /end OUT_MEASUREMENT /begin SUB_FUNCTION FUELP_Override FUELP_Config /end SUB_FUNCTION /end FUNCTION
/begin FUNCTION FuelPump "" /begin SUB_FUNCTION FUELP /end SUB_FUNCTION /end FUNCTION
/begin FUNCTION FUELP_Override "" /begin DEF_CHARACTERISTIC FUELP_new FUELP_ovr /end DEF_CHARACTERISTIC /end FUNCTION
/begin FUNCTION FUELP_Config "" /begin DEF_CHARACTERISTIC FUELP_Polarity /end DEF_CHARACTERISTIC /end FUNCTION
/begin FUNCTION FuelPres "" /begin OUT_MEASUREMENT FuelPres FuelPresADC FuelPresRaw /end OUT_MEASUREMENT /begin SUB_FUNCTION FuelPres_Override FuelPres_Config /end SUB_FUNCTION /end FUNCTION
/begin FUNCTION Wrong_Fuel_Pressure_Fault_Logic ""
 /begin DEF_CHARACTERISTIC FuelPres_DeltaTarget FuelPres_DeltaTolerance FuelPres_FaultTimer /end DEF_CHARACTERISTIC
/end FUNCTION
/begin FUNCTION FuelPres_Override "" /begin DEF_CHARACTERISTIC FuelPres_new FuelPres_ovr /end DEF_CHARACTERISTIC /end FUNCTION
/begin FUNCTION FuelPres_Config ""
 /begin DEF_CHARACTERISTIC FuelPresDfltValue FuelPresFilterConst FuelPresGain FuelPresInputHiFltPos FuelPresInputLoFltPos FuelPresOfst /end DEF_CHARACTERISTIC
/end FUNCTION
/begin FUNCTION FuelSens "" /begin OUT_MEASUREMENT FuelSens FuelSensADC FuelSensRaw /end OUT_MEASUREMENT /begin SUB_FUNCTION FuelSens_Override FuelSens_Config /end SUB_FUNCTION /end FUNCTION
/begin FUNCTION FuelSens_Override "" /begin DEF_CHARACTERISTIC FuelSens_new FuelSens_ovr /end DEF_CHARACTERISTIC /end FUNCTION
/begin FUNCTION FuelSens_Config ""
 /begin DEF_CHARACTERISTIC FuelSensDfltValue FuelSensFilterConst FuelSensGain FuelSensInputHiFltPos FuelSensInputLoFltPos FuelSensOfst /end DEF_CHARACTERISTIC
/end FUNCTION
/begin FUNCTION Frequency_In_Config ""
 /begin DEF_CHARACTERISTIC FuelSensorPin_AliasProtect FuelSensorPin_EdgeDetect FuelSensorPin_Interface FuelSensorPin_MinFrequency MAF_Pin_AliasProtect MAF_Pin_EdgeDetect MAF_Pin_Interface MAF_Pin_MinFrequency /end DEF_CHARACTERISTIC
/end FUNCTION
/begin FUNCTION Moving_Average_Filter "" /begin DEF_CHARACTERISTIC Gain1 Gain2 Gain3 Gain4 /end DEF_CHARACTERISTIC /end FUNCTION
/begin FUNCTION Generating_Ovr_Override "" /begin DEF_CHARACTERISTIC Generating_Ovr_new Generating_Ovr_ovr /end DEF_CHARACTERISTIC /end FUNCTION
/begin FUNCTION Generating_Torque_Lim_Ovr_Override ""
 /begin DEF_CHARACTERISTIC Generating_Torque_Lim_Ovr_new Generating_Torque_Lim_Ovr_ovr /end DEF_CHARACTERISTIC
/end FUNCTION
/begin FUNCTION Generating_Tq_Curve_Ovr_Override "" /begin DEF_CHARACTERISTIC Generating_Tq_Curve_Ovr_new Generating_Tq_Curve_Ovr_ovr /end DEF_CHARACTERISTIC /end FUNCTION
/begin FUNCTION GeneratingTq_Curve_Ovr_Override "" /begin DEF_CHARACTERISTIC GeneratingTq_Curve_Ovr_new GeneratingTq_Curve_Ovr_ovr /end DEF_CHARACTERISTIC /end FUNCTION
/begin FUNCTION Genset_Enable_Ovr_Override "" /begin DEF_CHARACTERISTIC Genset_Enable_Ovr_new Genset_Enable_Ovr_ovr /end DEF_CHARACTERISTIC /end FUNCTION
/begin FUNCTION Genset_Load_Ovr_Override "" /begin DEF_CHARACTERISTIC Genset_Load_Ovr_new Genset_Load_Ovr_ovr /end DEF_CHARACTERISTIC /end FUNCTION
/begin FUNCTION Cycle1CutPatter ""
 /begin DEF_CHARACTERISTIC HardCycle1Cyl1 HardCycle1Cyl2 HardCycle1Cyl3 HardCycle1Cyl4 HardCycle1Cyl5 HardCycle1Cyl6 HardCycle1Cyl7 HardCycle1Cyl8 /end DEF_CHARACTERISTIC
/end FUNCTION
/begin FUNCTION Hard_Cycle_Cut_Pattern ""
 /begin SUB_FUNCTION Cycle1CutPatter Cycle2CutPatter Cycle3CutPatter Cycle4CutPatter /end SUB_FUNCTION
/end FUNCTION
/begin FUNCTION SequenceCutPattern "" /begin DEF_CHARACTERISTIC RevLimitType /end DEF_CHARACTERISTIC /begin OUT_MEASUREMENT RevLimiterState /end OUT_MEASUREMENT
 /begin SUB_FUNCTION Hard_Cycle_Cut_Pattern Medium_Cycle_Cut_Pattern Soft_Cycle_Cut_Pattern /end SUB_FUNCTION
/end FUNCTION
/begin FUNCTION Cycle2CutPatter ""
 /begin DEF_CHARACTERISTIC HardCycle2Cyl1 HardCycle2Cyl2 HardCycle2Cyl3 HardCycle2Cyl4 HardCycle2Cyl5 HardCycle2Cyl6 HardCycle2Cyl7 HardCycle2Cyl8 /end DEF_CHARACTERISTIC
/end FUNCTION
/begin FUNCTION Cycle3CutPatter ""
 /begin DEF_CHARACTERISTIC HardCycle3Cyl1 HardCycle3Cyl2 HardCycle3Cyl3 HardCycle3Cyl4 HardCycle3Cyl5 HardCycle3Cyl6 HardCycle3Cyl7 HardCycle3Cyl8 /end DEF_CHARACTERISTIC
/end FUNCTION
/begin FUNCTION Cycle4CutPatter ""
 /begin DEF_CHARACTERISTIC HardCycle4Cyl1 HardCycle4Cyl2 HardCycle4Cyl3 HardCycle4Cyl4 HardCycle4Cyl5 HardCycle4Cyl6 HardCycle4Cyl7 HardCycle4Cyl8 /end DEF_CHARACTERISTIC
/end FUNCTION
/begin FUNCTION HVBus_Voltage_Ovr_Override "" /begin DEF_CHARACTERISTIC HVBus_Voltage_Ovr_new HVBus_Voltage_Ovr_ovr /end DEF_CHARACTERISTIC /end FUNCTION
/begin FUNCTION IAT "" /begin DEF_CHARACTERISTIC IATTbl /end DEF_CHARACTERISTIC /begin OUT_MEASUREMENT IAT IATADC IATIdx IATRaw /end OUT_MEASUREMENT /begin SUB_FUNCTION IAT_Override IAT_Config /end SUB_FUNCTION /end FUNCTION
/begin FUNCTION Capture_IAT_At_Startup "" /begin DEF_CHARACTERISTIC IAT_KeyUp_Count /end DEF_CHARACTERISTIC /begin OUT_MEASUREMENT IAT_KeyUp /end OUT_MEASUREMENT /end FUNCTION
/begin FUNCTION IAT_Override "" /begin DEF_CHARACTERISTIC IAT_new IAT_ovr /end DEF_CHARACTERISTIC /end FUNCTION
/begin FUNCTION IAT_Indexes "" /begin OUT_MEASUREMENT IAT05Idx IAT05In IAT17Idx IAT17In /end OUT_MEASUREMENT /end FUNCTION
/begin FUNCTION IAT_Config "" /begin DEF_CHARACTERISTIC IATDefault IATFiltConst IATMax IATMin /end DEF_CHARACTERISTIC /end FUNCTION
/begin FUNCTION Ramp_Air_Into_Idle_State "" /begin DEF_CHARACTERISTIC IdleEntryAirRampInFiltC /end DEF_CHARACTERISTIC /end FUNCTION
/begin FUNCTION Torque_Indexes ""
 /begin OUT_MEASUREMENT IndLoadNom05Idx IndLoadNom05In IndLoadNom09Idx IndLoadNom09In IndLoadNom17Idx IndLoadNom17In /end OUT_MEASUREMENT
/end FUNCTION
/begin FUNCTION Calculate_Power_and_Work "" /begin DEF_CHARACTERISTIC IndWorkMax /end DEF_CHARACTERISTIC /begin OUT_MEASUREMENT IndPower IndWork /end OUT_MEASUREMENT /end FUNCTION
/begin FUNCTION Power_Index "" /begin OUT_MEASUREMENT IndPower05Idx IndPower05In /end OUT_MEASUREMENT /end FUNCTION
/begin FUNCTION Ramp_RPM "" /begin DEF_CHARACTERISTIC InGearRPMCtrlEntryFiltC /end DEF_CHARACTERISTIC /begin OUT_MEASUREMENT MinGovRPMSetPt /end OUT_MEASUREMENT /end FUNCTION
/begin FUNCTION InjEnable_Override "" /begin DEF_CHARACTERISTIC InjEnable_new InjEnable_ovr /end DEF_CHARACTERISTIC /end FUNCTION
/begin FUNCTION Inverter_Temp_Ovr_Override "" /begin DEF_CHARACTERISTIC Inverter_Temp_Ovr_new Inverter_Temp_Ovr_ovr /end DEF_CHARACTERISTIC /end FUNCTION
/begin FUNCTION Keyed_Voltage_Ovr_Override "" /begin DEF_CHARACTERISTIC Keyed_Voltage_Ovr_new Keyed_Voltage_Ovr_ovr /end DEF_CHARACTERISTIC /end FUNCTION
/begin FUNCTION O2_Control_Switch_Point_Maps ""
 /begin DEF_CHARACTERISTIC LeanSwPtDeltaMap LeanTargetDeltaMap RichSwPtDeltaMap RichTargetDeltaMap /end DEF_CHARACTERISTIC
 /begin OUT_MEASUREMENT LeanSwPtDelta LeanTargetDelta RichSwPtDelta RichTargetDelta /end OUT_MEASUREMENT
/end FUNCTION
/begin FUNCTION O2_PID_Calibrations ""
 /begin DEF_CHARACTERISTIC O2CtrlDGain O2CtrlIGain O2CtrlPGain O2CtrlPIDOutLowerLimit O2CtrlPIDOutUpperLimit O2ITermLowerLimit O2ITermUpperLimit /end DEF_CHARACTERISTIC
 /begin SUB_FUNCTION O2_Control_Switch_Point_Maps Error_Gain_Scheduling /end SUB_FUNCTION
/end FUNCTION
/begin FUNCTION Closed_Loop_O2_PID_Controller ""
 /begin OUT_MEASUREMENT LiquidO2Control_DTerm LiquidO2Control_ErrorTerm LiquidO2Control_ITerm LiquidO2Control_PTerm /end OUT_MEASUREMENT
/end FUNCTION
/begin FUNCTION O2_PID_Controller "" /begin OUT_MEASUREMENT O2TargetEquivRatio /end OUT_MEASUREMENT
 /begin SUB_FUNCTION Closed_Loop_O2_PID_Controller Equivalence_Ratio_Perturbation /end SUB_FUNCTION
/end FUNCTION
/begin FUNCTION Load_On_Ovr_Override "" /begin DEF_CHARACTERISTIC Load_On_Ovr_new Load_On_Ovr_ovr /end DEF_CHARACTERISTIC /end FUNCTION
/begin FUNCTION Load_RPM_Ovr_Override "" /begin DEF_CHARACTERISTIC Load_RPM_Ovr_new Load_RPM_Ovr_ovr /end DEF_CHARACTERISTIC /end FUNCTION
/begin FUNCTION Load_Throttle_Ovr_Override "" /begin DEF_CHARACTERISTIC Load_Throttle_Ovr_new Load_Throttle_Ovr_ovr /end DEF_CHARACTERISTIC /end FUNCTION
/begin FUNCTION MAF "" /begin DEF_CHARACTERISTIC MAFTbl /end DEF_CHARACTERISTIC /begin OUT_MEASUREMENT MAF MAFADC MAFIdx MAFRaw /end OUT_MEASUREMENT /begin SUB_FUNCTION MAF_Override MAF_Config /end SUB_FUNCTION /end FUNCTION
/begin FUNCTION MAF_Override "" /begin DEF_CHARACTERISTIC MAF_new MAF_ovr /end DEF_CHARACTERISTIC /end FUNCTION
/begin FUNCTION MAF_Config "" /begin DEF_CHARACTERISTIC MAFDefault MAFFiltConst MAFMax MAFMin /end DEF_CHARACTERISTIC /end FUNCTION
/begin FUNCTION MAFPortIndex "" /begin OUT_MEASUREMENT MAFPort05Idx MAFPort05In /end OUT_MEASUREMENT /end FUNCTION
/begin FUNCTION MakeUp_EOI_Override "" /begin DEF_CHARACTERISTIC MakeUp_EOI_new MakeUp_EOI_ovr /end DEF_CHARACTERISTIC /end FUNCTION
/begin FUNCTION _MAP "" /begin OUT_MEASUREMENT MAP MAPADC MAPRaw /end OUT_MEASUREMENT /begin SUB_FUNCTION MAP_Override MAP_Config /end SUB_FUNCTION /end FUNCTION
/begin FUNCTION MAP_Fault_Logic ""
 /begin DEF_CHARACTERISTIC MAP_IR_HI MAP_IR_LO MAP_IR_TPS_CL MAP_IR_TPS_OP MAP_STUCK MAP_TPS_STUCK /end DEF_CHARACTERISTIC
/end FUNCTION
/begin FUNCTION MAP_Override "" /begin DEF_CHARACTERISTIC MAP_new MAP_ovr /end DEF_CHARACTERISTIC /end FUNCTION
/begin FUNCTION MAP_Config ""
 /begin DEF_CHARACTERISTIC MAPDfltValue MAPFilterConst MAPGain MAPInputHiFltPos MAPInputLoFltPos MAPOfst /end DEF_CHARACTERISTIC
/end FUNCTION
/begin FUNCTION MAPTime "" /begin OUT_MEASUREMENT MAPTime MAPTimeADC MAPTimeRaw /end OUT_MEASUREMENT /begin SUB_FUNCTION MAPTime_Override MAPTime_Config /end SUB_FUNCTION /end FUNCTION
/begin FUNCTION MAPTime_Override "" /begin DEF_CHARACTERISTIC MAPTime_new MAPTime_ovr /end DEF_CHARACTERISTIC /end FUNCTION
/begin FUNCTION MAPTime_Config ""
 /begin DEF_CHARACTERISTIC MAPTimeDfltValue MAPTimeFilterConst MAPTimeGain MAPTimeInputHiFltPos MAPTimeInputLoFltPos MAPTimeOfst /end DEF_CHARACTERISTIC
/end FUNCTION
/begin FUNCTION MaxGovState "" /begin DEF_CHARACTERISTIC MaxGov MaxGovDisable MaxGovTPSHyst /end DEF_CHARACTERISTIC /begin OUT_MEASUREMENT MaxGovETCMode MaxGovHold MaxGovReset MaxGovState /end OUT_MEASUREMENT /end FUNCTION
/begin FUNCTION MaxGovernor "" /begin OUT_MEASUREMENT MaxGovOutput TPSRequestLookupAirOfst /end OUT_MEASUREMENT
 /begin SUB_FUNCTION MaxGovState Universal_PID__Tunable___Scheduled__1 I_Term_Preload Trigger_Pre_load Ramp_RPM_1 /end SUB_FUNCTION
/end FUNCTION
/begin FUNCTION Universal_PID__Tunable___Scheduled__1 ""
 /begin DEF_CHARACTERISTIC MaxGovDGain MaxGovDGainErrorMultTbl MaxGovErrorGain MaxGovIGain MaxGovIGainErrorMultTbl MaxGovITermLowerLimit MaxGovITermUpperLimit MaxGovPGain MaxGovPGainErrorMultTbl MaxGovPIDOutLowerLimit MaxGovPIDOutUpperLimit /end DEF_CHARACTERISTIC
 /begin OUT_MEASUREMENT MaxGovDGainErrorMult MaxGovDTerm MaxGovError MaxGovIGainErrorMult MaxGovITerm MaxGovPGainErrorMult MaxGovPTerm MaxGovSpeedErrorIdx MaxGovSpeedErrorIn /end OUT_MEASUREMENT
/end FUNCTION
/begin FUNCTION I_Term_Preload "" /begin DEF_CHARACTERISTIC MaxGovPreloadITermTbl /end DEF_CHARACTERISTIC /begin OUT_MEASUREMENT MaxGovIC MaxGovPreloadITerm /end OUT_MEASUREMENT /end FUNCTION
/begin FUNCTION InGear ""
 /begin DEF_CHARACTERISTIC MaxGovInGearLowerLim MaxGovInGearRPMSetPt MaxGovInGearRPMThresh MaxGovInGearSetPt MaxGovInGearUpperLim /end DEF_CHARACTERISTIC
/end FUNCTION
/begin FUNCTION Trigger_Pre_load "" /begin SUB_FUNCTION InGear InNeutral /end SUB_FUNCTION /end FUNCTION
/begin FUNCTION InNeutral ""
 /begin DEF_CHARACTERISTIC MaxGovNtrlLowerLim MaxGovNtrlRPMSetPt MaxGovNtrlRPMThresh MaxGovNtrlSetPt MaxGovNtrlUpperLim /end DEF_CHARACTERISTIC
/end FUNCTION
/begin FUNCTION Ramp_RPM_1 "" /begin DEF_CHARACTERISTIC MaxGovRPMCtrlEntryFiltC /end DEF_CHARACTERISTIC /begin OUT_MEASUREMENT MaxGovRPMSetpoint /end OUT_MEASUREMENT /end FUNCTION
/begin FUNCTION Normalized_Effective_Combustion_Chamber_Temperature "" /begin DEF_CHARACTERISTIC MaxIndEngPwr SteadyStateECT WarmUpTimeConst /end DEF_CHARACTERISTIC /begin OUT_MEASUREMENT NECCT /end OUT_MEASUREMENT /end FUNCTION
/begin FUNCTION SparkAdvanceLimiter "" /begin DEF_CHARACTERISTIC MaxSparkLimitOffIdle MaxSparkLimitTbl MinSparkLimit /end DEF_CHARACTERISTIC /begin OUT_MEASUREMENT MaxSparkLimit TotalSparkAdv /end OUT_MEASUREMENT /end FUNCTION
/begin FUNCTION Mech_PW_Override "" /begin DEF_CHARACTERISTIC Mech_PW_new Mech_PW_ovr /end DEF_CHARACTERISTIC /end FUNCTION
/begin FUNCTION Cycle1CutPatter_1 ""
 /begin DEF_CHARACTERISTIC MediumCycle1Cyl1 MediumCycle1Cyl2 MediumCycle1Cyl3 MediumCycle1Cyl4 MediumCycle1Cyl5 MediumCycle1Cyl6 MediumCycle1Cyl7 MediumCycle1Cyl8 /end DEF_CHARACTERISTIC
/end FUNCTION
/begin FUNCTION Medium_Cycle_Cut_Pattern ""
 /begin SUB_FUNCTION Cycle1CutPatter_1 Cycle2CutPatter_1 Cycle3CutPatter_1 Cycle4CutPatter_1 /end SUB_FUNCTION
/end FUNCTION
/begin FUNCTION Cycle2CutPatter_1 ""
 /begin DEF_CHARACTERISTIC MediumCycle2Cyl1 MediumCycle2Cyl2 MediumCycle2Cyl3 MediumCycle2Cyl4 MediumCycle2Cyl5 MediumCycle2Cyl6 MediumCycle2Cyl7 MediumCycle2Cyl8 /end DEF_CHARACTERISTIC
/end FUNCTION
/begin FUNCTION Cycle3CutPatter_1 ""
 /begin DEF_CHARACTERISTIC MediumCycle3Cyl1 MediumCycle3Cyl2 MediumCycle3Cyl3 MediumCycle3Cyl4 MediumCycle3Cyl5 MediumCycle3Cyl6 MediumCycle3Cyl7 MediumCycle3Cyl8 /end DEF_CHARACTERISTIC
/end FUNCTION
/begin FUNCTION Cycle4CutPatter_1 ""
 /begin DEF_CHARACTERISTIC MediumCycle4Cyl1 MediumCycle4Cyl2 MediumCycle4Cyl3 MediumCycle4Cyl4 MediumCycle4Cyl5 MediumCycle4Cyl6 MediumCycle4Cyl7 MediumCycle4Cyl8 /end DEF_CHARACTERISTIC
/end FUNCTION
/begin FUNCTION Base_RPM_Set_Pt "" /begin DEF_CHARACTERISTIC MinGovClntRPMSetPtTbl /end DEF_CHARACTERISTIC /begin OUT_MEASUREMENT MinGovClntRPMSetPt /end OUT_MEASUREMENT /end FUNCTION
/begin FUNCTION Low_Oil_Pressure_Fault_Logic ""
 /begin DEF_CHARACTERISTIC MinOilPressure_FaultTbl MinOilPressure_WarnTbl NoOilPres_FaultTime /end DEF_CHARACTERISTIC
 /begin OUT_MEASUREMENT MinOilPressure_Fault MinOilPressure_Warn /end OUT_MEASUREMENT
/end FUNCTION
/begin FUNCTION Motor_Speed_Ovr_Override "" /begin DEF_CHARACTERISTIC Motor_Speed_Ovr_new Motor_Speed_Ovr_ovr /end DEF_CHARACTERISTIC /end FUNCTION
/begin FUNCTION Temp_Sensor_Arbitration "" /begin DEF_CHARACTERISTIC Motor_Temp_Offset /end DEF_CHARACTERISTIC /end FUNCTION
/begin FUNCTION Motor_Temp_Ovr_Override "" /begin DEF_CHARACTERISTIC Motor_Temp_Ovr_new Motor_Temp_Ovr_ovr /end DEF_CHARACTERISTIC /end FUNCTION
/begin FUNCTION Motoring_Torque_Lim_Ovr_Override "" /begin DEF_CHARACTERISTIC Motoring_Torque_Lim_Ovr_new Motoring_Torque_Lim_Ovr_ovr /end DEF_CHARACTERISTIC /end FUNCTION
/begin FUNCTION Motoring_Tq_Curve_Ovr_Override "" /begin DEF_CHARACTERISTIC Motoring_Tq_Curve_Ovr_new Motoring_Tq_Curve_Ovr_ovr /end DEF_CHARACTERISTIC /end FUNCTION
/begin FUNCTION MotoringDetection "" /begin DEF_CHARACTERISTIC MotoringDeltaRPMLimit MotoringDtctTimerLimit /end DEF_CHARACTERISTIC /begin OUT_MEASUREMENT MotoringDetectionFlag MotoringDetectionTime /end OUT_MEASUREMENT /end FUNCTION
/begin FUNCTION MotoringTq_Curve_Ovr_Override "" /begin DEF_CHARACTERISTIC MotoringTq_Curve_Ovr_new MotoringTq_Curve_Ovr_ovr /end DEF_CHARACTERISTIC /end FUNCTION
/begin FUNCTION MPRD_Override "" /begin DEF_CHARACTERISTIC MPRD_new MPRD_ovr /end DEF_CHARACTERISTIC /end FUNCTION
/begin FUNCTION NECCT_Index "" /begin OUT_MEASUREMENT NECCT09Idx NECCT09In /end OUT_MEASUREMENT /end FUNCTION
/begin FUNCTION NegativeTq_Ovr_Override "" /begin DEF_CHARACTERISTIC NegativeTq_Ovr_new NegativeTq_Ovr_ovr /end DEF_CHARACTERISTIC /end FUNCTION
/begin FUNCTION Injector_Sequence "" /begin OUT_MEASUREMENT NextCylinderToInject NextInjectorAngle /end OUT_MEASUREMENT /end FUNCTION
/begin FUNCTION General "" /begin SUB_FUNCTION Injector_Sequence Spark_Sequence /end SUB_FUNCTION /end FUNCTION
/begin FUNCTION Spark_Sequence "" /begin OUT_MEASUREMENT NextCylinderToSpark NextSparkAngle /end OUT_MEASUREMENT /end FUNCTION
/begin FUNCTION NonVolatile_Storage "" /begin DEF_CHARACTERISTIC RestoreNVFactoryDefaults StoreNV /end DEF_CHARACTERISTIC /begin OUT_MEASUREMENT NonVolatileCRC NonVolatileFormatID NonVolatileStatus /end OUT_MEASUREMENT /begin SUB_FUNCTION NonVolatile_Storage_Config /end SUB_FUNCTION /end FUNCTION
/begin FUNCTION NonVolatile_Storage_Config ""
 /begin DEF_CHARACTERISTIC NonVolatileRestoreOnFirstStartup NonVolatileRestoreOnStartup /end DEF_CHARACTERISTIC
/end FUNCTION
/begin FUNCTION O2_PostCat "" /begin DEF_CHARACTERISTIC O2_PostCatTbl /end DEF_CHARACTERISTIC /begin OUT_MEASUREMENT O2_PostCat O2_PostCatADC O2_PostCatIdx O2_PostCatRaw /end OUT_MEASUREMENT /begin SUB_FUNCTION O2_PostCat_Override O2_PostCat_Config /end SUB_FUNCTION /end FUNCTION
/begin FUNCTION O2_PostCat_Override "" /begin DEF_CHARACTERISTIC O2_PostCat_new O2_PostCat_ovr /end DEF_CHARACTERISTIC /end FUNCTION
/begin FUNCTION O2_PostCat_Config ""
 /begin DEF_CHARACTERISTIC O2_PostCatDefault O2_PostCatFiltConst O2_PostCatMax O2_PostCatMin /end DEF_CHARACTERISTIC
/end FUNCTION
/begin FUNCTION Equivalence_Ratio_Perturbation "" /begin DEF_CHARACTERISTIC O2ActiveTimeThresh O2LeanTimeThresh O2RichTimeThresh /end DEF_CHARACTERISTIC /begin OUT_MEASUREMENT O2LeanTime O2NotActiveTime O2RichTime /end OUT_MEASUREMENT /end FUNCTION
/begin FUNCTION O2_Control_Enable_Delay "" /begin DEF_CHARACTERISTIC O2CtrlAdaptDelayTime /end DEF_CHARACTERISTIC /end FUNCTION
/begin FUNCTION O2_De_lag "" /begin DEF_CHARACTERISTIC O2DelagFilterConst PostO2DelagFiltConst /end DEF_CHARACTERISTIC /begin OUT_MEASUREMENT PostO2Delag PreO2Delag /end OUT_MEASUREMENT /end FUNCTION
/begin FUNCTION Error_Gain_Scheduling "" /begin DEF_CHARACTERISTIC O2MAFErrGainMultTbl O2NECCTErrGainMultTbl /end DEF_CHARACTERISTIC /begin OUT_MEASUREMENT O2MAFErrGainMult O2NECCTErrGainMult /end OUT_MEASUREMENT /end FUNCTION
/begin FUNCTION Oil_Pressure_Ovr_Override "" /begin DEF_CHARACTERISTIC Oil_Pressure_Ovr_new Oil_Pressure_Ovr_ovr /end DEF_CHARACTERISTIC /end FUNCTION
/begin FUNCTION OILP "" /begin OUT_MEASUREMENT OILP /end OUT_MEASUREMENT /begin SUB_FUNCTION OILP_Override OILP_Config /end SUB_FUNCTION /end FUNCTION
/begin FUNCTION OilPump "" /begin SUB_FUNCTION OILP /end SUB_FUNCTION /end FUNCTION
/begin FUNCTION OILP_Override "" /begin DEF_CHARACTERISTIC OILP_new OILP_ovr /end DEF_CHARACTERISTIC /end FUNCTION
/begin FUNCTION OILP_Config "" /begin DEF_CHARACTERISTIC OILP_Polarity /end DEF_CHARACTERISTIC /end FUNCTION
/begin FUNCTION OilPres "" /begin OUT_MEASUREMENT OilPres OilPresADC OilPresRaw /end OUT_MEASUREMENT /begin SUB_FUNCTION OilPres_Override OilPres_Config /end SUB_FUNCTION /end FUNCTION
/begin FUNCTION OilPres_Override "" /begin DEF_CHARACTERISTIC OilPres_new OilPres_ovr /end DEF_CHARACTERISTIC /end FUNCTION
/begin FUNCTION OilPres_Config ""
 /begin DEF_CHARACTERISTIC OilPresDfltValue OilPresFilterConst OilPresGain OilPresInputHiFltPos OilPresInputLoFltPos OilPresOfst /end DEF_CHARACTERISTIC
/end FUNCTION
/begin FUNCTION OneShot "" /begin OUT_MEASUREMENT oneshot_create_ONESHOT /end OUT_MEASUREMENT /end FUNCTION
/begin FUNCTION ESTOP_at_Startup "" /begin DEF_CHARACTERISTIC ONTime /end DEF_CHARACTERISTIC /begin OUT_MEASUREMENT ONTSE /end OUT_MEASUREMENT /end FUNCTION
/begin FUNCTION CutThrottle_APP_Limiting "" /begin DEF_CHARACTERISTIC Overheat_MaxAPP Overheat_ScaleAPP /end DEF_CHARACTERISTIC /end FUNCTION
/begin FUNCTION O2_Heater "" /begin OUT_MEASUREMENT Oxygen_Heater /end OUT_MEASUREMENT /begin SUB_FUNCTION Oxygen_Heater_Override O2_Heater_Config /end SUB_FUNCTION /end FUNCTION
/begin FUNCTION Oxygen_Heater "" /begin SUB_FUNCTION O2_Heater /end SUB_FUNCTION /end FUNCTION
/begin FUNCTION Oxygen_Heater_Override "" /begin DEF_CHARACTERISTIC Oxygen_Heater_new Oxygen_Heater_ovr /end DEF_CHARACTERISTIC /end FUNCTION
/begin FUNCTION O2_Heater_Config "" /begin DEF_CHARACTERISTIC Oxygen_Heater_Polarity /end DEF_CHARACTERISTIC /end FUNCTION
/begin FUNCTION Phoenix_Fault_Ovr_Override "" /begin DEF_CHARACTERISTIC Phoenix_Fault_Ovr_new Phoenix_Fault_Ovr_ovr /end DEF_CHARACTERISTIC /end FUNCTION
/begin FUNCTION PWM "" /begin OUT_MEASUREMENT pwm_create_ETCPin_PWMOutput pwm_set_ETCPin_PWMOutput /end OUT_MEASUREMENT /end FUNCTION
/begin FUNCTION PWMOutput_State_Ovr_Override "" /begin DEF_CHARACTERISTIC PWMOutput_State_Ovr_new PWMOutput_State_Ovr_ovr /end DEF_CHARACTERISTIC /end FUNCTION
/begin FUNCTION Other "" /begin OUT_MEASUREMENT resource_allocation /end OUT_MEASUREMENT /end FUNCTION
/begin FUNCTION RPM_Ovr_Override "" /begin DEF_CHARACTERISTIC RPM_Ovr_new RPM_Ovr_ovr /end DEF_CHARACTERISTIC /end FUNCTION
/begin FUNCTION RPM_Indexes "" /begin OUT_MEASUREMENT RPM05Idx RPM05In RPM09Idx RPM09In RPM17Idx RPM17In /end OUT_MEASUREMENT /end FUNCTION
/begin FUNCTION Determine_if_RPM_is_Falling "" /begin DEF_CHARACTERISTIC RPMFallingFiltConst RPMFallingRate /end DEF_CHARACTERISTIC /begin OUT_MEASUREMENT RPMFalling /end OUT_MEASUREMENT /end FUNCTION
/begin FUNCTION Run_Enable_Ovr_Override "" /begin DEF_CHARACTERISTIC Run_Enable_Ovr_new Run_Enable_Ovr_ovr /end DEF_CHARACTERISTIC /end FUNCTION
/begin FUNCTION Run_Request_Ovr_Override "" /begin DEF_CHARACTERISTIC Run_Request_Ovr_new Run_Request_Ovr_ovr /end DEF_CHARACTERISTIC /end FUNCTION
/begin FUNCTION SecondartSpeedLim_CenterPT_Ovr_Override ""
 /begin DEF_CHARACTERISTIC SecondartSpeedLim_CenterPT_Ovr_new SecondartSpeedLim_CenterPT_Ovr_ovr /end DEF_CHARACTERISTIC
/end FUNCTION
/begin FUNCTION SecondaryVoltLim_CenterPT_Ovr_Override ""
 /begin DEF_CHARACTERISTIC SecondaryVoltLim_CenterPT_Ovr_new SecondaryVoltLim_CenterPT_Ovr_ovr /end DEF_CHARACTERISTIC
/end FUNCTION
/begin FUNCTION SensVolt "" /begin OUT_MEASUREMENT SensVolt SensVoltADC SensVoltRaw /end OUT_MEASUREMENT /begin SUB_FUNCTION SensVolt_Override SensVolt_Config /end SUB_FUNCTION /end FUNCTION
/begin FUNCTION SensVolt_Override "" /begin DEF_CHARACTERISTIC SensVolt_new SensVolt_ovr /end DEF_CHARACTERISTIC /end FUNCTION
/begin FUNCTION SensVolt_Config ""
 /begin DEF_CHARACTERISTIC SensVoltDfltValue SensVoltFilterConst SensVoltGain SensVoltInputHiFltPos SensVoltInputLoFltPos SensVoltOfst /end DEF_CHARACTERISTIC
/end FUNCTION
/begin FUNCTION Cycle1CutPatter_2 ""
 /begin DEF_CHARACTERISTIC SoftCycle1Cyl1 SoftCycle1Cyl2 SoftCycle1Cyl3 SoftCycle1Cyl4 SoftCycle1Cyl5 SoftCycle1Cyl6 SoftCycle1Cyl7 SoftCycle1Cyl8 /end DEF_CHARACTERISTIC
/end FUNCTION
/begin FUNCTION Soft_Cycle_Cut_Pattern ""
 /begin SUB_FUNCTION Cycle1CutPatter_2 Cycle2CutPatter_2 Cycle3CutPatter_2 Cycle4CutPatter_2 /end SUB_FUNCTION
/end FUNCTION
/begin FUNCTION Cycle2CutPatter_2 ""
 /begin DEF_CHARACTERISTIC SoftCycle2Cyl1 SoftCycle2Cyl2 SoftCycle2Cyl3 SoftCycle2Cyl4 SoftCycle2Cyl5 SoftCycle2Cyl6 SoftCycle2Cyl7 SoftCycle2Cyl8 /end DEF_CHARACTERISTIC
/end FUNCTION
/begin FUNCTION Cycle3CutPatter_2 ""
 /begin DEF_CHARACTERISTIC SoftCycle3Cyl1 SoftCycle3Cyl2 SoftCycle3Cyl3 SoftCycle3Cyl4 SoftCycle3Cyl5 SoftCycle3Cyl6 SoftCycle3Cyl7 SoftCycle3Cyl8 /end DEF_CHARACTERISTIC
/end FUNCTION
/begin FUNCTION Cycle4CutPatter_2 ""
 /begin DEF_CHARACTERISTIC SoftCycle4Cyl1 SoftCycle4Cyl2 SoftCycle4Cyl3 SoftCycle4Cyl4 SoftCycle4Cyl5 SoftCycle4Cyl6 SoftCycle4Cyl7 SoftCycle4Cyl8 /end DEF_CHARACTERISTIC
/end FUNCTION
/begin FUNCTION SOI_Override "" /begin DEF_CHARACTERISTIC SOI_new SOI_ovr /end DEF_CHARACTERISTIC /end FUNCTION
/begin FUNCTION Spark_Advance_Rate_Limiter "" /begin DEF_CHARACTERISTIC SparkAdv_DeltaHi SparkAdv_DeltaLo /end DEF_CHARACTERISTIC /end FUNCTION
/begin FUNCTION SparkDwell_Override "" /begin DEF_CHARACTERISTIC SparkDwell_offset SparkDwell_ovr /end DEF_CHARACTERISTIC /end FUNCTION
/begin FUNCTION SparkStartAngle_Override "" /begin DEF_CHARACTERISTIC SparkStartAngle_offset SparkStartAngle_ovr /end DEF_CHARACTERISTIC /end FUNCTION
/begin FUNCTION SparkStopAngle_Override "" /begin DEF_CHARACTERISTIC SparkStopAngle_offset SparkStopAngle_ovr /end DEF_CHARACTERISTIC /end FUNCTION
/begin FUNCTION Speed_Voltage_Torque_CMD_Ovr_Override ""
 /begin DEF_CHARACTERISTIC Speed_Voltage_Torque_CMD_Ovr_new Speed_Voltage_Torque_CMD_Ovr_ovr /end DEF_CHARACTERISTIC
/end FUNCTION
/begin FUNCTION PID_Gain_Select ""
 /begin DEF_CHARACTERISTIC SpkMinGovDGain SpkMinGovDGainErrorMultTbl SpkMinGovPGain SpkMinGovPGainErrorMultTbl /end DEF_CHARACTERISTIC
 /begin OUT_MEASUREMENT SpkMinGovDGainErrorMult SpkMinGovPGainErrorMult /end OUT_MEASUREMENT
/end FUNCTION
/begin FUNCTION Universal_PD__Tunable___Scheduled_ ""
 /begin DEF_CHARACTERISTIC SpkMinGovErrorGain SpkMinGovPIDOutLowerLimit SpkMinGovPIDOutUpperLimit /end DEF_CHARACTERISTIC
 /begin OUT_MEASUREMENT SpkMinGovDTerm SpkMinGovError SpkMinGovPTerm SpkMinGovSpeedErrorIdx SpkMinGovSpeedErrorIn /end OUT_MEASUREMENT
 /begin SUB_FUNCTION PID_Gain_Select /end SUB_FUNCTION
/end FUNCTION
/begin FUNCTION Engine_Steady_State_Flag "" /begin DEF_CHARACTERISTIC SSLoadTol SSRPMTol /end DEF_CHARACTERISTIC /begin OUT_MEASUREMENT SSEngOpr /end OUT_MEASUREMENT /end FUNCTION
/begin FUNCTION LoadBasedCalcs_Config "" /begin DEF_CHARACTERISTIC SSLoadDecFiltC SSLoadIncFiltC SSRPMDecFiltC SSRPMIncFiltC /end DEF_CHARACTERISTIC /end FUNCTION
/begin FUNCTION StableEngine_Ovr_Override "" /begin DEF_CHARACTERISTIC StableEngine_Ovr_new StableEngine_Ovr_ovr /end DEF_CHARACTERISTIC /end FUNCTION
/begin FUNCTION Stable_Engine "" /begin DEF_CHARACTERISTIC StableLoad_ StableLoad_t StableRPM_ StableRPM_t /end DEF_CHARACTERISTIC
 /begin OUT_MEASUREMENT StableEngine_Prb StableLoad_Prb StableLoad_t_Prb StableRPM_Prb StableRPM_t_Prb /end OUT_MEASUREMENT
 /begin SUB_FUNCTION StableEngine_Ovr_Override /end SUB_FUNCTION
/end FUNCTION
/begin FUNCTION Status1_Age_Count_Ovr_Override "" /begin DEF_CHARACTERISTIC Status1_Age_Count_Ovr_new Status1_Age_Count_Ovr_ovr /end DEF_CHARACTERISTIC /end FUNCTION
/begin FUNCTION Status2_Age_Count_Ovr_Override "" /begin DEF_CHARACTERISTIC Status2_Age_Count_Ovr_new Status2_Age_Count_Ovr_ovr /end DEF_CHARACTERISTIC /end FUNCTION
/begin FUNCTION Status3_Age_Count_Ovr_Override "" /begin DEF_CHARACTERISTIC Status3_Age_Count_Ovr_new Status3_Age_Count_Ovr_ovr /end DEF_CHARACTERISTIC /end FUNCTION
/begin FUNCTION Status4_Age_Count_Ovr_Override "" /begin DEF_CHARACTERISTIC Status4_Age_Count_Ovr_new Status4_Age_Count_Ovr_ovr /end DEF_CHARACTERISTIC /end FUNCTION
/begin FUNCTION SysVolt "" /begin OUT_MEASUREMENT SysVolt SysVoltADC SysVoltRaw /end OUT_MEASUREMENT /begin SUB_FUNCTION SysVolt_Override SysVolt_Config /end SUB_FUNCTION /end FUNCTION
/begin FUNCTION SysVolt_Override "" /begin DEF_CHARACTERISTIC SysVolt_new SysVolt_ovr /end DEF_CHARACTERISTIC /end FUNCTION
/begin FUNCTION SysVolt_Index "" /begin OUT_MEASUREMENT SysVolt09Idx SysVolt09In /end OUT_MEASUREMENT /end FUNCTION
/begin FUNCTION SysVolt_Config ""
 /begin DEF_CHARACTERISTIC SysVoltDfltValue SysVoltFilterConst SysVoltGain SysVoltInputHiFltPos SysVoltInputLoFltPos SysVoltOfst /end DEF_CHARACTERISTIC
/end FUNCTION
/begin FUNCTION Temp_Guage_Ovr_Override "" /begin DEF_CHARACTERISTIC Temp_Guage_Ovr_new Temp_Guage_Ovr_ovr /end DEF_CHARACTERISTIC /end FUNCTION
/begin FUNCTION Engine_Overheat_Fault_Logic ""
 /begin DEF_CHARACTERISTIC TempOverheat_Fault TempOverheat_Warn TempOverheatSevere_Fault /end DEF_CHARACTERISTIC
/end FUNCTION
/begin FUNCTION ThreePhase_HVIL_Status_Ovr_Override ""
 /begin DEF_CHARACTERISTIC ThreePhase_HVIL_Status_Ovr_new ThreePhase_HVIL_Status_Ovr_ovr /end DEF_CHARACTERISTIC
/end FUNCTION
/begin FUNCTION Time_Since_Key_On "" /begin OUT_MEASUREMENT TimeSinceKeyOn /end OUT_MEASUREMENT /end FUNCTION
/begin FUNCTION Time_Since_Run "" /begin OUT_MEASUREMENT TimeSinceRun /end OUT_MEASUREMENT /end FUNCTION
/begin FUNCTION Time_Since_Stall "" /begin OUT_MEASUREMENT TimeSinceStall /end OUT_MEASUREMENT /end FUNCTION
/begin FUNCTION TPS_Indexes "" /begin OUT_MEASUREMENT TPS09Idx TPS09In /end OUT_MEASUREMENT /end FUNCTION
/begin FUNCTION TPS1_Override "" /begin DEF_CHARACTERISTIC TPS1_new TPS1_ovr /end DEF_CHARACTERISTIC /end FUNCTION
/begin FUNCTION TPS1 ""
 /begin OUT_MEASUREMENT TPS1Adapt_Hi TPS1Adapt_Low TPS1ADC TPS1Percent TPS1PercentRaw /end OUT_MEASUREMENT
 /begin SUB_FUNCTION TPS1_Override TPS1_Config /end SUB_FUNCTION
/end FUNCTION
/begin FUNCTION TPS__Sensor_Arbitration "" /begin DEF_CHARACTERISTIC TPS1_TPS2_Max_Deviation /end DEF_CHARACTERISTIC /end FUNCTION
/begin FUNCTION TPS1_Config ""
 /begin DEF_CHARACTERISTIC TPS1Adapt_Delta TPS1Adapt_Hi_Max TPS1Adapt_Hi_Min TPS1Adapt_Low_Max TPS1Adapt_Low_Min TPS1AdaptHiEnable TPS1AdaptLoEnable TPS1DfltValue TPS1FilterConst TPS1InputHiFltPos TPS1InputLoFltPos TPS1MaxLimit TPS1Rev_Polarity /end DEF_CHARACTERISTIC
/end FUNCTION
/begin FUNCTION TPS2_Override "" /begin DEF_CHARACTERISTIC TPS2_new TPS2_ovr /end DEF_CHARACTERISTIC /end FUNCTION
/begin FUNCTION TPS2 ""
 /begin OUT_MEASUREMENT TPS2Adapt_Hi TPS2Adapt_Low TPS2ADC TPS2Percent TPS2PercentRaw /end OUT_MEASUREMENT
 /begin SUB_FUNCTION TPS2_Override TPS2_Config /end SUB_FUNCTION
/end FUNCTION
/begin FUNCTION TPS2_Config ""
 /begin DEF_CHARACTERISTIC TPS2Adapt_Delta TPS2Adapt_Hi_Max TPS2Adapt_Hi_Min TPS2Adapt_Low_Max TPS2Adapt_Low_Min TPS2AdaptHiEnable TPS2AdaptLoEnable TPS2DfltValue TPS2FilterConst TPS2InputHiFltPos TPS2InputLoFltPos TPS2MaxLimit TPS2Rev_Polarity /end DEF_CHARACTERISTIC
/end FUNCTION
/begin FUNCTION TqLimiting_Reason_Ovr_Override "" /begin DEF_CHARACTERISTIC TqLimiting_Reason_Ovr_new TqLimiting_Reason_Ovr_ovr /end DEF_CHARACTERISTIC /end FUNCTION
/begin FUNCTION Trigger_Ovr_Override "" /begin DEF_CHARACTERISTIC Trigger_Ovr_new Trigger_Ovr_ovr /end DEF_CHARACTERISTIC /end FUNCTION
/begin FUNCTION Adapt_Table "" /begin DEF_CHARACTERISTIC VE_Adapt_Max VE_Adapt_Min /end DEF_CHARACTERISTIC /end FUNCTION
/begin FUNCTION Vehicle_Speed_Ovr_Override "" /begin DEF_CHARACTERISTIC Vehicle_Speed_Ovr_new Vehicle_Speed_Ovr_ovr /end DEF_CHARACTERISTIC /end FUNCTION
/begin FUNCTION VETable_Ovr_Override "" /begin DEF_CHARACTERISTIC VETable_Ovr_new VETable_Ovr_ovr /end DEF_CHARACTERISTIC /end FUNCTION
/begin FUNCTION WarmUp_Disable "" /begin OUT_MEASUREMENT WarmUpO2AdaptEnabled /end OUT_MEASUREMENT /end FUNCTION
/begin FUNCTION Wrench_Status_Ovr_Override "" /begin DEF_CHARACTERISTIC Wrench_Status_Ovr_new Wrench_Status_Ovr_ovr /end DEF_CHARACTERISTIC /end FUNCTION
/begin FUNCTION XDRP_Internal_Meas_Ovr_Override "" /begin DEF_CHARACTERISTIC XDRP_Internal_Meas_Ovr_new XDRP_Internal_Meas_Ovr_ovr /end DEF_CHARACTERISTIC /end FUNCTION
/begin FUNCTION XDRP_State_Ovr_Override "" /begin DEF_CHARACTERISTIC XDRP_State_Ovr_new XDRP_State_Ovr_ovr /end DEF_CHARACTERISTIC /end FUNCTION
/begin FUNCTION XDRP_Supply_State_Ovr_Override "" /begin DEF_CHARACTERISTIC XDRP_Supply_State_Ovr_new XDRP_Supply_State_Ovr_ovr /end DEF_CHARACTERISTIC /end FUNCTION
/end MODULE
/end PROJECT
