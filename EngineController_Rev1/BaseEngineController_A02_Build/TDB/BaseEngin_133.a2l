ASAP2_VERSION 1 51
/begin PROJECT Project ""
/begin MODULE BaseEngin_133 ""
/begin MOD_COMMON /* MOD_COMMON Comment */ "" BYTE_ORDER MSB_FIRST ALIGNMENT_BYTE 1 ALIGNMENT_FLOAT32_IEEE 1 ALIGNMENT_FLOAT64_IEEE 1 ALIGNMENT_LONG 1 ALIGNMENT_WORD 1 /end MOD_COMMON
/begin MEASUREMENT Aux_PWM_DutyCycle_Prb "" FLOAT32_IEEE CompuMethod_2 1 0 -1E+17 1E+17 ECU_ADDRESS 0x4000019B /end MEASUREMENT
/begin MEASUREMENT Aux_PWM_Freq_Prb "" FLOAT32_IEEE CompuMethod_2 1 0 -1E+17 1E+17 ECU_ADDRESS 0x4000019F /end MEASUREMENT
/begin MEASUREMENT Aux_PWM_State_Prb "" FLOAT32_IEEE CompuMethod_2 1 0 -1E+17 1E+17 ECU_ADDRESS 0x400001A3 /end MEASUREMENT
/begin MEASUREMENT BARO "" FLOAT32_IEEE CompuMethod_19 1 0 -1E+17 1E+17 ECU_ADDRESS 0x400001A7 /end MEASUREMENT
/begin MEASUREMENT BARO09Idx "" UWORD CompuMethod_11 1 0 0 127.998 ECU_ADDRESS 0x400001AB /end MEASUREMENT
/begin MEASUREMENT BaroDelayTime "" FLOAT32_IEEE CompuMethod_21 1 0 -1E+17 1E+17 ECU_ADDRESS 0x400001AD /end MEASUREMENT
/begin MEASUREMENT BaseAirflowAdaptEnabled "" UBYTE CompuMethod_22 1 0 0 1 ECU_ADDRESS 0x400001B1 /end MEASUREMENT
/begin MEASUREMENT BaseAirflowOfst "Base air position in based on ECT." FLOAT32_IEEE CompuMethod_5 1 0 -1E+17 1E+17 ECU_ADDRESS 0x400001B2 /end MEASUREMENT
/begin MEASUREMENT BaseAirOffset "Base air request position, includes ramp into idle manager." FLOAT32_IEEE CompuMethod_25 1 0 -1E+17 1E+17 ECU_ADDRESS 0x400001B6 /end MEASUREMENT
/begin MEASUREMENT BaseEquivRatio "Base equivalence ratio for selected fuel system." FLOAT32_IEEE CompuMethod_2 1 0 -1E+17 1E+17 ECU_ADDRESS 0x400001BA /end MEASUREMENT
/begin MEASUREMENT BaseSparkEnergy "Spark energy - Run state" FLOAT32_IEEE CompuMethod_27 1 0 -1E+17 1E+17 ECU_ADDRESS 0x400001BE /end MEASUREMENT
/begin MEASUREMENT BgndAngTaskStatus "Background Time Scheduler Status" UBYTE CompuMethod_29 1 0 0 0 ECU_ADDRESS 0x400001C2 /end MEASUREMENT
/begin MEASUREMENT BgndStackMinBytesFree "Min bytes observed on the Background Stack" ULONG CompuMethod_30 1 0 0 0 ECU_ADDRESS 0x400001C3 /end MEASUREMENT
/begin MEASUREMENT BgndTimeTaskStatus "Background Time Scheduler Status" UBYTE CompuMethod_31 1 0 0 0 ECU_ADDRESS 0x400001C7 /end MEASUREMENT
/begin MEASUREMENT CAN_1_ext_handled_count "Total number of handled ext CAN messages on bus CAN_1" ULONG CompuMethod_33 1 0 0 4294970000 ECU_ADDRESS 0x400001CC /end MEASUREMENT
/begin MEASUREMENT CAN_1_ext_last_unhandled_id "Last received ext CAN message on bus CAN_1, which was unhandled" ULONG CompuMethod_33 1 0 0 4294970000 ECU_ADDRESS 0x400001D0 /end MEASUREMENT
/begin MEASUREMENT CAN_1_ext_receive_count "Total number of received ext CAN messages on bus CAN_1" ULONG CompuMethod_33 1 0 0 4294970000 ECU_ADDRESS 0x400001D4 /end MEASUREMENT
/begin MEASUREMENT CAN_1_std_handled_count "Total number of handled std CAN messages on bus CAN_1" ULONG CompuMethod_33 1 0 0 4294970000 ECU_ADDRESS 0x400001D8 /end MEASUREMENT
/begin MEASUREMENT CAN_1_std_last_unhandled_id "Last received std CAN message on bus CAN_1, which was unhandled" ULONG CompuMethod_33 1 0 0 4294970000 ECU_ADDRESS 0x400001DC /end MEASUREMENT
/begin MEASUREMENT CAN_1_std_receive_count "Total number of received std CAN messages on bus CAN_1" ULONG CompuMethod_33 1 0 0 4294970000 ECU_ADDRESS 0x400001E0 /end MEASUREMENT
/begin MEASUREMENT CAN_2_ext_handled_count "Total number of handled ext CAN messages on bus CAN_2" ULONG CompuMethod_33 1 0 0 4294970000 ECU_ADDRESS 0x400001E4 /end MEASUREMENT
/begin MEASUREMENT CAN_2_ext_last_unhandled_id "Last received ext CAN message on bus CAN_2, which was unhandled" ULONG CompuMethod_33 1 0 0 4294970000 ECU_ADDRESS 0x400001E8 /end MEASUREMENT
/begin MEASUREMENT CAN_2_ext_receive_count "Total number of received ext CAN messages on bus CAN_2" ULONG CompuMethod_33 1 0 0 4294970000 ECU_ADDRESS 0x400001EC /end MEASUREMENT
/begin MEASUREMENT can_create_CAN_1 "Debug Variable" UBYTE CompuMethod_9 1 0 0 0 ECU_ADDRESS 0x400001F0 /end MEASUREMENT
/begin MEASUREMENT can_create_CAN_2 "Debug Variable" UBYTE CompuMethod_9 1 0 0 0 ECU_ADDRESS 0x400001F1 /end MEASUREMENT
/begin MEASUREMENT CAN_Timeout_112_Prb "" ULONG CompuMethod_33 1 0 0 4294970000 ECU_ADDRESS 0x400001F2 /end MEASUREMENT
/begin MEASUREMENT CAN_Timeout_Phoenix_1_Prb "" ULONG CompuMethod_33 1 0 0 4294970000 ECU_ADDRESS 0x400001F6 /end MEASUREMENT
/begin MEASUREMENT CAN_Timeout_Phoenix_2_Prb "" ULONG CompuMethod_33 1 0 0 4294970000 ECU_ADDRESS 0x400001FA /end MEASUREMENT
/begin MEASUREMENT CAN_Timeout_Phoenix_3_Prb "" ULONG CompuMethod_33 1 0 0 4294970000 ECU_ADDRESS 0x400001FE /end MEASUREMENT
/begin MEASUREMENT CAN_Timeout_Phoenix_4_Prb "" ULONG CompuMethod_33 1 0 0 4294970000 ECU_ADDRESS 0x40000202 /end MEASUREMENT
/begin MEASUREMENT can_tx_err_CAN_1_0 "Debug Variable" UBYTE CompuMethod_9 1 0 0 0 ECU_ADDRESS 0x40000206 /end MEASUREMENT
/begin MEASUREMENT can_tx_err_CAN_1_0_50 "Debug Variable" UBYTE CompuMethod_9 1 0 0 0 ECU_ADDRESS 0x40000207 /end MEASUREMENT
/begin MEASUREMENT can_tx_err_CAN_2_0 "Debug Variable" UBYTE CompuMethod_9 1 0 0 0 ECU_ADDRESS 0x40000208 /end MEASUREMENT
/begin MEASUREMENT can_tx_err_CAN_2_0_51 "Debug Variable" UBYTE CompuMethod_9 1 0 0 0 ECU_ADDRESS 0x40000209 /end MEASUREMENT
/begin MEASUREMENT CCP_CCP1_Access.CCP_CCP1_CAL "Calibration Authentication Status for CCP Handler CCP1" UBYTE CompuMethod_34 1 0 0 1 ECU_ADDRESS 0x4000020A BIT_MASK 0x00000001 /end MEASUREMENT
/begin MEASUREMENT CCP_CCP1_Access.CCP_CCP1_DAQ "Data Acquisition Authentication Status for CCP Handler CCP1" UBYTE CompuMethod_35 1 0 0 1 ECU_ADDRESS 0x4000020A BIT_MASK 0x00000002 /end MEASUREMENT
/begin MEASUREMENT CCP_CCP1_Access.CCP_CCP1_PGM "Programming Authentication Status for CCP Handler CCP1" UBYTE CompuMethod_36 1 0 0 1 ECU_ADDRESS 0x4000020A BIT_MASK 0x00000040 /end MEASUREMENT
/begin MEASUREMENT CCP_CCP1_Access "Current Access Code for CCP Handler CCP1" UBYTE CompuMethod_2 1 0 0 255 ECU_ADDRESS 0x4000020A /end MEASUREMENT
/begin MEASUREMENT CCP_CCP1_ConnectionStatus "CCP Handler CCP1 connection status" UBYTE CompuMethod_37 1 0 0 255 ECU_ADDRESS 0x4000020B /end MEASUREMENT
/begin MEASUREMENT CEL_Status_Prb "" UBYTE CompuMethod_38 1 0 0 1 ECU_ADDRESS 0x4000020C /end MEASUREMENT
/begin MEASUREMENT CoilDwell "Required spark dwell to give the desired spark energy." FLOAT32_IEEE CompuMethod_41 1 0 -1E+17 1E+17 ECU_ADDRESS 0x4000020D /end MEASUREMENT
/begin MEASUREMENT CoilEnabled "Enable sate for coils." UBYTE CompuMethod_42 1 0 0 1 ECU_ADDRESS 0x40000211 MATRIX_DIM 8 1 1 /end MEASUREMENT
/begin MEASUREMENT CoilStartAngle "StartAngle for coils to establish dwell." FLOAT32_IEEE CompuMethod_43 1 0 -1E+17 1E+17 ECU_ADDRESS 0x40000219 /end MEASUREMENT
/begin MEASUREMENT CoilStopAngle "Stop angle for coils to establish dwell." FLOAT32_IEEE CompuMethod_43 1 0 -1E+17 1E+17 ECU_ADDRESS 0x4000021D /end MEASUREMENT
/begin MEASUREMENT Control_Mode_Cmd_Prb "" FLOAT32_IEEE CompuMethod_2 1 0 -1E+17 1E+17 ECU_ADDRESS 0x40000273 /end MEASUREMENT
/begin MEASUREMENT CoolantTempEnrichment "Multiplier on base eq. ratio as a function of Load and ECT" FLOAT32_IEEE CompuMethod_8 1 0 -1E+17 1E+17 ECU_ADDRESS 0x400002AD /end MEASUREMENT
/begin MEASUREMENT CPUIdlePcent "Percentage of the CPU time spent servicing idle priority work." UWORD CompuMethod_44 1 0 0 99.9999 ECU_ADDRESS 0x400002B1 /end MEASUREMENT
/begin MEASUREMENT CPUTime_AppISR "Percentage of the CPU time spent executing the periodic timer interrupt" UWORD CompuMethod_44 1 0 0 99.9999 ECU_ADDRESS 0x400002B3 /end MEASUREMENT
/begin MEASUREMENT CPUTime_Bgnd "Percentage of the CPU time spent servicing background priority tasks" UWORD CompuMethod_44 1 0 0 99.9999 ECU_ADDRESS 0x400002B5 /end MEASUREMENT
/begin MEASUREMENT CPUTime_CAN "Percentage of the CPU time spent executing CAN interrupts" UWORD CompuMethod_44 1 0 0 99.9999 ECU_ADDRESS 0x400002B7 /end MEASUREMENT
/begin MEASUREMENT CPUTime_FgndAngle "Percentage of the CPU time spent executing application callbacks due to framework events" UWORD CompuMethod_44 1 0 0 99.9999 ECU_ADDRESS 0x400002B9 /end MEASUREMENT
/begin MEASUREMENT CPUTime_FgndTime "Percentage of the CPU time spent servicing background priority tasks" UWORD CompuMethod_44 1 0 0 99.9999 ECU_ADDRESS 0x400002BB /end MEASUREMENT
/begin MEASUREMENT CPUTime_MIOS "Percentage of the CPU time spent executing MIOS interrupts" UWORD CompuMethod_44 1 0 0 99.9999 ECU_ADDRESS 0x400002BD /end MEASUREMENT
/begin MEASUREMENT CPUTime_Serial "Percentage of the CPU time spent executing serial interrupts" UWORD CompuMethod_44 1 0 0 99.9999 ECU_ADDRESS 0x400002BF /end MEASUREMENT
/begin MEASUREMENT CPUTime_TimerISR "Percentage of the CPU time spent executing the periodic timer interrupt" UWORD CompuMethod_44 1 0 0 99.9999 ECU_ADDRESS 0x400002C1 /end MEASUREMENT
/begin MEASUREMENT CPUTime_TPU "Percentage of the CPU time spent executing TPU interrupts" UWORD CompuMethod_44 1 0 0 99.9999 ECU_ADDRESS 0x400002C3 /end MEASUREMENT
/begin MEASUREMENT CrankAirflowSetPt "ETC setpoint during cranking." FLOAT32_IEEE CompuMethod_5 1 0 -1E+17 1E+17 ECU_ADDRESS 0x400002C5 /end MEASUREMENT
/begin MEASUREMENT CrankECT05Idx "ECT pre-lookup for crank maps." UWORD CompuMethod_11 1 0 0 127.998 ECU_ADDRESS 0x400002C9 /end MEASUREMENT
/begin MEASUREMENT CrankFPC "Liquid fuel supplied during crank." FLOAT32_IEEE CompuMethod_48 1 0 -1E+17 1E+17 ECU_ADDRESS 0x400002CB /end MEASUREMENT
/begin MEASUREMENT CrankMakeUpEOI "Start of injection during cranking." FLOAT32_IEEE CompuMethod_43 1 0 -1E+17 1E+17 ECU_ADDRESS 0x400002CF /end MEASUREMENT
/begin MEASUREMENT CrankRPM05Idx "RPM pre-lookup for crank maps" UWORD CompuMethod_11 1 0 0 127.998 ECU_ADDRESS 0x400002D3 /end MEASUREMENT
/begin MEASUREMENT CrankRPM05In "RPM pre-lookup for crank maps" FLOAT32_IEEE CompuMethod_26 1 0 -1E+17 1E+17 ECU_ADDRESS 0x400002D5 /end MEASUREMENT
/begin MEASUREMENT CrankSOI "Start of injection during cranking." FLOAT32_IEEE CompuMethod_43 1 0 -1E+17 1E+17 ECU_ADDRESS 0x400002D9 /end MEASUREMENT
/begin MEASUREMENT CrankSpark "Spark adv during cranking." FLOAT32_IEEE CompuMethod_43 1 0 -1E+17 1E+17 ECU_ADDRESS 0x400002DD /end MEASUREMENT
/begin MEASUREMENT CrankSpkEnergy "Spark energy during cranking." FLOAT32_IEEE CompuMethod_50 1 0 -1E+17 1E+17 ECU_ADDRESS 0x400002E1 /end MEASUREMENT
/begin MEASUREMENT CrankTDCs "" UBYTE CompuMethod_1 1 0 0 255 ECU_ADDRESS 0x400002E5 /end MEASUREMENT
/begin MEASUREMENT CrankTrans "" UBYTE CompuMethod_38 1 0 0 1 ECU_ADDRESS 0x400002E6 /end MEASUREMENT
/begin MEASUREMENT DeltaTPS "" FLOAT32_IEEE CompuMethod_2 1 0 -1E+17 1E+17 ECU_ADDRESS 0x400002EB /end MEASUREMENT
/begin MEASUREMENT DeltaTPS_Mult "Transient Fueling Multiplier for adjustment based on delta TPS" FLOAT32_IEEE CompuMethod_8 1 0 -1E+17 1E+17 ECU_ADDRESS 0x400002EF /end MEASUREMENT
/begin MEASUREMENT DeltaTPS17Idx "" UWORD CompuMethod_11 1 0 0 127.998 ECU_ADDRESS 0x400002F3 /end MEASUREMENT
/begin MEASUREMENT DeltaTPS17In "" FLOAT32_IEEE CompuMethod_2 1 0 -1E+17 1E+17 ECU_ADDRESS 0x400002F5 /end MEASUREMENT
/begin MEASUREMENT DesEquivInRange "" UBYTE CompuMethod_55 1 0 0 1 ECU_ADDRESS 0x400002F9 /end MEASUREMENT
/begin MEASUREMENT DesEquivRatio "Desired liquid equivalence ratio." FLOAT32_IEEE CompuMethod_2 1 0 -1E+17 1E+17 ECU_ADDRESS 0x400002FA /end MEASUREMENT
/begin MEASUREMENT dout_create_DOut7679p0004 "Debug Variable" UBYTE CompuMethod_9 1 0 0 0 ECU_ADDRESS 0x40000312 /end MEASUREMENT
/begin MEASUREMENT dout_create_DOut7963p0001 "Debug Variable" UBYTE CompuMethod_9 1 0 0 0 ECU_ADDRESS 0x40000313 /end MEASUREMENT
/begin MEASUREMENT dout_create_DOut7973p0001 "Debug Variable" UBYTE CompuMethod_9 1 0 0 0 ECU_ADDRESS 0x40000314 /end MEASUREMENT
/begin MEASUREMENT dout_create_DOut8218p0001 "Debug Variable" UBYTE CompuMethod_9 1 0 0 0 ECU_ADDRESS 0x40000315 /end MEASUREMENT
/begin MEASUREMENT Duration_Prb "" SLONG CompuMethod_33 1 0 -2147480000 2147480000 ECU_ADDRESS 0x4000031E /end MEASUREMENT
/begin MEASUREMENT ECT "Final value after Linear Sensor Characterization" FLOAT32_IEEE CompuMethod_57 1 0 -1E+17 1E+17 ECU_ADDRESS 0x40000322 /end MEASUREMENT
/begin MEASUREMENT ECT_KeyUp09Idx "Index of ECT captured at key-up." UWORD CompuMethod_11 1 0 0 127.998 ECU_ADDRESS 0x4000032A /end MEASUREMENT
/begin MEASUREMENT ECT_KeyUp09In "Index of ECT captured at key-up." FLOAT32_IEEE CompuMethod_57 1 0 -1E+17 1E+17 ECU_ADDRESS 0x4000032C /end MEASUREMENT
/begin MEASUREMENT ECT_SpkOfst "" FLOAT32_IEEE CompuMethod_2 1 0 -1E+17 1E+17 ECU_ADDRESS 0x40000330 /end MEASUREMENT
/begin MEASUREMENT ECT_SpkOfstMult "Multiplier on ECT spark offset table." FLOAT32_IEEE CompuMethod_8 1 0 -1E+17 1E+17 ECU_ADDRESS 0x40000334 /end MEASUREMENT
/begin MEASUREMENT ECT05Idx "" UWORD CompuMethod_11 1 0 0 127.998 ECU_ADDRESS 0x40000338 /end MEASUREMENT
/begin MEASUREMENT ECT05In "" FLOAT32_IEEE CompuMethod_2 1 0 -1E+17 1E+17 ECU_ADDRESS 0x4000033A /end MEASUREMENT
/begin MEASUREMENT ECTADC "Signal measured directly from sensor" UWORD CompuMethod_58 1 0 0 65535 ECU_ADDRESS 0x4000033E /end MEASUREMENT
/begin MEASUREMENT ECTEGRInterpolation "" FLOAT32_IEEE CompuMethod_2 1 0 -1E+17 1E+17 ECU_ADDRESS 0x40000340 /end MEASUREMENT
/begin MEASUREMENT ECTIdx "Look up table to allownon-linear characterization of sensors" UWORD CompuMethod_11 1 0 0 127.998 ECU_ADDRESS 0x40000344 /end MEASUREMENT
/begin MEASUREMENT ECTRaw "After conversion to engineering units, before range checking" FLOAT32_IEEE CompuMethod_57 1 0 -1E+17 1E+17 ECU_ADDRESS 0x40000346 /end MEASUREMENT
/begin MEASUREMENT ECTTransFuelMult "Transient fuel multiplier based on ECT.  Only engaged during transient fueling" FLOAT32_IEEE CompuMethod_2 1 0 -1E+17 1E+17 ECU_ADDRESS 0x4000034A /end MEASUREMENT
/begin MEASUREMENT ECUP_Enabled "" UBYTE CompuMethod_55 1 0 0 1 ECU_ADDRESS 0x4000034E /end MEASUREMENT
/begin MEASUREMENT EGR_Interpolation_DC "" FLOAT32_IEEE CompuMethod_5 1 0 -1E+17 1E+17 ECU_ADDRESS 0x4000034F /end MEASUREMENT
/begin MEASUREMENT EGR_Interpolation_PW "" FLOAT32_IEEE CompuMethod_53 1 0 -1E+17 1E+17 ECU_ADDRESS 0x40000353 /end MEASUREMENT
/begin MEASUREMENT EGR_Mult "Multiplier on ECT EGR table." FLOAT32_IEEE CompuMethod_8 1 0 -1E+17 1E+17 ECU_ADDRESS 0x40000357 /end MEASUREMENT
/begin MEASUREMENT EGR_Percentage "Total Spark Offset based on ECT, IAT2, engine speed and load" FLOAT32_IEEE CompuMethod_63 1 0 -1E+17 1E+17 ECU_ADDRESS 0x4000035B /end MEASUREMENT
/begin MEASUREMENT EGR_Prelookup_DCIdx "" UWORD CompuMethod_11 1 0 0 127.998 ECU_ADDRESS 0x4000035F /end MEASUREMENT
/begin MEASUREMENT EGR_Prelookup_DCIn "" FLOAT32_IEEE CompuMethod_2 1 0 -1E+17 1E+17 ECU_ADDRESS 0x40000361 /end MEASUREMENT
/begin MEASUREMENT EGR_Prelookup_PWIdx "" UWORD CompuMethod_11 1 0 0 127.998 ECU_ADDRESS 0x40000365 /end MEASUREMENT
/begin MEASUREMENT EGR_Prelookup_PWIn "" FLOAT32_IEEE CompuMethod_2 1 0 -1E+17 1E+17 ECU_ADDRESS 0x40000367 /end MEASUREMENT
/begin MEASUREMENT EGRSense "Final value after Linear Sensor Characterization" FLOAT32_IEEE CompuMethod_5 1 0 -1E+17 1E+17 ECU_ADDRESS 0x4000036B /end MEASUREMENT
/begin MEASUREMENT EGRSenseADC "Singal measured directly from sensor" UWORD CompuMethod_64 1 0 0 65535 ECU_ADDRESS 0x4000036F /end MEASUREMENT
/begin MEASUREMENT EGRSenseRaw "After conversion to engineering units, before range checking" FLOAT32_IEEE CompuMethod_5 1 0 -1E+17 1E+17 ECU_ADDRESS 0x40000371 /end MEASUREMENT
/begin MEASUREMENT encoder_create "Debug Variable" UBYTE CompuMethod_9 1 0 0 0 ECU_ADDRESS 0x40000375 /end MEASUREMENT
/begin MEASUREMENT EncoderFault "" UBYTE CompuMethod_69 1 0 0 255 ECU_ADDRESS 0x40000376 /end MEASUREMENT
/begin MEASUREMENT EncoderFaultCount "" ULONG CompuMethod_33 1 0 0 4294970000 ECU_ADDRESS 0x40000377 /end MEASUREMENT
/begin MEASUREMENT EncoderState "" UBYTE CompuMethod_70 1 0 0 255 ECU_ADDRESS 0x4000037B /end MEASUREMENT
/begin MEASUREMENT EncoderTDCOrder "Order of TDC angles (0 means unused)" SBYTE CompuMethod_71 1 0 -1 127 ECU_ADDRESS 0x4000037C MATRIX_DIM 8 1 1 /end MEASUREMENT
/begin MEASUREMENT Engine_Crank_Prb "" UBYTE CompuMethod_38 1 0 0 1 ECU_ADDRESS 0x40000384 /end MEASUREMENT
/begin MEASUREMENT Engine_On_Prb "" UBYTE CompuMethod_38 1 0 0 1 ECU_ADDRESS 0x40000385 /end MEASUREMENT
/begin MEASUREMENT EngineAccel "Acceleration rate of engine" FLOAT32_IEEE CompuMethod_72 1 0 -1E+17 1E+17 ECU_ADDRESS 0x40000386 /end MEASUREMENT
/begin MEASUREMENT EngineStateRaw "" UBYTE CompuMethod_1 1 0 0 255 ECU_ADDRESS 0x4000038A /end MEASUREMENT
/begin MEASUREMENT EnginSteadyState "" UBYTE CompuMethod_55 1 0 0 1 ECU_ADDRESS 0x4000038B /end MEASUREMENT
/begin MEASUREMENT EST_DiagDwell "Dwell time used to diagnose ESTs during run-state." UWORD CompuMethod_75 1 0 0 65535 ECU_ADDRESS 0x40000390 MATRIX_DIM 8 1 1 /end MEASUREMENT
/begin MEASUREMENT EST_Spark "Debug Variable" UBYTE CompuMethod_9 1 0 0 0 ECU_ADDRESS 0x400003A4 /end MEASUREMENT
/begin MEASUREMENT EST_SparkCreate "Debug Variable" UBYTE CompuMethod_9 1 0 0 0 ECU_ADDRESS 0x400003A5 /end MEASUREMENT
/begin MEASUREMENT EST_TDCEnabled "" SBYTE CompuMethod_14 1 0 -128 127 ECU_ADDRESS 0x400003A6 /end MEASUREMENT
/begin MEASUREMENT ESTOP_Prb "" UBYTE CompuMethod_38 1 0 0 1 ECU_ADDRESS 0x400003AB /end MEASUREMENT
/begin MEASUREMENT ESTOpenADC "ADC counts of measured voltage feedback for diagnosing the ESTs during stall state." UWORD CompuMethod_28 1 0 0 65535 ECU_ADDRESS 0x400003AC MATRIX_DIM 8 1 1 /end MEASUREMENT
/begin MEASUREMENT ETC_Current "Current output of ETC duty cycle." SWORD CompuMethod_78 1 0 -32768 32767 ECU_ADDRESS 0x400003BC /end MEASUREMENT
/begin MEASUREMENT ETC_DutyCycle "Actual duty cycle of actuator" FLOAT32_IEEE CompuMethod_5 1 0 -1E+17 1E+17 ECU_ADDRESS 0x400003BE /end MEASUREMENT
/begin MEASUREMENT ETC_ECUPState "" UBYTE CompuMethod_38 1 0 0 1 ECU_ADDRESS 0x400003C2 /end MEASUREMENT
/begin MEASUREMENT ETC_ErrorIdx "" UWORD CompuMethod_11 1 0 0 127.998 ECU_ADDRESS 0x400003C3 /end MEASUREMENT
/begin MEASUREMENT ETC_ErrorIn "" FLOAT32_IEEE CompuMethod_2 1 0 -1E+17 1E+17 ECU_ADDRESS 0x400003C5 /end MEASUREMENT
/begin MEASUREMENT ETC_IGainMult "Multiplier on the ETC I gain based on ETC error." FLOAT32_IEEE CompuMethod_2 1 0 -1E+17 1E+17 ECU_ADDRESS 0x400003C9 /end MEASUREMENT
/begin MEASUREMENT ETC_PGainMult "Multiplier on the ETC P gain based on ETC error." FLOAT32_IEEE CompuMethod_2 1 0 -1E+17 1E+17 ECU_ADDRESS 0x400003CD /end MEASUREMENT
/begin MEASUREMENT ETC_Setpoint "Commanded electronic throttle position" FLOAT32_IEEE CompuMethod_5 1 0 -1E+17 1E+17 ECU_ADDRESS 0x400003D1 /end MEASUREMENT
/begin MEASUREMENT ETC_SetpointIdx "" UWORD CompuMethod_11 1 0 0 127.998 ECU_ADDRESS 0x400003D5 /end MEASUREMENT
/begin MEASUREMENT ETC_SetpointIn "" FLOAT32_IEEE CompuMethod_2 1 0 -1E+17 1E+17 ECU_ADDRESS 0x400003D7 /end MEASUREMENT
/begin MEASUREMENT ETC_ShutdownSetpointMode "Shutdown mode for ETC setpoint. 0=Passthrough, 1=LoAdapt, 2=SpringTest." SBYTE CompuMethod_1 1 0 -128 127 ECU_ADDRESS 0x400003DB /end MEASUREMENT
/begin MEASUREMENT ETC_ShutDownTimer "" FLOAT32_IEEE CompuMethod_2 1 0 -1E+17 1E+17 ECU_ADDRESS 0x400003DC /end MEASUREMENT
/begin MEASUREMENT ETC_VoltageComp "Gain on ETC duty cycle based on DRVP" FLOAT32_IEEE CompuMethod_2 1 0 -1E+17 1E+17 ECU_ADDRESS 0x400003E0 /end MEASUREMENT
/begin MEASUREMENT ETCDamperSwtichState "" UBYTE CompuMethod_38 1 0 0 1 ECU_ADDRESS 0x400003E4 /end MEASUREMENT
/begin MEASUREMENT ETCDamperTPS "" FLOAT32_IEEE CompuMethod_2 1 0 -1E+17 1E+17 ECU_ADDRESS 0x400003E5 /end MEASUREMENT
/begin MEASUREMENT ETCDamperTPSThresh "" FLOAT32_IEEE CompuMethod_2 1 0 -1E+17 1E+17 ECU_ADDRESS 0x400003E9 /end MEASUREMENT
/begin MEASUREMENT ETCDampTerm "PID Damper Term" FLOAT32_IEEE CompuMethod_5 1 0 -1E+17 1E+17 ECU_ADDRESS 0x400003ED /end MEASUREMENT
/begin MEASUREMENT ETCDCOffset "Duty cycle offset based on desired ETC position." FLOAT32_IEEE CompuMethod_5 1 0 -1E+17 1E+17 ECU_ADDRESS 0x400003F1 /end MEASUREMENT
/begin MEASUREMENT ETCDTerm "PID Derivative Term" FLOAT32_IEEE CompuMethod_5 1 0 -1E+17 1E+17 ECU_ADDRESS 0x400003F5 /end MEASUREMENT
/begin MEASUREMENT ETCError "PID Error Term" FLOAT32_IEEE CompuMethod_5 1 0 -1E+17 1E+17 ECU_ADDRESS 0x400003F9 /end MEASUREMENT
/begin MEASUREMENT ETCITerm "PID Integrator Term" FLOAT32_IEEE CompuMethod_5 1 0 -1E+17 1E+17 ECU_ADDRESS 0x400003FD /end MEASUREMENT
/begin MEASUREMENT ETCOut "PID Final Output" FLOAT32_IEEE CompuMethod_5 1 0 -1E+17 1E+17 ECU_ADDRESS 0x40000401 /end MEASUREMENT
/begin MEASUREMENT ETCPTerm "PID Proportional Term" FLOAT32_IEEE CompuMethod_5 1 0 -1E+17 1E+17 ECU_ADDRESS 0x40000405 /end MEASUREMENT
/begin MEASUREMENT ETCStallStateShutdown "" UBYTE CompuMethod_55 1 0 0 1 ECU_ADDRESS 0x4000041E /end MEASUREMENT
/begin MEASUREMENT Ethanol_Spk_Ofst "Total Spark Offset based on ECT, IAT2, engine speed and load" FLOAT32_IEEE CompuMethod_63 1 0 -1E+17 1E+17 ECU_ADDRESS 0x4000041F /end MEASUREMENT
/begin MEASUREMENT Ethanol_SpkOfstMult "Multiplier on ECT spark offset table." FLOAT32_IEEE CompuMethod_8 1 0 -1E+17 1E+17 ECU_ADDRESS 0x40000423 /end MEASUREMENT
/begin MEASUREMENT EthanolInterpolation "" FLOAT32_IEEE CompuMethod_2 1 0 -1E+17 1E+17 ECU_ADDRESS 0x40000427 /end MEASUREMENT
/begin MEASUREMENT EthanolPreLookupIdx "" UWORD CompuMethod_11 1 0 0 127.998 ECU_ADDRESS 0x4000042B /end MEASUREMENT
/begin MEASUREMENT EthanolPreLookupIn "" FLOAT32_IEEE CompuMethod_2 1 0 -1E+17 1E+17 ECU_ADDRESS 0x4000042D /end MEASUREMENT
/begin MEASUREMENT Fault_Prb "" FLOAT32_IEEE CompuMethod_2 1 0 -1E+17 1E+17 ECU_ADDRESS 0x40000431 /end MEASUREMENT
/begin MEASUREMENT FaultActionReason._.CEL "Displays a rolling marquee of the reasons for fault action: FaultActionReason." UBYTE CompuMethod_87 1 0 0 255 ECU_ADDRESS 0x40000435 /end MEASUREMENT
/begin MEASUREMENT FaultActionReason._.CutThrottle "Displays a rolling marquee of the reasons for fault action: FaultActionReason." UBYTE CompuMethod_87 1 0 0 255 ECU_ADDRESS 0x40000436 /end MEASUREMENT
/begin MEASUREMENT FaultActionReason._.DelayedEngineShutdown "Displays a rolling marquee of the reasons for fault action: FaultActionReason." UBYTE CompuMethod_87 1 0 0 255 ECU_ADDRESS 0x40000437 /end MEASUREMENT
/begin MEASUREMENT FaultActionReason._.DisableO2Ctrl "Displays a rolling marquee of the reasons for fault action: FaultActionReason." UBYTE CompuMethod_87 1 0 0 255 ECU_ADDRESS 0x40000438 /end MEASUREMENT
/begin MEASUREMENT FaultActionReason._.EngineShutdown "Displays a rolling marquee of the reasons for fault action: FaultActionReason." UBYTE CompuMethod_87 1 0 0 255 ECU_ADDRESS 0x40000439 /end MEASUREMENT
/begin MEASUREMENT FaultActionReason._.HardRevLimit "Displays a rolling marquee of the reasons for fault action: FaultActionReason." UBYTE CompuMethod_87 1 0 0 255 ECU_ADDRESS 0x4000043A /end MEASUREMENT
/begin MEASUREMENT FaultActionReason._.MediumRevLimit "Displays a rolling marquee of the reasons for fault action: FaultActionReason." UBYTE CompuMethod_87 1 0 0 255 ECU_ADDRESS 0x4000043B /end MEASUREMENT
/begin MEASUREMENT FaultActionReason._.SoftRevLimit "Displays a rolling marquee of the reasons for fault action: FaultActionReason." UBYTE CompuMethod_87 1 0 0 255 ECU_ADDRESS 0x4000043C /end MEASUREMENT
/begin MEASUREMENT FaultActionReason._.Wrench_Light "Displays a rolling marquee of the reasons for fault action: FaultActionReason." UBYTE CompuMethod_87 1 0 0 255 ECU_ADDRESS 0x4000043D /end MEASUREMENT
/begin MEASUREMENT Faults_Light_Status_Prb "" FLOAT32_IEEE CompuMethod_2 1 0 -1E+17 1E+17 ECU_ADDRESS 0x40000441 /end MEASUREMENT
/begin MEASUREMENT FgndAngleStackMinBytesFree "Min bytes observed on the Foreground Angle Stack (may not exist depending onapplication)" ULONG CompuMethod_30 1 0 0 0 ECU_ADDRESS 0x40000445 /end MEASUREMENT
/begin MEASUREMENT FgndAngTaskStatus "Foreground Time Scheduler Status" UBYTE CompuMethod_29 1 0 0 0 ECU_ADDRESS 0x40000449 /end MEASUREMENT
/begin MEASUREMENT FgndTimeStackMinBytesFree "Min bytes observed on the Foreground Time Stack" ULONG CompuMethod_30 1 0 0 0 ECU_ADDRESS 0x4000044A /end MEASUREMENT
/begin MEASUREMENT ForcedShutDownTimer "" FLOAT32_IEEE CompuMethod_2 1 0 -1E+17 1E+17 ECU_ADDRESS 0x40000452 /end MEASUREMENT
/begin MEASUREMENT FrameworkGlueErrors "This indicates the currently Active Errors within the Framework Glue module." UWORD CompuMethod_94 1 0 0 65535 ECU_ADDRESS 0x40000456 /end MEASUREMENT
/begin MEASUREMENT freq_in_create_FuelSensorPin "Debug Variable" UBYTE CompuMethod_9 1 0 0 0 ECU_ADDRESS 0x40000458 /end MEASUREMENT
/begin MEASUREMENT freq_in_create_MAF_Pin "Debug Variable" UBYTE CompuMethod_9 1 0 0 0 ECU_ADDRESS 0x40000459 /end MEASUREMENT
/begin MEASUREMENT freq_in_read_FuelSensorPin "Debug Variable" UBYTE CompuMethod_9 1 0 0 0 ECU_ADDRESS 0x4000045A /end MEASUREMENT
/begin MEASUREMENT freq_in_read_MAF_Pin "Debug Variable" UBYTE CompuMethod_9 1 0 0 0 ECU_ADDRESS 0x4000045B /end MEASUREMENT
/begin MEASUREMENT FuelPumpTSE "" FLOAT32_IEEE CompuMethod_2 1 0 -1E+17 1E+17 ECU_ADDRESS 0x400004C0 /end MEASUREMENT
/begin MEASUREMENT Generating_Torque_Lim_Prb "" FLOAT32_IEEE CompuMethod_2 1 0 -1E+17 1E+17 ECU_ADDRESS 0x400004D4 /end MEASUREMENT
/begin MEASUREMENT Generating_Tq_Curve_Prb "" FLOAT32_IEEE CompuMethod_2 1 0 -1E+17 1E+17 ECU_ADDRESS 0x400004D8 /end MEASUREMENT
/begin MEASUREMENT Genset_Enable_Prb "" UBYTE CompuMethod_38 1 0 0 1 ECU_ADDRESS 0x400004E0 /end MEASUREMENT
/begin MEASUREMENT Genset_Load_Prb "" FLOAT32_IEEE CompuMethod_2 1 0 -1E+17 1E+17 ECU_ADDRESS 0x400004E1 /end MEASUREMENT
/begin MEASUREMENT IAT_SpkOfst "" FLOAT32_IEEE CompuMethod_2 1 0 -1E+17 1E+17 ECU_ADDRESS 0x400004F5 /end MEASUREMENT
/begin MEASUREMENT IAT_SpkOfstMult "Multiplier on IAT2 spark offset table." FLOAT32_IEEE CompuMethod_8 1 0 -1E+17 1E+17 ECU_ADDRESS 0x400004F9 /end MEASUREMENT
/begin MEASUREMENT IdleStackMinBytesFree "Min bytes observed on the Idle Stack" ULONG CompuMethod_30 1 0 0 0 ECU_ADDRESS 0x40000515 /end MEASUREMENT
/begin MEASUREMENT IdleState "The idle governor may be one of: Flaring, OnIdle, OffIdle" UBYTE CompuMethod_107 1 0 0 255 ECU_ADDRESS 0x40000519 /end MEASUREMENT
/begin MEASUREMENT INJ_InjectorCreate "Debug Variable" UBYTE CompuMethod_9 1 0 0 0 ECU_ADDRESS 0x4000053E /end MEASUREMENT
/begin MEASUREMENT InjdPComp "Injector characterization compenastion based on dP across injector." FLOAT32_IEEE CompuMethod_114 1 0 -1E+17 1E+17 ECU_ADDRESS 0x40000545 /end MEASUREMENT
/begin MEASUREMENT InjectorsEnabled "Enable state for injectors." UBYTE CompuMethod_42 1 0 0 1 ECU_ADDRESS 0x40000549 MATRIX_DIM 8 1 1 /end MEASUREMENT
/begin MEASUREMENT InjEPW "" FLOAT32_IEEE CompuMethod_2 1 0 -1E+17 1E+17 ECU_ADDRESS 0x40000551 /end MEASUREMENT
/begin MEASUREMENT InjMPW "" FLOAT32_IEEE CompuMethod_2 1 0 -1E+17 1E+17 ECU_ADDRESS 0x40000555 MATRIX_DIM 8 1 1 /end MEASUREMENT
/begin MEASUREMENT InjTransitionCount "" UBYTE CompuMethod_1 1 0 0 255 ECU_ADDRESS 0x40000575 MATRIX_DIM 8 1 1 /end MEASUREMENT
/begin MEASUREMENT InjTurnOff "Injector turn off time" FLOAT32_IEEE CompuMethod_40 1 0 -1E+17 1E+17 ECU_ADDRESS 0x4000057D /end MEASUREMENT
/begin MEASUREMENT InjTurnOn "Injector turn on time." FLOAT32_IEEE CompuMethod_40 1 0 -1E+17 1E+17 ECU_ADDRESS 0x40000581 /end MEASUREMENT
/begin MEASUREMENT IntakeAirTempEnrichment "Multiplier on base eq. ratio as a function of IAT and ECT" FLOAT32_IEEE CompuMethod_8 1 0 -1E+17 1E+17 ECU_ADDRESS 0x40000585 /end MEASUREMENT
/begin MEASUREMENT InterruptStackMinBytesFree "Minimum observed stack free for use by the interrupts" UWORD CompuMethod_117 1 0 0 65535 ECU_ADDRESS 0x40000589 /end MEASUREMENT
/begin MEASUREMENT Inverter_Temp_Prb "" FLOAT32_IEEE CompuMethod_2 1 0 -1E+17 1E+17 ECU_ADDRESS 0x4000058B /end MEASUREMENT
/begin MEASUREMENT LastOSError "Monitor of Internal OS Errors" UBYTE CompuMethod_118 1 0 0 0 ECU_ADDRESS 0x40000593 /end MEASUREMENT
/begin MEASUREMENT Load_On_Prb "" UBYTE CompuMethod_38 1 0 0 1 ECU_ADDRESS 0x400005AD /end MEASUREMENT
/begin MEASUREMENT Load_RPM_Prb "" FLOAT32_IEEE CompuMethod_2 1 0 -1E+17 1E+17 ECU_ADDRESS 0x400005AE /end MEASUREMENT
/begin MEASUREMENT Load_Throttle_Prb "" FLOAT32_IEEE CompuMethod_2 1 0 -1E+17 1E+17 ECU_ADDRESS 0x400005B2 /end MEASUREMENT
/begin MEASUREMENT MAF09Idx "" UWORD CompuMethod_11 1 0 0 127.998 ECU_ADDRESS 0x400005BA /end MEASUREMENT
/begin MEASUREMENT MAF09In "" FLOAT32_IEEE CompuMethod_2 1 0 -1E+17 1E+17 ECU_ADDRESS 0x400005BC /end MEASUREMENT
/begin MEASUREMENT MAFPort "" FLOAT32_IEEE CompuMethod_7 1 0 -1E+17 1E+17 ECU_ADDRESS 0x400005C6 /end MEASUREMENT
/begin MEASUREMENT MAFPortModel "" FLOAT32_IEEE CompuMethod_7 1 0 -1E+17 1E+17 ECU_ADDRESS 0x400005D0 /end MEASUREMENT
/begin MEASUREMENT MakeUpEOI "End of injection timing for transient makeup fuel pulse" FLOAT32_IEEE CompuMethod_43 1 0 -1E+17 1E+17 ECU_ADDRESS 0x400005D8 /end MEASUREMENT
/begin MEASUREMENT MaxAllowableMPW "" FLOAT32_IEEE CompuMethod_2 1 0 -1E+17 1E+17 ECU_ADDRESS 0x40000642 /end MEASUREMENT
/begin MEASUREMENT Motoring_Torque_Lim_Prb "" FLOAT32_IEEE CompuMethod_2 1 0 -1E+17 1E+17 ECU_ADDRESS 0x4000081C /end MEASUREMENT
/begin MEASUREMENT Motoring_Tq_Curve_Prb "" FLOAT32_IEEE CompuMethod_2 1 0 -1E+17 1E+17 ECU_ADDRESS 0x40000820 /end MEASUREMENT
/begin MEASUREMENT MPRD "Indicates whether the main power relay is active" UBYTE CompuMethod_55 1 0 0 1 ECU_ADDRESS 0x4000082D /end MEASUREMENT
/begin MEASUREMENT O2Calibration "" UBYTE CompuMethod_55 1 0 0 1 ECU_ADDRESS 0x4000085B /end MEASUREMENT
/begin MEASUREMENT O2CtrlMode "" UBYTE CompuMethod_137 1 0 0 1 ECU_ADDRESS 0x4000085C /end MEASUREMENT
/begin MEASUREMENT O2FuelMult "Closed-loop O2 control fuel multiplier." FLOAT32_IEEE CompuMethod_8 1 0 -1E+17 1E+17 ECU_ADDRESS 0x4000085D /end MEASUREMENT
/begin MEASUREMENT O2ITermIdx "Index for O2 ITerm." UWORD CompuMethod_11 1 0 0 127.998 ECU_ADDRESS 0x40000861 /end MEASUREMENT
/begin MEASUREMENT O2ITermIn "Index for O2 ITerm." FLOAT32_IEEE CompuMethod_8 1 0 -1E+17 1E+17 ECU_ADDRESS 0x40000863 /end MEASUREMENT
/begin MEASUREMENT O2SensorFaults "" UBYTE CompuMethod_55 1 0 0 1 ECU_ADDRESS 0x4000087B /end MEASUREMENT
/begin MEASUREMENT O2StartUpDelay "Delay O2 enable until TimeSinceRun is greater than this time." FLOAT32_IEEE CompuMethod_21 1 0 -1E+17 1E+17 ECU_ADDRESS 0x4000087C /end MEASUREMENT
/begin MEASUREMENT O2TimeDelay "" UBYTE CompuMethod_55 1 0 0 1 ECU_ADDRESS 0x40000884 /end MEASUREMENT
/begin MEASUREMENT Oil_Pressure_Prb "" FLOAT32_IEEE CompuMethod_2 1 0 -1E+17 1E+17 ECU_ADDRESS 0x40000885 /end MEASUREMENT
/begin MEASUREMENT OilPumpTSE "" FLOAT32_IEEE CompuMethod_2 1 0 -1E+17 1E+17 ECU_ADDRESS 0x40000894 /end MEASUREMENT
/begin MEASUREMENT OSErrorCnt "Number of errors observed by the OS" UBYTE CompuMethod_1 1 0 0 255 ECU_ADDRESS 0x4000089D /end MEASUREMENT
/begin MEASUREMENT OSStatus "" UBYTE CompuMethod_141 1 0 0 0 ECU_ADDRESS 0x4000089E /end MEASUREMENT
/begin MEASUREMENT PeakHeapBytesUsed "The peak number of bytes seen on the heap." ULONG CompuMethod_28 1 0 0 0 ECU_ADDRESS 0x400008C8 /end MEASUREMENT
/begin MEASUREMENT PortPressRatio17Idx "Map divided by BARO." UWORD CompuMethod_11 1 0 0 127.998 ECU_ADDRESS 0x400008D4 /end MEASUREMENT
/begin MEASUREMENT PressureRatio "" FLOAT32_IEEE CompuMethod_2 1 0 -1E+17 1E+17 ECU_ADDRESS 0x400008DE /end MEASUREMENT
/begin MEASUREMENT PrimarySOI "Injection timing for primary fuel pulse - SOI or EOI depending on Inj Config" FLOAT32_IEEE CompuMethod_43 1 0 -1E+17 1E+17 ECU_ADDRESS 0x400008E2 /end MEASUREMENT
/begin MEASUREMENT protocol_register_CAN_1 "Debug Variable" UBYTE CompuMethod_9 1 0 0 0 ECU_ADDRESS 0x400008E6 /end MEASUREMENT
/begin MEASUREMENT protocol_register_CAN_2 "Debug Variable" UBYTE CompuMethod_9 1 0 0 0 ECU_ADDRESS 0x400008E7 /end MEASUREMENT
/begin MEASUREMENT RPM "" FLOAT32_IEEE CompuMethod_2 1 0 -1E+17 1E+17 ECU_ADDRESS 0x400008F8 /end MEASUREMENT
/begin MEASUREMENT RPM_Prb "" FLOAT32_IEEE CompuMethod_2 1 0 -1E+17 1E+17 ECU_ADDRESS 0x400008FC /end MEASUREMENT
/begin MEASUREMENT RPMCtrlMode "" UBYTE CompuMethod_38 1 0 0 1 ECU_ADDRESS 0x40000918 /end MEASUREMENT
/begin MEASUREMENT RPMInst "" FLOAT32_IEEE CompuMethod_2 1 0 -1E+17 1E+17 ECU_ADDRESS 0x4000091A /end MEASUREMENT
/begin MEASUREMENT Run_Request_Prb "" FLOAT32_IEEE CompuMethod_2 1 0 -1E+17 1E+17 ECU_ADDRESS 0x40000922 /end MEASUREMENT
/begin MEASUREMENT SecondarySpeedLim_CenterPT_Prb "" FLOAT32_IEEE CompuMethod_2 1 0 -1E+17 1E+17 ECU_ADDRESS 0x40000926 /end MEASUREMENT
/begin MEASUREMENT SecondaryVoltLim_CenterPT_Prb "" FLOAT32_IEEE CompuMethod_2 1 0 -1E+17 1E+17 ECU_ADDRESS 0x4000092A /end MEASUREMENT
/begin MEASUREMENT Spark_Adv_Prb "" FLOAT32_IEEE CompuMethod_2 1 0 -1E+17 1E+17 ECU_ADDRESS 0x40000938 /end MEASUREMENT
/begin MEASUREMENT SparkAdv "Base spark advance map." FLOAT32_IEEE CompuMethod_43 1 0 -1E+17 1E+17 ECU_ADDRESS 0x4000093C /end MEASUREMENT
/begin MEASUREMENT SparkDwell "Total electrical spark dwell time" FLOAT32_IEEE CompuMethod_41 1 0 -1E+17 1E+17 ECU_ADDRESS 0x40000940 /end MEASUREMENT
/begin MEASUREMENT SparkEnabled "Enabled when spark energy is greater than zero" UBYTE CompuMethod_155 1 0 0 1 ECU_ADDRESS 0x40000944 /end MEASUREMENT
/begin MEASUREMENT SparkEnergyMonitor "Commanded spark energy, before conversion to dwell time" FLOAT32_IEEE CompuMethod_27 1 0 -1E+17 1E+17 ECU_ADDRESS 0x40000945 /end MEASUREMENT
/begin MEASUREMENT Speed_Voltage_Torque_CMD_Prb "" FLOAT32_IEEE CompuMethod_2 1 0 -1E+17 1E+17 ECU_ADDRESS 0x40000949 /end MEASUREMENT
/begin MEASUREMENT SpkEnergy09Idx "" UWORD CompuMethod_11 1 0 0 127.998 ECU_ADDRESS 0x4000094D /end MEASUREMENT
/begin MEASUREMENT SpkEnergy09In "" FLOAT32_IEEE CompuMethod_2 1 0 -1E+17 1E+17 ECU_ADDRESS 0x4000094F /end MEASUREMENT
/begin MEASUREMENT SWISRCurrQueueSize "Current size of the Software ISR Queue" UBYTE CompuMethod_159 1 0 0 255 ECU_ADDRESS 0x40000999 /end MEASUREMENT
/begin MEASUREMENT TDCCount "Number of TDC events counted after stall.  This will reset once in Crank and Run." UBYTE CompuMethod_1 1 0 0 255 ECU_ADDRESS 0x400009AE /end MEASUREMENT
/begin MEASUREMENT TDCCountThreshEnabled "" UBYTE CompuMethod_55 1 0 0 1 ECU_ADDRESS 0x400009AF /end MEASUREMENT
/begin MEASUREMENT Temp_Guage_Ovr "" FLOAT32_IEEE CompuMethod_2 1 0 -1E+17 1E+17 ECU_ADDRESS 0x400009B0 /end MEASUREMENT
/begin MEASUREMENT Tot_Temp_SpkOfst "Total Spark Offset based on ECT, IAT2, engine speed and load" FLOAT32_IEEE CompuMethod_63 1 0 -1E+17 1E+17 ECU_ADDRESS 0x400009CA /end MEASUREMENT
/begin MEASUREMENT TotalFPC "Total fuel per cylinder after application of transient algorithm" FLOAT32_IEEE CompuMethod_12 1 0 -1E+17 1E+17 ECU_ADDRESS 0x400009CE MATRIX_DIM 8 1 1 /end MEASUREMENT
/begin MEASUREMENT TransFuel_TPSFilt "" FLOAT32_IEEE CompuMethod_2 1 0 -1E+17 1E+17 ECU_ADDRESS 0x40000A2A /end MEASUREMENT
/begin MEASUREMENT Trigger_Prb "" UBYTE CompuMethod_38 1 0 0 1 ECU_ADDRESS 0x40000A2E /end MEASUREMENT
/begin MEASUREMENT VE "" FLOAT32_IEEE CompuMethod_2 1 0 -1E+17 1E+17 ECU_ADDRESS 0x40000A30 /end MEASUREMENT
/begin MEASUREMENT VEBaroCorr "Vol Eff compensation based on BARO." FLOAT32_IEEE CompuMethod_2 1 0 -1E+17 1E+17 ECU_ADDRESS 0x40000A38 /end MEASUREMENT
/begin MEASUREMENT Vehicle_Speed_Prb "" FLOAT32_IEEE CompuMethod_2 1 0 -1E+17 1E+17 ECU_ADDRESS 0x40000A3C /end MEASUREMENT
/begin MEASUREMENT VETable "" FLOAT32_IEEE CompuMethod_5 1 0 -1E+17 1E+17 ECU_ADDRESS 0x40000A40 /end MEASUREMENT
/begin MEASUREMENT VETempCorr "Vol Eff compensation based on IAT." FLOAT32_IEEE CompuMethod_2 1 0 -1E+17 1E+17 ECU_ADDRESS 0x40000A44 /end MEASUREMENT
/begin MEASUREMENT WarmUpEqRatioMult "Multiplier on base eq. ratio as a function of NECCT and Ind Power." FLOAT32_IEEE CompuMethod_8 1 0 -1E+17 1E+17 ECU_ADDRESS 0x40000A48 /end MEASUREMENT
/begin MEASUREMENT WarmUpTimeMult "Multiplier on base eq. ratio as a function of TimeSinceRun and ECT" FLOAT32_IEEE CompuMethod_8 1 0 -1E+17 1E+17 ECU_ADDRESS 0x40000A4D /end MEASUREMENT
/begin MEASUREMENT Wrench_Status_Prb "" UBYTE CompuMethod_38 1 0 0 1 ECU_ADDRESS 0x40000A51 /end MEASUREMENT
/begin MEASUREMENT XDRP_Supply_State_Prb "" FLOAT32_IEEE CompuMethod_2 1 0 -1E+17 1E+17 ECU_ADDRESS 0x40000A5A /end MEASUREMENT
/begin CHARACTERISTIC ApplicationMonitorEnable "Enables runtime checking of stack, heap, CPU, and OS errors.  Stops the application on error." VALUE 0x800001B7 RecordLayout_1 0 CompuMethod_14 0 1 /end CHARACTERISTIC
/begin CHARACTERISTIC ApplicationPausePoint "Selects the startup pause point, for debugging.  Can be moved forward to step through the initialization" VALUE 0x800001B8 RecordLayout_1 0 CompuMethod_15 0 3 /end CHARACTERISTIC
/begin CHARACTERISTIC Aux_PWM_DutyCycle_Ovr_new "" VALUE 0x800001BA RecordLayout_4 0 CompuMethod_2 -1E+17 1E+17 /end CHARACTERISTIC
/begin CHARACTERISTIC Aux_PWM_DutyCycle_Ovr_ovr "" VALUE 0x800001BE RecordLayout_1 0 CompuMethod_4 0 1 /end CHARACTERISTIC
/begin CHARACTERISTIC Aux_PWM_Freq_Ovr_new "" VALUE 0x800001BF RecordLayout_4 0 CompuMethod_2 -1E+17 1E+17 /end CHARACTERISTIC
/begin CHARACTERISTIC Aux_PWM_Freq_Ovr_ovr "" VALUE 0x800001C3 RecordLayout_1 0 CompuMethod_4 0 1 /end CHARACTERISTIC
/begin CHARACTERISTIC Aux_PWM_State_Ovr_new "" VALUE 0x800001C4 RecordLayout_4 0 CompuMethod_2 -1E+17 1E+17 /end CHARACTERISTIC
/begin CHARACTERISTIC Aux_PWM_State_Ovr_ovr "" VALUE 0x800001C8 RecordLayout_1 0 CompuMethod_4 0 1 /end CHARACTERISTIC
/begin CHARACTERISTIC BARO_Count "Number of samples to average at key-up to produce signal value" VALUE 0x800001C9 RecordLayout_6 0 CompuMethod_1 -128 127 /end CHARACTERISTIC
/begin CHARACTERISTIC BARO_offset "Provides an override to the input by adding this amount to either the locked or running value" VALUE 0x800001CA RecordLayout_4 0 CompuMethod_19 -1E+17 1E+17 /end CHARACTERISTIC
/begin CHARACTERISTIC BARO_ovr "Provides an override to the input by adding this amount to either the locked or running value" VALUE 0x800001CE RecordLayout_1 0 CompuMethod_20 0 1 /end CHARACTERISTIC
/begin CHARACTERISTIC BaroRunStallDelay "Delay time after transitioning from Run to Stall before resampling baro." VALUE 0x800001F3 RecordLayout_4 0 CompuMethod_21 -1E+17 1E+17 /end CHARACTERISTIC
/begin CHARACTERISTIC BaseAirflowAdaptDelayTime "Idle Control must be enabled for this amount of time before fuel adaption is enabled" VALUE 0x800001F7 RecordLayout_4 0 CompuMethod_21 0 1E+17 /end CHARACTERISTIC
/begin CHARACTERISTIC BaseAirflowAdaptDelta "Air PID Iterm must be less than this delta to adapt the BaseAirflow table." VALUE 0x800001FB RecordLayout_4 0 CompuMethod_8 -1E+17 1E+17 /end CHARACTERISTIC
/begin CHARACTERISTIC BaseAirflowAdaptEnable "Determines whether the BaseAirflow table will be adapted using the air PID Iterm." VALUE 0x800001FF RecordLayout_1 0 CompuMethod_6 0 1 /end CHARACTERISTIC
/begin CHARACTERISTIC BaseAirflowAdaptErrorLwrLim "Lower Limit Value" VALUE 0x80000200 RecordLayout_4 0 CompuMethod_23 -1E+17 1E+17 /end CHARACTERISTIC
/begin CHARACTERISTIC BaseAirflowAdaptErrorUprLim "Upper Limit Value" VALUE 0x80000204 RecordLayout_4 0 CompuMethod_23 -1E+17 1E+17 /end CHARACTERISTIC
/begin CHARACTERISTIC BaseAirflowAdaptGain "Gain for updating BaseAirflow table.  This fraction of the error is added to the map every 5ms." VALUE 0x80000208 RecordLayout_4 0 CompuMethod_24 -1E+17 1E+17 /end CHARACTERISTIC
/begin CHARACTERISTIC BaseAirflowOfstMaxValue "Maximum value that can be adapted into the BaseAirflowOfst table." VALUE 0x8000020C RecordLayout_4 0 CompuMethod_5 -1E+17 1E+17 /end CHARACTERISTIC
/begin CHARACTERISTIC BaseAirflowOfstMinValue "Minimum value that can be adapted into the BaseAirflowOfst table." VALUE 0x80000210 RecordLayout_4 0 CompuMethod_5 -1E+17 1E+17 /end CHARACTERISTIC
/begin CHARACTERISTIC BaseAirflowOfstTbl "Base air position in based on ECT." CURVE 0x80000214 RecordLayout_4 0 CompuMethod_5 -1E+17 1E+17
 /begin AXIS_DESCR COM_AXIS ECT05In CompuMethod_2 5 -1E+17 1E+17 AXIS_PTS_REF ECT05IdxArr /end AXIS_DESCR
/end CHARACTERISTIC
/begin CHARACTERISTIC BaseRevLimit "Maximum RPM allowed, before any action is taken" VALUE 0x80000228 RecordLayout_4 0 CompuMethod_26 0 1E+17 /end CHARACTERISTIC
/begin CHARACTERISTIC BaseSparkEnergyMap "Spark energy - Run state" MAP 0x8000022C RecordLayout_4 0 CompuMethod_27 -1E+17 1E+17
 /begin AXIS_DESCR COM_AXIS RPM09In CompuMethod_2 9 -1E+17 1E+17 AXIS_PTS_REF RPM09IdxArr /end AXIS_DESCR
 /begin AXIS_DESCR COM_AXIS IndLoadNom09In CompuMethod_2 9 -1E+17 1E+17 AXIS_PTS_REF IndLoadNom09IdxArr /end AXIS_DESCR
/end CHARACTERISTIC
/begin CHARACTERISTIC BGND_BASE_Multiple "Base rate of the BGND_BASE_PERIODIC event, as a multiple of FGND_RTI_Period" VALUE 0x80000370 RecordLayout_7 0 CompuMethod_28 0 65535 /end CHARACTERISTIC
/begin CHARACTERISTIC BGND_BASE_PERIODIC_RunCnt "The number of times to execute BGND_BASE_PERIODIC before pausing.  -1 means run forever" VALUE 0x80000372 RecordLayout_8 0 CompuMethod_28 -1 2147480000 /end CHARACTERISTIC
/begin CHARACTERISTIC BGND_BASEx10_PERIODIC_RunCnt "The number of times to execute BGND_BASEx10_PERIODIC before pausing.  -1 means run forever" VALUE 0x80000376 RecordLayout_8 0 CompuMethod_28 -1 2147480000 /end CHARACTERISTIC
/begin CHARACTERISTIC BGND_BASEx2_PERIODIC_RunCnt "The number of times to execute BGND_BASEx2_PERIODIC before pausing.  -1 means run forever" VALUE 0x8000037A RecordLayout_8 0 CompuMethod_28 -1 2147480000 /end CHARACTERISTIC
/begin CHARACTERISTIC BgndStackMargin "When the available stack space drops below this threshold, the application performs a safety stop" VALUE 0x8000037E RecordLayout_7 0 CompuMethod_28 0 2048 /end CHARACTERISTIC
/begin CHARACTERISTIC Bus_HVIL_Status_Ovr_new "" VALUE 0x80000380 RecordLayout_4 0 CompuMethod_2 -1E+17 1E+17 /end CHARACTERISTIC
/begin CHARACTERISTIC Bus_HVIL_Status_Ovr_ovr "" VALUE 0x80000384 RecordLayout_1 0 CompuMethod_4 0 1 /end CHARACTERISTIC
/begin CHARACTERISTIC CAMDelay "Delay between the rising edge of the actual CAM signal and the rising edge of the ideal CAM.  If it leads the ideal CAM by one tooth (60-6 system) then the delay would be 6 degCA and 714 degCA if it lagged.  Applicable if crank encoder has >1 sync pts" VALUE 0x80000385 RecordLayout_7 0 CompuMethod_32 0 720 /end CHARACTERISTIC
/begin CHARACTERISTIC CAN_Timeout_112 "" VALUE 0x80000387 RecordLayout_4 0 CompuMethod_2 -1E+17 1E+17 /end CHARACTERISTIC
/begin CHARACTERISTIC CAN_Timeout_Phoenix_1 "" VALUE 0x8000038B RecordLayout_4 0 CompuMethod_2 -1E+17 1E+17 /end CHARACTERISTIC
/begin CHARACTERISTIC CAN_Timeout_Phoenix_2 "" VALUE 0x8000038F RecordLayout_4 0 CompuMethod_2 -1E+17 1E+17 /end CHARACTERISTIC
/begin CHARACTERISTIC CAN_Timeout_Phoenix_3 "" VALUE 0x80000393 RecordLayout_4 0 CompuMethod_2 -1E+17 1E+17 /end CHARACTERISTIC
/begin CHARACTERISTIC CAN_Timeout_Phoenix_4 "" VALUE 0x80000397 RecordLayout_4 0 CompuMethod_2 -1E+17 1E+17 /end CHARACTERISTIC
/begin CHARACTERISTIC CCP1_StationAddr "Station ID for CCP handler: CCP1" VALUE 0x8000039F RecordLayout_7 0 CompuMethod_28 0 65535 /end CHARACTERISTIC
/begin CHARACTERISTIC CCP1RxID "Receive CAN ID for CCP handler: CCP1" VALUE 0x800003A1 RecordLayout_3 0 CompuMethod_33 0 4294970000 /end CHARACTERISTIC
/begin CHARACTERISTIC CCP1RxIDMask "Receive CAN ID Mask for CCP handler: CCP1" VALUE 0x800003A5 RecordLayout_3 0 CompuMethod_33 0 4294970000 /end CHARACTERISTIC
/begin CHARACTERISTIC CCP1TxID "Transmit CAN ID for CCP handler: CCP1" VALUE 0x800003A9 RecordLayout_3 0 CompuMethod_33 0 4294970000 /end CHARACTERISTIC
/begin CHARACTERISTIC CEL_Status_Ovr_new "" VALUE 0x800003AD RecordLayout_1 0 CompuMethod_38 0 1 /end CHARACTERISTIC
/begin CHARACTERISTIC CEL_Status_Ovr_ovr "" VALUE 0x800003AE RecordLayout_1 0 CompuMethod_4 0 1 /end CHARACTERISTIC
/begin CHARACTERISTIC CityID_CAN_1 "City ID for CAN bus CAN_1" VALUE 0x800003AF RecordLayout_1 0 CompuMethod_1 0 255 /end CHARACTERISTIC
/begin CHARACTERISTIC CityID_CAN_2 "City ID for CAN bus CAN_2" VALUE 0x800003B0 RecordLayout_1 0 CompuMethod_1 0 255 /end CHARACTERISTIC
/begin CHARACTERISTIC ClearFloodThreshold "In crank mode, throttle commands greater than this threshold will disable crank fueling." VALUE 0x800003B1 RecordLayout_4 0 CompuMethod_39 -1E+17 1E+17 /end CHARACTERISTIC
/begin CHARACTERISTIC CoilDrvrDlyTime "Coil driver delay time between receipt of EST signal and initiation of coil dwell." VALUE 0x800003B5 RecordLayout_4 0 CompuMethod_40 -1E+17 1E+17 /end CHARACTERISTIC
/begin CHARACTERISTIC CoilDwellMap "Required spark dwell to give the desired spark energy." MAP 0x800003B9 RecordLayout_4 0 CompuMethod_41 -1E+17 1E+17
 /begin AXIS_DESCR COM_AXIS SysVolt09In CompuMethod_2 9 -1E+17 1E+17 AXIS_PTS_REF SysVolt09IdxArr /end AXIS_DESCR
 /begin AXIS_DESCR COM_AXIS SpkEnergy09In CompuMethod_2 9 -1E+17 1E+17 AXIS_PTS_REF SpkEnergy09IdxArr /end AXIS_DESCR
/end CHARACTERISTIC
/begin CHARACTERISTIC CombEventsPerRev "Number of conbustion events per engine revolution. For example, for a four-stroke, eight cylinder engine the value would be 4." VALUE 0x800004FD RecordLayout_1 0 CompuMethod_1 0.5 255 /end CHARACTERISTIC
/begin CHARACTERISTIC Constant_Fuel_Pump "" VALUE 0x800004FE RecordLayout_4 0 CompuMethod_2 -1E+17 1E+17 /end CHARACTERISTIC
/begin CHARACTERISTIC Constant_Oil_Pump "" VALUE 0x80000502 RecordLayout_4 0 CompuMethod_2 -1E+17 1E+17 /end CHARACTERISTIC
/begin CHARACTERISTIC Control_Mode_Cmd_Ovr_new "" VALUE 0x80000506 RecordLayout_4 0 CompuMethod_2 -1E+17 1E+17 /end CHARACTERISTIC
/begin CHARACTERISTIC Control_Mode_Cmd_Ovr_ovr "" VALUE 0x8000050A RecordLayout_1 0 CompuMethod_4 0 1 /end CHARACTERISTIC
/begin CHARACTERISTIC Control_Mode_Ovr_new "" VALUE 0x8000050B RecordLayout_4 0 CompuMethod_2 -1E+17 1E+17 /end CHARACTERISTIC
/begin CHARACTERISTIC Control_Mode_Ovr_ovr "" VALUE 0x8000050F RecordLayout_1 0 CompuMethod_4 0 1 /end CHARACTERISTIC
/begin CHARACTERISTIC CoolantTempEnrichmentMap "Multiplier on base eq. ratio as a function of Load and ECT" MAP 0x80000510 RecordLayout_4 0 CompuMethod_8 0 1E+17
 /begin AXIS_DESCR COM_AXIS ECT05In CompuMethod_2 5 -1E+17 1E+17 AXIS_PTS_REF ECT05IdxArr /end AXIS_DESCR
 /begin AXIS_DESCR COM_AXIS IndLoadNom09In CompuMethod_2 9 -1E+17 1E+17 AXIS_PTS_REF IndLoadNom09IdxArr /end AXIS_DESCR
/end CHARACTERISTIC
/begin CHARACTERISTIC CPUMargin "When the available CPU idle time drops below this threshold, the application performs a safety stop" VALUE 0x800005C4 RecordLayout_7 0 CompuMethod_45 0 100 /end CHARACTERISTIC
/begin CHARACTERISTIC CrankAirflowSetPtTbl "ETC setpoint during cranking." CURVE 0x800005CE RecordLayout_4 0 CompuMethod_5 -1E+17 1E+17
 /begin AXIS_DESCR COM_AXIS ECT CompuMethod_47 5 -1E+17 1E+17 AXIS_PTS_REF CrankECT05IdxArr /end AXIS_DESCR
/end CHARACTERISTIC
/begin CHARACTERISTIC CrankFPCMap "Liquid fuel supplied during crank." MAP 0x800005F6 RecordLayout_4 0 CompuMethod_48 0 1E+17
 /begin AXIS_DESCR COM_AXIS CrankRPM05In CompuMethod_26 5 -1E+17 1E+17 AXIS_PTS_REF CrankRPM05IdxArr /end AXIS_DESCR
 /begin AXIS_DESCR COM_AXIS ECT CompuMethod_47 5 -1E+17 1E+17 AXIS_PTS_REF CrankECT05IdxArr /end AXIS_DESCR
/end CHARACTERISTIC
/begin CHARACTERISTIC CrankMakeUpEOITbl "Start of injection during cranking." CURVE 0x8000065E RecordLayout_4 0 CompuMethod_43 -920 920
 /begin AXIS_DESCR COM_AXIS CrankRPM05In CompuMethod_26 5 -1E+17 1E+17 AXIS_PTS_REF CrankRPM05IdxArr /end AXIS_DESCR
/end CHARACTERISTIC
/begin CHARACTERISTIC CrankSOITbl "Start of injection during cranking." CURVE 0x80000686 RecordLayout_4 0 CompuMethod_43 -920 920
 /begin AXIS_DESCR COM_AXIS CrankRPM05In CompuMethod_26 5 -1E+17 1E+17 AXIS_PTS_REF CrankRPM05IdxArr /end AXIS_DESCR
/end CHARACTERISTIC
/begin CHARACTERISTIC CrankSparkTbl "Spark adv during cranking." CURVE 0x8000069A RecordLayout_4 0 CompuMethod_43 -100 100
 /begin AXIS_DESCR COM_AXIS CrankRPM05In CompuMethod_26 5 -1E+17 1E+17 AXIS_PTS_REF CrankRPM05IdxArr /end AXIS_DESCR
/end CHARACTERISTIC
/begin CHARACTERISTIC CrankSpkEnergyMap "Spark energy during cranking." MAP 0x800006AE RecordLayout_4 0 CompuMethod_50 0 1E+17
 /begin AXIS_DESCR COM_AXIS CrankRPM05In CompuMethod_26 5 -1E+17 1E+17 AXIS_PTS_REF CrankRPM05IdxArr /end AXIS_DESCR
 /begin AXIS_DESCR COM_AXIS ECT CompuMethod_47 5 -1E+17 1E+17 AXIS_PTS_REF CrankECT05IdxArr /end AXIS_DESCR
/end CHARACTERISTIC
/begin CHARACTERISTIC CrankToRunRPMThresh "RPM above which RUN mode can be entered from CRANK mode." VALUE 0x80000712 RecordLayout_7 0 CompuMethod_51 0 65535 /end CHARACTERISTIC
/begin CHARACTERISTIC CtrlBoard_Temp_Ovr_new "" VALUE 0x80000714 RecordLayout_4 0 CompuMethod_2 -1E+17 1E+17 /end CHARACTERISTIC
/begin CHARACTERISTIC CtrlBoard_Temp_Ovr_ovr "" VALUE 0x80000718 RecordLayout_1 0 CompuMethod_4 0 1 /end CHARACTERISTIC
/begin CHARACTERISTIC CylSweptVol "Cylinder swept volume for a single cylinder." VALUE 0x80000719 RecordLayout_4 0 CompuMethod_52 0 1E+17 /end CHARACTERISTIC
/begin CHARACTERISTIC Default_DC "" VALUE 0x8000071D RecordLayout_4 0 CompuMethod_5 0 100 /end CHARACTERISTIC
/begin CHARACTERISTIC Default_PW "" VALUE 0x80000721 RecordLayout_4 0 CompuMethod_53 0 1E+17 /end CHARACTERISTIC
/begin CHARACTERISTIC DeltaTPS_FiltConst "Filter time constant" VALUE 0x80000725 RecordLayout_4 0 CompuMethod_54 -1E+17 1E+17 /end CHARACTERISTIC
/begin CHARACTERISTIC DeltaTPS_MultMap "Transient Fueling Multiplier for adjustment based on delta TPS" MAP 0x80000729 RecordLayout_4 0 CompuMethod_8 -1E+17 1E+17
 /begin AXIS_DESCR COM_AXIS DeltaTPS17In CompuMethod_2 17 -1E+17 1E+17 AXIS_PTS_REF DeltaTPS17IdxArr /end AXIS_DESCR
 /begin AXIS_DESCR COM_AXIS MAF09In CompuMethod_2 9 -1E+17 1E+17 AXIS_PTS_REF MAF09IdxArr /end AXIS_DESCR
/end CHARACTERISTIC
/begin CHARACTERISTIC DeltaTPSFuelingEnable "Enable Delta TPS transient fuel algorithm" VALUE 0x800009D1 RecordLayout_1 0 CompuMethod_55 0 1 /end CHARACTERISTIC
/begin CHARACTERISTIC DesEquivRatioMap "Desired liquid equivalence ratio." MAP 0x800009D2 RecordLayout_4 0 CompuMethod_2 0 1E+17
 /begin AXIS_DESCR COM_AXIS RPM17In CompuMethod_2 17 -1E+17 1E+17 AXIS_PTS_REF RPM17IdxArr /end AXIS_DESCR
 /begin AXIS_DESCR COM_AXIS IndLoadNom17In CompuMethod_2 17 -1E+17 1E+17 AXIS_PTS_REF IndLoadNom17IdxArr /end AXIS_DESCR
/end CHARACTERISTIC
/begin CHARACTERISTIC DigPos_Sens2_Ovr_new "" VALUE 0x80000E56 RecordLayout_4 0 CompuMethod_2 -1E+17 1E+17 /end CHARACTERISTIC
/begin CHARACTERISTIC DigPos_Sens2_Ovr_ovr "" VALUE 0x80000E5A RecordLayout_1 0 CompuMethod_4 0 1 /end CHARACTERISTIC
/begin CHARACTERISTIC DigPos_Sens3_Ovr_new "" VALUE 0x80000E5B RecordLayout_4 0 CompuMethod_2 -1E+17 1E+17 /end CHARACTERISTIC
/begin CHARACTERISTIC DigPos_Sens3_Ovr_ovr "" VALUE 0x80000E5F RecordLayout_1 0 CompuMethod_4 0 1 /end CHARACTERISTIC
/begin CHARACTERISTIC DigPos_Sens4_Ovr_new "" VALUE 0x80000E60 RecordLayout_4 0 CompuMethod_2 -1E+17 1E+17 /end CHARACTERISTIC
/begin CHARACTERISTIC DigPos_Sens4_Ovr_ovr "" VALUE 0x80000E64 RecordLayout_1 0 CompuMethod_4 0 1 /end CHARACTERISTIC
/begin CHARACTERISTIC DigPos_Sens5_Ovr_new "" VALUE 0x80000E65 RecordLayout_4 0 CompuMethod_2 -1E+17 1E+17 /end CHARACTERISTIC
/begin CHARACTERISTIC DigPos_Sens5_Ovr_ovr "" VALUE 0x80000E69 RecordLayout_1 0 CompuMethod_4 0 1 /end CHARACTERISTIC
/begin CHARACTERISTIC Disable_ESTOP "" VALUE 0x80000E6A RecordLayout_4 0 CompuMethod_2 -1E+17 1E+17 /end CHARACTERISTIC
/begin CHARACTERISTIC DPos_Sens1_Ovr_new "" VALUE 0x80000E6E RecordLayout_4 0 CompuMethod_2 -1E+17 1E+17 /end CHARACTERISTIC
/begin CHARACTERISTIC DPos_Sens1_Ovr_ovr "" VALUE 0x80000E72 RecordLayout_1 0 CompuMethod_4 0 1 /end CHARACTERISTIC
/begin CHARACTERISTIC Drive_Hot "" VALUE 0x80000E73 RecordLayout_4 0 CompuMethod_2 -1E+17 1E+17 /end CHARACTERISTIC
/begin CHARACTERISTIC Drive_Temp_Ovr_new "" VALUE 0x80000E77 RecordLayout_4 0 CompuMethod_2 -1E+17 1E+17 /end CHARACTERISTIC
/begin CHARACTERISTIC Drive_Temp_Ovr_ovr "" VALUE 0x80000E7B RecordLayout_1 0 CompuMethod_4 0 1 /end CHARACTERISTIC
/begin CHARACTERISTIC Drive_Warm "" VALUE 0x80000E7C RecordLayout_4 0 CompuMethod_2 -1E+17 1E+17 /end CHARACTERISTIC
/begin CHARACTERISTIC Duration_Ovr_new "" VALUE 0x80000E80 RecordLayout_8 0 CompuMethod_33 -2147480000 2147480000 /end CHARACTERISTIC
/begin CHARACTERISTIC Duration_Ovr_ovr "" VALUE 0x80000E84 RecordLayout_1 0 CompuMethod_4 0 1 /end CHARACTERISTIC
/begin CHARACTERISTIC ECT_KeyUp_Count "Number of samples to average at key-up to produce signal value" VALUE 0x80000E85 RecordLayout_6 0 CompuMethod_1 -128 127 /end CHARACTERISTIC
/begin CHARACTERISTIC ECT_new "Override result of linear sensor characterization, in engineering units" VALUE 0x80000EAA RecordLayout_4 0 CompuMethod_57 -1E+17 1E+17 /end CHARACTERISTIC
/begin CHARACTERISTIC ECT_ovr "" VALUE 0x80000EAE RecordLayout_1 0 CompuMethod_4 0 1 /end CHARACTERISTIC
/begin CHARACTERISTIC ECT_SpkOfstMultMap "Multiplier on ECT spark offset table." MAP 0x80000EAF RecordLayout_4 0 CompuMethod_8 -1E+17 1E+17
 /begin AXIS_DESCR COM_AXIS RPM09In CompuMethod_2 9 -1E+17 1E+17 AXIS_PTS_REF RPM09IdxArr /end AXIS_DESCR
 /begin AXIS_DESCR COM_AXIS IndLoadNom09In CompuMethod_2 9 -1E+17 1E+17 AXIS_PTS_REF IndLoadNom09IdxArr /end AXIS_DESCR
/end CHARACTERISTIC
/begin CHARACTERISTIC ECT_SpkOfstTbl "" CURVE 0x80000FF3 RecordLayout_4 0 CompuMethod_2 -1E+17 1E+17
 /begin AXIS_DESCR COM_AXIS ECT05In CompuMethod_2 5 -1E+17 1E+17 AXIS_PTS_REF ECT05IdxArr /end AXIS_DESCR
/end CHARACTERISTIC
/begin CHARACTERISTIC ECTDefault "This is the initial default value should the sensor be in fault on key-up.  Otherwise the sensors outputs the last value prior to faulting" VALUE 0x8000101B RecordLayout_4 0 CompuMethod_57 -1E+17 1E+17 /end CHARACTERISTIC
/begin CHARACTERISTIC ECTEGRInterpolationTbl "" CURVE 0x8000101F RecordLayout_4 0 CompuMethod_2 -1E+17 1E+17
 /begin AXIS_DESCR COM_AXIS ECT05In CompuMethod_2 5 -1E+17 1E+17 AXIS_PTS_REF ECT05IdxArr /end AXIS_DESCR
/end CHARACTERISTIC
/begin CHARACTERISTIC ECTFiltConst "Filter time constant" VALUE 0x80001033 RecordLayout_4 0 CompuMethod_54 -1E+17 1E+17 /end CHARACTERISTIC
/begin CHARACTERISTIC ECTMax "Maximum allowable input, indicating short or open circuit" VALUE 0x800010D3 RecordLayout_4 0 CompuMethod_59 -1E+17 1E+17 /end CHARACTERISTIC
/begin CHARACTERISTIC ECTMin "Minimum allowable input, indicating short or open circuit" VALUE 0x800010D7 RecordLayout_4 0 CompuMethod_59 -1E+17 1E+17 /end CHARACTERISTIC
/begin CHARACTERISTIC ECTSensorPin "Analog input pin selection for ECTSensorPin" VALUE 0x800010DB RecordLayout_9 0 CompuMethod_60 -32768 32767 /end CHARACTERISTIC
/begin CHARACTERISTIC ECTSensorPin_ref "Reference Voltage Selection" VALUE 0x800010DD RecordLayout_1 0 CompuMethod_61 0 255 /end CHARACTERISTIC
/begin CHARACTERISTIC ECTTbl "Look up table to allownon-linear characterization of sensors" CURVE 0x800010DE RecordLayout_4 0 CompuMethod_57 -1E+17 1E+17
 /begin AXIS_DESCR COM_AXIS ECTADC CompuMethod_59 39 -1E+17 1E+17 AXIS_PTS_REF ECTIdxArr /end AXIS_DESCR
/end CHARACTERISTIC
/begin CHARACTERISTIC ECTTransFuelMultTbl "Transient fuel multiplier based on ECT.  Only engaged during transient fueling" CURVE 0x8000117A RecordLayout_4 0 CompuMethod_2 -1E+17 1E+17
 /begin AXIS_DESCR COM_AXIS ECT05In CompuMethod_2 5 -1E+17 1E+17 AXIS_PTS_REF ECT05IdxArr /end AXIS_DESCR
/end CHARACTERISTIC
/begin CHARACTERISTIC ECUP_Threshold "ADC voltage threshold above which ECU is considered powered" VALUE 0x8000118E RecordLayout_7 0 CompuMethod_62 0 1023 /end CHARACTERISTIC
/begin CHARACTERISTIC EGR_Hyst "" VALUE 0x80001190 RecordLayout_4 0 CompuMethod_2 -1E+17 1E+17 /end CHARACTERISTIC
/begin CHARACTERISTIC EGR_Interpolation_DCTbl "" CURVE 0x80001194 RecordLayout_4 0 CompuMethod_5 0 100
 /begin AXIS_DESCR COM_AXIS EGR_Prelookup_DCIn CompuMethod_2 11 -1E+17 1E+17 AXIS_PTS_REF EGR_Prelookup_DCIdxArr /end AXIS_DESCR
/end CHARACTERISTIC
/begin CHARACTERISTIC EGR_Interpolation_PWTbl "" CURVE 0x800011C0 RecordLayout_4 0 CompuMethod_53 0 1E+17
 /begin AXIS_DESCR COM_AXIS EGR_Prelookup_PWIn CompuMethod_2 11 -1E+17 1E+17 AXIS_PTS_REF EGR_Prelookup_PWIdxArr /end AXIS_DESCR
/end CHARACTERISTIC
/begin CHARACTERISTIC EGR_MultMap "Multiplier on ECT EGR table." MAP 0x800011EC RecordLayout_4 0 CompuMethod_8 -1E+17 1E+17
 /begin AXIS_DESCR COM_AXIS RPM09In CompuMethod_2 9 -1E+17 1E+17 AXIS_PTS_REF RPM09IdxArr /end AXIS_DESCR
 /begin AXIS_DESCR COM_AXIS IndLoadNom09In CompuMethod_2 9 -1E+17 1E+17 AXIS_PTS_REF IndLoadNom09IdxArr /end AXIS_DESCR
/end CHARACTERISTIC
/begin CHARACTERISTIC EGRPin "Analog input pin selection for EGRPin" VALUE 0x80001388 RecordLayout_9 0 CompuMethod_60 -32768 32767 /end CHARACTERISTIC
/begin CHARACTERISTIC EGRPin_ref "Reference Voltage Selection" VALUE 0x8000138A RecordLayout_1 0 CompuMethod_61 0 255 /end CHARACTERISTIC
/begin CHARACTERISTIC EGRSense_new "Override result of linear sensor characterization, in engineering units" VALUE 0x8000138B RecordLayout_4 0 CompuMethod_5 -1E+17 1E+17 /end CHARACTERISTIC
/begin CHARACTERISTIC EGRSense_ovr "" VALUE 0x8000138F RecordLayout_1 0 CompuMethod_4 0 1 /end CHARACTERISTIC
/begin CHARACTERISTIC EGRSenseDfltValue "This is the initial default value should the sensor be in fault on key-up.  Otherwise the sensors outputs the last value prior to faulting" VALUE 0x80001390 RecordLayout_4 0 CompuMethod_5 -1E+17 1E+17 /end CHARACTERISTIC
/begin CHARACTERISTIC EGRSenseFilterConst "Filter time constant" VALUE 0x80001394 RecordLayout_4 0 CompuMethod_54 -1E+17 1E+17 /end CHARACTERISTIC
/begin CHARACTERISTIC EGRSenseGain "Scaling from A/D counts to engineering units" VALUE 0x80001398 RecordLayout_4 0 CompuMethod_65 -1E+17 1E+17 /end CHARACTERISTIC
/begin CHARACTERISTIC EGRSenseInputHiFltPos "Maximum allowable input, indicating short or open circuit" VALUE 0x8000139C RecordLayout_4 0 CompuMethod_66 -1E+17 1E+17 /end CHARACTERISTIC
/begin CHARACTERISTIC EGRSenseInputLoFltPos "Minimum allowable input, indicating short or open circuit" VALUE 0x800013A0 RecordLayout_4 0 CompuMethod_66 -1E+17 1E+17 /end CHARACTERISTIC
/begin CHARACTERISTIC EGRSenseOfst "Offset after gain in engineering units" VALUE 0x800013A4 RecordLayout_4 0 CompuMethod_5 -1E+17 1E+17 /end CHARACTERISTIC
/begin CHARACTERISTIC Elec_PW_new "" VALUE 0x800013A8 RecordLayout_4 0 CompuMethod_2 -1E+17 1E+17 /end CHARACTERISTIC
/begin CHARACTERISTIC Elec_PW_ovr "" VALUE 0x800013AC RecordLayout_1 0 CompuMethod_4 0 1 /end CHARACTERISTIC
/begin CHARACTERISTIC EnableRPMFalling "If disabled, Min Gov will enable immediately after cranking without waiting for falling RPM." VALUE 0x800013AD RecordLayout_1 0 CompuMethod_42 0 1 /end CHARACTERISTIC
/begin CHARACTERISTIC EncoderCamPullup "Selects the pullup conditioning applied to the Cam Input" VALUE 0x800013AE RecordLayout_1 0 CompuMethod_67 0 1 /end CHARACTERISTIC
/begin CHARACTERISTIC EncoderCamSyncEdge "Selects which edge of a digital signal represents the synchronous edge of the CAM tooth.  It has no meaning for a variable reluctance type sensor" VALUE 0x800013AF RecordLayout_1 0 CompuMethod_68 0 1 /end CHARACTERISTIC
/begin CHARACTERISTIC EncoderCrankPullup "Selects the pullup conditioning applied to the Crank Input" VALUE 0x800013B0 RecordLayout_1 0 CompuMethod_67 0 1 /end CHARACTERISTIC
/begin CHARACTERISTIC EncoderCrankTeethAfterCam "The number of crank teeth between the synchronizing edge of the cam and the first tooth in the crank pattern.  May be -1 to disable explicit tooth counting." VALUE 0x800013B1 RecordLayout_9 0 CompuMethod_28 -1 32766 /end CHARACTERISTIC
/begin CHARACTERISTIC EncoderNumCylinders "Number of cylinders" VALUE 0x800013B3 RecordLayout_1 0 CompuMethod_1 1 8 /end CHARACTERISTIC
/begin CHARACTERISTIC EncoderSyncEdge "Selects which edge of a digital signal represents the synchronous edge of the tooth.  It has no meaning for a variable reluctance type sensor" VALUE 0x800013B4 RecordLayout_1 0 CompuMethod_68 0 1 /end CHARACTERISTIC
/begin CHARACTERISTIC EncoderTDCAngles "TDC angle of each cylinder in degrees after TDC1" VAL_BLK 0x800013B5 RecordLayout_9 0 CompuMethod_32 0 720 MATRIX_DIM 8 1 1 /end CHARACTERISTIC
/begin CHARACTERISTIC Engine_Crank_Ovr_new "" VALUE 0x800013C5 RecordLayout_1 0 CompuMethod_38 0 1 /end CHARACTERISTIC
/begin CHARACTERISTIC Engine_Crank_Ovr_ovr "" VALUE 0x800013C6 RecordLayout_1 0 CompuMethod_4 0 1 /end CHARACTERISTIC
/begin CHARACTERISTIC Engine_On_Ovr_new "" VALUE 0x800013C7 RecordLayout_1 0 CompuMethod_38 0 1 /end CHARACTERISTIC
/begin CHARACTERISTIC Engine_On_Ovr_ovr "" VALUE 0x800013C8 RecordLayout_1 0 CompuMethod_4 0 1 /end CHARACTERISTIC
/begin CHARACTERISTIC EngineAccelFiltConst "Filter time constant" VALUE 0x800013C9 RecordLayout_4 0 CompuMethod_54 -1E+17 1E+17 /end CHARACTERISTIC
/begin CHARACTERISTIC EngineShutdownDelayTime "Delays the engine shutdown when DelayedEngineShutdown fault-action is active." VALUE 0x800013CD RecordLayout_4 0 CompuMethod_21 0 1E+17 /end CHARACTERISTIC
/begin CHARACTERISTIC EngineState "Engine state based on RPM." VALUE 0x800013D1 RecordLayout_1 0 CompuMethod_73 0 255 /end CHARACTERISTIC
/begin CHARACTERISTIC EngineToEncoderOffset "" VALUE 0x800013D2 RecordLayout_4 0 CompuMethod_2 -1E+17 1E+17 /end CHARACTERISTIC
/begin CHARACTERISTIC EquivRatio_new "" VALUE 0x800013D6 RecordLayout_4 0 CompuMethod_2 -1E+17 1E+17 /end CHARACTERISTIC
/begin CHARACTERISTIC EquivRatio_ovr "" VALUE 0x800013DA RecordLayout_1 0 CompuMethod_4 0 1 /end CHARACTERISTIC
/begin CHARACTERISTIC EquivRatioDelta "Equivalence ratio has to be with this band of 1 to achieve close loop." VALUE 0x800013DB RecordLayout_4 0 CompuMethod_74 -1E+17 1E+17 /end CHARACTERISTIC
/begin CHARACTERISTIC Est_Absolute_Torque_Ovr_new "" VALUE 0x800013DF RecordLayout_4 0 CompuMethod_2 -1E+17 1E+17 /end CHARACTERISTIC
/begin CHARACTERISTIC Est_Absolute_Torque_Ovr_ovr "" VALUE 0x800013E3 RecordLayout_1 0 CompuMethod_4 0 1 /end CHARACTERISTIC
/begin CHARACTERISTIC EST_InitialPin "First pin selection for Spark Sequence.  Goes up from here depending on the Sequence Type and number of cylinders" VALUE 0x800013E4 RecordLayout_9 0 CompuMethod_76 -32768 32767 /end CHARACTERISTIC
/begin CHARACTERISTIC EST_OpenThreshold "ADC counts for the diagnostic inputs, above which the driver is considered an open-circuit" VALUE 0x800013E6 RecordLayout_7 0 CompuMethod_28 0 1023 /end CHARACTERISTIC
/begin CHARACTERISTIC Est_Relative_Torque_Ovr_new "" VALUE 0x800013E8 RecordLayout_4 0 CompuMethod_2 -1E+17 1E+17 /end CHARACTERISTIC
/begin CHARACTERISTIC Est_Relative_Torque_Ovr_ovr "" VALUE 0x800013EC RecordLayout_1 0 CompuMethod_4 0 1 /end CHARACTERISTIC
/begin CHARACTERISTIC EST_SequenceType "Select the type of spark sequence.  The number of pins used will depend on this selection" VALUE 0x800013ED RecordLayout_1 0 CompuMethod_77 0 255 /end CHARACTERISTIC
/begin CHARACTERISTIC Estimating_VBATT_Lv_Ovr_new "" VALUE 0x800013EE RecordLayout_4 0 CompuMethod_2 -1E+17 1E+17 /end CHARACTERISTIC
/begin CHARACTERISTIC Estimating_VBATT_Lv_Ovr_ovr "" VALUE 0x800013F2 RecordLayout_1 0 CompuMethod_4 0 1 /end CHARACTERISTIC
/begin CHARACTERISTIC ESTOP "" VALUE 0x800013F3 RecordLayout_1 0 CompuMethod_38 0 1 /end CHARACTERISTIC
/begin CHARACTERISTIC ESTOP_FuelInj_Ovr_new "" VALUE 0x800013F4 RecordLayout_1 0 CompuMethod_38 0 1 /end CHARACTERISTIC
/begin CHARACTERISTIC ESTOP_FuelInj_Ovr_ovr "" VALUE 0x800013F5 RecordLayout_1 0 CompuMethod_4 0 1 /end CHARACTERISTIC
/begin CHARACTERISTIC ESTOP_Ovr_new "" VALUE 0x800013F6 RecordLayout_1 0 CompuMethod_38 0 1 /end CHARACTERISTIC
/begin CHARACTERISTIC ESTOP_Ovr_ovr "" VALUE 0x800013F7 RecordLayout_1 0 CompuMethod_4 0 1 /end CHARACTERISTIC
/begin CHARACTERISTIC ETC_CutPower_Permitted "Cut power to ETC after ESTOP or long stalled period" VALUE 0x800013F8 RecordLayout_1 0 CompuMethod_79 0 1 /end CHARACTERISTIC
/begin CHARACTERISTIC ETC_CutPower_StallTime "Cut power to ETC after stalled this long" VALUE 0x800013F9 RecordLayout_4 0 CompuMethod_80 0 100 /end CHARACTERISTIC
/begin CHARACTERISTIC ETC_Frequency "Frequency of PWM output" VALUE 0x80001425 RecordLayout_4 0 CompuMethod_81 7.63 1E+17 /end CHARACTERISTIC
/begin CHARACTERISTIC ETC_I_MIN "H-bridge open circuit fault:  ETC current must exceed this when ETC duty cycle is > ETC_OC_MIN, otherwise an open circuit fault may exist." VALUE 0x80001429 RecordLayout_4 0 CompuMethod_82 0 1E+17 /end CHARACTERISTIC
/begin CHARACTERISTIC ETC_IGainMultTbl "Multiplier on the ETC I gain based on ETC error." CURVE 0x8000142D RecordLayout_4 0 CompuMethod_2 -1E+17 1E+17
 /begin AXIS_DESCR COM_AXIS ETC_ErrorIn CompuMethod_2 10 -1E+17 1E+17 AXIS_PTS_REF ETC_ErrorIdxArr /end AXIS_DESCR
/end CHARACTERISTIC
/begin CHARACTERISTIC ETC_LoAdaptRateLimit "Dictates the rate at which the ETC setpoint is decreased during shutdown to perform a low TPS adapt." VALUE 0x80001455 RecordLayout_4 0 CompuMethod_83 -1E+17 1E+17 /end CHARACTERISTIC
/begin CHARACTERISTIC ETC_new "Override result of linear sensor characterization, in engineering units" VALUE 0x80001459 RecordLayout_4 0 CompuMethod_2 -1E+17 1E+17 /end CHARACTERISTIC
/begin CHARACTERISTIC ETC_OC_MIN "H-bridge open circuit fault:  ETC duty cycle must exceed this to enable open circuit fault detection." VALUE 0x8000145D RecordLayout_4 0 CompuMethod_5 0 1E+17 /end CHARACTERISTIC
/begin CHARACTERISTIC ETC_Offset "Offset from engineering units to PWM duty cycle" VALUE 0x80001461 RecordLayout_4 0 CompuMethod_5 -1E+17 1E+17 /end CHARACTERISTIC
/begin CHARACTERISTIC ETC_ovr "" VALUE 0x80001465 RecordLayout_1 0 CompuMethod_4 0 1 /end CHARACTERISTIC
/begin CHARACTERISTIC ETC_PGainMultTbl "Multiplier on the ETC P gain based on ETC error." CURVE 0x80001466 RecordLayout_4 0 CompuMethod_2 -1E+17 1E+17
 /begin AXIS_DESCR COM_AXIS ETC_ErrorIn CompuMethod_2 10 -1E+17 1E+17 AXIS_PTS_REF ETC_ErrorIdxArr /end AXIS_DESCR
/end CHARACTERISTIC
/begin CHARACTERISTIC ETC_ShutdownLoAdaptError "Drive ETC closed until this error has been achieved in order to catch lo side adapt point." VALUE 0x800014DE RecordLayout_4 0 CompuMethod_5 -1E+17 1E+17 /end CHARACTERISTIC
/begin CHARACTERISTIC ETC_SpringTestHiThresh "Before initiating spring test during shutdown, open the ETC to this setpoint. When achieved, the ETC controller will release the ETC to have the spring close the valve." VALUE 0x800014E2 RecordLayout_4 0 CompuMethod_5 -1E+17 1E+17 /end CHARACTERISTIC
/begin CHARACTERISTIC ETC_SpringTestLoThresh "Spring test timer will measure time of travel between ETC_SpringTestHiThresh and ETC_SpringTestLoThresh." VALUE 0x800014E6 RecordLayout_4 0 CompuMethod_5 -1E+17 1E+17 /end CHARACTERISTIC
/begin CHARACTERISTIC ETC_SpringTestTimerThresh "During spring test at shutdown, TPS must fall to 0% within this time to prevent fault." VALUE 0x800014EA RecordLayout_4 0 CompuMethod_21 -1E+17 1E+17 /end CHARACTERISTIC
/begin CHARACTERISTIC ETC_StickingThresh "Defines error limit between TPS_Request and TPS where ETC sticking fault will be set." VALUE 0x800014EE RecordLayout_4 0 CompuMethod_5 -1E+17 1E+17 /end CHARACTERISTIC
/begin CHARACTERISTIC ETC_VoltageCompTbl "Gain on ETC duty cycle based on DRVP" CURVE 0x800014F2 RecordLayout_4 0 CompuMethod_2 -1E+17 1E+17
 /begin AXIS_DESCR COM_AXIS SysVolt09In CompuMethod_2 9 -1E+17 1E+17 AXIS_PTS_REF SysVolt09IdxArr /end AXIS_DESCR
/end CHARACTERISTIC
/begin CHARACTERISTIC ETCDamperSwitchHyst "Hysterisis around the ThrPosDamperSwitchThresh." VALUE 0x80001516 RecordLayout_4 0 CompuMethod_83 -1E+17 1E+17 /end CHARACTERISTIC
/begin CHARACTERISTIC ETCDamperSwitchThresh "When filtered derivative of TPS is greater than this threshold, Damper_Up gain will be used." VALUE 0x8000151A RecordLayout_4 0 CompuMethod_83 -1E+17 1E+17 /end CHARACTERISTIC
/begin CHARACTERISTIC ETCDamperTPSFilt "Filter time constant" VALUE 0x8000151E RecordLayout_4 0 CompuMethod_54 -1E+17 1E+17 /end CHARACTERISTIC
/begin CHARACTERISTIC ETCDampGainDown "PID Damper Gain - Down Direction" VALUE 0x80001522 RecordLayout_4 0 CompuMethod_8 -1E+17 1E+17 /end CHARACTERISTIC
/begin CHARACTERISTIC ETCDampGainUp "PID Damper Gain - Up Direction" VALUE 0x80001526 RecordLayout_4 0 CompuMethod_8 -1E+17 1E+17 /end CHARACTERISTIC
/begin CHARACTERISTIC ETCDCOffsetTbl "Duty cycle offset based on desired ETC position." CURVE 0x8000152A RecordLayout_4 0 CompuMethod_5 -1E+17 1E+17
 /begin AXIS_DESCR COM_AXIS ETC_SetpointIn CompuMethod_2 20 -1E+17 1E+17 AXIS_PTS_REF ETC_SetpointIdxArr /end AXIS_DESCR
/end CHARACTERISTIC
/begin CHARACTERISTIC ETCDGain "PID Derivative Gain" VALUE 0x8000157A RecordLayout_4 0 CompuMethod_8 -1E+17 1E+17 /end CHARACTERISTIC
/begin CHARACTERISTIC ETCErrorGain "PID Error Gain" VALUE 0x8000157E RecordLayout_4 0 CompuMethod_8 -1E+17 1E+17 /end CHARACTERISTIC
/begin CHARACTERISTIC ETCIGain "PID Integral Gain" VALUE 0x80001582 RecordLayout_4 0 CompuMethod_8 -1E+17 1E+17 /end CHARACTERISTIC
/begin CHARACTERISTIC ETCIMax "PID Integrator Upper Limit" VALUE 0x80001586 RecordLayout_4 0 CompuMethod_5 -1E+17 1E+17 /end CHARACTERISTIC
/begin CHARACTERISTIC ETCIMin "PID Integrator Lower Limit" VALUE 0x8000158A RecordLayout_4 0 CompuMethod_5 -1E+17 1E+17 /end CHARACTERISTIC
/begin CHARACTERISTIC ETCLwrLim "Lower Limit Value" VALUE 0x8000158E RecordLayout_4 0 CompuMethod_5 -1E+17 1E+17 /end CHARACTERISTIC
/begin CHARACTERISTIC ETCPGain "PID Proportional Gain" VALUE 0x80001592 RecordLayout_4 0 CompuMethod_8 -1E+17 1E+17 /end CHARACTERISTIC
/begin CHARACTERISTIC ETCPin "PWM output pin selection for ETCPin" VALUE 0x80001596 RecordLayout_9 0 CompuMethod_84 -32768 32767 /end CHARACTERISTIC
/begin CHARACTERISTIC ETCReq_new "Override the electronic throttle position" VALUE 0x80001598 RecordLayout_4 0 CompuMethod_5 0 100 /end CHARACTERISTIC
/begin CHARACTERISTIC ETCReq_ovr "" VALUE 0x8000159C RecordLayout_1 0 CompuMethod_4 0 1 /end CHARACTERISTIC
/begin CHARACTERISTIC ETCShutdownTimerThresh "Time limit in Stall State after which ETC will shutdown." VALUE 0x80001631 RecordLayout_4 0 CompuMethod_21 -1E+17 1E+17 /end CHARACTERISTIC
/begin CHARACTERISTIC ETCTuneAmp "" VALUE 0x80001635 RecordLayout_4 0 CompuMethod_2 -1E+17 1E+17 /end CHARACTERISTIC
/begin CHARACTERISTIC ETCTuneEnable "" VALUE 0x80001639 RecordLayout_1 0 CompuMethod_55 0 1 /end CHARACTERISTIC
/begin CHARACTERISTIC ETCTuneFreq "" VALUE 0x8000163A RecordLayout_4 0 CompuMethod_81 0 100 /end CHARACTERISTIC
/begin CHARACTERISTIC ETCTuneOffset "" VALUE 0x8000163E RecordLayout_4 0 CompuMethod_2 -1E+17 1E+17 /end CHARACTERISTIC
/begin CHARACTERISTIC ETCUprLim "Upper Limit Value" VALUE 0x80001642 RecordLayout_4 0 CompuMethod_5 -1E+17 1E+17 /end CHARACTERISTIC
/begin CHARACTERISTIC Ethanol_SpkOfstMultMap "Multiplier on ECT spark offset table." MAP 0x80001646 RecordLayout_4 0 CompuMethod_8 -1E+17 1E+17
 /begin AXIS_DESCR COM_AXIS RPM09In CompuMethod_2 9 -1E+17 1E+17 AXIS_PTS_REF RPM09IdxArr /end AXIS_DESCR
 /begin AXIS_DESCR COM_AXIS IndLoadNom09In CompuMethod_2 9 -1E+17 1E+17 AXIS_PTS_REF IndLoadNom09IdxArr /end AXIS_DESCR
/end CHARACTERISTIC
/begin CHARACTERISTIC EthanolInterpolationTbl "" CURVE 0x8000178A RecordLayout_4 0 CompuMethod_2 -1E+17 1E+17
 /begin AXIS_DESCR COM_AXIS EthanolPreLookupIn CompuMethod_2 11 -1E+17 1E+17 AXIS_PTS_REF EthanolPreLookupIdxArr /end AXIS_DESCR
/end CHARACTERISTIC
/begin CHARACTERISTIC Fall_Rate "" VALUE 0x800017E2 RecordLayout_4 0 CompuMethod_2 -1E+17 1E+17 /end CHARACTERISTIC
/begin CHARACTERISTIC Fault_Ovr_new "" VALUE 0x800017E6 RecordLayout_4 0 CompuMethod_2 -1E+17 1E+17 /end CHARACTERISTIC
/begin CHARACTERISTIC Fault_Ovr_ovr "" VALUE 0x800017EA RecordLayout_1 0 CompuMethod_4 0 1 /end CHARACTERISTIC
/begin CHARACTERISTIC Faults_Light_Status_Ovr_new "" VALUE 0x80001F8A RecordLayout_4 0 CompuMethod_2 -1E+17 1E+17 /end CHARACTERISTIC
/begin CHARACTERISTIC Faults_Light_Status_Ovr_ovr "" VALUE 0x80001F8E RecordLayout_1 0 CompuMethod_4 0 1 /end CHARACTERISTIC
/begin CHARACTERISTIC FGND_10XRTI_PERIODIC_RunCnt "The number of times to execute FGND_10XRTI_PERIODIC before pausing.  -1 means run forever" VALUE 0x80001F8F RecordLayout_8 0 CompuMethod_28 -1 2147480000 /end CHARACTERISTIC
/begin CHARACTERISTIC FGND_20XRTI_PERIODIC_RunCnt "The number of times to execute FGND_20XRTI_PERIODIC before pausing.  -1 means run forever" VALUE 0x80001F93 RecordLayout_8 0 CompuMethod_28 -1 2147480000 /end CHARACTERISTIC
/begin CHARACTERISTIC FGND_2XRTI_PERIODIC_RunCnt "The number of times to execute FGND_2XRTI_PERIODIC before pausing.  -1 means run forever" VALUE 0x80001F97 RecordLayout_8 0 CompuMethod_28 -1 2147480000 /end CHARACTERISTIC
/begin CHARACTERISTIC FGND_5XRTI_PERIODIC_RunCnt "The number of times to execute FGND_5XRTI_PERIODIC before pausing.  -1 means run forever" VALUE 0x80001F9B RecordLayout_8 0 CompuMethod_28 -1 2147480000 /end CHARACTERISTIC
/begin CHARACTERISTIC FGND_MID_TDC_EVENT_RunCnt "The number of times to execute FGND_MID_TDC_EVENT before pausing.  -1 means run forever" VALUE 0x80001F9F RecordLayout_8 0 CompuMethod_28 -1 2147480000 /end CHARACTERISTIC
/begin CHARACTERISTIC FGND_RTI_Period "Base rate of the FGND_RTI_PERIODIC event" VALUE 0x80001FA3 RecordLayout_7 0 CompuMethod_75 0 65535 /end CHARACTERISTIC
/begin CHARACTERISTIC FGND_RTI_PERIODIC_RunCnt "The number of times to execute FGND_RTI_PERIODIC before pausing.  -1 means run forever" VALUE 0x80001FA5 RecordLayout_8 0 CompuMethod_28 -1 2147480000 /end CHARACTERISTIC
/begin CHARACTERISTIC FGND_TDC_EVENT_RunCnt "The number of times to execute FGND_TDC_EVENT before pausing.  -1 means run forever" VALUE 0x80001FA9 RecordLayout_8 0 CompuMethod_28 -1 2147480000 /end CHARACTERISTIC
/begin CHARACTERISTIC FGND_TDC1_EVENT_RunCnt "The number of times to execute FGND_TDC1_EVENT before pausing.  -1 means run forever" VALUE 0x80001FAD RecordLayout_8 0 CompuMethod_28 -1 2147480000 /end CHARACTERISTIC
/begin CHARACTERISTIC FgndTimeStackMargin "When the available stack space drops below this threshold, the application performs a safety stop" VALUE 0x80001FB1 RecordLayout_7 0 CompuMethod_28 0 3072 /end CHARACTERISTIC
/begin CHARACTERISTIC Filter_Type_Selection "Filter Section For Fuel Oxygenation Sensor" VALUE 0x80001FB3 RecordLayout_1 0 CompuMethod_93 0 255 /end CHARACTERISTIC
/begin CHARACTERISTIC ForcedShutDownTimerThresh "If ECUP is off for this time and application has not turned off, then force a shutdown routine." VALUE 0x80001FB4 RecordLayout_4 0 CompuMethod_54 0 1023 /end CHARACTERISTIC
/begin CHARACTERISTIC Fuel_Cyl1_offset "Provide lock and relative offset to input signal." VALUE 0x80001FB8 RecordLayout_4 0 CompuMethod_12 -1E+17 1E+17 /end CHARACTERISTIC
/begin CHARACTERISTIC Fuel_Cyl1_ovr "Provide lock and relative offset to input signal." VALUE 0x80001FBC RecordLayout_1 0 CompuMethod_95 0 1 /end CHARACTERISTIC
/begin CHARACTERISTIC Fuel_Cyl2_offset "Provide lock and relative offset to input signal." VALUE 0x80001FBD RecordLayout_4 0 CompuMethod_12 -1E+17 1E+17 /end CHARACTERISTIC
/begin CHARACTERISTIC Fuel_Cyl2_ovr "Provide lock and relative offset to input signal." VALUE 0x80001FC1 RecordLayout_1 0 CompuMethod_95 0 1 /end CHARACTERISTIC
/begin CHARACTERISTIC FuelPresPin "Analog input pin selection for FuelPresPin" VALUE 0x800022D6 RecordLayout_9 0 CompuMethod_60 -32768 32767 /end CHARACTERISTIC
/begin CHARACTERISTIC FuelPresPin_ref "Reference Voltage Selection" VALUE 0x800022D8 RecordLayout_1 0 CompuMethod_61 0 255 /end CHARACTERISTIC
/begin CHARACTERISTIC FuelPumpPin "Digital output pin selection for DOut7679p0004" VALUE 0x800022D9 RecordLayout_9 0 CompuMethod_100 -32768 32767 /end CHARACTERISTIC
/begin CHARACTERISTIC FuelPumpStartTime "The length of time for the Fuel Pump relay to be enabled at startup" VALUE 0x800022DB RecordLayout_4 0 CompuMethod_54 0 100 /end CHARACTERISTIC
/begin CHARACTERISTIC FuelSensorPin "Frequency input pin selection for FuelSensorPin" VALUE 0x800022FC RecordLayout_9 0 CompuMethod_101 -32768 32767 /end CHARACTERISTIC
/begin CHARACTERISTIC GaugeFuelPress "Fuel pressure of fuel rail." VALUE 0x80002315 RecordLayout_4 0 CompuMethod_19 0 1E+17 /end CHARACTERISTIC
/begin CHARACTERISTIC HardRevOffset "RPM rev limit for hard action to be taken" VALUE 0x80002358 RecordLayout_4 0 CompuMethod_26 0 1E+17 /end CHARACTERISTIC
/begin CHARACTERISTIC HeapMargin "When the available heap drops below this threshold, the application performs a safety stop" VALUE 0x8000235C RecordLayout_7 0 CompuMethod_28 0 4096 /end CHARACTERISTIC
/begin CHARACTERISTIC IAT_SpkOfstMultMap "Multiplier on IAT2 spark offset table." MAP 0x80002369 RecordLayout_4 0 CompuMethod_8 -1E+17 1E+17
 /begin AXIS_DESCR COM_AXIS RPM09In CompuMethod_2 9 -1E+17 1E+17 AXIS_PTS_REF RPM09IdxArr /end AXIS_DESCR
 /begin AXIS_DESCR COM_AXIS IndLoadNom09In CompuMethod_2 9 -1E+17 1E+17 AXIS_PTS_REF IndLoadNom09IdxArr /end AXIS_DESCR
/end CHARACTERISTIC
/begin CHARACTERISTIC IAT_SpkOfstTbl "" CURVE 0x800024AD RecordLayout_4 0 CompuMethod_2 -1E+17 1E+17
 /begin AXIS_DESCR COM_AXIS IAT05In CompuMethod_2 5 -1E+17 1E+17 AXIS_PTS_REF IAT05IdxArr /end AXIS_DESCR
/end CHARACTERISTIC
/begin CHARACTERISTIC IATSensorPin "Analog input pin selection for IATSensorPin" VALUE 0x800025C5 RecordLayout_9 0 CompuMethod_60 -32768 32767 /end CHARACTERISTIC
/begin CHARACTERISTIC IATSensorPin_ref "Reference Voltage Selection" VALUE 0x800025C7 RecordLayout_1 0 CompuMethod_61 0 255 /end CHARACTERISTIC
/begin CHARACTERISTIC IDLE_EVENT_RunCnt "The number of times to execute IDLE_EVENT before pausing.  -1 means run forever" VALUE 0x80002664 RecordLayout_8 0 CompuMethod_28 -1 2147480000 /end CHARACTERISTIC
/begin CHARACTERISTIC IdleStackMargin "When the available stack space drops below this threshold, the application performs a safety stop" VALUE 0x80002670 RecordLayout_7 0 CompuMethod_28 0 1024 /end CHARACTERISTIC
/begin CHARACTERISTIC InGearMinGovEntryRPMDelta "RPM above setpoint where Min Gov will enable when RPM is falling into idle." VALUE 0x8000272E RecordLayout_4 0 CompuMethod_26 -1E+17 1E+17 /end CHARACTERISTIC
/begin CHARACTERISTIC INJ_Behavior "Select the type of injector behavior.  Transient behavior will take more CPU time, but will allow make-up pulses.  Batch Mode always uses Standard Behavior." VALUE 0x80002736 RecordLayout_1 0 CompuMethod_111 0 255 /end CHARACTERISTIC
/begin CHARACTERISTIC INJ_InitialPin "First pin selection for Injector Sequence.  Goes up from here depending on the Sequence Type and number of cylinders" VALUE 0x80002737 RecordLayout_9 0 CompuMethod_112 -32768 32767 /end CHARACTERISTIC
/begin CHARACTERISTIC INJ_SequenceType "Select the type of injector sequence.  The number of pins used will depend on this selection" VALUE 0x80002739 RecordLayout_1 0 CompuMethod_113 0 255 /end CHARACTERISTIC
/begin CHARACTERISTIC InjdPCompTbl "Injector characterization compenastion based on dP across injector." CURVE 0x8000275E RecordLayout_4 0 CompuMethod_114 -1E+17 1E+17
 /begin AXIS_DESCR COM_AXIS InjDeltaPress09In CompuMethod_2 9 -1E+17 1E+17 AXIS_PTS_REF InjDeltaPress09IdxArr /end AXIS_DESCR
/end CHARACTERISTIC
/begin CHARACTERISTIC Injector1Enable "" VALUE 0x80002782 RecordLayout_1 0 CompuMethod_55 0 1 /end CHARACTERISTIC
/begin CHARACTERISTIC Injector2Enable "" VALUE 0x80002783 RecordLayout_1 0 CompuMethod_55 0 1 /end CHARACTERISTIC
/begin CHARACTERISTIC Injector3Enable "" VALUE 0x80002784 RecordLayout_1 0 CompuMethod_55 0 1 /end CHARACTERISTIC
/begin CHARACTERISTIC Injector4Enable "" VALUE 0x80002785 RecordLayout_1 0 CompuMethod_55 0 1 /end CHARACTERISTIC
/begin CHARACTERISTIC Injector5Enable "" VALUE 0x80002786 RecordLayout_1 0 CompuMethod_55 0 1 /end CHARACTERISTIC
/begin CHARACTERISTIC Injector6Enable "" VALUE 0x80002787 RecordLayout_1 0 CompuMethod_55 0 1 /end CHARACTERISTIC
/begin CHARACTERISTIC Injector7Enable "" VALUE 0x80002788 RecordLayout_1 0 CompuMethod_55 0 1 /end CHARACTERISTIC
/begin CHARACTERISTIC Injector8Enable "" VALUE 0x80002789 RecordLayout_1 0 CompuMethod_55 0 1 /end CHARACTERISTIC
/begin CHARACTERISTIC InjectorMaxDuration "Maximum duration for an injector pulse.  Must be a multiple of 5ms" VALUE 0x8000278A RecordLayout_4 0 CompuMethod_41 -1E+17 1E+17 /end CHARACTERISTIC
/begin CHARACTERISTIC InjGain "Gain value used in the linear transformation of FPC to mechanical pulsewidth." VALUE 0x80002797 RecordLayout_4 0 CompuMethod_115 0 1E+17 /end CHARACTERISTIC
/begin CHARACTERISTIC InjOffset "Offset value used in the linear transformation of FPC to mechanical pulsewidth." VALUE 0x8000279B RecordLayout_4 0 CompuMethod_116 -1E+17 1E+17 /end CHARACTERISTIC
/begin CHARACTERISTIC InjTurnOffTbl "Injector turn off time" CURVE 0x8000279F RecordLayout_4 0 CompuMethod_40 -1E+17 1E+17
 /begin AXIS_DESCR COM_AXIS InjDeltaPress09In CompuMethod_2 9 -1E+17 1E+17 AXIS_PTS_REF InjDeltaPress09IdxArr /end AXIS_DESCR
/end CHARACTERISTIC
/begin CHARACTERISTIC InjTurnOnTbl "Injector turn on time." CURVE 0x800027C3 RecordLayout_4 0 CompuMethod_40 -1E+17 1E+17
 /begin AXIS_DESCR COM_AXIS SysVolt09In CompuMethod_2 9 -1E+17 1E+17 AXIS_PTS_REF SysVolt09IdxArr /end AXIS_DESCR
/end CHARACTERISTIC
/begin CHARACTERISTIC IntakeAirTempEnrichmentMap "Multiplier on base eq. ratio as a function of IAT and ECT" MAP 0x800027E7 RecordLayout_4 0 CompuMethod_8 0 1E+17
 /begin AXIS_DESCR COM_AXIS IAT05In CompuMethod_2 5 -1E+17 1E+17 AXIS_PTS_REF IAT05IdxArr /end AXIS_DESCR
 /begin AXIS_DESCR COM_AXIS IndLoadNom09In CompuMethod_2 9 -1E+17 1E+17 AXIS_PTS_REF IndLoadNom09IdxArr /end AXIS_DESCR
/end CHARACTERISTIC
/begin CHARACTERISTIC InterruptStackMargin "When the available stack space drops below this threshold, the application performs a safety stop" VALUE 0x8000289B RecordLayout_7 0 CompuMethod_28 0 1536 /end CHARACTERISTIC
/begin CHARACTERISTIC Load_On "" VALUE 0x80002B2F RecordLayout_4 0 CompuMethod_2 -1E+17 1E+17 /end CHARACTERISTIC
/begin CHARACTERISTIC MAF_Pin "Frequency input pin selection for MAF_Pin" VALUE 0x80002B44 RecordLayout_9 0 CompuMethod_101 -32768 32767 /end CHARACTERISTIC
/begin CHARACTERISTIC MAF_Source "Selects the source for the fueling algorithm" VALUE 0x80002B4D RecordLayout_1 0 CompuMethod_120 0 255 /end CHARACTERISTIC
/begin CHARACTERISTIC MakeUpEOIMap "End of injection timing for transient makeup fuel pulse" MAP 0x80002CDB RecordLayout_4 0 CompuMethod_43 -1000 1000
 /begin AXIS_DESCR COM_AXIS RPM09In CompuMethod_2 9 -1E+17 1E+17 AXIS_PTS_REF RPM09IdxArr /end AXIS_DESCR
 /begin AXIS_DESCR COM_AXIS IndLoadNom09In CompuMethod_2 9 -1E+17 1E+17 AXIS_PTS_REF IndLoadNom09IdxArr /end AXIS_DESCR
/end CHARACTERISTIC
/begin CHARACTERISTIC MAPSensorPin "Analog input pin selection for MAPSensorPin" VALUE 0x80002E54 RecordLayout_9 0 CompuMethod_60 -32768 32767 /end CHARACTERISTIC
/begin CHARACTERISTIC MAPSensorPin_ref "Reference Voltage Selection" VALUE 0x80002E56 RecordLayout_1 0 CompuMethod_61 0 255 /end CHARACTERISTIC
/begin CHARACTERISTIC MediumRevOffset "RPM rev limit for medium action to be taken" VALUE 0x80003032 RecordLayout_4 0 CompuMethod_26 0 1E+17 /end CHARACTERISTIC
/begin CHARACTERISTIC MinGovAirPcntHyst "Hysteresis around MinGovEntryAirPcnt where Min Gov will disable." VALUE 0x8000303A RecordLayout_4 0 CompuMethod_5 -1E+17 1E+17 /end CHARACTERISTIC
/begin CHARACTERISTIC MinGovEntryAirPcnt "Percent air (TPS or APP) position where below which Min Gov will enable." VALUE 0x80003052 RecordLayout_4 0 CompuMethod_5 -1E+17 1E+17 /end CHARACTERISTIC
/begin CHARACTERISTIC MinGovEntryAirTimeThresh "If entry AirPcnt condition is satisfied, but RPM is high, Min Gov will enable if this time is exceeded." VALUE 0x80003056 RecordLayout_4 0 CompuMethod_21 -1E+17 1E+17 /end CHARACTERISTIC
/begin CHARACTERISTIC MinMakeUpPW "Minimum change in injector pulse width that will trigger a make-up pulse." VALUE 0x8000305A RecordLayout_4 0 CompuMethod_41 -1E+17 1E+17 /end CHARACTERISTIC
/begin CHARACTERISTIC Mode "" VALUE 0x800030AA RecordLayout_1 0 CompuMethod_127 0 255 /end CHARACTERISTIC
/begin CHARACTERISTIC Motor_Hot "" VALUE 0x800030AB RecordLayout_4 0 CompuMethod_2 -1E+17 1E+17 /end CHARACTERISTIC
/begin CHARACTERISTIC Motor_Warm "" VALUE 0x800030BD RecordLayout_4 0 CompuMethod_2 -1E+17 1E+17 /end CHARACTERISTIC
/begin CHARACTERISTIC O2_Heater "Digital output pin selection for DOut7973p0001" VALUE 0x80003109 RecordLayout_9 0 CompuMethod_100 -32768 32767 /end CHARACTERISTIC
/begin CHARACTERISTIC O2ControlEnable "Enables O2 control" VALUE 0x800031C4 RecordLayout_1 0 CompuMethod_135 0 1 /end CHARACTERISTIC
/begin CHARACTERISTIC O2DisablmentMult "" VALUE 0x800031E1 RecordLayout_6 0 CompuMethod_14 -128 127 /end CHARACTERISTIC
/begin CHARACTERISTIC O2StartUpDelayTbl "Delay O2 enable until TimeSinceRun is greater than this time." CURVE 0x8000324E RecordLayout_4 0 CompuMethod_21 -1E+17 1E+17
 /begin AXIS_DESCR COM_AXIS ECT_KeyUp09In CompuMethod_57 9 -1E+17 1E+17 AXIS_PTS_REF ECT_KeyUp09IdxArr /end AXIS_DESCR
/end CHARACTERISTIC
/begin CHARACTERISTIC OilPresPin "Analog input pin selection for OilPresPin" VALUE 0x80003297 RecordLayout_9 0 CompuMethod_60 -32768 32767 /end CHARACTERISTIC
/begin CHARACTERISTIC OilPresPin_ref "Reference Voltage Selection" VALUE 0x80003299 RecordLayout_1 0 CompuMethod_61 0 255 /end CHARACTERISTIC
/begin CHARACTERISTIC OilPumpPin "Digital output pin selection for DOut7963p0001" VALUE 0x8000329A RecordLayout_9 0 CompuMethod_100 -32768 32767 /end CHARACTERISTIC
/begin CHARACTERISTIC OilPumpStartTime "The length of time for the Fuel Pump relay to be enabled at startup" VALUE 0x8000329C RecordLayout_4 0 CompuMethod_54 0 100 /end CHARACTERISTIC
/begin CHARACTERISTIC ONE_SECOND_EVENT_RunCnt "The number of times to execute ONE_SECOND_EVENT before pausing.  -1 means run forever" VALUE 0x800032A0 RecordLayout_8 0 CompuMethod_28 -1 2147480000 /end CHARACTERISTIC
/begin CHARACTERISTIC ONESHOT "One Shot output pin selection for ONESHOT" VALUE 0x800032A4 RecordLayout_9 0 CompuMethod_140 -32768 32767 /end CHARACTERISTIC
/begin CHARACTERISTIC OpenThrottleFPCScalar "Crank FPC is scaled up with throttle opening for mechanical throttle systems, this parameter sets the gain for this relationship.  CrankFPC=CrankFPC*(1+TPS/100*FPCScalar)." VALUE 0x800032AA RecordLayout_4 0 CompuMethod_39 -1E+17 1E+17 /end CHARACTERISTIC
/begin CHARACTERISTIC PostO2Pin "Analog input pin selection for PostO2Pin" VALUE 0x80003327 RecordLayout_9 0 CompuMethod_60 -32768 32767 /end CHARACTERISTIC
/begin CHARACTERISTIC PostO2Pin_ref "Reference Voltage Selection" VALUE 0x80003329 RecordLayout_1 0 CompuMethod_61 0 255 /end CHARACTERISTIC
/begin CHARACTERISTIC PrimarySOIMap "Injection timing for primary fuel pulse - SOI or EOI depending on Inj Config" MAP 0x8000332A RecordLayout_4 0 CompuMethod_43 -1000 1000
 /begin AXIS_DESCR COM_AXIS RPM09In CompuMethod_2 9 -1E+17 1E+17 AXIS_PTS_REF RPM09IdxArr /end AXIS_DESCR
 /begin AXIS_DESCR COM_AXIS IndLoadNom09In CompuMethod_2 9 -1E+17 1E+17 AXIS_PTS_REF IndLoadNom09IdxArr /end AXIS_DESCR
/end CHARACTERISTIC
/begin CHARACTERISTIC ProcessorReboot "Reboots the processor when set." VALUE 0x8000346E RecordLayout_1 0 CompuMethod_143 0 1 /end CHARACTERISTIC
/begin CHARACTERISTIC PseudoRPM "" VALUE 0x8000346F RecordLayout_7 0 CompuMethod_28 0 65535 /end CHARACTERISTIC
/begin CHARACTERISTIC RevLimitHyst "Hysteresis applied to MaxRPM once rev limit threshold is satisfied" VALUE 0x80003477 RecordLayout_4 0 CompuMethod_26 0 12000 /end CHARACTERISTIC
/begin CHARACTERISTIC Rise_Rate "" VALUE 0x80003704 RecordLayout_4 0 CompuMethod_2 -1E+17 1E+17 /end CHARACTERISTIC
/begin CHARACTERISTIC RPMFiltConst "Filter time constant" VALUE 0x800037D5 RecordLayout_4 0 CompuMethod_54 -1E+17 1E+17 /end CHARACTERISTIC
/begin CHARACTERISTIC RunLatchTDCs "Number of TDCs required to be above CrankToRunRPMThresh before the RUN mode is invoked." VALUE 0x800037E3 RecordLayout_1 0 CompuMethod_149 0 255 /end CHARACTERISTIC
/begin CHARACTERISTIC SecondarySpdLim_Cal "" VALUE 0x800037E9 RecordLayout_4 0 CompuMethod_2 -1E+17 1E+17 /end CHARACTERISTIC
/begin CHARACTERISTIC SecondaryVoltLim_Cal "" VALUE 0x800037ED RecordLayout_4 0 CompuMethod_2 -1E+17 1E+17 /end CHARACTERISTIC
/begin CHARACTERISTIC SensVoltSensorPin "Analog input pin selection for SensVoltSensorPin" VALUE 0x80003813 RecordLayout_9 0 CompuMethod_60 -32768 32767 /end CHARACTERISTIC
/begin CHARACTERISTIC SensVoltSensorPin_ref "Reference Voltage Selection" VALUE 0x80003815 RecordLayout_1 0 CompuMethod_61 0 255 /end CHARACTERISTIC
/begin CHARACTERISTIC ShutDownTasksComplete "" VALUE 0x80003816 RecordLayout_1 0 CompuMethod_152 0 1 /end CHARACTERISTIC
/begin CHARACTERISTIC SparkAdvMap "Base spark advance map." MAP 0x80003844 RecordLayout_4 0 CompuMethod_43 -1E+17 1E+17
 /begin AXIS_DESCR COM_AXIS RPM17In CompuMethod_2 17 -1E+17 1E+17 AXIS_PTS_REF RPM17IdxArr /end AXIS_DESCR
 /begin AXIS_DESCR COM_AXIS IndLoadNom17In CompuMethod_2 17 -1E+17 1E+17 AXIS_PTS_REF IndLoadNom17IdxArr /end AXIS_DESCR
/end CHARACTERISTIC
/begin CHARACTERISTIC SparkEnableCyl1 "Disable spark to particular cylinder." VALUE 0x80003CCD RecordLayout_1 0 CompuMethod_154 0 1 /end CHARACTERISTIC
/begin CHARACTERISTIC SparkEnableCyl2 "Disable spark to particular cylinder." VALUE 0x80003CCE RecordLayout_1 0 CompuMethod_154 0 1 /end CHARACTERISTIC
/begin CHARACTERISTIC SparkEnableCyl3 "Disable spark to particular cylinder." VALUE 0x80003CCF RecordLayout_1 0 CompuMethod_154 0 1 /end CHARACTERISTIC
/begin CHARACTERISTIC SparkEnableCyl4 "Disable spark to particular cylinder." VALUE 0x80003CD0 RecordLayout_1 0 CompuMethod_154 0 1 /end CHARACTERISTIC
/begin CHARACTERISTIC SparkEnableCyl5 "Disable spark to particular cylinder." VALUE 0x80003CD1 RecordLayout_1 0 CompuMethod_154 0 1 /end CHARACTERISTIC
/begin CHARACTERISTIC SparkEnableCyl6 "Disable spark to particular cylinder." VALUE 0x80003CD2 RecordLayout_1 0 CompuMethod_154 0 1 /end CHARACTERISTIC
/begin CHARACTERISTIC SparkEnableCyl7 "Disable spark to particular cylinder." VALUE 0x80003CD3 RecordLayout_1 0 CompuMethod_154 0 1 /end CHARACTERISTIC
/begin CHARACTERISTIC SparkEnableCyl8 "Disable spark to particular cylinder." VALUE 0x80003CD4 RecordLayout_1 0 CompuMethod_154 0 1 /end CHARACTERISTIC
/begin CHARACTERISTIC SparkEnableTDCCounts "Do not enable spark until this many TDCs have occurred in order to guarantee cam synchronization. This number should typically be 2." VALUE 0x80003CD5 RecordLayout_1 0 CompuMethod_1 0 255 /end CHARACTERISTIC
/begin CHARACTERISTIC SparkMaxDuration "Maximum duration for a spark pulse.  Must be a multiple of 5ms" VALUE 0x80003CD6 RecordLayout_4 0 CompuMethod_41 -1E+17 1E+17 /end CHARACTERISTIC
/begin CHARACTERISTIC SpringTestTime "Time for ETC to close from 80% to 40% at 0% duty cycle." VALUE 0x80003D8D RecordLayout_4 0 CompuMethod_21 -1E+17 1E+17 /end CHARACTERISTIC
/begin CHARACTERISTIC StallRPMMinThreshold "Min. RPM Threshold below which engine state transition to STALL." VALUE 0x80003DBB RecordLayout_7 0 CompuMethod_51 0 65535 /end CHARACTERISTIC
/begin CHARACTERISTIC StallRPMThresholdHyst "Hysteresis used in conjunction with Min. RPM Threshold to determine when engine state transition to STALL. " VALUE 0x80003DBD RecordLayout_7 0 CompuMethod_51 0 65535 /end CHARACTERISTIC
/begin CHARACTERISTIC StallSaverDeltaRPM "RPM delta below setpoint where Min Gov will enable to prevent engine stalls." VALUE 0x80003DBF RecordLayout_4 0 CompuMethod_26 -1E+17 1E+17 /end CHARACTERISTIC
/begin CHARACTERISTIC STARTUP_EVENT_RunCnt "The number of times to execute STARTUP_EVENT before pausing.  -1 means run forever" VALUE 0x80003DC3 RecordLayout_8 0 CompuMethod_28 -1 2147480000 /end CHARACTERISTIC
/begin CHARACTERISTIC SysVoltage "Analog input pin selection for SysVoltage" VALUE 0x80003E09 RecordLayout_9 0 CompuMethod_60 -32768 32767 /end CHARACTERISTIC
/begin CHARACTERISTIC SysVoltage_ref "Reference Voltage Selection" VALUE 0x80003E0B RecordLayout_1 0 CompuMethod_61 0 255 /end CHARACTERISTIC
/begin CHARACTERISTIC TeethBeforeSyncAllowed "The number of teeth that must be observed before the encoder will allow synchronization to occur." VALUE 0x80003E24 RecordLayout_1 0 CompuMethod_1 0 255 /end CHARACTERISTIC
/begin CHARACTERISTIC TimeBeforeSyncAllowed "The amount of time that must be observed after initial encoder activity before the encoder will allow synchronization to occur." VALUE 0x80003E3C RecordLayout_7 0 CompuMethod_162 0 65535 /end CHARACTERISTIC
/begin CHARACTERISTIC TPS1AnalogInput "Analog input pin selection for TPS1AnalogInput" VALUE 0x80003EA9 RecordLayout_9 0 CompuMethod_60 -32768 32767 /end CHARACTERISTIC
/begin CHARACTERISTIC TPS1AnalogInput_ref "Reference Voltage Selection" VALUE 0x80003EAB RecordLayout_1 0 CompuMethod_61 0 255 /end CHARACTERISTIC
/begin CHARACTERISTIC TPS2AnalogInput "Analog input pin selection for TPS2AnalogInput" VALUE 0x80003EDC RecordLayout_9 0 CompuMethod_60 -32768 32767 /end CHARACTERISTIC
/begin CHARACTERISTIC TPS2AnalogInput_ref "Reference Voltage Selection" VALUE 0x80003EDE RecordLayout_1 0 CompuMethod_61 0 255 /end CHARACTERISTIC
/begin CHARACTERISTIC TPSAdaptLoRequest "" VALUE 0x80003EF4 RecordLayout_1 0 CompuMethod_38 0 1 /end CHARACTERISTIC
/begin CHARACTERISTIC VEBaroCorrTbl "Vol Eff compensation based on BARO." CURVE 0x80003F0C RecordLayout_4 0 CompuMethod_2 -1E+17 1E+17
 /begin AXIS_DESCR COM_AXIS BARO CompuMethod_2 9 -1E+17 1E+17 AXIS_PTS_REF BARO09IdxArr /end AXIS_DESCR
/end CHARACTERISTIC
/begin CHARACTERISTIC VEMap "" MAP 0x80003F35 RecordLayout_4 0 CompuMethod_2 -1E+17 1E+17
 /begin AXIS_DESCR COM_AXIS RPM17In CompuMethod_2 17 -1E+17 1E+17 AXIS_PTS_REF RPM17IdxArr /end AXIS_DESCR
 /begin AXIS_DESCR COM_AXIS PressureRatio CompuMethod_2 17 -1E+17 1E+17 AXIS_PTS_REF PortPressRatio17IdxArr /end AXIS_DESCR
/end CHARACTERISTIC
/begin CHARACTERISTIC VETempCorrTbl "Vol Eff compensation based on IAT." CURVE 0x800043BE RecordLayout_4 0 CompuMethod_2 -1E+17 1E+17
 /begin AXIS_DESCR COM_AXIS IAT17In CompuMethod_2 17 -1E+17 1E+17 AXIS_PTS_REF IAT17IdxArr /end AXIS_DESCR
/end CHARACTERISTIC
/begin CHARACTERISTIC WarmUpEqRatioMultMap "Multiplier on base eq. ratio as a function of NECCT and Ind Power." MAP 0x80004402 RecordLayout_4 0 CompuMethod_8 0 1E+17
 /begin AXIS_DESCR COM_AXIS NECCT09In CompuMethod_2 9 -1E+17 1E+17 AXIS_PTS_REF NECCT09IdxArr /end AXIS_DESCR
 /begin AXIS_DESCR COM_AXIS IndPower05In CompuMethod_2 5 -1E+17 1E+17 AXIS_PTS_REF IndPower05IdxArr /end AXIS_DESCR
/end CHARACTERISTIC
/begin CHARACTERISTIC WarmUpTimeMultMap "Multiplier on base eq. ratio as a function of TimeSinceRun and ECT" MAP 0x800044BA RecordLayout_4 0 CompuMethod_8 0 1E+17
 /begin AXIS_DESCR COM_AXIS ECT05In CompuMethod_2 5 -1E+17 1E+17 AXIS_PTS_REF ECT05IdxArr /end AXIS_DESCR
 /begin AXIS_DESCR COM_AXIS TimeSinceRun09In CompuMethod_2 9 -1E+17 1E+17 AXIS_PTS_REF TimeSinceRun09IdxArr /end AXIS_DESCR
/end CHARACTERISTIC
/begin AXIS_PTS BARO09IdxArr "" 0x800001CF BARO RecordLayout_5 0 CompuMethod_2 9 -1E+17 1E+17 DEPOSIT ABSOLUTE /end AXIS_PTS
/begin AXIS_PTS CrankECT05IdxArr "ECT pre-lookup for crank maps." 0x800005E2 ECT RecordLayout_5 0 CompuMethod_47 5 -1E+17 1E+17 DEPOSIT ABSOLUTE /end AXIS_PTS
/begin AXIS_PTS CrankRPM05IdxArr "RPM pre-lookup for crank maps" 0x80000672 CrankRPM05In RecordLayout_5 0 CompuMethod_26 5 -1E+17 1E+17 DEPOSIT ABSOLUTE /end AXIS_PTS
/begin AXIS_PTS DeltaTPS17IdxArr "" 0x8000098D DeltaTPS17In RecordLayout_5 0 CompuMethod_2 17 -1E+17 1E+17 DEPOSIT ABSOLUTE /end AXIS_PTS
/begin AXIS_PTS ECT_KeyUp09IdxArr "Index of ECT captured at key-up." 0x80000E86 ECT_KeyUp09In RecordLayout_5 0 CompuMethod_57 9 -1E+17 1E+17 DEPOSIT ABSOLUTE /end AXIS_PTS
/begin AXIS_PTS ECT05IdxArr "" 0x80001007 ECT05In RecordLayout_5 0 CompuMethod_2 5 -1E+17 1E+17 DEPOSIT ABSOLUTE /end AXIS_PTS
/begin AXIS_PTS ECTIdxArr "Look up table to allownon-linear characterization of sensors" 0x80001037 ECTADC RecordLayout_5 0 CompuMethod_59 39 -1E+17 1E+17 DEPOSIT ABSOLUTE /end AXIS_PTS
/begin AXIS_PTS EGR_Prelookup_DCIdxArr "" 0x80001330 EGR_Prelookup_DCIn RecordLayout_5 0 CompuMethod_2 11 -1E+17 1E+17 DEPOSIT ABSOLUTE /end AXIS_PTS
/begin AXIS_PTS EGR_Prelookup_PWIdxArr "" 0x8000135C EGR_Prelookup_PWIn RecordLayout_5 0 CompuMethod_2 11 -1E+17 1E+17 DEPOSIT ABSOLUTE /end AXIS_PTS
/begin AXIS_PTS ETC_ErrorIdxArr "" 0x800013FD ETC_ErrorIn RecordLayout_5 0 CompuMethod_2 10 -1E+17 1E+17 DEPOSIT ABSOLUTE /end AXIS_PTS
/begin AXIS_PTS ETC_SetpointIdxArr "" 0x8000148E ETC_SetpointIn RecordLayout_5 0 CompuMethod_2 20 -1E+17 1E+17 DEPOSIT ABSOLUTE /end AXIS_PTS
/begin AXIS_PTS EthanolPreLookupIdxArr "" 0x800017B6 EthanolPreLookupIn RecordLayout_5 0 CompuMethod_2 11 -1E+17 1E+17 DEPOSIT ABSOLUTE /end AXIS_PTS
/begin AXIS_PTS IAT05IdxArr "" 0x800024C1 IAT05In RecordLayout_5 0 CompuMethod_2 5 -1E+17 1E+17 DEPOSIT ABSOLUTE /end AXIS_PTS
/begin AXIS_PTS IAT17IdxArr "" 0x800024D5 IAT17In RecordLayout_5 0 CompuMethod_2 17 -1E+17 1E+17 DEPOSIT ABSOLUTE /end AXIS_PTS
/begin AXIS_PTS IndLoadNom09IdxArr "" 0x80002686 IndLoadNom09In RecordLayout_5 0 CompuMethod_2 9 -1E+17 1E+17 DEPOSIT ABSOLUTE /end AXIS_PTS
/begin AXIS_PTS IndLoadNom17IdxArr "" 0x800026AA IndLoadNom17In RecordLayout_5 0 CompuMethod_2 17 -1E+17 1E+17 DEPOSIT ABSOLUTE /end AXIS_PTS
/begin AXIS_PTS IndPower05IdxArr "" 0x80002716 IndPower05In RecordLayout_5 0 CompuMethod_2 5 -1E+17 1E+17 DEPOSIT ABSOLUTE /end AXIS_PTS
/begin AXIS_PTS InjDeltaPress09IdxArr "" 0x8000273A InjDeltaPress09In RecordLayout_5 0 CompuMethod_2 9 -1E+17 1E+17 DEPOSIT ABSOLUTE /end AXIS_PTS
/begin AXIS_PTS MAF09IdxArr "" 0x80002B4E MAF09In RecordLayout_5 0 CompuMethod_2 9 -1E+17 1E+17 DEPOSIT ABSOLUTE /end AXIS_PTS
/begin AXIS_PTS NECCT09IdxArr "" 0x800030DA NECCT09In RecordLayout_5 0 CompuMethod_2 9 -1E+17 1E+17 DEPOSIT ABSOLUTE /end AXIS_PTS
/begin AXIS_PTS PortPressRatio17IdxArr "Map divided by BARO." 0x800032DF PressureRatio RecordLayout_5 0 CompuMethod_2 17 -1E+17 1E+17 DEPOSIT ABSOLUTE /end AXIS_PTS
/begin AXIS_PTS RPM09IdxArr "" 0x80003721 RPM09In RecordLayout_5 0 CompuMethod_2 9 -1E+17 1E+17 DEPOSIT ABSOLUTE /end AXIS_PTS
/begin AXIS_PTS RPM17IdxArr "" 0x80003745 RPM17In RecordLayout_5 0 CompuMethod_2 17 -1E+17 1E+17 DEPOSIT ABSOLUTE /end AXIS_PTS
/begin AXIS_PTS SpkEnergy09IdxArr "" 0x80003CE9 SpkEnergy09In RecordLayout_5 0 CompuMethod_2 9 -1E+17 1E+17 DEPOSIT ABSOLUTE /end AXIS_PTS
/begin AXIS_PTS SysVolt09IdxArr "" 0x80003DE5 SysVolt09In RecordLayout_5 0 CompuMethod_2 9 -1E+17 1E+17 DEPOSIT ABSOLUTE /end AXIS_PTS
/begin AXIS_PTS TimeSinceRun09IdxArr "" 0x80003E3E TimeSinceRun09In RecordLayout_5 0 CompuMethod_2 9 -1E+17 1E+17 DEPOSIT ABSOLUTE /end AXIS_PTS
/*~~~~~~~~~ 6.3.106 RECORD_LAYOUTs ~~~~~~~~~*/
/begin RECORD_LAYOUT RecordLayout_1 FNC_VALUES 1 UBYTE ROW_DIR DIRECT /end RECORD_LAYOUT
/begin RECORD_LAYOUT RecordLayout_3 FNC_VALUES 1 ULONG ROW_DIR DIRECT /end RECORD_LAYOUT
/begin RECORD_LAYOUT RecordLayout_4 FNC_VALUES 1 FLOAT32_IEEE ROW_DIR DIRECT /end RECORD_LAYOUT
/begin RECORD_LAYOUT RecordLayout_5 AXIS_PTS_X 1 FLOAT32_IEEE /* IndexIncr */ INDEX_INCR /* Addressing */ DIRECT /end RECORD_LAYOUT
/begin RECORD_LAYOUT RecordLayout_6 FNC_VALUES 1 SBYTE ROW_DIR DIRECT /end RECORD_LAYOUT
/begin RECORD_LAYOUT RecordLayout_7 FNC_VALUES 1 UWORD ROW_DIR DIRECT /end RECORD_LAYOUT
/begin RECORD_LAYOUT RecordLayout_8 FNC_VALUES 1 SLONG ROW_DIR DIRECT /end RECORD_LAYOUT
/begin RECORD_LAYOUT RecordLayout_9 FNC_VALUES 1 SWORD ROW_DIR DIRECT /end RECORD_LAYOUT
/*~~~~~~~~~ 6.3.31 COMPU_METHODs ~~~~~~~~~*/
/begin COMPU_METHOD CompuMethod_1 "" RAT_FUNC "%3.0" "" COEFFS 0 1 0 0 0 1 /end COMPU_METHOD
/begin COMPU_METHOD CompuMethod_2 "" RAT_FUNC "%6.2" "" COEFFS 0 1 0 0 0 1 /end COMPU_METHOD
/begin COMPU_METHOD CompuMethod_4 "" TAB_VERB "%1.0" "" COMPU_TAB_REF CompuVtab_1 /end COMPU_METHOD
/begin COMPU_METHOD CompuMethod_5 "" RAT_FUNC "%6.2" "%" COEFFS 0 1 0 0 0 1 /end COMPU_METHOD
/begin COMPU_METHOD CompuMethod_6 "" TAB_VERB "%1.0" "bool" COMPU_TAB_REF CompuVtab_2 /end COMPU_METHOD
/begin COMPU_METHOD CompuMethod_7 "" RAT_FUNC "%6.2" "g/s" COEFFS 0 1 0 0 0 1 /end COMPU_METHOD
/begin COMPU_METHOD CompuMethod_8 "" RAT_FUNC "%6.2" "mult" COEFFS 0 1 0 0 0 1 /end COMPU_METHOD
/begin COMPU_METHOD CompuMethod_9 "" TAB_VERB "%6.2" "" COMPU_TAB_REF CompuVtab_3 /end COMPU_METHOD
/begin COMPU_METHOD CompuMethod_11 "" RAT_FUNC "%6.2" "idx.frac" COEFFS 0 1 0 0 0 0.00195313 /end COMPU_METHOD
/begin COMPU_METHOD CompuMethod_12 "" RAT_FUNC "%6.2" "mg" COEFFS 0 1 0 0 0 1 /end COMPU_METHOD
/begin COMPU_METHOD CompuMethod_14 "" TAB_VERB "%3.0" "" COMPU_TAB_REF CompuVtab_2 /end COMPU_METHOD
/begin COMPU_METHOD CompuMethod_15 "" TAB_VERB "%3.0" "" COMPU_TAB_REF CompuVtab_5 /end COMPU_METHOD
/begin COMPU_METHOD CompuMethod_19 "" RAT_FUNC "%6.2" "kPa" COEFFS 0 1 0 0 0 1 /end COMPU_METHOD
/begin COMPU_METHOD CompuMethod_20 "" TAB_VERB "%1.0" "kPa" COMPU_TAB_REF CompuVtab_9 /end COMPU_METHOD
/begin COMPU_METHOD CompuMethod_21 "" RAT_FUNC "%6.2" "s" COEFFS 0 1 0 0 0 1 /end COMPU_METHOD
/begin COMPU_METHOD CompuMethod_22 "" TAB_VERB "%1.0" "" COMPU_TAB_REF CompuVtab_10 /end COMPU_METHOD
/begin COMPU_METHOD CompuMethod_23 "" RAT_FUNC "%5.4" "" COEFFS 0 1 0 0 0 1 /end COMPU_METHOD
/begin COMPU_METHOD CompuMethod_24 "" RAT_FUNC "%5.4" "mult" COEFFS 0 1 0 0 0 1 /end COMPU_METHOD
/begin COMPU_METHOD CompuMethod_25 "" RAT_FUNC "%7.2" "%" COEFFS 0 1 0 0 0 1 /end COMPU_METHOD
/begin COMPU_METHOD CompuMethod_26 "" RAT_FUNC "%6.2" "RPM" COEFFS 0 1 0 0 0 1 /end COMPU_METHOD
/begin COMPU_METHOD CompuMethod_27 "" RAT_FUNC "%6.2" "mJ" COEFFS 0 1 0 0 0 1 /end COMPU_METHOD
/begin COMPU_METHOD CompuMethod_28 "" RAT_FUNC "%5.0" "" COEFFS 0 1 0 0 0 1 /end COMPU_METHOD
/begin COMPU_METHOD CompuMethod_29 "" TAB_VERB "%3.0" "" COMPU_TAB_REF CompuVtab_11 /end COMPU_METHOD
/begin COMPU_METHOD CompuMethod_30 "" RAT_FUNC "%4.0" "" COEFFS 0 1 0 0 0 1 /end COMPU_METHOD
/begin COMPU_METHOD CompuMethod_31 "" TAB_VERB "%3.0" "" COMPU_TAB_REF CompuVtab_12 /end COMPU_METHOD
/begin COMPU_METHOD CompuMethod_32 "" RAT_FUNC "%5.0" "degCA" COEFFS 0 1 0 0 0 0.0625 /end COMPU_METHOD
/begin COMPU_METHOD CompuMethod_33 "" RAT_FUNC "%8.0" "" COEFFS 0 1 0 0 0 1 /end COMPU_METHOD
/begin COMPU_METHOD CompuMethod_34 "" TAB_VERB "%1.0" "" COMPU_TAB_REF CompuVtab_13 /end COMPU_METHOD
/begin COMPU_METHOD CompuMethod_35 "" TAB_VERB "%1.0" "" COMPU_TAB_REF CompuVtab_14 /end COMPU_METHOD
/begin COMPU_METHOD CompuMethod_36 "" TAB_VERB "%1.0" "" COMPU_TAB_REF CompuVtab_15 /end COMPU_METHOD
/begin COMPU_METHOD CompuMethod_37 "" TAB_VERB "%1.0" "" COMPU_TAB_REF CompuVtab_16 /end COMPU_METHOD
/begin COMPU_METHOD CompuMethod_38 "" RAT_FUNC "%1.0" "" COEFFS 0 1 0 0 0 1 /end COMPU_METHOD
/begin COMPU_METHOD CompuMethod_39 "" RAT_FUNC "%6.2" "Mult" COEFFS 0 1 0 0 0 1 /end COMPU_METHOD
/begin COMPU_METHOD CompuMethod_40 "" RAT_FUNC "%5.3" "ms" COEFFS 0 1 0 0 0 1 /end COMPU_METHOD
/begin COMPU_METHOD CompuMethod_41 "" RAT_FUNC "%6.2" "ms" COEFFS 0 1 0 0 0 1 /end COMPU_METHOD
/begin COMPU_METHOD CompuMethod_42 "" RAT_FUNC "%1.0" "bool" COEFFS 0 1 0 0 0 1 /end COMPU_METHOD
/begin COMPU_METHOD CompuMethod_43 "" RAT_FUNC "%6.2" "degBTDC" COEFFS 0 1 0 0 0 1 /end COMPU_METHOD
/begin COMPU_METHOD CompuMethod_44 "" RAT_FUNC "%6.2" "%" COEFFS 0 1 0 0 0 0.0015259 /end COMPU_METHOD
/begin COMPU_METHOD CompuMethod_45 "" RAT_FUNC "%3.0" "" COEFFS 0 1 0 0 0 0.0015259 /end COMPU_METHOD
/begin COMPU_METHOD CompuMethod_47 "" RAT_FUNC "%6.2" "degC" COEFFS 0 1 0 0 0 1 /end COMPU_METHOD
/begin COMPU_METHOD CompuMethod_48 "" RAT_FUNC "%6.2" "mg/cyl" COEFFS 0 1 0 0 0 1 /end COMPU_METHOD
/begin COMPU_METHOD CompuMethod_50 "" RAT_FUNC "%6.2" "MJ" COEFFS 0 1 0 0 0 1 /end COMPU_METHOD
/begin COMPU_METHOD CompuMethod_51 "" RAT_FUNC "%5.0" "RPM" COEFFS 0 1 0 0 0 1 /end COMPU_METHOD
/begin COMPU_METHOD CompuMethod_52 "" RAT_FUNC "%6.2" "cm3" COEFFS 0 1 0 0 0 1 /end COMPU_METHOD
/begin COMPU_METHOD CompuMethod_53 "" RAT_FUNC "%6.2" "us" COEFFS 0 1 0 0 0 1 /end COMPU_METHOD
/begin COMPU_METHOD CompuMethod_54 "" RAT_FUNC "%6.2" "sec" COEFFS 0 1 0 0 0 1 /end COMPU_METHOD
/begin COMPU_METHOD CompuMethod_55 "" TAB_VERB "%1.0" "" COMPU_TAB_REF CompuVtab_2 /end COMPU_METHOD
/begin COMPU_METHOD CompuMethod_57 "" RAT_FUNC "%6.2" "C" COEFFS 0 1 0 0 0 1 /end COMPU_METHOD
/begin COMPU_METHOD CompuMethod_58 "" RAT_FUNC "%5.0" "ADC" COEFFS 0 1 0 0 0 1 /end COMPU_METHOD
/begin COMPU_METHOD CompuMethod_59 "" RAT_FUNC "%6.2" "ADC" COEFFS 0 1 0 0 0 1 /end COMPU_METHOD
/begin COMPU_METHOD CompuMethod_60 "" TAB_VERB "%5.0" "" COMPU_TAB_REF CompuVtab_17 /end COMPU_METHOD
/begin COMPU_METHOD CompuMethod_61 "" TAB_VERB "%3.0" "" COMPU_TAB_REF CompuVtab_18 /end COMPU_METHOD
/begin COMPU_METHOD CompuMethod_62 "" RAT_FUNC "%5.0" "ADC_counts" COEFFS 0 1 0 0 0 1 /end COMPU_METHOD
/begin COMPU_METHOD CompuMethod_63 "" RAT_FUNC "%6.2" "degCA" COEFFS 0 1 0 0 0 1 /end COMPU_METHOD
/begin COMPU_METHOD CompuMethod_64 "" RAT_FUNC "%5.0" "V" COEFFS 0 1 0 0 0 1 /end COMPU_METHOD
/begin COMPU_METHOD CompuMethod_65 "" RAT_FUNC "%9.4" "%/ADC" COEFFS 0 1 0 0 0 1 /end COMPU_METHOD
/begin COMPU_METHOD CompuMethod_66 "" RAT_FUNC "%6.2" "V" COEFFS 0 1 0 0 0 1 /end COMPU_METHOD
/begin COMPU_METHOD CompuMethod_67 "" TAB_VERB "%3.0" "" COMPU_TAB_REF CompuVtab_19 /end COMPU_METHOD
/begin COMPU_METHOD CompuMethod_68 "" TAB_VERB "%3.0" "" COMPU_TAB_REF CompuVtab_20 /end COMPU_METHOD
/begin COMPU_METHOD CompuMethod_69 "" TAB_VERB "%3.0" "" COMPU_TAB_REF CompuVtab_21 /end COMPU_METHOD
/begin COMPU_METHOD CompuMethod_70 "" TAB_VERB "%3.0" "" COMPU_TAB_REF CompuVtab_22 /end COMPU_METHOD
/begin COMPU_METHOD CompuMethod_71 "" RAT_FUNC "%3.0" "cyl#" COEFFS 0 1 -1 0 0 1 /end COMPU_METHOD
/begin COMPU_METHOD CompuMethod_72 "" RAT_FUNC "%6.2" "RPM/s" COEFFS 0 1 0 0 0 1 /end COMPU_METHOD
/begin COMPU_METHOD CompuMethod_73 "" TAB_VERB "%3.0" "" COMPU_TAB_REF CompuVtab_23 /end COMPU_METHOD
/begin COMPU_METHOD CompuMethod_74 "" RAT_FUNC "%8.3" "EquivRatio" COEFFS 0 1 0 0 0 1 /end COMPU_METHOD
/begin COMPU_METHOD CompuMethod_75 "" RAT_FUNC "%5.0" "us" COEFFS 0 1 0 0 0 1 /end COMPU_METHOD
/begin COMPU_METHOD CompuMethod_76 "" TAB_VERB "%5.0" "" COMPU_TAB_REF CompuVtab_24 /end COMPU_METHOD
/begin COMPU_METHOD CompuMethod_77 "" TAB_VERB "%3.0" "" COMPU_TAB_REF CompuVtab_25 /end COMPU_METHOD
/begin COMPU_METHOD CompuMethod_78 "" RAT_FUNC "%5.0" "mA" COEFFS 0 1 0 0 0 1 /end COMPU_METHOD
/begin COMPU_METHOD CompuMethod_79 "" RAT_FUNC "%5.3" "flag" COEFFS 0 1 0 0 0 1 /end COMPU_METHOD
/begin COMPU_METHOD CompuMethod_80 "" RAT_FUNC "%5.3" "s" COEFFS 0 1 0 0 0 1 /end COMPU_METHOD
/begin COMPU_METHOD CompuMethod_81 "" RAT_FUNC "%6.2" "Hz" COEFFS 0 1 0 0 0 1 /end COMPU_METHOD
/begin COMPU_METHOD CompuMethod_82 "" RAT_FUNC "%6.2" "mA" COEFFS 0 1 0 0 0 1 /end COMPU_METHOD
/begin COMPU_METHOD CompuMethod_83 "" RAT_FUNC "%6.2" "%/s" COEFFS 0 1 0 0 0 1 /end COMPU_METHOD
/begin COMPU_METHOD CompuMethod_84 "" TAB_VERB "%5.0" "" COMPU_TAB_REF CompuVtab_26 /end COMPU_METHOD
/begin COMPU_METHOD CompuMethod_87 "" TAB_VERB "%3.0" "" COMPU_TAB_REF CompuVtab_28 /end COMPU_METHOD
/begin COMPU_METHOD CompuMethod_93 "" TAB_VERB "%3.0" "" COMPU_TAB_REF CompuVtab_34 /end COMPU_METHOD
/begin COMPU_METHOD CompuMethod_94 "" TAB_VERB "%3.0" "" COMPU_TAB_REF CompuVtab_3 /end COMPU_METHOD
/begin COMPU_METHOD CompuMethod_95 "" TAB_VERB "%1.0" "mg" COMPU_TAB_REF CompuVtab_9 /end COMPU_METHOD
/begin COMPU_METHOD CompuMethod_100 "" TAB_VERB "%5.0" "" COMPU_TAB_REF CompuVtab_35 /end COMPU_METHOD
/begin COMPU_METHOD CompuMethod_101 "" TAB_VERB "%5.0" "" COMPU_TAB_REF CompuVtab_36 /end COMPU_METHOD
/begin COMPU_METHOD CompuMethod_107 "" TAB_VERB "%3.0" "" COMPU_TAB_REF CompuVtab_40 /end COMPU_METHOD
/begin COMPU_METHOD CompuMethod_111 "" TAB_VERB "%3.0" "" COMPU_TAB_REF CompuVtab_41 /end COMPU_METHOD
/begin COMPU_METHOD CompuMethod_112 "" TAB_VERB "%5.0" "" COMPU_TAB_REF CompuVtab_42 /end COMPU_METHOD
/begin COMPU_METHOD CompuMethod_113 "" TAB_VERB "%3.0" "" COMPU_TAB_REF CompuVtab_43 /end COMPU_METHOD
/begin COMPU_METHOD CompuMethod_114 "" RAT_FUNC "%5.3" "" COEFFS 0 1 0 0 0 1 /end COMPU_METHOD
/begin COMPU_METHOD CompuMethod_115 "" RAT_FUNC "%6.4" "ms/mg" COEFFS 0 1 0 0 0 1 /end COMPU_METHOD
/begin COMPU_METHOD CompuMethod_116 "" RAT_FUNC "%7.4" "ms" COEFFS 0 1 0 0 0 1 /end COMPU_METHOD
/begin COMPU_METHOD CompuMethod_117 "" RAT_FUNC "%5.0" "bytes" COEFFS 0 1 0 0 0 1 /end COMPU_METHOD
/begin COMPU_METHOD CompuMethod_118 "" TAB_VERB "%6.2" "" COMPU_TAB_REF CompuVtab_44 /end COMPU_METHOD
/begin COMPU_METHOD CompuMethod_120 "" TAB_VERB "%3.0" "" COMPU_TAB_REF CompuVtab_45 /end COMPU_METHOD
/begin COMPU_METHOD CompuMethod_127 "" TAB_VERB "%3.0" "" COMPU_TAB_REF CompuVtab_50 /end COMPU_METHOD
/begin COMPU_METHOD CompuMethod_135 "" TAB_VERB "%8.3" "bool" COMPU_TAB_REF CompuVtab_2 /end COMPU_METHOD
/begin COMPU_METHOD CompuMethod_137 "" TAB_VERB "%1.0" "" COMPU_TAB_REF CompuVtab_55 /end COMPU_METHOD
/begin COMPU_METHOD CompuMethod_140 "" TAB_VERB "%5.0" "" COMPU_TAB_REF CompuVtab_56 /end COMPU_METHOD
/begin COMPU_METHOD CompuMethod_141 "" TAB_VERB "%6.2" "" COMPU_TAB_REF CompuVtab_57 /end COMPU_METHOD
/begin COMPU_METHOD CompuMethod_143 "" TAB_VERB "%1.0" "" COMPU_TAB_REF CompuVtab_58 /end COMPU_METHOD
/begin COMPU_METHOD CompuMethod_149 "" RAT_FUNC "%3.0" "TDCs" COEFFS 0 1 0 0 0 1 /end COMPU_METHOD
/begin COMPU_METHOD CompuMethod_152 "" TAB_VERB "%1.0" "" COMPU_TAB_REF CompuVtab_63 /end COMPU_METHOD
/begin COMPU_METHOD CompuMethod_154 "" TAB_VERB "%1.0" "boolean" COMPU_TAB_REF CompuVtab_2 /end COMPU_METHOD
/begin COMPU_METHOD CompuMethod_155 "" RAT_FUNC "%1.0" "boolean" COEFFS 0 1 0 0 0 1 /end COMPU_METHOD
/begin COMPU_METHOD CompuMethod_159 "" RAT_FUNC "%2.0" "ISRs" COEFFS 0 1 0 0 0 1 /end COMPU_METHOD
/begin COMPU_METHOD CompuMethod_162 "" RAT_FUNC "%5.0" "ms" COEFFS 0 1 0 0 0 1 /end COMPU_METHOD
/*~~~~~~~~~ 6.3.34 COMPU_VTABs ~~~~~~~~~*/
/begin COMPU_VTAB CompuVtab_1 "" TAB_VERB 2 0 "Pass-Through" 1 "Override" /end COMPU_VTAB
/begin COMPU_VTAB CompuVtab_2 "" TAB_VERB 2 0 "Disabled" 1 "Enabled" /end COMPU_VTAB
/begin COMPU_VTAB CompuVtab_3 "" TAB_VERB 90 0 "Normal Operation" 1 "Bad Resource ID" 2 "Hardware Not Supported" 3 "Behaviour Not Supported" 4 "Bad Attribute Data" 5 "Fail On Create" 6 "Fail On Set Attributes" 7 "Resource Not Created" 8 "Missing Attribute" 9 "Behaviour Method Not Supported" 10 "A Service Failed" 11 "Failed to destroy a resource" 12 "Resource Was Created" 13 "Resource Conflict" 14 "Invalid Encoder Type" 15 "2-Strike Not Supported" 16 "720degCA Pattern Not Supported" 17 "CAM Pattern Not Supported" 18 "Unknown CAM Pattern Supplied" 19 "Engine Speed Present" 20 "Hardware Interface Not Supported" 21 "Service Already Started" 22 "Register Write Failed to verify" 23 "Register access was denied" 24 "Out of free store memory" 25 "Software Q Overrun" 26 "Hardware Q Overrun" 27 "Feature unsupported in archive" 28 "Insufficient FW resource" 29 "OS Resource conflict" 30 "Driver Mode conflict" 31 "RTC time is illegal" 32 "FFS unmounted" 33 "Access from an ISR" 34 "FFS internal" 35 "Operation timed out" 36 "Task Kernel API Usage" 37 "Operation aborted" 38 "File not Found" 39 "Invalid characters in filename" 40 "Duplicate filename" 41 "Filename is too long" 42 "Dir not empty on remove" 43 "Dir not found" 44 "Dir name invalid" 45 "Dir exists" 46 "Dir too deep" 47 "Illegal Handle" 48 "End of File" 49 "Media Full" 50 "Media Write" 51 "Media Read" 52 "Media Write Protected" 53 "File Read Only" 54 "FS Media Changed" 55 "Internal USB" 56 "Voltage too high for USB IC" 57 "Encoder not created" 64 "TPU Chan Conflict" 65 "TPU Func Unavailable" 66 "TPU Config" 67 "TPU Primative Usage" 68 "TPU Primitive Count" 69 "TPU Restricted TPU channel" 70 "TPU Not Created" 71 "TPU Self Modify constant write err" 72 "TPU Error 0x48" 73 "TPU Error 0x49" 74 "TPU Error 0x4A" 75 "TPU Error 0x4B" 76 "TPU Error 0x4C" 77 "TPU Error 0x4D" 78 "TPU Error 0x4E" 79 "TPU Error 0x4F" 80 "TPU Error 0x50" 81 "TPU Error 0x51" 82 "TPU Error 0x52" 83 "TPU Error 0x53" 84 "TPU Error 0x54" 85 "TPU Error 0x55" 86 "TPU Error 0x56" 87 "TPU Error 0x57" 88 "TPU Error 0x58" 89 "TPU Error 0x59" 90 "TPU Error 0x5A" 91 "TPU Error 0x5B" 92 "TPU Error 0x5C" 93 "TPU Error 0x5D" 94 "TPU Error 0x5E" 95 "TPU Error 0x5F" /end COMPU_VTAB
/begin COMPU_VTAB CompuVtab_5 "" TAB_VERB 4 0 "Before Model Initialize" 1 "After Model Init - Before STARTUP Event" 2 "After STARTUP Event - Before Run" 3 "Run" /end COMPU_VTAB
/begin COMPU_VTAB CompuVtab_9 "" TAB_VERB 2 0 "Unlocked" 1 "Locked" /end COMPU_VTAB
/begin COMPU_VTAB CompuVtab_10 "" TAB_VERB 2 0 "Not Enabled" 1 "Enabled" /end COMPU_VTAB
/begin COMPU_VTAB CompuVtab_11 "" TAB_VERB 11 0 "None Late" 1 "720 Late" 2 "360 Late" 4 "180 Late" 6 "360, 180 Late" 8 "120 Late" 16 "90 Late" 32 "60 Late" 64 "30 Late" 128 "HIRES Late" 192 "HIRES, 30 Late" /end COMPU_VTAB
/begin COMPU_VTAB CompuVtab_12 "" TAB_VERB 8 0 "None Late" 1 "x1 Late" 2 "x2 Late" 3 "x1, x2 Late" 4 "x10 Late" 5 "x1, x10 Late" 6 "x2, x10 Late" 7 "x1, 2, 10 Late" /end COMPU_VTAB
/begin COMPU_VTAB CompuVtab_13 "" TAB_VERB 2 0 "Calibration Locked" 1 "Calibration Unlocked" /end COMPU_VTAB
/begin COMPU_VTAB CompuVtab_14 "" TAB_VERB 2 0 "Data Acquisition Locked" 1 "Data Acquisition Unlocked" /end COMPU_VTAB
/begin COMPU_VTAB CompuVtab_15 "" TAB_VERB 2 0 "Programming Locked" 1 "Programming Unlocked" /end COMPU_VTAB
/begin COMPU_VTAB CompuVtab_16 "" TAB_VERB 2 0 "Not Connected" 1 "Connected" /end COMPU_VTAB
/begin COMPU_VTAB CompuVtab_17 "" TAB_VERB 26 -1 "(None)" 53 "ECUP" 54 "DRVP" 55 "XDRP" 56 "AN1M" 57 "AN2M" 58 "AN3M" 59 "AN4M" 60 "AN5M" 61 "AN6M" 62 "AN7M" 63 "AN8M" 64 "AN9M" 65 "AN10M" 66 "AN11M" 67 "AN12M" 68 "AN13M" 69 "AN14M" 70 "AN15M" 71 "AN16M" 72 "AN17M" 73 "AN18M" 74 "AN19M" 90 "O2A" 91 "O2B" 92 "XDRP_B" /end COMPU_VTAB
/begin COMPU_VTAB CompuVtab_18 "" TAB_VERB 2 0 "5V" 1 "2.7V" /end COMPU_VTAB
/begin COMPU_VTAB CompuVtab_19 "" TAB_VERB 2 0 "Weak Pullup" 1 "Strong Pullup" /end COMPU_VTAB
/begin COMPU_VTAB CompuVtab_20 "" TAB_VERB 2 0 "Rising Edge" 1 "Falling Edge" /end COMPU_VTAB
/begin COMPU_VTAB CompuVtab_21 "" TAB_VERB 6 0 "No Fault" 1 "Crank Sync Fault" 2 "Reverse Rotation Fault" 3 "No Crank Edges Fault" 4 "No CAM edges fault" 5 "Cam Sync Fault" /end COMPU_VTAB
/begin COMPU_VTAB CompuVtab_22 "" TAB_VERB 5 0 "zero" 1 "ZERO_SPEED" 2 "POSN_UNKNOWN" 3 "ENC_SYNC_CAM_UNKNOWN" 4 "ENC_SYNC_CAM_SYNC" /end COMPU_VTAB
/begin COMPU_VTAB CompuVtab_23 "" TAB_VERB 4 0 "-" 1 "Stall" 2 "Crank" 3 "Run" /end COMPU_VTAB
/begin COMPU_VTAB CompuVtab_24 "" TAB_VERB 9 -1 "(None)" 36 "EST 1" 37 "EST 2" 38 "EST 3" 39 "EST 4" 40 "EST 5" 41 "EST 6" 42 "EST 7" 43 "EST 8" /end COMPU_VTAB
/begin COMPU_VTAB CompuVtab_25 "" TAB_VERB 4 0 "Standard (Coil per cylinder)" 1 "Banked (Fire on both phases until CAM sync)" 2 "Batch (Wasted spark)" 3 "Muxed (Distributed)" /end COMPU_VTAB
/begin COMPU_VTAB CompuVtab_26 "" TAB_VERB 30 -1 "(None)" 0 "FUELP" 1 "ETC" 2 "HSOL1" 3 "HSOL2" 4 "HSOL3" 5 "HSOL4" 6 "START" 11 "OILP" 12 "FINJ1" 13 "FINJ2" 14 "FINJ3" 15 "FINJ4" 16 "FINJ5" 17 "FINJ6" 18 "AINJ1" 19 "AINJ2" 20 "AINJ3" 21 "AINJ4" 22 "AINJ5" 23 "AINJ6" 24 "TACH" 36 "EST 1" 37 "EST 2" 38 "EST 3" 39 "EST 4" 40 "EST 5" 41 "EST 6" 42 "EST 7" 43 "EST 8" /end COMPU_VTAB
/begin COMPU_VTAB CompuVtab_28 "" TAB_VERB 76 0 "CAN_Timeout_112" 1 "CAN_Timeout_Phoenix_1" 2 "CAN_Timeout_Phoenix_2" 3 "CAN_Timeout_Phoenix_3" 4 "CAN_Timeout_Phoenix_4" 5 "CamEdgesFault" 6 "CamSyncFault" 7 "CrankEdgesFault" 8 "CrankSyncFault" 9 "Drive_Hot" 10 "Drive_Warm" 11 "ECTOverTempFault" 12 "ECTRangeHigh" 13 "ECTRangeLow" 14 "ECTSevereOverTempFault" 15 "EGRSenseRangeHigh" 16 "EGRSenseRangeLow" 17 "EST1_Open" 18 "EST1_Short" 19 "EST2_Open" 20 "EST2_Short" 21 "ETCSpringTest" 22 "ETC_Open_Fault" 23 "ETC_Sticking" 24 "FuelAdaptRangeHi" 25 "FuelAdaptRangeLow" 26 "FuelPresHigh_Fault" 27 "FuelPresLow_Fault" 28 "FuelPresRangeHigh" 29 "FuelPresRangeLow" 30 "FuelSensRangeHigh" 31 "FuelSensRangeLow" 32 "HardOverspeed" 33 "IATRangeHigh" 34 "IATRangeLow" 35 "Inj1Open" 36 "Inj2Open" 37 "MAFRangeHigh" 38 "MAFRangeLow" 39 "MAPRangeHigh" 40 "MAPRangeLow" 41 "MAPTimeRangeHigh" 42 "MAPTimeRangeLow" 43 "MAP_IR_HI" 44 "MAP_IR_LO" 45 "MAP_STICKING" 46 "MediumOverspeed" 47 "Motor_Hot" 48 "Motor_Warm" 49 "NoOil_Fault" 50 "O2FailedLean" 51 "O2FailedRich" 52 "O2NotActive" 53 "O2_PostCatRangeHigh" 54 "O2_PostCatRangeLow" 55 "OilPresRangeHigh" 56 "OilPresRangeLow" 57 "SensVoltRangeHigh" 58 "SensVoltRangeLow" 59 "SoftOverspeed" 60 "SysVoltRangeHigh" 61 "SysVoltRangeLow" 62 "TPS1AdaptHiMax" 63 "TPS1AdaptHiMin" 64 "TPS1AdaptLoMax" 65 "TPS1AdaptLoMin" 66 "TPS1RangeHigh" 67 "TPS1RangeLow" 68 "TPS2AdaptHiMax" 69 "TPS2AdaptHiMin" 70 "TPS2AdaptLoMax" 71 "TPS2AdaptLoMin" 72 "TPS2RangeHigh" 73 "TPS2RangeLow" 74 "TPS_Sensors_Conflict" 75 "(None)" /end COMPU_VTAB
/begin COMPU_VTAB CompuVtab_34 "" TAB_VERB 3 0 "Rate Limiter" 1 "Low Pass" 2 "Moving Average" /end COMPU_VTAB
/begin COMPU_VTAB CompuVtab_35 "" TAB_VERB 30 -1 "(None)" 0 "FUELP" 2 "HSOL1" 3 "HSOL2" 4 "HSOL3" 5 "HSOL4" 6 "START" 11 "OILP" 12 "FINJ1" 13 "FINJ2" 14 "FINJ3" 15 "FINJ4" 16 "FINJ5" 17 "FINJ6" 18 "AINJ1" 19 "AINJ2" 20 "AINJ3" 21 "AINJ4" 22 "AINJ5" 23 "AINJ6" 24 "TACH" 36 "EST 1" 37 "EST 2" 38 "EST 3" 39 "EST 4" 40 "EST 5" 41 "EST 6" 42 "EST 7" 43 "EST 8" 52 "MPRD" /end COMPU_VTAB
/begin COMPU_VTAB CompuVtab_36 "" TAB_VERB 5 -1 "(None)" 93 "DG1M" 94 "DG2M" 96 "DG4M" 100 "CNK" /end COMPU_VTAB
/begin COMPU_VTAB CompuVtab_40 "" TAB_VERB 4 0 "Unknown" 1 "Flaring" 2 "OnIdle" 3 "OffIdle" /end COMPU_VTAB
/begin COMPU_VTAB CompuVtab_41 "" TAB_VERB 2 0 "Standard" 1 "Transient" /end COMPU_VTAB
/begin COMPU_VTAB CompuVtab_42 "" TAB_VERB 13 -1 "(None)" 12 "FINJ1" 13 "FINJ2" 14 "FINJ3" 15 "FINJ4" 16 "FINJ5" 17 "FINJ6" 18 "AINJ1" 19 "AINJ2" 20 "AINJ3" 21 "AINJ4" 22 "AINJ5" 23 "AINJ6" /end COMPU_VTAB
/begin COMPU_VTAB CompuVtab_43 "" TAB_VERB 3 0 "Standard (Injector per cylinder)" 1 "Batch (Fire half fuel on half of the injectors every rev)" 2 " Wasted (Fire half fuel on all injectors every rev)" /end COMPU_VTAB
/begin COMPU_VTAB CompuVtab_44 "" TAB_VERB 74 0 "NO_OS_ERROR" 1 "PROSAK_TPU_ALLOCATE" 2 "PROSAK_DEADLOCK_PROT" 3 "QSPI_SEND_SIZE_ZERO" 4 "QSPI_SEND_SIZE_TOO_BIG" 5 "QSPI_RD_SIZE_TOO_BIG" 6 "QSPI_RD_SIZE_ZERO" 7 "QSPI_WR_SIZE_TOO_BIG" 8 "QSPI_WR_SIZE_ZERO" 9 "QSPI_CMD_SIZE_TOO_BIG" 10 "QSPI_CMD_SIZE_ZERO" 11 "IGN_DIAG_MDA_ALLOCATE" 12 "EEDataDirSizeMisMatch" 13 "EE_WRITE_QUEUE_OVFLOW" 14 "ESC_HBRIDGE_MDA_ALLOCATE" 15 "ETC_DIAG_MDA_ALLOCATE" 16 "DFLT_ENCODER_CREATE_ERR" 17 "ADC_TPU_ALLOCATE" 18 "SWISR_QUEUE_OVERFLOW" 19 "WATCHDOG_RESET" 20 "CHECKSTOP_RESET" 21 "SPIEE_WR_STAT_REG_ERR" 22 "SPIEE_QUEUE_OVFL_STATUS" 23 "SPIEE_WRITE_FAIL_ERR" 24 "Requested TPU Func not in mask" 25 "Unable to allocate QSPI knock" 26 "Stack has overflowed!" 27 "TPU Limits not setup" 28 "INVALID TPU MASK" 29 "TPU Mask Corrupt" 30 "Sequence Create with No Encoder" 31 "Illegal Sequence ISR" 32 "TPU Mask Version is insufficient" 33 "MUX PSP requested for 2-Stroke" 34 "Ext Flash Acc Denied" 35 "Ext Flash Erase Fail" 36 "Ext Flash Write Fail" 37 "Ext Flash Allign Error" 38 "EXT_FLASH_WR_ZERO_SIZE" 39 "Illegal Ext Flash Addr" 40 "Error: Write to non-existent Flash" 41 "Too many Logs want to be active" 42 "Bank Seq Destroy Problem" 43 "Transient Seq Destroy Problem" 44 "Transient Seq Update Problem" 45 "SPIEE System had a memory problem" 46 "Spent too long waiting for a sync return" 47 "TPUC Mask does not pair with TPUA/B mask" 48 "The Module Configuration was not available" 49 "Diagnostic Mux did not create" 50 "FGND Angle event queue overflow" 51 "FGND Time event queue overflow" 52 "EEPROM write to CAMDelay failed" 53 "SleepTask call from in ISR" 54 "Bad Kernel API call detected" 55 "Kernel Internal" 56 "SPIEE Device create" 57 "NAND Flash timeout on Write" 58 "NAND Flash timeout on Erase" 59 "NAND Flash WP" 60 "NAND Flash RDY/BUSYb" 61 "NAND Flash Access" 62 "NAND Flash Device" 63 "USB Core Stack Initialisation" 64 "USB Stack Assert" 65 "EXT_EE_ACCESS" 66 "VARCAM_PATTERN_SETUP" 67 "FP Divide by Zero" 68 "Unable to allocate requested memory on heap" 69 "Unable create Fgnd Angle task" 70 "FP Denormalized number" 71 "RPMVector Buffers Full" 72 "RPMVector Overrun" 73 "Failed to Write TPU Self Modify Parameter" /end COMPU_VTAB
/begin COMPU_VTAB CompuVtab_45 "" TAB_VERB 2 0 "Model From MAP" 1 "Use MAF Sensor" /end COMPU_VTAB
/begin COMPU_VTAB CompuVtab_50 "" TAB_VERB 3 0 "PulseWidth" 1 "DutyCycle" 2 "Both" /end COMPU_VTAB
/begin COMPU_VTAB CompuVtab_55 "" TAB_VERB 2 0 "Open-Loop" 1 "Closed-Loop" /end COMPU_VTAB
/begin COMPU_VTAB CompuVtab_56 "" TAB_VERB 16 -1 "(None)" 2 "HSOL1" 3 "HSOL2" 4 "HSOL3" 5 "HSOL4" 6 "START" 11 "OILP" 35 "ESC" 36 "EST 1" 37 "EST 2" 38 "EST 3" 39 "EST 4" 40 "EST 5" 41 "EST 6" 42 "EST 7" 43 "EST 8" /end COMPU_VTAB
/begin COMPU_VTAB CompuVtab_57 "" TAB_VERB 2 0 "Abnormal Operation!" 1 "Operating Normally" /end COMPU_VTAB
/begin COMPU_VTAB CompuVtab_58 "" TAB_VERB 2 0 "Run" 1 "Reboot" /end COMPU_VTAB
/begin COMPU_VTAB CompuVtab_63 "" TAB_VERB 2 0 "False" 1 "True" /end COMPU_VTAB
/begin FUNCTION Application_Monitor_Config ""
 /begin DEF_CHARACTERISTIC ApplicationMonitorEnable ApplicationPausePoint BgndStackMargin CPUMargin FgndTimeStackMargin HeapMargin IdleStackMargin InterruptStackMargin /end DEF_CHARACTERISTIC
/end FUNCTION
/begin FUNCTION Aux_PWM_DutyCycle_Ovr_Override "" /begin DEF_CHARACTERISTIC Aux_PWM_DutyCycle_Ovr_new Aux_PWM_DutyCycle_Ovr_ovr /end DEF_CHARACTERISTIC /end FUNCTION
/begin FUNCTION Phoenix_1 "" /begin DEF_CHARACTERISTIC SecondarySpdLim_Cal SecondaryVoltLim_Cal /end DEF_CHARACTERISTIC
 /begin OUT_MEASUREMENT Aux_PWM_DutyCycle_Prb Aux_PWM_Freq_Prb Aux_PWM_State_Prb Control_Mode_Cmd_Prb Generating_Torque_Lim_Prb Generating_Tq_Curve_Prb Motoring_Torque_Lim_Prb Motoring_Tq_Curve_Prb Run_Request_Prb SecondarySpeedLim_CenterPT_Prb SecondaryVoltLim_CenterPT_Prb Speed_Voltage_Torque_CMD_Prb XDRP_Supply_State_Prb /end OUT_MEASUREMENT
 /begin SUB_FUNCTION Aux_PWM_DutyCycle_Ovr_Override Aux_PWM_Freq_Ovr_Override Aux_PWM_State_Ovr_Override Control_Mode_Cmd_Ovr_Override Generating_Torque_Lim_Ovr_Override Generating_Tq_Curve_Ovr_Override Motoring_Torque_Lim_Ovr_Override Motoring_Tq_Curve_Ovr_Override Run_Request_Ovr_Override SecondartSpeedLim_CenterPT_Ovr_Override SecondaryVoltLim_CenterPT_Ovr_Override Speed_Voltage_Torque_CMD_Ovr_Override XDRP_Supply_State_Ovr_Override /end SUB_FUNCTION
/end FUNCTION
/begin FUNCTION CAN_Out "" /begin SUB_FUNCTION Phoenix_1 _112_1 /end SUB_FUNCTION /end FUNCTION
/begin FUNCTION Outputs "" /begin DEF_CHARACTERISTIC ETC_CutPower_StallTime /end DEF_CHARACTERISTIC
 /begin SUB_FUNCTION CAN_Out Coil_Control EGR_Out Injector_Control HBridge FuelPump OilPump Oxygen_Heater /end SUB_FUNCTION
/end FUNCTION
/begin FUNCTION Aux_PWM_Freq_Ovr_Override "" /begin DEF_CHARACTERISTIC Aux_PWM_Freq_Ovr_new Aux_PWM_Freq_Ovr_ovr /end DEF_CHARACTERISTIC /end FUNCTION
/begin FUNCTION Aux_PWM_State_Ovr_Override "" /begin DEF_CHARACTERISTIC Aux_PWM_State_Ovr_new Aux_PWM_State_Ovr_ovr /end DEF_CHARACTERISTIC /end FUNCTION
/begin FUNCTION AirCalcs "" /begin DEF_CHARACTERISTIC BaroRunStallDelay /end DEF_CHARACTERISTIC /begin OUT_MEASUREMENT BARO BaroDelayTime /end OUT_MEASUREMENT
 /begin SUB_FUNCTION Capture_Signal_At_Startup BARO_Override SpeedDensityMAPReferenced /end SUB_FUNCTION
/end FUNCTION
/begin FUNCTION Capture_Signal_At_Startup "" /begin DEF_CHARACTERISTIC BARO_Count /end DEF_CHARACTERISTIC /end FUNCTION
/begin FUNCTION BARO_Override "" /begin DEF_CHARACTERISTIC BARO_offset BARO_ovr /end DEF_CHARACTERISTIC /end FUNCTION
/begin FUNCTION SpeedDensityMAPReferenced ""
 /begin DEF_CHARACTERISTIC CombEventsPerRev CylSweptVol MAF_Source VEBaroCorrTbl VEMap VETempCorrTbl /end DEF_CHARACTERISTIC
 /begin OUT_MEASUREMENT BARO09Idx MAFPort MAFPortModel PortPressRatio17Idx PressureRatio VE VEBaroCorr VETable VETempCorr /end OUT_MEASUREMENT
 /begin SUB_FUNCTION VETable_Ovr_Override /end SUB_FUNCTION
/end FUNCTION
/begin FUNCTION Idle_Control_Enable_Delay "" /begin DEF_CHARACTERISTIC BaseAirflowAdaptDelayTime /end DEF_CHARACTERISTIC /end FUNCTION
/begin FUNCTION Base_Airflow_Table_Adapt ""
 /begin DEF_CHARACTERISTIC BaseAirflowAdaptDelta BaseAirflowAdaptEnable BaseAirflowAdaptGain /end DEF_CHARACTERISTIC
 /begin OUT_MEASUREMENT BaseAirflowAdaptEnabled /end OUT_MEASUREMENT
 /begin SUB_FUNCTION Idle_Control_Enable_Delay Saturation__Tunable_ Adapt_Base_Airflow_Table /end SUB_FUNCTION
/end FUNCTION
/begin FUNCTION Saturation__Tunable_ "" /begin DEF_CHARACTERISTIC BaseAirflowAdaptErrorLwrLim BaseAirflowAdaptErrorUprLim /end DEF_CHARACTERISTIC /end FUNCTION
/begin FUNCTION AiflowOffset "" /begin DEF_CHARACTERISTIC BaseAirflowOfstTbl /end DEF_CHARACTERISTIC /begin OUT_MEASUREMENT BaseAirflowOfst BaseAirOffset /end OUT_MEASUREMENT /begin SUB_FUNCTION Ramp_Air_Into_Idle_State /end SUB_FUNCTION /end FUNCTION
/begin FUNCTION Adapt_Base_Airflow_Table "" /begin DEF_CHARACTERISTIC BaseAirflowOfstMaxValue BaseAirflowOfstMinValue /end DEF_CHARACTERISTIC /end FUNCTION
/begin FUNCTION Base_Equiv_Ratio ""
 /begin DEF_CHARACTERISTIC CoolantTempEnrichmentMap DesEquivRatioMap IntakeAirTempEnrichmentMap WarmUpEqRatioMultMap WarmUpTimeMultMap /end DEF_CHARACTERISTIC
 /begin OUT_MEASUREMENT BaseEquivRatio CoolantTempEnrichment DesEquivRatio IntakeAirTempEnrichment WarmUpEqRatioMult WarmUpTimeMult /end OUT_MEASUREMENT
 /begin SUB_FUNCTION EquivRatio_Override /end SUB_FUNCTION
/end FUNCTION
/begin FUNCTION Overspeed_Protection "" /begin DEF_CHARACTERISTIC BaseRevLimit HardRevOffset MediumRevOffset RevLimitHyst /end DEF_CHARACTERISTIC /end FUNCTION
/begin FUNCTION Diagnostics ""
 /begin SUB_FUNCTION Overspeed_Protection Phoenix_AgeCount_Fault Motor_Overheat_Fault_Logic Fuel_Economy Wrong_Fuel_Pressure_Fault_Logic MAP_Fault_Logic Low_Oil_Pressure_Fault_Logic Engine_Overheat_Fault_Logic /end SUB_FUNCTION
/end FUNCTION
/begin FUNCTION Spark_Manager "" /begin DEF_CHARACTERISTIC BaseSparkEnergyMap SparkAdvMap /end DEF_CHARACTERISTIC /begin OUT_MEASUREMENT BaseSparkEnergy Spark_Adv_Prb SparkAdv /end OUT_MEASUREMENT
 /begin SUB_FUNCTION Temp_Comp_Offset Ethanol_Spark_Offset SparkAdvanceLimiter Spark_Advance_Rate_Limiter /end SUB_FUNCTION
/end FUNCTION
/begin FUNCTION Trigger_Config "" /begin DEF_CHARACTERISTIC BGND_BASE_Multiple FGND_RTI_Period /end DEF_CHARACTERISTIC /end FUNCTION
/begin FUNCTION Event_Pause_Counters ""
 /begin DEF_CHARACTERISTIC BGND_BASE_PERIODIC_RunCnt BGND_BASEx10_PERIODIC_RunCnt BGND_BASEx2_PERIODIC_RunCnt FGND_10XRTI_PERIODIC_RunCnt FGND_20XRTI_PERIODIC_RunCnt FGND_2XRTI_PERIODIC_RunCnt FGND_5XRTI_PERIODIC_RunCnt FGND_MID_TDC_EVENT_RunCnt FGND_RTI_PERIODIC_RunCnt FGND_TDC_EVENT_RunCnt FGND_TDC1_EVENT_RunCnt IDLE_EVENT_RunCnt ONE_SECOND_EVENT_RunCnt STARTUP_EVENT_RunCnt /end DEF_CHARACTERISTIC
/end FUNCTION
/begin FUNCTION OS ""
 /begin OUT_MEASUREMENT BgndAngTaskStatus BgndStackMinBytesFree BgndTimeTaskStatus FgndAngleStackMinBytesFree FgndAngTaskStatus FgndTimeStackMinBytesFree IdleStackMinBytesFree InterruptStackMinBytesFree LastOSError OSErrorCnt OSStatus PeakHeapBytesUsed SWISRCurrQueueSize /end OUT_MEASUREMENT
/end FUNCTION
/begin FUNCTION Bus_HVIL_Status_Ovr_Override "" /begin DEF_CHARACTERISTIC Bus_HVIL_Status_Ovr_new Bus_HVIL_Status_Ovr_ovr /end DEF_CHARACTERISTIC /end FUNCTION
/begin FUNCTION Encoder_Config ""
 /begin DEF_CHARACTERISTIC CAMDelay EncoderCamPullup EncoderCamSyncEdge EncoderCrankPullup EncoderCrankTeethAfterCam EncoderNumCylinders EncoderSyncEdge EncoderTDCAngles TeethBeforeSyncAllowed TimeBeforeSyncAllowed /end DEF_CHARACTERISTIC
/end FUNCTION
/begin FUNCTION EngineSpeed "" /begin DEF_CHARACTERISTIC EngineToEncoderOffset PseudoRPM RPMFiltConst /end DEF_CHARACTERISTIC /begin OUT_MEASUREMENT EncoderState EncoderTDCOrder RPM RPMInst /end OUT_MEASUREMENT /begin SUB_FUNCTION Encoder_Config Encoder_Diagnostics /end SUB_FUNCTION /end FUNCTION
/begin FUNCTION CAN ""
 /begin OUT_MEASUREMENT CAN_1_ext_handled_count CAN_1_ext_last_unhandled_id CAN_1_ext_receive_count CAN_1_std_handled_count CAN_1_std_last_unhandled_id CAN_1_std_receive_count CAN_2_ext_handled_count CAN_2_ext_last_unhandled_id CAN_2_ext_receive_count can_create_CAN_1 can_create_CAN_2 can_tx_err_CAN_1_0 can_tx_err_CAN_1_0_50 can_tx_err_CAN_2_0 can_tx_err_CAN_2_0_51 protocol_register_CAN_1 protocol_register_CAN_2 /end OUT_MEASUREMENT
/end FUNCTION
/begin FUNCTION _112_CAN_Faults "" /begin DEF_CHARACTERISTIC CAN_Timeout_112 /end DEF_CHARACTERISTIC /begin OUT_MEASUREMENT CAN_Timeout_112_Prb /end OUT_MEASUREMENT /end FUNCTION
/begin FUNCTION _112 "" /begin DEF_CHARACTERISTIC Disable_ESTOP ESTOP /end DEF_CHARACTERISTIC
 /begin OUT_MEASUREMENT Genset_Enable_Prb Genset_Load_Prb Load_RPM_Prb Load_Throttle_Prb Vehicle_Speed_Prb /end OUT_MEASUREMENT
 /begin SUB_FUNCTION _112_CAN_Faults Genset_Enable_Ovr_Override Genset_Load_Ovr_Override Load_RPM_Ovr_Override Load_Throttle_Ovr_Override ESTOP_at_Startup Vehicle_Speed_Ovr_Override /end SUB_FUNCTION
/end FUNCTION
/begin FUNCTION Phoenix_1_CAN_Faults "" /begin DEF_CHARACTERISTIC CAN_Timeout_Phoenix_1 /end DEF_CHARACTERISTIC /begin OUT_MEASUREMENT CAN_Timeout_Phoenix_1_Prb /end OUT_MEASUREMENT /end FUNCTION
/begin FUNCTION Phoenix_AgeCount_Fault ""
 /begin SUB_FUNCTION Phoenix_1_CAN_Faults Phoenix_2_CAN_Faults Phoenix_3_CAN_Faults Phoenix_4_CAN_Faults /end SUB_FUNCTION
/end FUNCTION
/begin FUNCTION Phoenix_2_CAN_Faults "" /begin DEF_CHARACTERISTIC CAN_Timeout_Phoenix_2 /end DEF_CHARACTERISTIC /begin OUT_MEASUREMENT CAN_Timeout_Phoenix_2_Prb /end OUT_MEASUREMENT /end FUNCTION
/begin FUNCTION Phoenix_3_CAN_Faults "" /begin DEF_CHARACTERISTIC CAN_Timeout_Phoenix_3 /end DEF_CHARACTERISTIC /begin OUT_MEASUREMENT CAN_Timeout_Phoenix_3_Prb /end OUT_MEASUREMENT /end FUNCTION
/begin FUNCTION Phoenix_4_CAN_Faults "" /begin DEF_CHARACTERISTIC CAN_Timeout_Phoenix_4 /end DEF_CHARACTERISTIC /begin OUT_MEASUREMENT CAN_Timeout_Phoenix_4_Prb /end OUT_MEASUREMENT /end FUNCTION
/begin FUNCTION CCP1 "" /begin DEF_CHARACTERISTIC CCP1_StationAddr CCP1RxID CCP1RxIDMask CCP1TxID /end DEF_CHARACTERISTIC
 /begin OUT_MEASUREMENT CCP_CCP1_Access CCP_CCP1_Access.CCP_CCP1_CAL CCP_CCP1_Access.CCP_CCP1_DAQ CCP_CCP1_Access.CCP_CCP1_PGM CCP_CCP1_ConnectionStatus /end OUT_MEASUREMENT
/end FUNCTION
/begin FUNCTION CCP "" /begin SUB_FUNCTION CCP1 /end SUB_FUNCTION /end FUNCTION
/begin FUNCTION CEL_Status_Ovr_Override "" /begin DEF_CHARACTERISTIC CEL_Status_Ovr_new CEL_Status_Ovr_ovr /end DEF_CHARACTERISTIC /end FUNCTION
/begin FUNCTION MIL_States "" /begin OUT_MEASUREMENT CEL_Status_Prb Faults_Light_Status_Prb Wrench_Status_Prb /end OUT_MEASUREMENT
 /begin SUB_FUNCTION CEL_Status_Ovr_Override Faults_Light_Status_Ovr_Override Wrench_Status_Ovr_Override /end SUB_FUNCTION
/end FUNCTION
/begin FUNCTION _112_1 "" /begin DEF_CHARACTERISTIC Load_On /end DEF_CHARACTERISTIC
 /begin OUT_MEASUREMENT Engine_Crank_Prb Engine_On_Prb Fault_Prb Inverter_Temp_Prb Load_On_Prb Oil_Pressure_Prb RPM_Prb Temp_Guage_Ovr /end OUT_MEASUREMENT
 /begin SUB_FUNCTION MIL_States Engine_Crank_Ovr_Override Engine_On_Ovr_Override Fault_Ovr_Override Inverter_Temp_Ovr_Override Load_On_Ovr_Override Temp_Sensor_Arbitration Oil_Pressure_Ovr_Override RPM_Ovr_Override Temp_Guage_Ovr_Override /end SUB_FUNCTION
/end FUNCTION
/begin FUNCTION Communication_Config "" /begin DEF_CHARACTERISTIC CityID_CAN_1 CityID_CAN_2 /end DEF_CHARACTERISTIC /end FUNCTION
/begin FUNCTION CrankFueling "" /begin DEF_CHARACTERISTIC ClearFloodThreshold CrankFPCMap OpenThrottleFPCScalar /end DEF_CHARACTERISTIC /begin OUT_MEASUREMENT CrankFPC /end OUT_MEASUREMENT /end FUNCTION
/begin FUNCTION Crank ""
 /begin DEF_CHARACTERISTIC CrankAirflowSetPtTbl CrankMakeUpEOITbl CrankSOITbl CrankSparkTbl CrankSpkEnergyMap /end DEF_CHARACTERISTIC
 /begin OUT_MEASUREMENT CrankAirflowSetPt CrankECT05Idx CrankMakeUpEOI CrankRPM05Idx CrankRPM05In CrankSOI CrankSpark CrankSpkEnergy /end OUT_MEASUREMENT
 /begin SUB_FUNCTION CrankFueling /end SUB_FUNCTION
/end FUNCTION
/begin FUNCTION Spark_Coil_Characterization "" /begin DEF_CHARACTERISTIC CoilDrvrDlyTime CoilDwellMap /end DEF_CHARACTERISTIC
 /begin OUT_MEASUREMENT CoilDwell SparkDwell SparkEnabled SparkEnergyMonitor SpkEnergy09Idx SpkEnergy09In /end OUT_MEASUREMENT
 /begin SUB_FUNCTION SparkDwell_Override /end SUB_FUNCTION
/end FUNCTION
/begin FUNCTION ActuatorCharacterization ""
 /begin SUB_FUNCTION Spark_Coil_Characterization EGR_Characterization Electronic_Throttle_Controller Injector_Characterization SequenceCutPattern /end SUB_FUNCTION
/end FUNCTION
/begin FUNCTION Coil_Control "" /begin DEF_CHARACTERISTIC SparkMaxDuration /end DEF_CHARACTERISTIC /begin OUT_MEASUREMENT CoilEnabled CoilStartAngle CoilStopAngle /end OUT_MEASUREMENT
 /begin SUB_FUNCTION EST_Fault_Management Coil_Enable_Manager SparkStartAngle_Override SparkStopAngle_Override /end SUB_FUNCTION
/end FUNCTION
/begin FUNCTION Fuel_Pump_at_Startup "" /begin DEF_CHARACTERISTIC Constant_Fuel_Pump FuelPumpStartTime /end DEF_CHARACTERISTIC /begin OUT_MEASUREMENT FuelPumpTSE /end OUT_MEASUREMENT /end FUNCTION
/begin FUNCTION Stall "" /begin SUB_FUNCTION Fuel_Pump_at_Startup Oil_Pump_at_Startup /end SUB_FUNCTION /end FUNCTION
/begin FUNCTION Oil_Pump_at_Startup "" /begin DEF_CHARACTERISTIC Constant_Oil_Pump OilPumpStartTime /end DEF_CHARACTERISTIC /begin OUT_MEASUREMENT OilPumpTSE /end OUT_MEASUREMENT /end FUNCTION
/begin FUNCTION Control_Mode_Cmd_Ovr_Override "" /begin DEF_CHARACTERISTIC Control_Mode_Cmd_Ovr_new Control_Mode_Cmd_Ovr_ovr /end DEF_CHARACTERISTIC /end FUNCTION
/begin FUNCTION Control_Mode_Ovr_Override "" /begin DEF_CHARACTERISTIC Control_Mode_Ovr_new Control_Mode_Ovr_ovr /end DEF_CHARACTERISTIC /end FUNCTION
/begin FUNCTION Performance ""
 /begin OUT_MEASUREMENT CPUIdlePcent CPUTime_AppISR CPUTime_Bgnd CPUTime_CAN CPUTime_FgndAngle CPUTime_FgndTime CPUTime_MIOS CPUTime_Serial CPUTime_TimerISR CPUTime_TPU /end OUT_MEASUREMENT
/end FUNCTION
/begin FUNCTION TDC_Counter "" /begin OUT_MEASUREMENT CrankTDCs /end OUT_MEASUREMENT /end FUNCTION
/begin FUNCTION EngineState ""
 /begin DEF_CHARACTERISTIC CrankToRunRPMThresh EngineState RunLatchTDCs StallRPMMinThreshold StallRPMThresholdHyst /end DEF_CHARACTERISTIC
 /begin OUT_MEASUREMENT CrankTrans EngineStateRaw /end OUT_MEASUREMENT
 /begin SUB_FUNCTION TDC_Counter /end SUB_FUNCTION
/end FUNCTION
/begin FUNCTION CtrlBoard_Temp_Ovr_Override "" /begin DEF_CHARACTERISTIC CtrlBoard_Temp_Ovr_new CtrlBoard_Temp_Ovr_ovr /end DEF_CHARACTERISTIC /end FUNCTION
/begin FUNCTION Signal_Generator "" /begin DEF_CHARACTERISTIC Default_DC Default_PW /end DEF_CHARACTERISTIC /end FUNCTION
/begin FUNCTION EGR_Characterization ""
 /begin DEF_CHARACTERISTIC EGR_Hyst EGR_Interpolation_DCTbl EGR_Interpolation_PWTbl Mode /end DEF_CHARACTERISTIC
 /begin OUT_MEASUREMENT EGR_Interpolation_DC EGR_Interpolation_PW EGR_Prelookup_DCIdx EGR_Prelookup_DCIn EGR_Prelookup_PWIdx EGR_Prelookup_PWIn /end OUT_MEASUREMENT
 /begin SUB_FUNCTION Signal_Generator /end SUB_FUNCTION
/end FUNCTION
/begin FUNCTION Delta_TPS_Transient_Fueling "" /begin DEF_CHARACTERISTIC DeltaTPS_FiltConst DeltaTPS_MultMap /end DEF_CHARACTERISTIC
 /begin OUT_MEASUREMENT DeltaTPS DeltaTPS_Mult DeltaTPS17Idx DeltaTPS17In MAF09Idx MAF09In TransFuel_TPSFilt /end OUT_MEASUREMENT
 /begin SUB_FUNCTION ECT_Transient_Fueling /end SUB_FUNCTION
/end FUNCTION
/begin FUNCTION Injector_Manager "" /begin DEF_CHARACTERISTIC DeltaTPSFuelingEnable MakeUpEOIMap PrimarySOIMap /end DEF_CHARACTERISTIC /begin OUT_MEASUREMENT MakeUpEOI PrimarySOI /end OUT_MEASUREMENT /begin SUB_FUNCTION Delta_TPS_Transient_Fueling /end SUB_FUNCTION /end FUNCTION
/begin FUNCTION O2_Control_State_Determination "" /begin DEF_CHARACTERISTIC EquivRatioDelta O2ControlEnable O2StartUpDelayTbl /end DEF_CHARACTERISTIC
 /begin OUT_MEASUREMENT DesEquivInRange EnginSteadyState O2Calibration O2CtrlMode O2SensorFaults O2StartUpDelay O2TimeDelay /end OUT_MEASUREMENT
/end FUNCTION
/begin FUNCTION O2_Control "" /begin DEF_CHARACTERISTIC O2DisablmentMult /end DEF_CHARACTERISTIC /begin OUT_MEASUREMENT O2FuelMult O2ITermIdx O2ITermIn /end OUT_MEASUREMENT
 /begin SUB_FUNCTION O2_Control_State_Determination O2_PID_Calibrations O2_PID_Controller /end SUB_FUNCTION
/end FUNCTION
/begin FUNCTION DigPos_Sens2_Ovr_Override "" /begin DEF_CHARACTERISTIC DigPos_Sens2_Ovr_new DigPos_Sens2_Ovr_ovr /end DEF_CHARACTERISTIC /end FUNCTION
/begin FUNCTION DigPos_Sens3_Ovr_Override "" /begin DEF_CHARACTERISTIC DigPos_Sens3_Ovr_new DigPos_Sens3_Ovr_ovr /end DEF_CHARACTERISTIC /end FUNCTION
/begin FUNCTION DigPos_Sens4_Ovr_Override "" /begin DEF_CHARACTERISTIC DigPos_Sens4_Ovr_new DigPos_Sens4_Ovr_ovr /end DEF_CHARACTERISTIC /end FUNCTION
/begin FUNCTION DigPos_Sens5_Ovr_Override "" /begin DEF_CHARACTERISTIC DigPos_Sens5_Ovr_new DigPos_Sens5_Ovr_ovr /end DEF_CHARACTERISTIC /end FUNCTION
/begin FUNCTION DiscreteOut ""
 /begin OUT_MEASUREMENT dout_create_DOut7679p0004 dout_create_DOut7963p0001 dout_create_DOut7973p0001 dout_create_DOut8218p0001 /end OUT_MEASUREMENT
/end FUNCTION
/begin FUNCTION DPos_Sens1_Ovr_Override "" /begin DEF_CHARACTERISTIC DPos_Sens1_Ovr_new DPos_Sens1_Ovr_ovr /end DEF_CHARACTERISTIC /end FUNCTION
/begin FUNCTION Motor_Overheat_Fault_Logic "" /begin DEF_CHARACTERISTIC Drive_Hot Drive_Warm Motor_Hot Motor_Warm /end DEF_CHARACTERISTIC /end FUNCTION
/begin FUNCTION Drive_Temp_Ovr_Override "" /begin DEF_CHARACTERISTIC Drive_Temp_Ovr_new Drive_Temp_Ovr_ovr /end DEF_CHARACTERISTIC /end FUNCTION
/begin FUNCTION Duration_Ovr_Override "" /begin DEF_CHARACTERISTIC Duration_Ovr_new Duration_Ovr_ovr /end DEF_CHARACTERISTIC /end FUNCTION
/begin FUNCTION EGR_Out "" /begin OUT_MEASUREMENT Duration_Prb Trigger_Prb /end OUT_MEASUREMENT /begin SUB_FUNCTION Duration_Ovr_Override Trigger_Ovr_Override /end SUB_FUNCTION /end FUNCTION
/begin FUNCTION ECT "" /begin DEF_CHARACTERISTIC ECTTbl /end DEF_CHARACTERISTIC /begin OUT_MEASUREMENT ECT ECTADC ECTIdx ECTRaw /end OUT_MEASUREMENT /begin SUB_FUNCTION ECT_Override ECT_Config /end SUB_FUNCTION /end FUNCTION
/begin FUNCTION Temp_Sensors "" /begin SUB_FUNCTION ECT IAT /end SUB_FUNCTION /end FUNCTION
/begin FUNCTION NonLinearSensors "" /begin SUB_FUNCTION Temp_Sensors O2_PostCat /end SUB_FUNCTION /end FUNCTION
/begin FUNCTION Capture_ECT_At_Startup "" /begin DEF_CHARACTERISTIC ECT_KeyUp_Count /end DEF_CHARACTERISTIC /end FUNCTION
/begin FUNCTION ECT_KeyUp "" /begin OUT_MEASUREMENT ECT_KeyUp09Idx ECT_KeyUp09In /end OUT_MEASUREMENT /end FUNCTION
/begin FUNCTION ECT_Override "" /begin DEF_CHARACTERISTIC ECT_new ECT_ovr /end DEF_CHARACTERISTIC /end FUNCTION
/begin FUNCTION Temp_Comp_Offset ""
 /begin DEF_CHARACTERISTIC ECT_SpkOfstMultMap ECT_SpkOfstTbl IAT_SpkOfstMultMap IAT_SpkOfstTbl /end DEF_CHARACTERISTIC
 /begin OUT_MEASUREMENT ECT_SpkOfst ECT_SpkOfstMult IAT_SpkOfst IAT_SpkOfstMult Tot_Temp_SpkOfst /end OUT_MEASUREMENT
/end FUNCTION
/begin FUNCTION ECT_Index "" /begin OUT_MEASUREMENT ECT05Idx ECT05In /end OUT_MEASUREMENT /end FUNCTION
/begin FUNCTION Raw_Indexes ""
 /begin SUB_FUNCTION ECT_Index IAT_Indexes RPM_Indexes SysVolt_Index TPS_Indexes /end SUB_FUNCTION
/end FUNCTION
/begin FUNCTION ECT_Config "" /begin DEF_CHARACTERISTIC ECTDefault ECTFiltConst ECTMax ECTMin /end DEF_CHARACTERISTIC /end FUNCTION
/begin FUNCTION EGR "" /begin DEF_CHARACTERISTIC ECTEGRInterpolationTbl EGR_MultMap /end DEF_CHARACTERISTIC /begin OUT_MEASUREMENT ECTEGRInterpolation EGR_Mult EGR_Percentage /end OUT_MEASUREMENT /end FUNCTION
/begin FUNCTION Inputs_Config ""
 /begin DEF_CHARACTERISTIC ECTSensorPin ECTSensorPin_ref EGRPin EGRPin_ref FuelPresPin FuelPresPin_ref FuelSensorPin IATSensorPin IATSensorPin_ref MAF_Pin MAPSensorPin MAPSensorPin_ref OilPresPin OilPresPin_ref PostO2Pin PostO2Pin_ref SensVoltSensorPin SensVoltSensorPin_ref SysVoltage SysVoltage_ref TPS1AnalogInput TPS1AnalogInput_ref TPS2AnalogInput TPS2AnalogInput_ref /end DEF_CHARACTERISTIC
/end FUNCTION
/begin FUNCTION I_O_Pins "" /begin SUB_FUNCTION Inputs_Config Outputs_Config Frequency_In_Config /end SUB_FUNCTION /end FUNCTION
/begin FUNCTION ECT_Transient_Fueling "" /begin DEF_CHARACTERISTIC ECTTransFuelMultTbl /end DEF_CHARACTERISTIC /begin OUT_MEASUREMENT ECTTransFuelMult /end OUT_MEASUREMENT /end FUNCTION
/begin FUNCTION Main_Power_Relay "" /begin DEF_CHARACTERISTIC ProcessorReboot ShutDownTasksComplete /end DEF_CHARACTERISTIC /begin OUT_MEASUREMENT ECUP_Enabled ForcedShutDownTimer MPRD /end OUT_MEASUREMENT /begin SUB_FUNCTION Main_Power_Relay_Config MPRD_Override /end SUB_FUNCTION /end FUNCTION
/begin FUNCTION Main_Power_Relay_Config "" /begin DEF_CHARACTERISTIC ECUP_Threshold ForcedShutDownTimerThresh /end DEF_CHARACTERISTIC /end FUNCTION
/begin FUNCTION EGRSense "" /begin OUT_MEASUREMENT EGRSense EGRSenseADC EGRSenseRaw /end OUT_MEASUREMENT /begin SUB_FUNCTION EGRSense_Override EGRSense_Config /end SUB_FUNCTION /end FUNCTION
/begin FUNCTION LinearSensors ""
 /begin SUB_FUNCTION EGRSense FuelOxygenationSensor FuelPres FuelSens _MAP MAPTime OilPres SensVolt SysVolt /end SUB_FUNCTION
/end FUNCTION
/begin FUNCTION EGRSense_Override "" /begin DEF_CHARACTERISTIC EGRSense_new EGRSense_ovr /end DEF_CHARACTERISTIC /end FUNCTION
/begin FUNCTION EGRSense_Config ""
 /begin DEF_CHARACTERISTIC EGRSenseDfltValue EGRSenseFilterConst EGRSenseGain EGRSenseInputHiFltPos EGRSenseInputLoFltPos EGRSenseOfst /end DEF_CHARACTERISTIC
/end FUNCTION
/begin FUNCTION Elec_PW_Override "" /begin DEF_CHARACTERISTIC Elec_PW_new Elec_PW_ovr /end DEF_CHARACTERISTIC /end FUNCTION
/begin FUNCTION Injector_Control "" /begin DEF_CHARACTERISTIC InjectorMaxDuration MinMakeUpPW /end DEF_CHARACTERISTIC /begin OUT_MEASUREMENT InjectorsEnabled InjTransitionCount /end OUT_MEASUREMENT
 /begin SUB_FUNCTION Elec_PW_Override Injector_Enable_Manager ESTOP_FuelInj_Ovr_Override InjEnable_Override MakeUp_EOI_Override Mech_PW_Override SOI_Override /end SUB_FUNCTION
/end FUNCTION
/begin FUNCTION Idle_State_Determination ""
 /begin DEF_CHARACTERISTIC EnableRPMFalling InGearMinGovEntryRPMDelta MinGovAirPcntHyst MinGovEntryAirPcnt MinGovEntryAirTimeThresh StallSaverDeltaRPM /end DEF_CHARACTERISTIC
 /begin OUT_MEASUREMENT IdleState RPMCtrlMode /end OUT_MEASUREMENT
 /begin SUB_FUNCTION Determine_if_RPM_is_Falling /end SUB_FUNCTION
/end FUNCTION
/begin FUNCTION Encoder "" /begin OUT_MEASUREMENT encoder_create /end OUT_MEASUREMENT /end FUNCTION
/begin FUNCTION Encoder_Diagnostics "" /begin OUT_MEASUREMENT EncoderFault EncoderFaultCount /end OUT_MEASUREMENT /end FUNCTION
/begin FUNCTION Engine_Crank_Ovr_Override "" /begin DEF_CHARACTERISTIC Engine_Crank_Ovr_new Engine_Crank_Ovr_ovr /end DEF_CHARACTERISTIC /end FUNCTION
/begin FUNCTION Engine_On_Ovr_Override "" /begin DEF_CHARACTERISTIC Engine_On_Ovr_new Engine_On_Ovr_ovr /end DEF_CHARACTERISTIC /end FUNCTION
/begin FUNCTION Engine_Accel "" /begin DEF_CHARACTERISTIC EngineAccelFiltConst /end DEF_CHARACTERISTIC /begin OUT_MEASUREMENT EngineAccel /end OUT_MEASUREMENT /end FUNCTION
/begin FUNCTION Injector_Enable_Manager ""
 /begin DEF_CHARACTERISTIC EngineShutdownDelayTime Injector1Enable Injector2Enable Injector3Enable Injector4Enable Injector5Enable Injector6Enable Injector7Enable Injector8Enable /end DEF_CHARACTERISTIC
/end FUNCTION
/begin FUNCTION EquivRatio_Override "" /begin DEF_CHARACTERISTIC EquivRatio_new EquivRatio_ovr /end DEF_CHARACTERISTIC /end FUNCTION
/begin FUNCTION Est_Absolute_Torque_Ovr_Override "" /begin DEF_CHARACTERISTIC Est_Absolute_Torque_Ovr_new Est_Absolute_Torque_Ovr_ovr /end DEF_CHARACTERISTIC /end FUNCTION
/begin FUNCTION EST_Fault_Management "" /begin OUT_MEASUREMENT EST_DiagDwell ESTOpenADC /end OUT_MEASUREMENT /end FUNCTION
/begin FUNCTION Outputs_Config ""
 /begin DEF_CHARACTERISTIC EST_InitialPin EST_OpenThreshold EST_SequenceType ETCPin FuelPumpPin INJ_Behavior INJ_InitialPin INJ_SequenceType O2_Heater OilPumpPin ONESHOT /end DEF_CHARACTERISTIC
/end FUNCTION
/begin FUNCTION Est_Relative_Torque_Ovr_Override "" /begin DEF_CHARACTERISTIC Est_Relative_Torque_Ovr_new Est_Relative_Torque_Ovr_ovr /end DEF_CHARACTERISTIC /end FUNCTION
/begin FUNCTION SequenceOut "" /begin OUT_MEASUREMENT EST_Spark EST_SparkCreate INJ_InjectorCreate /end OUT_MEASUREMENT /end FUNCTION
/begin FUNCTION EST_Enable_TDC_Counter "" /begin DEF_CHARACTERISTIC SparkEnableTDCCounts /end DEF_CHARACTERISTIC /begin OUT_MEASUREMENT EST_TDCEnabled TDCCount TDCCountThreshEnabled /end OUT_MEASUREMENT /end FUNCTION
/begin FUNCTION Coil_Enable_Manager ""
 /begin DEF_CHARACTERISTIC SparkEnableCyl1 SparkEnableCyl2 SparkEnableCyl3 SparkEnableCyl4 SparkEnableCyl5 SparkEnableCyl6 SparkEnableCyl7 SparkEnableCyl8 /end DEF_CHARACTERISTIC
 /begin SUB_FUNCTION EST_Enable_TDC_Counter /end SUB_FUNCTION
/end FUNCTION
/begin FUNCTION Estimating_VBATT_Lv_Ovr_Override "" /begin DEF_CHARACTERISTIC Estimating_VBATT_Lv_Ovr_new Estimating_VBATT_Lv_Ovr_ovr /end DEF_CHARACTERISTIC /end FUNCTION
/begin FUNCTION ESTOP_FuelInj_Ovr_Override "" /begin DEF_CHARACTERISTIC ESTOP_FuelInj_Ovr_new ESTOP_FuelInj_Ovr_ovr /end DEF_CHARACTERISTIC /end FUNCTION
/begin FUNCTION ESTOP_Ovr_Override "" /begin DEF_CHARACTERISTIC ESTOP_Ovr_new ESTOP_Ovr_ovr /end DEF_CHARACTERISTIC /end FUNCTION
/begin FUNCTION Digital "" /begin OUT_MEASUREMENT ESTOP_Prb /end OUT_MEASUREMENT /begin SUB_FUNCTION ESTOP_Ovr_Override MAF /end SUB_FUNCTION /end FUNCTION
/begin FUNCTION HBridge ""
 /begin DEF_CHARACTERISTIC ETC_CutPower_Permitted ETC_Frequency ETC_I_MIN ETC_OC_MIN ETC_Offset ETC_VoltageCompTbl /end DEF_CHARACTERISTIC
 /begin OUT_MEASUREMENT ETC_Current ETC_DutyCycle ETC_VoltageComp /end OUT_MEASUREMENT
 /begin SUB_FUNCTION ETC_Override /end SUB_FUNCTION
/end FUNCTION
/begin FUNCTION State__Manager "" /begin OUT_MEASUREMENT ETC_ECUPState ETC_ShutDownTimer /end OUT_MEASUREMENT /end FUNCTION
/begin FUNCTION Electronic_Throttle_Controller ""
 /begin DEF_CHARACTERISTIC ETC_ShutdownLoAdaptError ETC_SpringTestHiThresh ETC_SpringTestLoThresh ETC_SpringTestTimerThresh SpringTestTime /end DEF_CHARACTERISTIC
 /begin SUB_FUNCTION State__Manager PID_With_Damper_Terms__Tunable_ Setpoint_Manager ETC_Adapt_Request ETC_Sticking_Fault ETC_PID_Config ETCStallShutDown /end SUB_FUNCTION
/end FUNCTION
/begin FUNCTION PID_With_Damper_Terms__Tunable_ ""
 /begin DEF_CHARACTERISTIC ETCDampGainDown ETCDampGainUp ETCDCOffsetTbl ETCDGain ETCErrorGain ETCIMax ETCIMin /end DEF_CHARACTERISTIC
 /begin OUT_MEASUREMENT ETC_ErrorIdx ETC_ErrorIn ETC_Setpoint ETC_SetpointIdx ETC_SetpointIn ETCDampTerm ETCDCOffset ETCDTerm ETCError ETCITerm ETCOut ETCPTerm /end OUT_MEASUREMENT
 /begin SUB_FUNCTION IGain PGain DamperSwitch /end SUB_FUNCTION
/end FUNCTION
/begin FUNCTION IGain "" /begin DEF_CHARACTERISTIC ETC_IGainMultTbl ETCIGain /end DEF_CHARACTERISTIC /begin OUT_MEASUREMENT ETC_IGainMult /end OUT_MEASUREMENT /end FUNCTION
/begin FUNCTION Setpoint_Manager "" /begin DEF_CHARACTERISTIC ETC_LoAdaptRateLimit /end DEF_CHARACTERISTIC /begin SUB_FUNCTION Tuning /end SUB_FUNCTION /end FUNCTION
/begin FUNCTION ETC_Override "" /begin DEF_CHARACTERISTIC ETC_new ETC_ovr /end DEF_CHARACTERISTIC /end FUNCTION
/begin FUNCTION PGain "" /begin DEF_CHARACTERISTIC ETC_PGainMultTbl ETCPGain /end DEF_CHARACTERISTIC /begin OUT_MEASUREMENT ETC_PGainMult /end OUT_MEASUREMENT /end FUNCTION
/begin FUNCTION ETC_Adapt_Request "" /begin DEF_CHARACTERISTIC TPSAdaptLoRequest /end DEF_CHARACTERISTIC /begin OUT_MEASUREMENT ETC_ShutdownSetpointMode /end OUT_MEASUREMENT /end FUNCTION
/begin FUNCTION ETC_Sticking_Fault "" /begin DEF_CHARACTERISTIC ETC_StickingThresh /end DEF_CHARACTERISTIC /end FUNCTION
/begin FUNCTION DamperSwitch "" /begin DEF_CHARACTERISTIC ETCDamperSwitchHyst ETCDamperSwitchThresh /end DEF_CHARACTERISTIC /begin OUT_MEASUREMENT ETCDamperSwtichState ETCDamperTPS ETCDamperTPSThresh /end OUT_MEASUREMENT /end FUNCTION
/begin FUNCTION ETC_PID_Config "" /begin DEF_CHARACTERISTIC ETCDamperTPSFilt ETCLwrLim ETCUprLim /end DEF_CHARACTERISTIC /end FUNCTION
/begin FUNCTION ETCReq_Override "" /begin DEF_CHARACTERISTIC ETCReq_new ETCReq_ovr /end DEF_CHARACTERISTIC /end FUNCTION
/begin FUNCTION Tuning "" /begin DEF_CHARACTERISTIC ETCTuneAmp ETCTuneEnable ETCTuneFreq ETCTuneOffset /end DEF_CHARACTERISTIC /begin SUB_FUNCTION ETCReq_Override /end SUB_FUNCTION /end FUNCTION
/begin FUNCTION ETCStallShutDown "" /begin DEF_CHARACTERISTIC ETCShutdownTimerThresh /end DEF_CHARACTERISTIC /begin OUT_MEASUREMENT ETCStallStateShutdown /end OUT_MEASUREMENT /end FUNCTION
/begin FUNCTION Ethanol_Spark_Offset "" /begin DEF_CHARACTERISTIC Ethanol_SpkOfstMultMap EthanolInterpolationTbl /end DEF_CHARACTERISTIC
 /begin OUT_MEASUREMENT Ethanol_Spk_Ofst Ethanol_SpkOfstMult EthanolInterpolation EthanolPreLookupIdx EthanolPreLookupIn /end OUT_MEASUREMENT
/end FUNCTION
/begin FUNCTION Rate_Limiter "" /begin DEF_CHARACTERISTIC Fall_Rate Rise_Rate /end DEF_CHARACTERISTIC /end FUNCTION
/begin FUNCTION Filter_Options "" /begin DEF_CHARACTERISTIC Filter_Type_Selection /end DEF_CHARACTERISTIC /begin SUB_FUNCTION Rate_Limiter Moving_Average_Filter /end SUB_FUNCTION /end FUNCTION
/begin FUNCTION FuelOxygenationSensor "" /begin SUB_FUNCTION Filter_Options /end SUB_FUNCTION /end FUNCTION
/begin FUNCTION Fault_Ovr_Override "" /begin DEF_CHARACTERISTIC Fault_Ovr_new Fault_Ovr_ovr /end DEF_CHARACTERISTIC /end FUNCTION
/begin FUNCTION Action_Reasons ""
 /begin OUT_MEASUREMENT FaultActionReason._.CEL FaultActionReason._.CutThrottle FaultActionReason._.DelayedEngineShutdown FaultActionReason._.DisableO2Ctrl FaultActionReason._.EngineShutdown FaultActionReason._.HardRevLimit FaultActionReason._.MediumRevLimit FaultActionReason._.SoftRevLimit FaultActionReason._.Wrench_Light /end OUT_MEASUREMENT
/end FUNCTION
/begin FUNCTION Faults_Light_Status_Ovr_Override "" /begin DEF_CHARACTERISTIC Faults_Light_Status_Ovr_new Faults_Light_Status_Ovr_ovr /end DEF_CHARACTERISTIC /end FUNCTION
/begin FUNCTION Framework "" /begin OUT_MEASUREMENT FrameworkGlueErrors /end OUT_MEASUREMENT /end FUNCTION
/begin FUNCTION FrequencyIn ""
 /begin OUT_MEASUREMENT freq_in_create_FuelSensorPin freq_in_create_MAF_Pin freq_in_read_FuelSensorPin freq_in_read_MAF_Pin /end OUT_MEASUREMENT
/end FUNCTION
/begin FUNCTION Fuel_Cyl1_Override "" /begin DEF_CHARACTERISTIC Fuel_Cyl1_offset Fuel_Cyl1_ovr /end DEF_CHARACTERISTIC /end FUNCTION
/begin FUNCTION Fuel_Inj_Offsets "" /begin OUT_MEASUREMENT TotalFPC /end OUT_MEASUREMENT
 /begin SUB_FUNCTION Fuel_Cyl1_Override Fuel_Cyl2_Override Fuel_Cyl3_Override Fuel_Cyl4_Override Fuel_Cyl5_Override Fuel_Cyl6_Override Fuel_Cyl7_Override Fuel_Cyl8_Override Fuel_Global_Override /end SUB_FUNCTION
/end FUNCTION
/begin FUNCTION Injector_Characterization ""
 /begin DEF_CHARACTERISTIC GaugeFuelPress InjdPCompTbl InjGain InjOffset InjTurnOffTbl InjTurnOnTbl /end DEF_CHARACTERISTIC
 /begin OUT_MEASUREMENT InjdPComp InjEPW InjMPW InjTurnOff InjTurnOn MaxAllowableMPW /end OUT_MEASUREMENT
 /begin SUB_FUNCTION Fuel_Inj_Offsets DeltaPressureIndex /end SUB_FUNCTION
/end FUNCTION
/begin FUNCTION Fuel_Cyl2_Override "" /begin DEF_CHARACTERISTIC Fuel_Cyl2_offset Fuel_Cyl2_ovr /end DEF_CHARACTERISTIC /end FUNCTION
/end MODULE
/end PROJECT
