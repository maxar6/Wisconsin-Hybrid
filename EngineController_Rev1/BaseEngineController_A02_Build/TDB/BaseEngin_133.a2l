ASAP2_VERSION 1 51
/begin PROJECT Project ""
/begin MODULE BaseEngin_133 ""
/begin MOD_COMMON /* MOD_COMMON Comment */ "" BYTE_ORDER MSB_FIRST ALIGNMENT_BYTE 1 ALIGNMENT_FLOAT32_IEEE 1 ALIGNMENT_FLOAT64_IEEE 1 ALIGNMENT_LONG 1 ALIGNMENT_WORD 1 /end MOD_COMMON
/begin MEASUREMENT Adapt_Amount "As table adapts, should trend to 0" FLOAT32_IEEE CompuMethod_5 1 0 -1E+17 1E+17 ECU_ADDRESS 0x40000126 /end MEASUREMENT
/begin MEASUREMENT AdjustedPerCylFuelRate "Desired fuel per cylinder after application of individual cylinder offsets and multipliers." FLOAT32_IEEE CompuMethod_7 1 0 -1E+17 1E+17 ECU_ADDRESS 0x4000012A /end MEASUREMENT
/begin MEASUREMENT ain_create_ECTSensorPin "Debug Variable" UBYTE CompuMethod_9 1 0 0 0 ECU_ADDRESS 0x4000012E /end MEASUREMENT
/begin MEASUREMENT ain_create_ECUP "Debug Variable" UBYTE CompuMethod_9 1 0 0 0 ECU_ADDRESS 0x4000012F /end MEASUREMENT
/begin MEASUREMENT ain_create_EGRPin "Debug Variable" UBYTE CompuMethod_9 1 0 0 0 ECU_ADDRESS 0x40000130 /end MEASUREMENT
/begin MEASUREMENT ain_create_FuelPresPin "Debug Variable" UBYTE CompuMethod_9 1 0 0 0 ECU_ADDRESS 0x40000131 /end MEASUREMENT
/begin MEASUREMENT ain_create_IATSensorPin "Debug Variable" UBYTE CompuMethod_9 1 0 0 0 ECU_ADDRESS 0x40000132 /end MEASUREMENT
/begin MEASUREMENT ain_create_MAPSensorPin "Debug Variable" UBYTE CompuMethod_9 1 0 0 0 ECU_ADDRESS 0x40000133 /end MEASUREMENT
/begin MEASUREMENT ain_create_OilPresPin "Debug Variable" UBYTE CompuMethod_9 1 0 0 0 ECU_ADDRESS 0x40000134 /end MEASUREMENT
/begin MEASUREMENT ain_create_PostO2Pin "Debug Variable" UBYTE CompuMethod_9 1 0 0 0 ECU_ADDRESS 0x40000135 /end MEASUREMENT
/begin MEASUREMENT ain_create_SensVoltSensorPin "Debug Variable" UBYTE CompuMethod_9 1 0 0 0 ECU_ADDRESS 0x40000136 /end MEASUREMENT
/begin MEASUREMENT ain_create_SysVoltage "Debug Variable" UBYTE CompuMethod_9 1 0 0 0 ECU_ADDRESS 0x40000137 /end MEASUREMENT
/begin MEASUREMENT ain_create_TPS1AnalogInput "Debug Variable" UBYTE CompuMethod_9 1 0 0 0 ECU_ADDRESS 0x40000138 /end MEASUREMENT
/begin MEASUREMENT ain_create_TPS2AnalogInput "Debug Variable" UBYTE CompuMethod_9 1 0 0 0 ECU_ADDRESS 0x40000139 /end MEASUREMENT
/begin MEASUREMENT ain_read_ECTSensorPin "Debug Variable" UBYTE CompuMethod_9 1 0 0 0 ECU_ADDRESS 0x4000013A /end MEASUREMENT
/begin MEASUREMENT ain_read_ECUP "Debug Variable" UBYTE CompuMethod_9 1 0 0 0 ECU_ADDRESS 0x4000013B /end MEASUREMENT
/begin MEASUREMENT ain_read_EGRPin "Debug Variable" UBYTE CompuMethod_9 1 0 0 0 ECU_ADDRESS 0x4000013C /end MEASUREMENT
/begin MEASUREMENT ain_read_FuelPresPin "Debug Variable" UBYTE CompuMethod_9 1 0 0 0 ECU_ADDRESS 0x4000013D /end MEASUREMENT
/begin MEASUREMENT ain_read_IATSensorPin "Debug Variable" UBYTE CompuMethod_9 1 0 0 0 ECU_ADDRESS 0x4000013E /end MEASUREMENT
/begin MEASUREMENT ain_read_MAPSensorPin "Debug Variable" UBYTE CompuMethod_9 1 0 0 0 ECU_ADDRESS 0x4000013F /end MEASUREMENT
/begin MEASUREMENT ain_read_OilPresPin "Debug Variable" UBYTE CompuMethod_9 1 0 0 0 ECU_ADDRESS 0x40000140 /end MEASUREMENT
/begin MEASUREMENT ain_read_PostO2Pin "Debug Variable" UBYTE CompuMethod_9 1 0 0 0 ECU_ADDRESS 0x40000141 /end MEASUREMENT
/begin MEASUREMENT ain_read_SensVoltSensorPin "Debug Variable" UBYTE CompuMethod_9 1 0 0 0 ECU_ADDRESS 0x40000142 /end MEASUREMENT
/begin MEASUREMENT ain_read_SysVoltage "Debug Variable" UBYTE CompuMethod_9 1 0 0 0 ECU_ADDRESS 0x40000143 /end MEASUREMENT
/begin MEASUREMENT ain_read_TPS1AnalogInput "Debug Variable" UBYTE CompuMethod_9 1 0 0 0 ECU_ADDRESS 0x40000144 /end MEASUREMENT
/begin MEASUREMENT ain_read_TPS2AnalogInput "Debug Variable" UBYTE CompuMethod_9 1 0 0 0 ECU_ADDRESS 0x40000145 /end MEASUREMENT
/begin MEASUREMENT AirMinGovDGainErrorMult "" FLOAT32_IEEE CompuMethod_8 1 0 -1E+17 1E+17 ECU_ADDRESS 0x40000146 /end MEASUREMENT
/begin MEASUREMENT AirMinGovDTerm "Air min governor D term" FLOAT32_IEEE CompuMethod_2 1 0 -1E+17 1E+17 ECU_ADDRESS 0x4000014A /end MEASUREMENT
/begin MEASUREMENT AirMinGovError "Air min governor P term" FLOAT32_IEEE CompuMethod_2 1 0 -1E+17 1E+17 ECU_ADDRESS 0x4000014E /end MEASUREMENT
/begin MEASUREMENT AirMinGovIGainErrorMult "" FLOAT32_IEEE CompuMethod_8 1 0 -1E+17 1E+17 ECU_ADDRESS 0x40000152 /end MEASUREMENT
/begin MEASUREMENT AirMinGovITerm "Air min governor I term" FLOAT32_IEEE CompuMethod_2 1 0 -1E+17 1E+17 ECU_ADDRESS 0x40000156 /end MEASUREMENT
/begin MEASUREMENT AirMinGovOutput "Total output from min. gov. air PID controller." FLOAT32_IEEE CompuMethod_5 1 0 -1E+17 1E+17 ECU_ADDRESS 0x4000015A /end MEASUREMENT
/begin MEASUREMENT AirMinGovPGainErrorMult "" FLOAT32_IEEE CompuMethod_8 1 0 -1E+17 1E+17 ECU_ADDRESS 0x4000015E /end MEASUREMENT
/begin MEASUREMENT AirMinGovPTerm "Air min governor P term" FLOAT32_IEEE CompuMethod_2 1 0 -1E+17 1E+17 ECU_ADDRESS 0x40000162 /end MEASUREMENT
/begin MEASUREMENT AirMinGovSpeedErrorIdx "" UWORD CompuMethod_11 1 0 0 127.998 ECU_ADDRESS 0x40000166 /end MEASUREMENT
/begin MEASUREMENT AirMinGovSpeedErrorIn "" FLOAT32_IEEE CompuMethod_2 1 0 -1E+17 1E+17 ECU_ADDRESS 0x40000168 /end MEASUREMENT
/begin MEASUREMENT APC_TPS10Idx "" UWORD CompuMethod_11 1 0 0 127.998 ECU_ADDRESS 0x40000174 /end MEASUREMENT
/begin MEASUREMENT APCPort "Air per cylinder per cycle." FLOAT32_IEEE CompuMethod_12 1 0 -1E+17 1E+17 ECU_ADDRESS 0x40000176 /end MEASUREMENT
/begin MEASUREMENT App05Idx "" UWORD CompuMethod_11 1 0 0 127.998 ECU_ADDRESS 0x4000017A /end MEASUREMENT
/begin MEASUREMENT App05In "" FLOAT32_IEEE CompuMethod_2 1 0 -1E+17 1E+17 ECU_ADDRESS 0x4000017C /end MEASUREMENT
/begin MEASUREMENT APP1_Prb "" FLOAT32_IEEE CompuMethod_2 1 0 -1E+17 1E+17 ECU_ADDRESS 0x40000180 /end MEASUREMENT
/begin MEASUREMENT APP17Idx "" UWORD CompuMethod_11 1 0 0 127.998 ECU_ADDRESS 0x40000184 /end MEASUREMENT
/begin MEASUREMENT APP17In "" FLOAT32_IEEE CompuMethod_2 1 0 -1E+17 1E+17 ECU_ADDRESS 0x40000186 /end MEASUREMENT
/begin MEASUREMENT APP2_Prb "" FLOAT32_IEEE CompuMethod_2 1 0 -1E+17 1E+17 ECU_ADDRESS 0x4000018A /end MEASUREMENT
/begin MEASUREMENT ApplicationInitStatus "Shows how far the module initialization has progressed" UBYTE CompuMethod_13 1 0 3 5 ECU_ADDRESS 0x4000018E /end MEASUREMENT
/begin MEASUREMENT ApplicationStopReason "Indicates the reason for an application stop" ULONG CompuMethod_17 1 0 0 5 ECU_ADDRESS 0x4000018F /end MEASUREMENT
/begin MEASUREMENT ApplicationStopReasonBlock "Indicates the block that caused the application stop" ULONG CompuMethod_18 1 0 0 5 ECU_ADDRESS 0x40000193 /end MEASUREMENT
/begin MEASUREMENT APPPcnt "APP used in controller (after power curve and CutThrottle limiting" FLOAT32_IEEE CompuMethod_5 1 0 -1E+17 1E+17 ECU_ADDRESS 0x40000197 /end MEASUREMENT
/begin MEASUREMENT Desired_AF_Ratio "Desired Air to Fuel Ratio based on Ethanol Percentage" FLOAT32_IEEE CompuMethod_56 1 0 -1E+17 1E+17 ECU_ADDRESS 0x400002FE /end MEASUREMENT
/begin MEASUREMENT ECT_KeyUp "" FLOAT32_IEEE CompuMethod_57 1 0 -1E+17 1E+17 ECU_ADDRESS 0x40000326 /end MEASUREMENT
/begin MEASUREMENT ETCReqFallRate "Limits fall rate of ETCRequestFiltered." FLOAT32_IEEE CompuMethod_85 1 0 -1E+17 1E+17 ECU_ADDRESS 0x40000409 /end MEASUREMENT
/begin MEASUREMENT ETCReqFilterConst "" FLOAT32_IEEE CompuMethod_2 1 0 -1E+17 1E+17 ECU_ADDRESS 0x4000040D /end MEASUREMENT
/begin MEASUREMENT ETCReqRiseRate "Limits rise rate of ETCRequestFiltered." FLOAT32_IEEE CompuMethod_85 1 0 -1E+17 1E+17 ECU_ADDRESS 0x40000411 /end MEASUREMENT
/begin MEASUREMENT ETCRequest "Converts pedal position into a desired ETC position." FLOAT32_IEEE CompuMethod_5 1 0 -1E+17 1E+17 ECU_ADDRESS 0x40000415 /end MEASUREMENT
/begin MEASUREMENT ETCRequestDirection "" UBYTE CompuMethod_86 1 0 0 1 ECU_ADDRESS 0x40000419 /end MEASUREMENT
/begin MEASUREMENT ETCRequestFinal "Final ETC request sent to ETC controller from Run state." FLOAT32_IEEE CompuMethod_25 1 0 -1E+17 1E+17 ECU_ADDRESS 0x4000041A /end MEASUREMENT
/begin MEASUREMENT FilteredETCRequest "" FLOAT32_IEEE CompuMethod_2 1 0 -1E+17 1E+17 ECU_ADDRESS 0x4000044E /end MEASUREMENT
/begin MEASUREMENT FuelAdapt_Error "Error in fuel flow at the current operating point, as compared to O2 sensor" FLOAT32_IEEE CompuMethod_2 1 0 -1E+17 1E+17 ECU_ADDRESS 0x4000049C /end MEASUREMENT
/begin MEASUREMENT FuelAdaptEnabled "Indicates whether FuelFlowComp map adapting is enabled" UBYTE CompuMethod_22 1 0 0 1 ECU_ADDRESS 0x400004A0 /end MEASUREMENT
/begin MEASUREMENT FuelAdaptGain "Gain for updating FuelFlowComp map.  This fraction of the error is added to the map every 5ms." FLOAT32_IEEE CompuMethod_23 1 0 -1E+17 1E+17 ECU_ADDRESS 0x400004A1 /end MEASUREMENT
/begin MEASUREMENT FuelFlowComp "Fuel Flow Compensation Multiplier - gain to adjust modelling errors in mechanical fuel system." FLOAT32_IEEE CompuMethod_8 1 0 -1E+17 1E+17 ECU_ADDRESS 0x400004AD /end MEASUREMENT
/begin MEASUREMENT FuelFlowCompAdapt "Adapt map based on O2 ITerm that is multiplied into FuelFlowComp." FLOAT32_IEEE CompuMethod_8 1 0 -1E+17 1E+17 ECU_ADDRESS 0x400004B1 /end MEASUREMENT
/begin MEASUREMENT GlobalBaseFuelRate "Liquid fuel rate based on airflow and target equivalence ratio" FLOAT32_IEEE CompuMethod_7 1 0 -1E+17 1E+17 ECU_ADDRESS 0x400004E5 /end MEASUREMENT
/begin MEASUREMENT IdleHandOffMult "" FLOAT32_IEEE CompuMethod_2 1 0 -1E+17 1E+17 ECU_ADDRESS 0x40000511 /end MEASUREMENT
/begin MEASUREMENT IndLoad "Converts APC into Indicated Torque." FLOAT32_IEEE CompuMethod_108 1 0 -1E+17 1E+17 ECU_ADDRESS 0x4000051A /end MEASUREMENT
/begin MEASUREMENT MaxETCSetPtLimit "Maximum allowable ETC position." FLOAT32_IEEE CompuMethod_5 1 0 -1E+17 1E+17 ECU_ADDRESS 0x40000646 /end MEASUREMENT
/begin MEASUREMENT MinGovReset "" UBYTE CompuMethod_38 1 0 0 1 ECU_ADDRESS 0x40000688 /end MEASUREMENT
/begin MEASUREMENT PerCylBaseFuelRate "Liquid fuel mass flow rate based on airflow and target equivalence ratio per cylinder." FLOAT32_IEEE CompuMethod_7 1 0 -1E+17 1E+17 ECU_ADDRESS 0x400008CC /end MEASUREMENT
/begin MEASUREMENT RPMAccel17Idx "" UWORD CompuMethod_11 1 0 0 127.998 ECU_ADDRESS 0x40000912 /end MEASUREMENT
/begin MEASUREMENT RPMAccel17In "" FLOAT32_IEEE CompuMethod_2 1 0 -1E+17 1E+17 ECU_ADDRESS 0x40000914 /end MEASUREMENT
/begin MEASUREMENT SpkMinGovOutput "" FLOAT32_IEEE CompuMethod_2 1 0 -1E+17 1E+17 ECU_ADDRESS 0x4000095F /end MEASUREMENT
/begin MEASUREMENT SSLoadDirection "" UBYTE CompuMethod_86 1 0 0 1 ECU_ADDRESS 0x40000972 /end MEASUREMENT
/begin MEASUREMENT SSLoadFilterConst "" FLOAT32_IEEE CompuMethod_2 1 0 -1E+17 1E+17 ECU_ADDRESS 0x40000973 /end MEASUREMENT
/begin MEASUREMENT SSLoadFiltered "" FLOAT32_IEEE CompuMethod_2 1 0 -1E+17 1E+17 ECU_ADDRESS 0x40000977 /end MEASUREMENT
/begin MEASUREMENT SSRPMDirection "" UBYTE CompuMethod_86 1 0 0 1 ECU_ADDRESS 0x4000097B /end MEASUREMENT
/begin MEASUREMENT SSRPMFilterConst "" FLOAT32_IEEE CompuMethod_2 1 0 -1E+17 1E+17 ECU_ADDRESS 0x4000097C /end MEASUREMENT
/begin MEASUREMENT SSRPMFiltered "" FLOAT32_IEEE CompuMethod_2 1 0 -1E+17 1E+17 ECU_ADDRESS 0x40000980 /end MEASUREMENT
/begin MEASUREMENT TimeSinceRun09Idx "" UWORD CompuMethod_11 1 0 0 127.998 ECU_ADDRESS 0x400009C0 /end MEASUREMENT
/begin MEASUREMENT TimeSinceRun09In "" FLOAT32_IEEE CompuMethod_2 1 0 -1E+17 1E+17 ECU_ADDRESS 0x400009C2 /end MEASUREMENT
/begin MEASUREMENT VE_Error "As table adapts, should trend to 1" FLOAT32_IEEE CompuMethod_5 1 0 -1E+17 1E+17 ECU_ADDRESS 0x40000A34 /end MEASUREMENT
/begin CHARACTERISTIC AD_Input1_Vin_Ovr_new "" VALUE 0x80000056 RecordLayout_4 0 CompuMethod_2 -1E+17 1E+17 /end CHARACTERISTIC
/begin CHARACTERISTIC AD_Input1_Vin_Ovr_ovr "" VALUE 0x8000005A RecordLayout_1 0 CompuMethod_4 0 1 /end CHARACTERISTIC
/begin CHARACTERISTIC AD_Input2_En_Ovr_new "" VALUE 0x8000005B RecordLayout_4 0 CompuMethod_2 -1E+17 1E+17 /end CHARACTERISTIC
/begin CHARACTERISTIC AD_Input2_En_Ovr_ovr "" VALUE 0x8000005F RecordLayout_1 0 CompuMethod_4 0 1 /end CHARACTERISTIC
/begin CHARACTERISTIC AD_Input2_Vin_Ovr_new "" VALUE 0x80000060 RecordLayout_4 0 CompuMethod_2 -1E+17 1E+17 /end CHARACTERISTIC
/begin CHARACTERISTIC AD_Input2_Vin_Ovr_ovr "" VALUE 0x80000064 RecordLayout_1 0 CompuMethod_4 0 1 /end CHARACTERISTIC
/begin CHARACTERISTIC AdaptEnable "Determines whether the FuelFlowComp map will be adapted using the MAF sensor" VALUE 0x80000065 RecordLayout_1 0 CompuMethod_6 0 1 /end CHARACTERISTIC
/begin CHARACTERISTIC AF_Ethanol "Stoichiometric ratio for ethanol" VALUE 0x80000066 RecordLayout_4 0 CompuMethod_8 5 30 /end CHARACTERISTIC
/begin CHARACTERISTIC AF_Gasoline "Stoichiometric ratio for gasoline" VALUE 0x8000006A RecordLayout_4 0 CompuMethod_8 5 30 /end CHARACTERISTIC
/begin CHARACTERISTIC AirControlSource "Selects source of idle air control" VALUE 0x8000006E RecordLayout_1 0 CompuMethod_10 0 1 /end CHARACTERISTIC
/begin CHARACTERISTIC AirMinGovDGain "Base D-gain for the min. governor controller." VALUE 0x8000006F RecordLayout_4 0 CompuMethod_8 -1E+17 1E+17 /end CHARACTERISTIC
/begin CHARACTERISTIC AirMinGovDGainErrorMultTbl "" CURVE 0x80000073 RecordLayout_4 0 CompuMethod_8 -1E+17 1E+17
 /begin AXIS_DESCR COM_AXIS AirMinGovSpeedErrorIn CompuMethod_2 9 -1E+17 1E+17 AXIS_PTS_REF AirMinGovSpeedErrorIdxArr /end AXIS_DESCR
/end CHARACTERISTIC
/begin CHARACTERISTIC AirMinGovErrorGain "Error gain for the min governor controller. This gain is applied to the RPM error term before it is used to calculate the P, I and D terms." VALUE 0x80000097 RecordLayout_4 0 CompuMethod_8 -1E+17 1E+17 /end CHARACTERISTIC
/begin CHARACTERISTIC AirMinGovIGain "Base I-gain for the min. governor controller." VALUE 0x8000009B RecordLayout_4 0 CompuMethod_8 -1E+17 1E+17 /end CHARACTERISTIC
/begin CHARACTERISTIC AirMinGovIGainErrorMultTbl "" CURVE 0x8000009F RecordLayout_4 0 CompuMethod_8 -1E+17 1E+17
 /begin AXIS_DESCR COM_AXIS AirMinGovSpeedErrorIn CompuMethod_2 9 -1E+17 1E+17 AXIS_PTS_REF AirMinGovSpeedErrorIdxArr /end AXIS_DESCR
/end CHARACTERISTIC
/begin CHARACTERISTIC AirMinGovITermLowerLimit "Lower limit on Air Min Governor I-term value." VALUE 0x800000C3 RecordLayout_4 0 CompuMethod_5 -1E+17 1E+17 /end CHARACTERISTIC
/begin CHARACTERISTIC AirMinGovITermUpperLimit "Upper limit on Air Min Governor I-term value." VALUE 0x800000C7 RecordLayout_4 0 CompuMethod_5 -1E+17 1E+17 /end CHARACTERISTIC
/begin CHARACTERISTIC AirMinGovPGain "Base P-gain for the min. governor controller." VALUE 0x800000CB RecordLayout_4 0 CompuMethod_8 -1E+17 1E+17 /end CHARACTERISTIC
/begin CHARACTERISTIC AirMinGovPGainErrorMultTbl "" CURVE 0x800000CF RecordLayout_4 0 CompuMethod_8 -1E+17 1E+17
 /begin AXIS_DESCR COM_AXIS AirMinGovSpeedErrorIn CompuMethod_2 9 -1E+17 1E+17 AXIS_PTS_REF AirMinGovSpeedErrorIdxArr /end AXIS_DESCR
/end CHARACTERISTIC
/begin CHARACTERISTIC AirMinGovPIDOutLowerLimit "Lower limit on air min governor PID Output." VALUE 0x800000F3 RecordLayout_4 0 CompuMethod_5 -1E+17 1E+17 /end CHARACTERISTIC
/begin CHARACTERISTIC AirMinGovPIDOutUpperLimit "Upper limit on air min governor PID Output." VALUE 0x800000F7 RecordLayout_4 0 CompuMethod_5 -1E+17 1E+17 /end CHARACTERISTIC
/begin CHARACTERISTIC An_PosSense1_Ovr_new "" VALUE 0x8000011F RecordLayout_4 0 CompuMethod_2 -1E+17 1E+17 /end CHARACTERISTIC
/begin CHARACTERISTIC An_PosSense1_Ovr_ovr "" VALUE 0x80000123 RecordLayout_1 0 CompuMethod_4 0 1 /end CHARACTERISTIC
/begin CHARACTERISTIC An_PosSense2_Ovr_new "" VALUE 0x80000124 RecordLayout_4 0 CompuMethod_2 -1E+17 1E+17 /end CHARACTERISTIC
/begin CHARACTERISTIC An_PosSense2_Ovr_ovr "" VALUE 0x80000128 RecordLayout_1 0 CompuMethod_4 0 1 /end CHARACTERISTIC
/begin CHARACTERISTIC APP "" VALUE 0x80000151 RecordLayout_4 0 CompuMethod_2 -1E+17 1E+17 /end CHARACTERISTIC
/begin CHARACTERISTIC APP1_Ovr_new "" VALUE 0x80000169 RecordLayout_4 0 CompuMethod_2 -1E+17 1E+17 /end CHARACTERISTIC
/begin CHARACTERISTIC APP1_Ovr_ovr "" VALUE 0x8000016D RecordLayout_1 0 CompuMethod_4 0 1 /end CHARACTERISTIC
/begin CHARACTERISTIC APP2_Ovr_new "" VALUE 0x800001B2 RecordLayout_4 0 CompuMethod_2 -1E+17 1E+17 /end CHARACTERISTIC
/begin CHARACTERISTIC APP2_Ovr_ovr "" VALUE 0x800001B6 RecordLayout_1 0 CompuMethod_4 0 1 /end CHARACTERISTIC
/begin CHARACTERISTIC ApplicationStatus "View and set the application runtime status" VALUE 0x800001B9 RecordLayout_1 0 CompuMethod_16 1 3 /end CHARACTERISTIC
/begin CHARACTERISTIC Caught_RPM "" VALUE 0x8000039B RecordLayout_4 0 CompuMethod_26 -1E+17 1E+17 /end CHARACTERISTIC
/begin CHARACTERISTIC Crank_Time "" VALUE 0x800005C6 RecordLayout_4 0 CompuMethod_46 -500000000000000 500000000000000 /end CHARACTERISTIC
/begin CHARACTERISTIC Crank_Wait_Before_Retry "" VALUE 0x800005CA RecordLayout_4 0 CompuMethod_46 -500000000000000 500000000000000 /end CHARACTERISTIC
/begin CHARACTERISTIC Cranking_Torque "" VALUE 0x8000065A RecordLayout_4 0 CompuMethod_49 -1E+17 1E+17 /end CHARACTERISTIC
/begin CHARACTERISTIC ETCReqDecFiltC "Filter time constant for a decreasing ETC Request signal." VALUE 0x8000159D RecordLayout_4 0 CompuMethod_54 -1E+17 1E+17 /end CHARACTERISTIC
/begin CHARACTERISTIC ETCReqFallRateTbl "Limits fall rate of ETCRequestFiltered." CURVE 0x800015A1 RecordLayout_4 0 CompuMethod_85 -1E+17 1E+17
 /begin AXIS_DESCR COM_AXIS TPS09In CompuMethod_2 9 -1E+17 1E+17 AXIS_PTS_REF TPS09IdxArr /end AXIS_DESCR
/end CHARACTERISTIC
/begin CHARACTERISTIC ETCReqIncFiltC "Filter time constant for a decreasing ETC Request signal." VALUE 0x800015C5 RecordLayout_4 0 CompuMethod_54 -1E+17 1E+17 /end CHARACTERISTIC
/begin CHARACTERISTIC ETCReqRiseRateTbl "Limits rise rate of ETCRequestFiltered." CURVE 0x800015C9 RecordLayout_4 0 CompuMethod_85 -1E+17 1E+17
 /begin AXIS_DESCR COM_AXIS TPS09In CompuMethod_2 9 -1E+17 1E+17 AXIS_PTS_REF TPS09IdxArr /end AXIS_DESCR
/end CHARACTERISTIC
/begin CHARACTERISTIC ETCRequestTbl "Converts pedal position into a desired ETC position." CURVE 0x800015ED RecordLayout_4 0 CompuMethod_5 0 1E+17
 /begin AXIS_DESCR COM_AXIS APP17In CompuMethod_2 17 -1E+17 1E+17 AXIS_PTS_REF APP17IdxArr /end AXIS_DESCR
/end CHARACTERISTIC
/begin CHARACTERISTIC FaultManager.MAPRangeHigh.Total_Samples__Y_ "Fault manager configuration.  Select up to 4 actions for each fault." VALUE 0x80001BEA RecordLayout_7 0 CompuMethod_1 0 65535 /end CHARACTERISTIC
/begin CHARACTERISTIC FaultManager.MAPRangeHigh.Action_1 "Fault manager configuration.  Select up to 4 actions for each fault." VALUE 0x80001BEC RecordLayout_7 0 CompuMethod_91 0 65535 /end CHARACTERISTIC
/begin CHARACTERISTIC FaultManager.MAPRangeHigh.Action_1_Condition "Fault manager configuration.  Select up to 4 actions for each fault." VALUE 0x80001BEE RecordLayout_7 0 CompuMethod_92 0 65535 /end CHARACTERISTIC
/begin CHARACTERISTIC FaultManager.MAPRangeHigh.Action_2 "Fault manager configuration.  Select up to 4 actions for each fault." VALUE 0x80001BF0 RecordLayout_7 0 CompuMethod_91 0 65535 /end CHARACTERISTIC
/begin CHARACTERISTIC FaultManager.MAPRangeHigh.Action_2_Condition "Fault manager configuration.  Select up to 4 actions for each fault." VALUE 0x80001BF2 RecordLayout_7 0 CompuMethod_92 0 65535 /end CHARACTERISTIC
/begin CHARACTERISTIC FaultManager.MAPRangeHigh.Action_3 "Fault manager configuration.  Select up to 4 actions for each fault." VALUE 0x80001BF4 RecordLayout_7 0 CompuMethod_91 0 65535 /end CHARACTERISTIC
/begin CHARACTERISTIC FaultManager.MAPRangeHigh.Action_3_Condition "Fault manager configuration.  Select up to 4 actions for each fault." VALUE 0x80001BF6 RecordLayout_7 0 CompuMethod_92 0 65535 /end CHARACTERISTIC
/begin CHARACTERISTIC FaultManager.MAPRangeHigh.Action_4 "Fault manager configuration.  Select up to 4 actions for each fault." VALUE 0x80001BF8 RecordLayout_7 0 CompuMethod_91 0 65535 /end CHARACTERISTIC
/begin CHARACTERISTIC FaultManager.MAPRangeHigh.Action_4_Condition "Fault manager configuration.  Select up to 4 actions for each fault." VALUE 0x80001BFA RecordLayout_7 0 CompuMethod_92 0 65535 /end CHARACTERISTIC
/begin CHARACTERISTIC FaultManager.MAPRangeLow.Mode "Fault manager configuration.  Select up to 4 actions for each fault." VALUE 0x80001BFC RecordLayout_7 0 CompuMethod_89 0 65535 /end CHARACTERISTIC
/begin CHARACTERISTIC FaultManager.MAPRangeLow.ID "Fault manager configuration.  Select up to 4 actions for each fault." VALUE 0x80001BFE RecordLayout_7 0 CompuMethod_1 0 65535 /end CHARACTERISTIC
/begin CHARACTERISTIC FaultManager.MAPRangeLow.Test "Fault manager configuration.  Select up to 4 actions for each fault." VALUE 0x80001C00 RecordLayout_7 0 CompuMethod_90 0 65535 /end CHARACTERISTIC
/begin CHARACTERISTIC FaultManager.MAPRangeLow.Faulty_Samples__X_ "Fault manager configuration.  Select up to 4 actions for each fault." VALUE 0x80001C02 RecordLayout_7 0 CompuMethod_1 0 65535 /end CHARACTERISTIC
/begin CHARACTERISTIC FaultManager.MAPRangeLow.Total_Samples__Y_ "Fault manager configuration.  Select up to 4 actions for each fault." VALUE 0x80001C04 RecordLayout_7 0 CompuMethod_1 0 65535 /end CHARACTERISTIC
/begin CHARACTERISTIC FaultManager.MAPRangeLow.Action_1 "Fault manager configuration.  Select up to 4 actions for each fault." VALUE 0x80001C06 RecordLayout_7 0 CompuMethod_91 0 65535 /end CHARACTERISTIC
/begin CHARACTERISTIC FaultManager.MAPRangeLow.Action_1_Condition "Fault manager configuration.  Select up to 4 actions for each fault." VALUE 0x80001C08 RecordLayout_7 0 CompuMethod_92 0 65535 /end CHARACTERISTIC
/begin CHARACTERISTIC FaultManager.MAPRangeLow.Action_2 "Fault manager configuration.  Select up to 4 actions for each fault." VALUE 0x80001C0A RecordLayout_7 0 CompuMethod_91 0 65535 /end CHARACTERISTIC
/begin CHARACTERISTIC FaultManager.MAPRangeLow.Action_2_Condition "Fault manager configuration.  Select up to 4 actions for each fault." VALUE 0x80001C0C RecordLayout_7 0 CompuMethod_92 0 65535 /end CHARACTERISTIC
/begin CHARACTERISTIC FaultManager.MAPRangeLow.Action_3 "Fault manager configuration.  Select up to 4 actions for each fault." VALUE 0x80001C0E RecordLayout_7 0 CompuMethod_91 0 65535 /end CHARACTERISTIC
/begin CHARACTERISTIC FaultManager.MAPRangeLow.Action_3_Condition "Fault manager configuration.  Select up to 4 actions for each fault." VALUE 0x80001C10 RecordLayout_7 0 CompuMethod_92 0 65535 /end CHARACTERISTIC
/begin CHARACTERISTIC FaultManager.MAPRangeLow.Action_4 "Fault manager configuration.  Select up to 4 actions for each fault." VALUE 0x80001C12 RecordLayout_7 0 CompuMethod_91 0 65535 /end CHARACTERISTIC
/begin CHARACTERISTIC FaultManager.MAPRangeLow.Action_4_Condition "Fault manager configuration.  Select up to 4 actions for each fault." VALUE 0x80001C14 RecordLayout_7 0 CompuMethod_92 0 65535 /end CHARACTERISTIC
/begin CHARACTERISTIC FaultManager.MAPTimeRangeHigh.Mode "Fault manager configuration.  Select up to 4 actions for each fault." VALUE 0x80001C16 RecordLayout_7 0 CompuMethod_89 0 65535 /end CHARACTERISTIC
/begin CHARACTERISTIC FaultManager.MAPTimeRangeHigh.ID "Fault manager configuration.  Select up to 4 actions for each fault." VALUE 0x80001C18 RecordLayout_7 0 CompuMethod_1 0 65535 /end CHARACTERISTIC
/begin CHARACTERISTIC FaultManager.MAPTimeRangeHigh.Test "Fault manager configuration.  Select up to 4 actions for each fault." VALUE 0x80001C1A RecordLayout_7 0 CompuMethod_90 0 65535 /end CHARACTERISTIC
/begin CHARACTERISTIC FaultManager.MAPTimeRangeHigh.Faulty_Samples__X_ "Fault manager configuration.  Select up to 4 actions for each fault." VALUE 0x80001C1C RecordLayout_7 0 CompuMethod_1 0 65535 /end CHARACTERISTIC
/begin CHARACTERISTIC FaultManager.MAPTimeRangeHigh.Total_Samples__Y_ "Fault manager configuration.  Select up to 4 actions for each fault." VALUE 0x80001C1E RecordLayout_7 0 CompuMethod_1 0 65535 /end CHARACTERISTIC
/begin CHARACTERISTIC FaultManager.MAPTimeRangeHigh.Action_1 "Fault manager configuration.  Select up to 4 actions for each fault." VALUE 0x80001C20 RecordLayout_7 0 CompuMethod_91 0 65535 /end CHARACTERISTIC
/begin CHARACTERISTIC FaultManager.MAPTimeRangeHigh.Action_1_Condition "Fault manager configuration.  Select up to 4 actions for each fault." VALUE 0x80001C22 RecordLayout_7 0 CompuMethod_92 0 65535 /end CHARACTERISTIC
/begin CHARACTERISTIC FaultManager.MAPTimeRangeHigh.Action_2 "Fault manager configuration.  Select up to 4 actions for each fault." VALUE 0x80001C24 RecordLayout_7 0 CompuMethod_91 0 65535 /end CHARACTERISTIC
/begin CHARACTERISTIC FaultManager.MAPTimeRangeHigh.Action_2_Condition "Fault manager configuration.  Select up to 4 actions for each fault." VALUE 0x80001C26 RecordLayout_7 0 CompuMethod_92 0 65535 /end CHARACTERISTIC
/begin CHARACTERISTIC FaultManager.MAPTimeRangeHigh.Action_3 "Fault manager configuration.  Select up to 4 actions for each fault." VALUE 0x80001C28 RecordLayout_7 0 CompuMethod_91 0 65535 /end CHARACTERISTIC
/begin CHARACTERISTIC FaultManager.MAPTimeRangeHigh.Action_3_Condition "Fault manager configuration.  Select up to 4 actions for each fault." VALUE 0x80001C2A RecordLayout_7 0 CompuMethod_92 0 65535 /end CHARACTERISTIC
/begin CHARACTERISTIC FaultManager.MAPTimeRangeHigh.Action_4 "Fault manager configuration.  Select up to 4 actions for each fault." VALUE 0x80001C2C RecordLayout_7 0 CompuMethod_91 0 65535 /end CHARACTERISTIC
/begin CHARACTERISTIC FaultManager.MAPTimeRangeHigh.Action_4_Condition "Fault manager configuration.  Select up to 4 actions for each fault." VALUE 0x80001C2E RecordLayout_7 0 CompuMethod_92 0 65535 /end CHARACTERISTIC
/begin CHARACTERISTIC FaultManager.MAPTimeRangeLow.Mode "Fault manager configuration.  Select up to 4 actions for each fault." VALUE 0x80001C30 RecordLayout_7 0 CompuMethod_89 0 65535 /end CHARACTERISTIC
/begin CHARACTERISTIC FaultManager.MAPTimeRangeLow.ID "Fault manager configuration.  Select up to 4 actions for each fault." VALUE 0x80001C32 RecordLayout_7 0 CompuMethod_1 0 65535 /end CHARACTERISTIC
/begin CHARACTERISTIC FaultManager.MAPTimeRangeLow.Test "Fault manager configuration.  Select up to 4 actions for each fault." VALUE 0x80001C34 RecordLayout_7 0 CompuMethod_90 0 65535 /end CHARACTERISTIC
/begin CHARACTERISTIC FaultManager.MAPTimeRangeLow.Faulty_Samples__X_ "Fault manager configuration.  Select up to 4 actions for each fault." VALUE 0x80001C36 RecordLayout_7 0 CompuMethod_1 0 65535 /end CHARACTERISTIC
/begin CHARACTERISTIC FaultManager.MAPTimeRangeLow.Total_Samples__Y_ "Fault manager configuration.  Select up to 4 actions for each fault." VALUE 0x80001C38 RecordLayout_7 0 CompuMethod_1 0 65535 /end CHARACTERISTIC
/begin CHARACTERISTIC FaultManager.MAPTimeRangeLow.Action_1 "Fault manager configuration.  Select up to 4 actions for each fault." VALUE 0x80001C3A RecordLayout_7 0 CompuMethod_91 0 65535 /end CHARACTERISTIC
/begin CHARACTERISTIC FaultManager.MAPTimeRangeLow.Action_1_Condition "Fault manager configuration.  Select up to 4 actions for each fault." VALUE 0x80001C3C RecordLayout_7 0 CompuMethod_92 0 65535 /end CHARACTERISTIC
/begin CHARACTERISTIC FaultManager.MAPTimeRangeLow.Action_2 "Fault manager configuration.  Select up to 4 actions for each fault." VALUE 0x80001C3E RecordLayout_7 0 CompuMethod_91 0 65535 /end CHARACTERISTIC
/begin CHARACTERISTIC FaultManager.MAPTimeRangeLow.Action_2_Condition "Fault manager configuration.  Select up to 4 actions for each fault." VALUE 0x80001C40 RecordLayout_7 0 CompuMethod_92 0 65535 /end CHARACTERISTIC
/begin CHARACTERISTIC FaultManager.MAPTimeRangeLow.Action_3 "Fault manager configuration.  Select up to 4 actions for each fault." VALUE 0x80001C42 RecordLayout_7 0 CompuMethod_91 0 65535 /end CHARACTERISTIC
/begin CHARACTERISTIC FaultManager.MAPTimeRangeLow.Action_3_Condition "Fault manager configuration.  Select up to 4 actions for each fault." VALUE 0x80001C44 RecordLayout_7 0 CompuMethod_92 0 65535 /end CHARACTERISTIC
/begin CHARACTERISTIC FaultManager.MAPTimeRangeLow.Action_4 "Fault manager configuration.  Select up to 4 actions for each fault." VALUE 0x80001C46 RecordLayout_7 0 CompuMethod_91 0 65535 /end CHARACTERISTIC
/begin CHARACTERISTIC FaultManager.MAPTimeRangeLow.Action_4_Condition "Fault manager configuration.  Select up to 4 actions for each fault." VALUE 0x80001C48 RecordLayout_7 0 CompuMethod_92 0 65535 /end CHARACTERISTIC
/begin CHARACTERISTIC FaultManager.MAP_IR_HI.Mode "Fault manager configuration.  Select up to 4 actions for each fault." VALUE 0x80001C4A RecordLayout_7 0 CompuMethod_89 0 65535 /end CHARACTERISTIC
/begin CHARACTERISTIC FaultManager.MAP_IR_HI.ID "Fault manager configuration.  Select up to 4 actions for each fault." VALUE 0x80001C4C RecordLayout_7 0 CompuMethod_1 0 65535 /end CHARACTERISTIC
/begin CHARACTERISTIC FaultManager.MAP_IR_HI.Test "Fault manager configuration.  Select up to 4 actions for each fault." VALUE 0x80001C4E RecordLayout_7 0 CompuMethod_90 0 65535 /end CHARACTERISTIC
/begin CHARACTERISTIC FaultManager.MAP_IR_HI.Faulty_Samples__X_ "Fault manager configuration.  Select up to 4 actions for each fault." VALUE 0x80001C50 RecordLayout_7 0 CompuMethod_1 0 65535 /end CHARACTERISTIC
/begin CHARACTERISTIC FaultManager.MAP_IR_HI.Total_Samples__Y_ "Fault manager configuration.  Select up to 4 actions for each fault." VALUE 0x80001C52 RecordLayout_7 0 CompuMethod_1 0 65535 /end CHARACTERISTIC
/begin CHARACTERISTIC FaultManager.MAP_IR_HI.Action_1 "Fault manager configuration.  Select up to 4 actions for each fault." VALUE 0x80001C54 RecordLayout_7 0 CompuMethod_91 0 65535 /end CHARACTERISTIC
/begin CHARACTERISTIC FaultManager.MAP_IR_HI.Action_1_Condition "Fault manager configuration.  Select up to 4 actions for each fault." VALUE 0x80001C56 RecordLayout_7 0 CompuMethod_92 0 65535 /end CHARACTERISTIC
/begin CHARACTERISTIC FaultManager.MAP_IR_HI.Action_2 "Fault manager configuration.  Select up to 4 actions for each fault." VALUE 0x80001C58 RecordLayout_7 0 CompuMethod_91 0 65535 /end CHARACTERISTIC
/begin CHARACTERISTIC FaultManager.MAP_IR_HI.Action_2_Condition "Fault manager configuration.  Select up to 4 actions for each fault." VALUE 0x80001C5A RecordLayout_7 0 CompuMethod_92 0 65535 /end CHARACTERISTIC
/begin CHARACTERISTIC FaultManager.MAP_IR_HI.Action_3 "Fault manager configuration.  Select up to 4 actions for each fault." VALUE 0x80001C5C RecordLayout_7 0 CompuMethod_91 0 65535 /end CHARACTERISTIC
/begin CHARACTERISTIC FaultManager.MAP_IR_HI.Action_3_Condition "Fault manager configuration.  Select up to 4 actions for each fault." VALUE 0x80001C5E RecordLayout_7 0 CompuMethod_92 0 65535 /end CHARACTERISTIC
/begin CHARACTERISTIC FaultManager.MAP_IR_HI.Action_4 "Fault manager configuration.  Select up to 4 actions for each fault." VALUE 0x80001C60 RecordLayout_7 0 CompuMethod_91 0 65535 /end CHARACTERISTIC
/begin CHARACTERISTIC FaultManager.MAP_IR_HI.Action_4_Condition "Fault manager configuration.  Select up to 4 actions for each fault." VALUE 0x80001C62 RecordLayout_7 0 CompuMethod_92 0 65535 /end CHARACTERISTIC
/begin CHARACTERISTIC FaultManager.MAP_IR_LO.Mode "Fault manager configuration.  Select up to 4 actions for each fault." VALUE 0x80001C64 RecordLayout_7 0 CompuMethod_89 0 65535 /end CHARACTERISTIC
/begin CHARACTERISTIC FaultManager.MAP_IR_LO.ID "Fault manager configuration.  Select up to 4 actions for each fault." VALUE 0x80001C66 RecordLayout_7 0 CompuMethod_1 0 65535 /end CHARACTERISTIC
/begin CHARACTERISTIC FaultManager.MAP_IR_LO.Test "Fault manager configuration.  Select up to 4 actions for each fault." VALUE 0x80001C68 RecordLayout_7 0 CompuMethod_90 0 65535 /end CHARACTERISTIC
/begin CHARACTERISTIC FaultManager.MAP_IR_LO.Faulty_Samples__X_ "Fault manager configuration.  Select up to 4 actions for each fault." VALUE 0x80001C6A RecordLayout_7 0 CompuMethod_1 0 65535 /end CHARACTERISTIC
/begin CHARACTERISTIC FaultManager.MAP_IR_LO.Total_Samples__Y_ "Fault manager configuration.  Select up to 4 actions for each fault." VALUE 0x80001C6C RecordLayout_7 0 CompuMethod_1 0 65535 /end CHARACTERISTIC
/begin CHARACTERISTIC FaultManager.MAP_IR_LO.Action_1 "Fault manager configuration.  Select up to 4 actions for each fault." VALUE 0x80001C6E RecordLayout_7 0 CompuMethod_91 0 65535 /end CHARACTERISTIC
/begin CHARACTERISTIC FaultManager.MAP_IR_LO.Action_1_Condition "Fault manager configuration.  Select up to 4 actions for each fault." VALUE 0x80001C70 RecordLayout_7 0 CompuMethod_92 0 65535 /end CHARACTERISTIC
/begin CHARACTERISTIC FaultManager.MAP_IR_LO.Action_2 "Fault manager configuration.  Select up to 4 actions for each fault." VALUE 0x80001C72 RecordLayout_7 0 CompuMethod_91 0 65535 /end CHARACTERISTIC
/begin CHARACTERISTIC FaultManager.MAP_IR_LO.Action_2_Condition "Fault manager configuration.  Select up to 4 actions for each fault." VALUE 0x80001C74 RecordLayout_7 0 CompuMethod_92 0 65535 /end CHARACTERISTIC
/begin CHARACTERISTIC FaultManager.MAP_IR_LO.Action_3 "Fault manager configuration.  Select up to 4 actions for each fault." VALUE 0x80001C76 RecordLayout_7 0 CompuMethod_91 0 65535 /end CHARACTERISTIC
/begin CHARACTERISTIC FaultManager.MAP_IR_LO.Action_3_Condition "Fault manager configuration.  Select up to 4 actions for each fault." VALUE 0x80001C78 RecordLayout_7 0 CompuMethod_92 0 65535 /end CHARACTERISTIC
/begin CHARACTERISTIC FaultManager.MAP_IR_LO.Action_4 "Fault manager configuration.  Select up to 4 actions for each fault." VALUE 0x80001C7A RecordLayout_7 0 CompuMethod_91 0 65535 /end CHARACTERISTIC
/begin CHARACTERISTIC FaultManager.MAP_IR_LO.Action_4_Condition "Fault manager configuration.  Select up to 4 actions for each fault." VALUE 0x80001C7C RecordLayout_7 0 CompuMethod_92 0 65535 /end CHARACTERISTIC
/begin CHARACTERISTIC FaultManager.MAP_STICKING.Mode "Fault manager configuration.  Select up to 4 actions for each fault." VALUE 0x80001C7E RecordLayout_7 0 CompuMethod_89 0 65535 /end CHARACTERISTIC
/begin CHARACTERISTIC FaultManager.MAP_STICKING.ID "Fault manager configuration.  Select up to 4 actions for each fault." VALUE 0x80001C80 RecordLayout_7 0 CompuMethod_1 0 65535 /end CHARACTERISTIC
/begin CHARACTERISTIC FaultManager.MAP_STICKING.Test "Fault manager configuration.  Select up to 4 actions for each fault." VALUE 0x80001C82 RecordLayout_7 0 CompuMethod_90 0 65535 /end CHARACTERISTIC
/begin CHARACTERISTIC FaultManager.MAP_STICKING.Faulty_Samples__X_ "Fault manager configuration.  Select up to 4 actions for each fault." VALUE 0x80001C84 RecordLayout_7 0 CompuMethod_1 0 65535 /end CHARACTERISTIC
/begin CHARACTERISTIC FaultManager.MAP_STICKING.Total_Samples__Y_ "Fault manager configuration.  Select up to 4 actions for each fault." VALUE 0x80001C86 RecordLayout_7 0 CompuMethod_1 0 65535 /end CHARACTERISTIC
/begin CHARACTERISTIC FaultManager.MAP_STICKING.Action_1 "Fault manager configuration.  Select up to 4 actions for each fault." VALUE 0x80001C88 RecordLayout_7 0 CompuMethod_91 0 65535 /end CHARACTERISTIC
/begin CHARACTERISTIC FaultManager.MAP_STICKING.Action_1_Condition "Fault manager configuration.  Select up to 4 actions for each fault." VALUE 0x80001C8A RecordLayout_7 0 CompuMethod_92 0 65535 /end CHARACTERISTIC
/begin CHARACTERISTIC FaultManager.MAP_STICKING.Action_2 "Fault manager configuration.  Select up to 4 actions for each fault." VALUE 0x80001C8C RecordLayout_7 0 CompuMethod_91 0 65535 /end CHARACTERISTIC
/begin CHARACTERISTIC FaultManager.MAP_STICKING.Action_2_Condition "Fault manager configuration.  Select up to 4 actions for each fault." VALUE 0x80001C8E RecordLayout_7 0 CompuMethod_92 0 65535 /end CHARACTERISTIC
/begin CHARACTERISTIC FaultManager.MAP_STICKING.Action_3 "Fault manager configuration.  Select up to 4 actions for each fault." VALUE 0x80001C90 RecordLayout_7 0 CompuMethod_91 0 65535 /end CHARACTERISTIC
/begin CHARACTERISTIC FaultManager.MAP_STICKING.Action_3_Condition "Fault manager configuration.  Select up to 4 actions for each fault." VALUE 0x80001C92 RecordLayout_7 0 CompuMethod_92 0 65535 /end CHARACTERISTIC
/begin CHARACTERISTIC FaultManager.MAP_STICKING.Action_4 "Fault manager configuration.  Select up to 4 actions for each fault." VALUE 0x80001C94 RecordLayout_7 0 CompuMethod_91 0 65535 /end CHARACTERISTIC
/begin CHARACTERISTIC FaultManager.MAP_STICKING.Action_4_Condition "Fault manager configuration.  Select up to 4 actions for each fault." VALUE 0x80001C96 RecordLayout_7 0 CompuMethod_92 0 65535 /end CHARACTERISTIC
/begin CHARACTERISTIC FaultManager.MediumOverspeed.Mode "Fault manager configuration.  Select up to 4 actions for each fault." VALUE 0x80001C98 RecordLayout_7 0 CompuMethod_89 0 65535 /end CHARACTERISTIC
/begin CHARACTERISTIC FaultManager.MediumOverspeed.ID "Fault manager configuration.  Select up to 4 actions for each fault." VALUE 0x80001C9A RecordLayout_7 0 CompuMethod_1 0 65535 /end CHARACTERISTIC
/begin CHARACTERISTIC FaultManager.MediumOverspeed.Test "Fault manager configuration.  Select up to 4 actions for each fault." VALUE 0x80001C9C RecordLayout_7 0 CompuMethod_90 0 65535 /end CHARACTERISTIC
/begin CHARACTERISTIC FaultManager.MediumOverspeed.Faulty_Samples__X_ "Fault manager configuration.  Select up to 4 actions for each fault." VALUE 0x80001C9E RecordLayout_7 0 CompuMethod_1 0 65535 /end CHARACTERISTIC
/begin CHARACTERISTIC FaultManager.MediumOverspeed.Total_Samples__Y_ "Fault manager configuration.  Select up to 4 actions for each fault." VALUE 0x80001CA0 RecordLayout_7 0 CompuMethod_1 0 65535 /end CHARACTERISTIC
/begin CHARACTERISTIC FaultManager.MediumOverspeed.Action_1 "Fault manager configuration.  Select up to 4 actions for each fault." VALUE 0x80001CA2 RecordLayout_7 0 CompuMethod_91 0 65535 /end CHARACTERISTIC
/begin CHARACTERISTIC FaultManager.MediumOverspeed.Action_1_Condition "Fault manager configuration.  Select up to 4 actions for each fault." VALUE 0x80001CA4 RecordLayout_7 0 CompuMethod_92 0 65535 /end CHARACTERISTIC
/begin CHARACTERISTIC FaultManager.MediumOverspeed.Action_2 "Fault manager configuration.  Select up to 4 actions for each fault." VALUE 0x80001CA6 RecordLayout_7 0 CompuMethod_91 0 65535 /end CHARACTERISTIC
/begin CHARACTERISTIC FaultManager.MediumOverspeed.Action_2_Condition "Fault manager configuration.  Select up to 4 actions for each fault." VALUE 0x80001CA8 RecordLayout_7 0 CompuMethod_92 0 65535 /end CHARACTERISTIC
/begin CHARACTERISTIC FaultManager.MediumOverspeed.Action_3 "Fault manager configuration.  Select up to 4 actions for each fault." VALUE 0x80001CAA RecordLayout_7 0 CompuMethod_91 0 65535 /end CHARACTERISTIC
/begin CHARACTERISTIC FaultManager.MediumOverspeed.Action_3_Condition "Fault manager configuration.  Select up to 4 actions for each fault." VALUE 0x80001CAC RecordLayout_7 0 CompuMethod_92 0 65535 /end CHARACTERISTIC
/begin CHARACTERISTIC FaultManager.MediumOverspeed.Action_4 "Fault manager configuration.  Select up to 4 actions for each fault." VALUE 0x80001CAE RecordLayout_7 0 CompuMethod_91 0 65535 /end CHARACTERISTIC
/begin CHARACTERISTIC FaultManager.MediumOverspeed.Action_4_Condition "Fault manager configuration.  Select up to 4 actions for each fault." VALUE 0x80001CB0 RecordLayout_7 0 CompuMethod_92 0 65535 /end CHARACTERISTIC
/begin CHARACTERISTIC FaultManager.Motor_Hot.Mode "Fault manager configuration.  Select up to 4 actions for each fault." VALUE 0x80001CB2 RecordLayout_7 0 CompuMethod_89 0 65535 /end CHARACTERISTIC
/begin CHARACTERISTIC FaultManager.Motor_Hot.ID "Fault manager configuration.  Select up to 4 actions for each fault." VALUE 0x80001CB4 RecordLayout_7 0 CompuMethod_1 0 65535 /end CHARACTERISTIC
/begin CHARACTERISTIC FaultManager.Motor_Hot.Test "Fault manager configuration.  Select up to 4 actions for each fault." VALUE 0x80001CB6 RecordLayout_7 0 CompuMethod_90 0 65535 /end CHARACTERISTIC
/begin CHARACTERISTIC FaultManager.Motor_Hot.Faulty_Samples__X_ "Fault manager configuration.  Select up to 4 actions for each fault." VALUE 0x80001CB8 RecordLayout_7 0 CompuMethod_1 0 65535 /end CHARACTERISTIC
/begin CHARACTERISTIC FaultManager.Motor_Hot.Total_Samples__Y_ "Fault manager configuration.  Select up to 4 actions for each fault." VALUE 0x80001CBA RecordLayout_7 0 CompuMethod_1 0 65535 /end CHARACTERISTIC
/begin CHARACTERISTIC FaultManager.Motor_Hot.Action_1 "Fault manager configuration.  Select up to 4 actions for each fault." VALUE 0x80001CBC RecordLayout_7 0 CompuMethod_91 0 65535 /end CHARACTERISTIC
/begin CHARACTERISTIC FaultManager.Motor_Hot.Action_1_Condition "Fault manager configuration.  Select up to 4 actions for each fault." VALUE 0x80001CBE RecordLayout_7 0 CompuMethod_92 0 65535 /end CHARACTERISTIC
/begin CHARACTERISTIC FaultManager.Motor_Hot.Action_2 "Fault manager configuration.  Select up to 4 actions for each fault." VALUE 0x80001CC0 RecordLayout_7 0 CompuMethod_91 0 65535 /end CHARACTERISTIC
/begin CHARACTERISTIC FaultManager.Motor_Hot.Action_2_Condition "Fault manager configuration.  Select up to 4 actions for each fault." VALUE 0x80001CC2 RecordLayout_7 0 CompuMethod_92 0 65535 /end CHARACTERISTIC
/begin CHARACTERISTIC FaultManager.Motor_Hot.Action_3 "Fault manager configuration.  Select up to 4 actions for each fault." VALUE 0x80001CC4 RecordLayout_7 0 CompuMethod_91 0 65535 /end CHARACTERISTIC
/begin CHARACTERISTIC FaultManager.Motor_Hot.Action_3_Condition "Fault manager configuration.  Select up to 4 actions for each fault." VALUE 0x80001CC6 RecordLayout_7 0 CompuMethod_92 0 65535 /end CHARACTERISTIC
/begin CHARACTERISTIC FaultManager.Motor_Hot.Action_4 "Fault manager configuration.  Select up to 4 actions for each fault." VALUE 0x80001CC8 RecordLayout_7 0 CompuMethod_91 0 65535 /end CHARACTERISTIC
/begin CHARACTERISTIC FaultManager.Motor_Hot.Action_4_Condition "Fault manager configuration.  Select up to 4 actions for each fault." VALUE 0x80001CCA RecordLayout_7 0 CompuMethod_92 0 65535 /end CHARACTERISTIC
/begin CHARACTERISTIC FaultManager.Motor_Warm.Mode "Fault manager configuration.  Select up to 4 actions for each fault." VALUE 0x80001CCC RecordLayout_7 0 CompuMethod_89 0 65535 /end CHARACTERISTIC
/begin CHARACTERISTIC FaultManager.Motor_Warm.ID "Fault manager configuration.  Select up to 4 actions for each fault." VALUE 0x80001CCE RecordLayout_7 0 CompuMethod_1 0 65535 /end CHARACTERISTIC
/begin CHARACTERISTIC FaultManager.Motor_Warm.Test "Fault manager configuration.  Select up to 4 actions for each fault." VALUE 0x80001CD0 RecordLayout_7 0 CompuMethod_90 0 65535 /end CHARACTERISTIC
/begin CHARACTERISTIC FaultManager.Motor_Warm.Faulty_Samples__X_ "Fault manager configuration.  Select up to 4 actions for each fault." VALUE 0x80001CD2 RecordLayout_7 0 CompuMethod_1 0 65535 /end CHARACTERISTIC
/begin CHARACTERISTIC FaultManager.Motor_Warm.Total_Samples__Y_ "Fault manager configuration.  Select up to 4 actions for each fault." VALUE 0x80001CD4 RecordLayout_7 0 CompuMethod_1 0 65535 /end CHARACTERISTIC
/begin CHARACTERISTIC FaultManager.Motor_Warm.Action_1 "Fault manager configuration.  Select up to 4 actions for each fault." VALUE 0x80001CD6 RecordLayout_7 0 CompuMethod_91 0 65535 /end CHARACTERISTIC
/begin CHARACTERISTIC FaultManager.Motor_Warm.Action_1_Condition "Fault manager configuration.  Select up to 4 actions for each fault." VALUE 0x80001CD8 RecordLayout_7 0 CompuMethod_92 0 65535 /end CHARACTERISTIC
/begin CHARACTERISTIC FaultManager.Motor_Warm.Action_2 "Fault manager configuration.  Select up to 4 actions for each fault." VALUE 0x80001CDA RecordLayout_7 0 CompuMethod_91 0 65535 /end CHARACTERISTIC
/begin CHARACTERISTIC FaultManager.Motor_Warm.Action_2_Condition "Fault manager configuration.  Select up to 4 actions for each fault." VALUE 0x80001CDC RecordLayout_7 0 CompuMethod_92 0 65535 /end CHARACTERISTIC
/begin CHARACTERISTIC FaultManager.Motor_Warm.Action_3 "Fault manager configuration.  Select up to 4 actions for each fault." VALUE 0x80001CDE RecordLayout_7 0 CompuMethod_91 0 65535 /end CHARACTERISTIC
/begin CHARACTERISTIC FaultManager.Motor_Warm.Action_3_Condition "Fault manager configuration.  Select up to 4 actions for each fault." VALUE 0x80001CE0 RecordLayout_7 0 CompuMethod_92 0 65535 /end CHARACTERISTIC
/begin CHARACTERISTIC FaultManager.Motor_Warm.Action_4 "Fault manager configuration.  Select up to 4 actions for each fault." VALUE 0x80001CE2 RecordLayout_7 0 CompuMethod_91 0 65535 /end CHARACTERISTIC
/begin CHARACTERISTIC FaultManager.Motor_Warm.Action_4_Condition "Fault manager configuration.  Select up to 4 actions for each fault." VALUE 0x80001CE4 RecordLayout_7 0 CompuMethod_92 0 65535 /end CHARACTERISTIC
/begin CHARACTERISTIC FaultManager.NoOil_Fault.Mode "Fault manager configuration.  Select up to 4 actions for each fault." VALUE 0x80001CE6 RecordLayout_7 0 CompuMethod_89 0 65535 /end CHARACTERISTIC
/begin CHARACTERISTIC FaultManager.NoOil_Fault.ID "Fault manager configuration.  Select up to 4 actions for each fault." VALUE 0x80001CE8 RecordLayout_7 0 CompuMethod_1 0 65535 /end CHARACTERISTIC
/begin CHARACTERISTIC FaultManager.NoOil_Fault.Test "Fault manager configuration.  Select up to 4 actions for each fault." VALUE 0x80001CEA RecordLayout_7 0 CompuMethod_90 0 65535 /end CHARACTERISTIC
/begin CHARACTERISTIC FaultManager.NoOil_Fault.Faulty_Samples__X_ "Fault manager configuration.  Select up to 4 actions for each fault." VALUE 0x80001CEC RecordLayout_7 0 CompuMethod_1 0 65535 /end CHARACTERISTIC
/begin CHARACTERISTIC FaultManager.NoOil_Fault.Total_Samples__Y_ "Fault manager configuration.  Select up to 4 actions for each fault." VALUE 0x80001CEE RecordLayout_7 0 CompuMethod_1 0 65535 /end CHARACTERISTIC
/begin CHARACTERISTIC FaultManager.NoOil_Fault.Action_1 "Fault manager configuration.  Select up to 4 actions for each fault." VALUE 0x80001CF0 RecordLayout_7 0 CompuMethod_91 0 65535 /end CHARACTERISTIC
/begin CHARACTERISTIC FaultManager.NoOil_Fault.Action_1_Condition "Fault manager configuration.  Select up to 4 actions for each fault." VALUE 0x80001CF2 RecordLayout_7 0 CompuMethod_92 0 65535 /end CHARACTERISTIC
/begin CHARACTERISTIC FaultManager.NoOil_Fault.Action_2 "Fault manager configuration.  Select up to 4 actions for each fault." VALUE 0x80001CF4 RecordLayout_7 0 CompuMethod_91 0 65535 /end CHARACTERISTIC
/begin CHARACTERISTIC FaultManager.NoOil_Fault.Action_2_Condition "Fault manager configuration.  Select up to 4 actions for each fault." VALUE 0x80001CF6 RecordLayout_7 0 CompuMethod_92 0 65535 /end CHARACTERISTIC
/begin CHARACTERISTIC FaultManager.NoOil_Fault.Action_3 "Fault manager configuration.  Select up to 4 actions for each fault." VALUE 0x80001CF8 RecordLayout_7 0 CompuMethod_91 0 65535 /end CHARACTERISTIC
/begin CHARACTERISTIC FaultManager.NoOil_Fault.Action_3_Condition "Fault manager configuration.  Select up to 4 actions for each fault." VALUE 0x80001CFA RecordLayout_7 0 CompuMethod_92 0 65535 /end CHARACTERISTIC
/begin CHARACTERISTIC FaultManager.NoOil_Fault.Action_4 "Fault manager configuration.  Select up to 4 actions for each fault." VALUE 0x80001CFC RecordLayout_7 0 CompuMethod_91 0 65535 /end CHARACTERISTIC
/begin CHARACTERISTIC FaultManager.NoOil_Fault.Action_4_Condition "Fault manager configuration.  Select up to 4 actions for each fault." VALUE 0x80001CFE RecordLayout_7 0 CompuMethod_92 0 65535 /end CHARACTERISTIC
/begin CHARACTERISTIC FaultManager.O2FailedLean.Mode "Fault manager configuration.  Select up to 4 actions for each fault." VALUE 0x80001D00 RecordLayout_7 0 CompuMethod_89 0 65535 /end CHARACTERISTIC
/begin CHARACTERISTIC FaultManager.O2FailedLean.ID "Fault manager configuration.  Select up to 4 actions for each fault." VALUE 0x80001D02 RecordLayout_7 0 CompuMethod_1 0 65535 /end CHARACTERISTIC
/begin CHARACTERISTIC FaultManager.O2FailedLean.Test "Fault manager configuration.  Select up to 4 actions for each fault." VALUE 0x80001D04 RecordLayout_7 0 CompuMethod_90 0 65535 /end CHARACTERISTIC
/begin CHARACTERISTIC FaultManager.O2FailedLean.Faulty_Samples__X_ "Fault manager configuration.  Select up to 4 actions for each fault." VALUE 0x80001D06 RecordLayout_7 0 CompuMethod_1 0 65535 /end CHARACTERISTIC
/begin CHARACTERISTIC FaultManager.O2FailedLean.Total_Samples__Y_ "Fault manager configuration.  Select up to 4 actions for each fault." VALUE 0x80001D08 RecordLayout_7 0 CompuMethod_1 0 65535 /end CHARACTERISTIC
/begin CHARACTERISTIC FaultManager.O2FailedLean.Action_1 "Fault manager configuration.  Select up to 4 actions for each fault." VALUE 0x80001D0A RecordLayout_7 0 CompuMethod_91 0 65535 /end CHARACTERISTIC
/begin CHARACTERISTIC FaultManager.O2FailedLean.Action_1_Condition "Fault manager configuration.  Select up to 4 actions for each fault." VALUE 0x80001D0C RecordLayout_7 0 CompuMethod_92 0 65535 /end CHARACTERISTIC
/begin CHARACTERISTIC FaultManager.O2FailedLean.Action_2 "Fault manager configuration.  Select up to 4 actions for each fault." VALUE 0x80001D0E RecordLayout_7 0 CompuMethod_91 0 65535 /end CHARACTERISTIC
/begin CHARACTERISTIC FaultManager.O2FailedLean.Action_2_Condition "Fault manager configuration.  Select up to 4 actions for each fault." VALUE 0x80001D10 RecordLayout_7 0 CompuMethod_92 0 65535 /end CHARACTERISTIC
/begin CHARACTERISTIC FaultManager.O2FailedLean.Action_3 "Fault manager configuration.  Select up to 4 actions for each fault." VALUE 0x80001D12 RecordLayout_7 0 CompuMethod_91 0 65535 /end CHARACTERISTIC
/begin CHARACTERISTIC FaultManager.O2FailedLean.Action_3_Condition "Fault manager configuration.  Select up to 4 actions for each fault." VALUE 0x80001D14 RecordLayout_7 0 CompuMethod_92 0 65535 /end CHARACTERISTIC
/begin CHARACTERISTIC FaultManager.O2FailedLean.Action_4 "Fault manager configuration.  Select up to 4 actions for each fault." VALUE 0x80001D16 RecordLayout_7 0 CompuMethod_91 0 65535 /end CHARACTERISTIC
/begin CHARACTERISTIC FaultManager.O2FailedLean.Action_4_Condition "Fault manager configuration.  Select up to 4 actions for each fault." VALUE 0x80001D18 RecordLayout_7 0 CompuMethod_92 0 65535 /end CHARACTERISTIC
/begin CHARACTERISTIC FaultManager.O2FailedRich.Mode "Fault manager configuration.  Select up to 4 actions for each fault." VALUE 0x80001D1A RecordLayout_7 0 CompuMethod_89 0 65535 /end CHARACTERISTIC
/begin CHARACTERISTIC FaultManager.O2FailedRich.ID "Fault manager configuration.  Select up to 4 actions for each fault." VALUE 0x80001D1C RecordLayout_7 0 CompuMethod_1 0 65535 /end CHARACTERISTIC
/begin CHARACTERISTIC FaultManager.O2FailedRich.Test "Fault manager configuration.  Select up to 4 actions for each fault." VALUE 0x80001D1E RecordLayout_7 0 CompuMethod_90 0 65535 /end CHARACTERISTIC
/begin CHARACTERISTIC FaultManager.O2FailedRich.Faulty_Samples__X_ "Fault manager configuration.  Select up to 4 actions for each fault." VALUE 0x80001D20 RecordLayout_7 0 CompuMethod_1 0 65535 /end CHARACTERISTIC
/begin CHARACTERISTIC FaultManager.O2FailedRich.Total_Samples__Y_ "Fault manager configuration.  Select up to 4 actions for each fault." VALUE 0x80001D22 RecordLayout_7 0 CompuMethod_1 0 65535 /end CHARACTERISTIC
/begin CHARACTERISTIC FaultManager.O2FailedRich.Action_1 "Fault manager configuration.  Select up to 4 actions for each fault." VALUE 0x80001D24 RecordLayout_7 0 CompuMethod_91 0 65535 /end CHARACTERISTIC
/begin CHARACTERISTIC FaultManager.O2FailedRich.Action_1_Condition "Fault manager configuration.  Select up to 4 actions for each fault." VALUE 0x80001D26 RecordLayout_7 0 CompuMethod_92 0 65535 /end CHARACTERISTIC
/begin CHARACTERISTIC FaultManager.O2FailedRich.Action_2 "Fault manager configuration.  Select up to 4 actions for each fault." VALUE 0x80001D28 RecordLayout_7 0 CompuMethod_91 0 65535 /end CHARACTERISTIC
/begin CHARACTERISTIC FaultManager.O2FailedRich.Action_2_Condition "Fault manager configuration.  Select up to 4 actions for each fault." VALUE 0x80001D2A RecordLayout_7 0 CompuMethod_92 0 65535 /end CHARACTERISTIC
/begin CHARACTERISTIC FaultManager.O2FailedRich.Action_3 "Fault manager configuration.  Select up to 4 actions for each fault." VALUE 0x80001D2C RecordLayout_7 0 CompuMethod_91 0 65535 /end CHARACTERISTIC
/begin CHARACTERISTIC FaultManager.O2FailedRich.Action_3_Condition "Fault manager configuration.  Select up to 4 actions for each fault." VALUE 0x80001D2E RecordLayout_7 0 CompuMethod_92 0 65535 /end CHARACTERISTIC
/begin CHARACTERISTIC FaultManager.O2FailedRich.Action_4 "Fault manager configuration.  Select up to 4 actions for each fault." VALUE 0x80001D30 RecordLayout_7 0 CompuMethod_91 0 65535 /end CHARACTERISTIC
/begin CHARACTERISTIC FaultManager.O2FailedRich.Action_4_Condition "Fault manager configuration.  Select up to 4 actions for each fault." VALUE 0x80001D32 RecordLayout_7 0 CompuMethod_92 0 65535 /end CHARACTERISTIC
/begin CHARACTERISTIC FaultManager.O2NotActive.Mode "Fault manager configuration.  Select up to 4 actions for each fault." VALUE 0x80001D34 RecordLayout_7 0 CompuMethod_89 0 65535 /end CHARACTERISTIC
/begin CHARACTERISTIC FaultManager.O2NotActive.ID "Fault manager configuration.  Select up to 4 actions for each fault." VALUE 0x80001D36 RecordLayout_7 0 CompuMethod_1 0 65535 /end CHARACTERISTIC
/begin CHARACTERISTIC FaultManager.O2NotActive.Test "Fault manager configuration.  Select up to 4 actions for each fault." VALUE 0x80001D38 RecordLayout_7 0 CompuMethod_90 0 65535 /end CHARACTERISTIC
/begin CHARACTERISTIC FaultManager.O2NotActive.Faulty_Samples__X_ "Fault manager configuration.  Select up to 4 actions for each fault." VALUE 0x80001D3A RecordLayout_7 0 CompuMethod_1 0 65535 /end CHARACTERISTIC
/begin CHARACTERISTIC FaultManager.O2NotActive.Total_Samples__Y_ "Fault manager configuration.  Select up to 4 actions for each fault." VALUE 0x80001D3C RecordLayout_7 0 CompuMethod_1 0 65535 /end CHARACTERISTIC
/begin CHARACTERISTIC FaultManager.O2NotActive.Action_1 "Fault manager configuration.  Select up to 4 actions for each fault." VALUE 0x80001D3E RecordLayout_7 0 CompuMethod_91 0 65535 /end CHARACTERISTIC
/begin CHARACTERISTIC FaultManager.O2NotActive.Action_1_Condition "Fault manager configuration.  Select up to 4 actions for each fault." VALUE 0x80001D40 RecordLayout_7 0 CompuMethod_92 0 65535 /end CHARACTERISTIC
/begin CHARACTERISTIC FaultManager.O2NotActive.Action_2 "Fault manager configuration.  Select up to 4 actions for each fault." VALUE 0x80001D42 RecordLayout_7 0 CompuMethod_91 0 65535 /end CHARACTERISTIC
/begin CHARACTERISTIC FaultManager.O2NotActive.Action_2_Condition "Fault manager configuration.  Select up to 4 actions for each fault." VALUE 0x80001D44 RecordLayout_7 0 CompuMethod_92 0 65535 /end CHARACTERISTIC
/begin CHARACTERISTIC FaultManager.O2NotActive.Action_3 "Fault manager configuration.  Select up to 4 actions for each fault." VALUE 0x80001D46 RecordLayout_7 0 CompuMethod_91 0 65535 /end CHARACTERISTIC
/begin CHARACTERISTIC FaultManager.O2NotActive.Action_3_Condition "Fault manager configuration.  Select up to 4 actions for each fault." VALUE 0x80001D48 RecordLayout_7 0 CompuMethod_92 0 65535 /end CHARACTERISTIC
/begin CHARACTERISTIC FaultManager.O2NotActive.Action_4 "Fault manager configuration.  Select up to 4 actions for each fault." VALUE 0x80001D4A RecordLayout_7 0 CompuMethod_91 0 65535 /end CHARACTERISTIC
/begin CHARACTERISTIC FaultManager.O2NotActive.Action_4_Condition "Fault manager configuration.  Select up to 4 actions for each fault." VALUE 0x80001D4C RecordLayout_7 0 CompuMethod_92 0 65535 /end CHARACTERISTIC
/begin CHARACTERISTIC FaultManager.O2_PostCatRangeHigh.Mode "Fault manager configuration.  Select up to 4 actions for each fault." VALUE 0x80001D4E RecordLayout_7 0 CompuMethod_89 0 65535 /end CHARACTERISTIC
/begin CHARACTERISTIC FaultManager.O2_PostCatRangeHigh.ID "Fault manager configuration.  Select up to 4 actions for each fault." VALUE 0x80001D50 RecordLayout_7 0 CompuMethod_1 0 65535 /end CHARACTERISTIC
/begin CHARACTERISTIC FaultManager.O2_PostCatRangeHigh.Test "Fault manager configuration.  Select up to 4 actions for each fault." VALUE 0x80001D52 RecordLayout_7 0 CompuMethod_90 0 65535 /end CHARACTERISTIC
/begin CHARACTERISTIC FaultManager.O2_PostCatRangeHigh.Faulty_Samples__X_ "Fault manager configuration.  Select up to 4 actions for each fault." VALUE 0x80001D54 RecordLayout_7 0 CompuMethod_1 0 65535 /end CHARACTERISTIC
/begin CHARACTERISTIC FaultManager.O2_PostCatRangeHigh.Total_Samples__Y_ "Fault manager configuration.  Select up to 4 actions for each fault." VALUE 0x80001D56 RecordLayout_7 0 CompuMethod_1 0 65535 /end CHARACTERISTIC
/begin CHARACTERISTIC FaultManager.O2_PostCatRangeHigh.Action_1 "Fault manager configuration.  Select up to 4 actions for each fault." VALUE 0x80001D58 RecordLayout_7 0 CompuMethod_91 0 65535 /end CHARACTERISTIC
/begin CHARACTERISTIC FaultManager.O2_PostCatRangeHigh.Action_1_Condition "Fault manager configuration.  Select up to 4 actions for each fault." VALUE 0x80001D5A RecordLayout_7 0 CompuMethod_92 0 65535 /end CHARACTERISTIC
/begin CHARACTERISTIC FaultManager.O2_PostCatRangeHigh.Action_2 "Fault manager configuration.  Select up to 4 actions for each fault." VALUE 0x80001D5C RecordLayout_7 0 CompuMethod_91 0 65535 /end CHARACTERISTIC
/begin CHARACTERISTIC FaultManager.O2_PostCatRangeHigh.Action_2_Condition "Fault manager configuration.  Select up to 4 actions for each fault." VALUE 0x80001D5E RecordLayout_7 0 CompuMethod_92 0 65535 /end CHARACTERISTIC
/begin CHARACTERISTIC FaultManager.O2_PostCatRangeHigh.Action_3 "Fault manager configuration.  Select up to 4 actions for each fault." VALUE 0x80001D60 RecordLayout_7 0 CompuMethod_91 0 65535 /end CHARACTERISTIC
/begin CHARACTERISTIC FaultManager.O2_PostCatRangeHigh.Action_3_Condition "Fault manager configuration.  Select up to 4 actions for each fault." VALUE 0x80001D62 RecordLayout_7 0 CompuMethod_92 0 65535 /end CHARACTERISTIC
/begin CHARACTERISTIC FaultManager.O2_PostCatRangeHigh.Action_4 "Fault manager configuration.  Select up to 4 actions for each fault." VALUE 0x80001D64 RecordLayout_7 0 CompuMethod_91 0 65535 /end CHARACTERISTIC
/begin CHARACTERISTIC FaultManager.O2_PostCatRangeHigh.Action_4_Condition "Fault manager configuration.  Select up to 4 actions for each fault." VALUE 0x80001D66 RecordLayout_7 0 CompuMethod_92 0 65535 /end CHARACTERISTIC
/begin CHARACTERISTIC FaultManager.O2_PostCatRangeLow.Mode "Fault manager configuration.  Select up to 4 actions for each fault." VALUE 0x80001D68 RecordLayout_7 0 CompuMethod_89 0 65535 /end CHARACTERISTIC
/begin CHARACTERISTIC FaultManager.O2_PostCatRangeLow.ID "Fault manager configuration.  Select up to 4 actions for each fault." VALUE 0x80001D6A RecordLayout_7 0 CompuMethod_1 0 65535 /end CHARACTERISTIC
/begin CHARACTERISTIC FaultManager.O2_PostCatRangeLow.Test "Fault manager configuration.  Select up to 4 actions for each fault." VALUE 0x80001D6C RecordLayout_7 0 CompuMethod_90 0 65535 /end CHARACTERISTIC
/begin CHARACTERISTIC FaultManager.O2_PostCatRangeLow.Faulty_Samples__X_ "Fault manager configuration.  Select up to 4 actions for each fault." VALUE 0x80001D6E RecordLayout_7 0 CompuMethod_1 0 65535 /end CHARACTERISTIC
/begin CHARACTERISTIC FaultManager.O2_PostCatRangeLow.Total_Samples__Y_ "Fault manager configuration.  Select up to 4 actions for each fault." VALUE 0x80001D70 RecordLayout_7 0 CompuMethod_1 0 65535 /end CHARACTERISTIC
/begin CHARACTERISTIC FaultManager.O2_PostCatRangeLow.Action_1 "Fault manager configuration.  Select up to 4 actions for each fault." VALUE 0x80001D72 RecordLayout_7 0 CompuMethod_91 0 65535 /end CHARACTERISTIC
/begin CHARACTERISTIC FaultManager.O2_PostCatRangeLow.Action_1_Condition "Fault manager configuration.  Select up to 4 actions for each fault." VALUE 0x80001D74 RecordLayout_7 0 CompuMethod_92 0 65535 /end CHARACTERISTIC
/begin CHARACTERISTIC FaultManager.O2_PostCatRangeLow.Action_2 "Fault manager configuration.  Select up to 4 actions for each fault." VALUE 0x80001D76 RecordLayout_7 0 CompuMethod_91 0 65535 /end CHARACTERISTIC
/begin CHARACTERISTIC FaultManager.O2_PostCatRangeLow.Action_2_Condition "Fault manager configuration.  Select up to 4 actions for each fault." VALUE 0x80001D78 RecordLayout_7 0 CompuMethod_92 0 65535 /end CHARACTERISTIC
/begin CHARACTERISTIC FaultManager.O2_PostCatRangeLow.Action_3 "Fault manager configuration.  Select up to 4 actions for each fault." VALUE 0x80001D7A RecordLayout_7 0 CompuMethod_91 0 65535 /end CHARACTERISTIC
/begin CHARACTERISTIC FaultManager.O2_PostCatRangeLow.Action_3_Condition "Fault manager configuration.  Select up to 4 actions for each fault." VALUE 0x80001D7C RecordLayout_7 0 CompuMethod_92 0 65535 /end CHARACTERISTIC
/begin CHARACTERISTIC FaultManager.O2_PostCatRangeLow.Action_4 "Fault manager configuration.  Select up to 4 actions for each fault." VALUE 0x80001D7E RecordLayout_7 0 CompuMethod_91 0 65535 /end CHARACTERISTIC
/begin CHARACTERISTIC FaultManager.O2_PostCatRangeLow.Action_4_Condition "Fault manager configuration.  Select up to 4 actions for each fault." VALUE 0x80001D80 RecordLayout_7 0 CompuMethod_92 0 65535 /end CHARACTERISTIC
/begin CHARACTERISTIC FaultManager.OilPresRangeHigh.Mode "Fault manager configuration.  Select up to 4 actions for each fault." VALUE 0x80001D82 RecordLayout_7 0 CompuMethod_89 0 65535 /end CHARACTERISTIC
/begin CHARACTERISTIC FaultManager.OilPresRangeHigh.ID "Fault manager configuration.  Select up to 4 actions for each fault." VALUE 0x80001D84 RecordLayout_7 0 CompuMethod_1 0 65535 /end CHARACTERISTIC
/begin CHARACTERISTIC FaultManager.OilPresRangeHigh.Test "Fault manager configuration.  Select up to 4 actions for each fault." VALUE 0x80001D86 RecordLayout_7 0 CompuMethod_90 0 65535 /end CHARACTERISTIC
/begin CHARACTERISTIC FaultManager.OilPresRangeHigh.Faulty_Samples__X_ "Fault manager configuration.  Select up to 4 actions for each fault." VALUE 0x80001D88 RecordLayout_7 0 CompuMethod_1 0 65535 /end CHARACTERISTIC
/begin CHARACTERISTIC FaultManager.OilPresRangeHigh.Total_Samples__Y_ "Fault manager configuration.  Select up to 4 actions for each fault." VALUE 0x80001D8A RecordLayout_7 0 CompuMethod_1 0 65535 /end CHARACTERISTIC
/begin CHARACTERISTIC FaultManager.OilPresRangeHigh.Action_1 "Fault manager configuration.  Select up to 4 actions for each fault." VALUE 0x80001D8C RecordLayout_7 0 CompuMethod_91 0 65535 /end CHARACTERISTIC
/begin CHARACTERISTIC FaultManager.OilPresRangeHigh.Action_1_Condition "Fault manager configuration.  Select up to 4 actions for each fault." VALUE 0x80001D8E RecordLayout_7 0 CompuMethod_92 0 65535 /end CHARACTERISTIC
/begin CHARACTERISTIC FaultManager.OilPresRangeHigh.Action_2 "Fault manager configuration.  Select up to 4 actions for each fault." VALUE 0x80001D90 RecordLayout_7 0 CompuMethod_91 0 65535 /end CHARACTERISTIC
/begin CHARACTERISTIC FaultManager.OilPresRangeHigh.Action_2_Condition "Fault manager configuration.  Select up to 4 actions for each fault." VALUE 0x80001D92 RecordLayout_7 0 CompuMethod_92 0 65535 /end CHARACTERISTIC
/begin CHARACTERISTIC FaultManager.OilPresRangeHigh.Action_3 "Fault manager configuration.  Select up to 4 actions for each fault." VALUE 0x80001D94 RecordLayout_7 0 CompuMethod_91 0 65535 /end CHARACTERISTIC
/begin CHARACTERISTIC FaultManager.OilPresRangeHigh.Action_3_Condition "Fault manager configuration.  Select up to 4 actions for each fault." VALUE 0x80001D96 RecordLayout_7 0 CompuMethod_92 0 65535 /end CHARACTERISTIC
/begin CHARACTERISTIC FaultManager.OilPresRangeHigh.Action_4 "Fault manager configuration.  Select up to 4 actions for each fault." VALUE 0x80001D98 RecordLayout_7 0 CompuMethod_91 0 65535 /end CHARACTERISTIC
/begin CHARACTERISTIC FaultManager.OilPresRangeHigh.Action_4_Condition "Fault manager configuration.  Select up to 4 actions for each fault." VALUE 0x80001D9A RecordLayout_7 0 CompuMethod_92 0 65535 /end CHARACTERISTIC
/begin CHARACTERISTIC FaultManager.OilPresRangeLow.Mode "Fault manager configuration.  Select up to 4 actions for each fault." VALUE 0x80001D9C RecordLayout_7 0 CompuMethod_89 0 65535 /end CHARACTERISTIC
/begin CHARACTERISTIC FaultManager.OilPresRangeLow.ID "Fault manager configuration.  Select up to 4 actions for each fault." VALUE 0x80001D9E RecordLayout_7 0 CompuMethod_1 0 65535 /end CHARACTERISTIC
/begin CHARACTERISTIC FaultManager.OilPresRangeLow.Test "Fault manager configuration.  Select up to 4 actions for each fault." VALUE 0x80001DA0 RecordLayout_7 0 CompuMethod_90 0 65535 /end CHARACTERISTIC
/begin CHARACTERISTIC FaultManager.OilPresRangeLow.Faulty_Samples__X_ "Fault manager configuration.  Select up to 4 actions for each fault." VALUE 0x80001DA2 RecordLayout_7 0 CompuMethod_1 0 65535 /end CHARACTERISTIC
/begin CHARACTERISTIC FaultManager.OilPresRangeLow.Total_Samples__Y_ "Fault manager configuration.  Select up to 4 actions for each fault." VALUE 0x80001DA4 RecordLayout_7 0 CompuMethod_1 0 65535 /end CHARACTERISTIC
/begin CHARACTERISTIC FaultManager.OilPresRangeLow.Action_1 "Fault manager configuration.  Select up to 4 actions for each fault." VALUE 0x80001DA6 RecordLayout_7 0 CompuMethod_91 0 65535 /end CHARACTERISTIC
/begin CHARACTERISTIC FaultManager.OilPresRangeLow.Action_1_Condition "Fault manager configuration.  Select up to 4 actions for each fault." VALUE 0x80001DA8 RecordLayout_7 0 CompuMethod_92 0 65535 /end CHARACTERISTIC
/begin CHARACTERISTIC FaultManager.OilPresRangeLow.Action_2 "Fault manager configuration.  Select up to 4 actions for each fault." VALUE 0x80001DAA RecordLayout_7 0 CompuMethod_91 0 65535 /end CHARACTERISTIC
/begin CHARACTERISTIC FaultManager.OilPresRangeLow.Action_2_Condition "Fault manager configuration.  Select up to 4 actions for each fault." VALUE 0x80001DAC RecordLayout_7 0 CompuMethod_92 0 65535 /end CHARACTERISTIC
/begin CHARACTERISTIC FaultManager.OilPresRangeLow.Action_3 "Fault manager configuration.  Select up to 4 actions for each fault." VALUE 0x80001DAE RecordLayout_7 0 CompuMethod_91 0 65535 /end CHARACTERISTIC
/begin CHARACTERISTIC FaultManager.OilPresRangeLow.Action_3_Condition "Fault manager configuration.  Select up to 4 actions for each fault." VALUE 0x80001DB0 RecordLayout_7 0 CompuMethod_92 0 65535 /end CHARACTERISTIC
/begin CHARACTERISTIC FaultManager.OilPresRangeLow.Action_4 "Fault manager configuration.  Select up to 4 actions for each fault." VALUE 0x80001DB2 RecordLayout_7 0 CompuMethod_91 0 65535 /end CHARACTERISTIC
/begin CHARACTERISTIC FaultManager.OilPresRangeLow.Action_4_Condition "Fault manager configuration.  Select up to 4 actions for each fault." VALUE 0x80001DB4 RecordLayout_7 0 CompuMethod_92 0 65535 /end CHARACTERISTIC
/begin CHARACTERISTIC FaultManager.SensVoltRangeHigh.Mode "Fault manager configuration.  Select up to 4 actions for each fault." VALUE 0x80001DB6 RecordLayout_7 0 CompuMethod_89 0 65535 /end CHARACTERISTIC
/begin CHARACTERISTIC FaultManager.SensVoltRangeHigh.ID "Fault manager configuration.  Select up to 4 actions for each fault." VALUE 0x80001DB8 RecordLayout_7 0 CompuMethod_1 0 65535 /end CHARACTERISTIC
/begin CHARACTERISTIC FaultManager.SensVoltRangeHigh.Test "Fault manager configuration.  Select up to 4 actions for each fault." VALUE 0x80001DBA RecordLayout_7 0 CompuMethod_90 0 65535 /end CHARACTERISTIC
/begin CHARACTERISTIC FaultManager.SensVoltRangeHigh.Faulty_Samples__X_ "Fault manager configuration.  Select up to 4 actions for each fault." VALUE 0x80001DBC RecordLayout_7 0 CompuMethod_1 0 65535 /end CHARACTERISTIC
/begin CHARACTERISTIC FaultManager.SensVoltRangeHigh.Total_Samples__Y_ "Fault manager configuration.  Select up to 4 actions for each fault." VALUE 0x80001DBE RecordLayout_7 0 CompuMethod_1 0 65535 /end CHARACTERISTIC
/begin CHARACTERISTIC FaultManager.SensVoltRangeHigh.Action_1 "Fault manager configuration.  Select up to 4 actions for each fault." VALUE 0x80001DC0 RecordLayout_7 0 CompuMethod_91 0 65535 /end CHARACTERISTIC
/begin CHARACTERISTIC FaultManager.SensVoltRangeHigh.Action_1_Condition "Fault manager configuration.  Select up to 4 actions for each fault." VALUE 0x80001DC2 RecordLayout_7 0 CompuMethod_92 0 65535 /end CHARACTERISTIC
/begin CHARACTERISTIC FaultManager.SensVoltRangeHigh.Action_2 "Fault manager configuration.  Select up to 4 actions for each fault." VALUE 0x80001DC4 RecordLayout_7 0 CompuMethod_91 0 65535 /end CHARACTERISTIC
/begin CHARACTERISTIC FaultManager.SensVoltRangeHigh.Action_2_Condition "Fault manager configuration.  Select up to 4 actions for each fault." VALUE 0x80001DC6 RecordLayout_7 0 CompuMethod_92 0 65535 /end CHARACTERISTIC
/begin CHARACTERISTIC FaultManager.SensVoltRangeHigh.Action_3 "Fault manager configuration.  Select up to 4 actions for each fault." VALUE 0x80001DC8 RecordLayout_7 0 CompuMethod_91 0 65535 /end CHARACTERISTIC
/begin CHARACTERISTIC FaultManager.SensVoltRangeHigh.Action_3_Condition "Fault manager configuration.  Select up to 4 actions for each fault." VALUE 0x80001DCA RecordLayout_7 0 CompuMethod_92 0 65535 /end CHARACTERISTIC
/begin CHARACTERISTIC FaultManager.SensVoltRangeHigh.Action_4 "Fault manager configuration.  Select up to 4 actions for each fault." VALUE 0x80001DCC RecordLayout_7 0 CompuMethod_91 0 65535 /end CHARACTERISTIC
/begin CHARACTERISTIC FaultManager.SensVoltRangeHigh.Action_4_Condition "Fault manager configuration.  Select up to 4 actions for each fault." VALUE 0x80001DCE RecordLayout_7 0 CompuMethod_92 0 65535 /end CHARACTERISTIC
/begin CHARACTERISTIC FaultManager.SensVoltRangeLow.Mode "Fault manager configuration.  Select up to 4 actions for each fault." VALUE 0x80001DD0 RecordLayout_7 0 CompuMethod_89 0 65535 /end CHARACTERISTIC
/begin CHARACTERISTIC FaultManager.SensVoltRangeLow.ID "Fault manager configuration.  Select up to 4 actions for each fault." VALUE 0x80001DD2 RecordLayout_7 0 CompuMethod_1 0 65535 /end CHARACTERISTIC
/begin CHARACTERISTIC FaultManager.SensVoltRangeLow.Test "Fault manager configuration.  Select up to 4 actions for each fault." VALUE 0x80001DD4 RecordLayout_7 0 CompuMethod_90 0 65535 /end CHARACTERISTIC
/begin CHARACTERISTIC FaultManager.SensVoltRangeLow.Faulty_Samples__X_ "Fault manager configuration.  Select up to 4 actions for each fault." VALUE 0x80001DD6 RecordLayout_7 0 CompuMethod_1 0 65535 /end CHARACTERISTIC
/begin CHARACTERISTIC FaultManager.SensVoltRangeLow.Total_Samples__Y_ "Fault manager configuration.  Select up to 4 actions for each fault." VALUE 0x80001DD8 RecordLayout_7 0 CompuMethod_1 0 65535 /end CHARACTERISTIC
/begin CHARACTERISTIC FaultManager.SensVoltRangeLow.Action_1 "Fault manager configuration.  Select up to 4 actions for each fault." VALUE 0x80001DDA RecordLayout_7 0 CompuMethod_91 0 65535 /end CHARACTERISTIC
/begin CHARACTERISTIC FaultManager.SensVoltRangeLow.Action_1_Condition "Fault manager configuration.  Select up to 4 actions for each fault." VALUE 0x80001DDC RecordLayout_7 0 CompuMethod_92 0 65535 /end CHARACTERISTIC
/begin CHARACTERISTIC FaultManager.SensVoltRangeLow.Action_2 "Fault manager configuration.  Select up to 4 actions for each fault." VALUE 0x80001DDE RecordLayout_7 0 CompuMethod_91 0 65535 /end CHARACTERISTIC
/begin CHARACTERISTIC FaultManager.SensVoltRangeLow.Action_2_Condition "Fault manager configuration.  Select up to 4 actions for each fault." VALUE 0x80001DE0 RecordLayout_7 0 CompuMethod_92 0 65535 /end CHARACTERISTIC
/begin CHARACTERISTIC FaultManager.SensVoltRangeLow.Action_3 "Fault manager configuration.  Select up to 4 actions for each fault." VALUE 0x80001DE2 RecordLayout_7 0 CompuMethod_91 0 65535 /end CHARACTERISTIC
/begin CHARACTERISTIC FaultManager.SensVoltRangeLow.Action_3_Condition "Fault manager configuration.  Select up to 4 actions for each fault." VALUE 0x80001DE4 RecordLayout_7 0 CompuMethod_92 0 65535 /end CHARACTERISTIC
/begin CHARACTERISTIC FaultManager.SensVoltRangeLow.Action_4 "Fault manager configuration.  Select up to 4 actions for each fault." VALUE 0x80001DE6 RecordLayout_7 0 CompuMethod_91 0 65535 /end CHARACTERISTIC
/begin CHARACTERISTIC FaultManager.SensVoltRangeLow.Action_4_Condition "Fault manager configuration.  Select up to 4 actions for each fault." VALUE 0x80001DE8 RecordLayout_7 0 CompuMethod_92 0 65535 /end CHARACTERISTIC
/begin CHARACTERISTIC FaultManager.SoftOverspeed.Mode "Fault manager configuration.  Select up to 4 actions for each fault." VALUE 0x80001DEA RecordLayout_7 0 CompuMethod_89 0 65535 /end CHARACTERISTIC
/begin CHARACTERISTIC FaultManager.SoftOverspeed.ID "Fault manager configuration.  Select up to 4 actions for each fault." VALUE 0x80001DEC RecordLayout_7 0 CompuMethod_1 0 65535 /end CHARACTERISTIC
/begin CHARACTERISTIC FaultManager.SoftOverspeed.Test "Fault manager configuration.  Select up to 4 actions for each fault." VALUE 0x80001DEE RecordLayout_7 0 CompuMethod_90 0 65535 /end CHARACTERISTIC
/begin CHARACTERISTIC FaultManager.SoftOverspeed.Faulty_Samples__X_ "Fault manager configuration.  Select up to 4 actions for each fault." VALUE 0x80001DF0 RecordLayout_7 0 CompuMethod_1 0 65535 /end CHARACTERISTIC
/begin CHARACTERISTIC FaultManager.SoftOverspeed.Total_Samples__Y_ "Fault manager configuration.  Select up to 4 actions for each fault." VALUE 0x80001DF2 RecordLayout_7 0 CompuMethod_1 0 65535 /end CHARACTERISTIC
/begin CHARACTERISTIC FaultManager.SoftOverspeed.Action_1 "Fault manager configuration.  Select up to 4 actions for each fault." VALUE 0x80001DF4 RecordLayout_7 0 CompuMethod_91 0 65535 /end CHARACTERISTIC
/begin CHARACTERISTIC FaultManager.SoftOverspeed.Action_1_Condition "Fault manager configuration.  Select up to 4 actions for each fault." VALUE 0x80001DF6 RecordLayout_7 0 CompuMethod_92 0 65535 /end CHARACTERISTIC
/begin CHARACTERISTIC FaultManager.SoftOverspeed.Action_2 "Fault manager configuration.  Select up to 4 actions for each fault." VALUE 0x80001DF8 RecordLayout_7 0 CompuMethod_91 0 65535 /end CHARACTERISTIC
/begin CHARACTERISTIC FaultManager.SoftOverspeed.Action_2_Condition "Fault manager configuration.  Select up to 4 actions for each fault." VALUE 0x80001DFA RecordLayout_7 0 CompuMethod_92 0 65535 /end CHARACTERISTIC
/begin CHARACTERISTIC FaultManager.SoftOverspeed.Action_3 "Fault manager configuration.  Select up to 4 actions for each fault." VALUE 0x80001DFC RecordLayout_7 0 CompuMethod_91 0 65535 /end CHARACTERISTIC
/begin CHARACTERISTIC FaultManager.SoftOverspeed.Action_3_Condition "Fault manager configuration.  Select up to 4 actions for each fault." VALUE 0x80001DFE RecordLayout_7 0 CompuMethod_92 0 65535 /end CHARACTERISTIC
/begin CHARACTERISTIC FaultManager.SoftOverspeed.Action_4 "Fault manager configuration.  Select up to 4 actions for each fault." VALUE 0x80001E00 RecordLayout_7 0 CompuMethod_91 0 65535 /end CHARACTERISTIC
/begin CHARACTERISTIC FaultManager.SoftOverspeed.Action_4_Condition "Fault manager configuration.  Select up to 4 actions for each fault." VALUE 0x80001E02 RecordLayout_7 0 CompuMethod_92 0 65535 /end CHARACTERISTIC
/begin CHARACTERISTIC FaultManager.SysVoltRangeHigh.Mode "Fault manager configuration.  Select up to 4 actions for each fault." VALUE 0x80001E04 RecordLayout_7 0 CompuMethod_89 0 65535 /end CHARACTERISTIC
/begin CHARACTERISTIC FaultManager.SysVoltRangeHigh.ID "Fault manager configuration.  Select up to 4 actions for each fault." VALUE 0x80001E06 RecordLayout_7 0 CompuMethod_1 0 65535 /end CHARACTERISTIC
/begin CHARACTERISTIC FaultManager.SysVoltRangeHigh.Test "Fault manager configuration.  Select up to 4 actions for each fault." VALUE 0x80001E08 RecordLayout_7 0 CompuMethod_90 0 65535 /end CHARACTERISTIC
/begin CHARACTERISTIC FaultManager.SysVoltRangeHigh.Faulty_Samples__X_ "Fault manager configuration.  Select up to 4 actions for each fault." VALUE 0x80001E0A RecordLayout_7 0 CompuMethod_1 0 65535 /end CHARACTERISTIC
/begin CHARACTERISTIC FaultManager.SysVoltRangeHigh.Total_Samples__Y_ "Fault manager configuration.  Select up to 4 actions for each fault." VALUE 0x80001E0C RecordLayout_7 0 CompuMethod_1 0 65535 /end CHARACTERISTIC
/begin CHARACTERISTIC FaultManager.SysVoltRangeHigh.Action_1 "Fault manager configuration.  Select up to 4 actions for each fault." VALUE 0x80001E0E RecordLayout_7 0 CompuMethod_91 0 65535 /end CHARACTERISTIC
/begin CHARACTERISTIC FaultManager.SysVoltRangeHigh.Action_1_Condition "Fault manager configuration.  Select up to 4 actions for each fault." VALUE 0x80001E10 RecordLayout_7 0 CompuMethod_92 0 65535 /end CHARACTERISTIC
/begin CHARACTERISTIC FaultManager.SysVoltRangeHigh.Action_2 "Fault manager configuration.  Select up to 4 actions for each fault." VALUE 0x80001E12 RecordLayout_7 0 CompuMethod_91 0 65535 /end CHARACTERISTIC
/begin CHARACTERISTIC FaultManager.SysVoltRangeHigh.Action_2_Condition "Fault manager configuration.  Select up to 4 actions for each fault." VALUE 0x80001E14 RecordLayout_7 0 CompuMethod_92 0 65535 /end CHARACTERISTIC
/begin CHARACTERISTIC FaultManager.SysVoltRangeHigh.Action_3 "Fault manager configuration.  Select up to 4 actions for each fault." VALUE 0x80001E16 RecordLayout_7 0 CompuMethod_91 0 65535 /end CHARACTERISTIC
/begin CHARACTERISTIC FaultManager.SysVoltRangeHigh.Action_3_Condition "Fault manager configuration.  Select up to 4 actions for each fault." VALUE 0x80001E18 RecordLayout_7 0 CompuMethod_92 0 65535 /end CHARACTERISTIC
/begin CHARACTERISTIC FaultManager.SysVoltRangeHigh.Action_4 "Fault manager configuration.  Select up to 4 actions for each fault." VALUE 0x80001E1A RecordLayout_7 0 CompuMethod_91 0 65535 /end CHARACTERISTIC
/begin CHARACTERISTIC FaultManager.SysVoltRangeHigh.Action_4_Condition "Fault manager configuration.  Select up to 4 actions for each fault." VALUE 0x80001E1C RecordLayout_7 0 CompuMethod_92 0 65535 /end CHARACTERISTIC
/begin CHARACTERISTIC FaultManager.SysVoltRangeLow.Mode "Fault manager configuration.  Select up to 4 actions for each fault." VALUE 0x80001E1E RecordLayout_7 0 CompuMethod_89 0 65535 /end CHARACTERISTIC
/begin CHARACTERISTIC FaultManager.SysVoltRangeLow.ID "Fault manager configuration.  Select up to 4 actions for each fault." VALUE 0x80001E20 RecordLayout_7 0 CompuMethod_1 0 65535 /end CHARACTERISTIC
/begin CHARACTERISTIC FaultManager.SysVoltRangeLow.Test "Fault manager configuration.  Select up to 4 actions for each fault." VALUE 0x80001E22 RecordLayout_7 0 CompuMethod_90 0 65535 /end CHARACTERISTIC
/begin CHARACTERISTIC FaultManager.SysVoltRangeLow.Faulty_Samples__X_ "Fault manager configuration.  Select up to 4 actions for each fault." VALUE 0x80001E24 RecordLayout_7 0 CompuMethod_1 0 65535 /end CHARACTERISTIC
/begin CHARACTERISTIC FaultManager.SysVoltRangeLow.Total_Samples__Y_ "Fault manager configuration.  Select up to 4 actions for each fault." VALUE 0x80001E26 RecordLayout_7 0 CompuMethod_1 0 65535 /end CHARACTERISTIC
/begin CHARACTERISTIC FaultManager.SysVoltRangeLow.Action_1 "Fault manager configuration.  Select up to 4 actions for each fault." VALUE 0x80001E28 RecordLayout_7 0 CompuMethod_91 0 65535 /end CHARACTERISTIC
/begin CHARACTERISTIC FaultManager.SysVoltRangeLow.Action_1_Condition "Fault manager configuration.  Select up to 4 actions for each fault." VALUE 0x80001E2A RecordLayout_7 0 CompuMethod_92 0 65535 /end CHARACTERISTIC
/begin CHARACTERISTIC FaultManager.SysVoltRangeLow.Action_2 "Fault manager configuration.  Select up to 4 actions for each fault." VALUE 0x80001E2C RecordLayout_7 0 CompuMethod_91 0 65535 /end CHARACTERISTIC
/begin CHARACTERISTIC FaultManager.SysVoltRangeLow.Action_2_Condition "Fault manager configuration.  Select up to 4 actions for each fault." VALUE 0x80001E2E RecordLayout_7 0 CompuMethod_92 0 65535 /end CHARACTERISTIC
/begin CHARACTERISTIC FaultManager.SysVoltRangeLow.Action_3 "Fault manager configuration.  Select up to 4 actions for each fault." VALUE 0x80001E30 RecordLayout_7 0 CompuMethod_91 0 65535 /end CHARACTERISTIC
/begin CHARACTERISTIC FaultManager.SysVoltRangeLow.Action_3_Condition "Fault manager configuration.  Select up to 4 actions for each fault." VALUE 0x80001E32 RecordLayout_7 0 CompuMethod_92 0 65535 /end CHARACTERISTIC
/begin CHARACTERISTIC FaultManager.SysVoltRangeLow.Action_4 "Fault manager configuration.  Select up to 4 actions for each fault." VALUE 0x80001E34 RecordLayout_7 0 CompuMethod_91 0 65535 /end CHARACTERISTIC
/begin CHARACTERISTIC FaultManager.SysVoltRangeLow.Action_4_Condition "Fault manager configuration.  Select up to 4 actions for each fault." VALUE 0x80001E36 RecordLayout_7 0 CompuMethod_92 0 65535 /end CHARACTERISTIC
/begin CHARACTERISTIC FaultManager.TPS1AdaptHiMax.Mode "Fault manager configuration.  Select up to 4 actions for each fault." VALUE 0x80001E38 RecordLayout_7 0 CompuMethod_89 0 65535 /end CHARACTERISTIC
/begin CHARACTERISTIC FaultManager.TPS1AdaptHiMax.ID "Fault manager configuration.  Select up to 4 actions for each fault." VALUE 0x80001E3A RecordLayout_7 0 CompuMethod_1 0 65535 /end CHARACTERISTIC
/begin CHARACTERISTIC FaultManager.TPS1AdaptHiMax.Test "Fault manager configuration.  Select up to 4 actions for each fault." VALUE 0x80001E3C RecordLayout_7 0 CompuMethod_90 0 65535 /end CHARACTERISTIC
/begin CHARACTERISTIC FaultManager.TPS1AdaptHiMax.Faulty_Samples__X_ "Fault manager configuration.  Select up to 4 actions for each fault." VALUE 0x80001E3E RecordLayout_7 0 CompuMethod_1 0 65535 /end CHARACTERISTIC
/begin CHARACTERISTIC FaultManager.TPS1AdaptHiMax.Total_Samples__Y_ "Fault manager configuration.  Select up to 4 actions for each fault." VALUE 0x80001E40 RecordLayout_7 0 CompuMethod_1 0 65535 /end CHARACTERISTIC
/begin CHARACTERISTIC FaultManager.TPS1AdaptHiMax.Action_1 "Fault manager configuration.  Select up to 4 actions for each fault." VALUE 0x80001E42 RecordLayout_7 0 CompuMethod_91 0 65535 /end CHARACTERISTIC
/begin CHARACTERISTIC FaultManager.TPS1AdaptHiMax.Action_1_Condition "Fault manager configuration.  Select up to 4 actions for each fault." VALUE 0x80001E44 RecordLayout_7 0 CompuMethod_92 0 65535 /end CHARACTERISTIC
/begin CHARACTERISTIC FaultManager.TPS1AdaptHiMax.Action_2 "Fault manager configuration.  Select up to 4 actions for each fault." VALUE 0x80001E46 RecordLayout_7 0 CompuMethod_91 0 65535 /end CHARACTERISTIC
/begin CHARACTERISTIC FaultManager.TPS1AdaptHiMax.Action_2_Condition "Fault manager configuration.  Select up to 4 actions for each fault." VALUE 0x80001E48 RecordLayout_7 0 CompuMethod_92 0 65535 /end CHARACTERISTIC
/begin CHARACTERISTIC FaultManager.TPS1AdaptHiMax.Action_3 "Fault manager configuration.  Select up to 4 actions for each fault." VALUE 0x80001E4A RecordLayout_7 0 CompuMethod_91 0 65535 /end CHARACTERISTIC
/begin CHARACTERISTIC FaultManager.TPS1AdaptHiMax.Action_3_Condition "Fault manager configuration.  Select up to 4 actions for each fault." VALUE 0x80001E4C RecordLayout_7 0 CompuMethod_92 0 65535 /end CHARACTERISTIC
/begin CHARACTERISTIC FaultManager.TPS1AdaptHiMax.Action_4 "Fault manager configuration.  Select up to 4 actions for each fault." VALUE 0x80001E4E RecordLayout_7 0 CompuMethod_91 0 65535 /end CHARACTERISTIC
/begin CHARACTERISTIC FaultManager.TPS1AdaptHiMax.Action_4_Condition "Fault manager configuration.  Select up to 4 actions for each fault." VALUE 0x80001E50 RecordLayout_7 0 CompuMethod_92 0 65535 /end CHARACTERISTIC
/begin CHARACTERISTIC FaultManager.TPS1AdaptHiMin.Mode "Fault manager configuration.  Select up to 4 actions for each fault." VALUE 0x80001E52 RecordLayout_7 0 CompuMethod_89 0 65535 /end CHARACTERISTIC
/begin CHARACTERISTIC FaultManager.TPS1AdaptHiMin.ID "Fault manager configuration.  Select up to 4 actions for each fault." VALUE 0x80001E54 RecordLayout_7 0 CompuMethod_1 0 65535 /end CHARACTERISTIC
/begin CHARACTERISTIC FaultManager.TPS1AdaptHiMin.Test "Fault manager configuration.  Select up to 4 actions for each fault." VALUE 0x80001E56 RecordLayout_7 0 CompuMethod_90 0 65535 /end CHARACTERISTIC
/begin CHARACTERISTIC FaultManager.TPS1AdaptHiMin.Faulty_Samples__X_ "Fault manager configuration.  Select up to 4 actions for each fault." VALUE 0x80001E58 RecordLayout_7 0 CompuMethod_1 0 65535 /end CHARACTERISTIC
/begin CHARACTERISTIC FaultManager.TPS1AdaptHiMin.Total_Samples__Y_ "Fault manager configuration.  Select up to 4 actions for each fault." VALUE 0x80001E5A RecordLayout_7 0 CompuMethod_1 0 65535 /end CHARACTERISTIC
/begin CHARACTERISTIC FaultManager.TPS1AdaptHiMin.Action_1 "Fault manager configuration.  Select up to 4 actions for each fault." VALUE 0x80001E5C RecordLayout_7 0 CompuMethod_91 0 65535 /end CHARACTERISTIC
/begin CHARACTERISTIC FaultManager.TPS1AdaptHiMin.Action_1_Condition "Fault manager configuration.  Select up to 4 actions for each fault." VALUE 0x80001E5E RecordLayout_7 0 CompuMethod_92 0 65535 /end CHARACTERISTIC
/begin CHARACTERISTIC FaultManager.TPS1AdaptHiMin.Action_2 "Fault manager configuration.  Select up to 4 actions for each fault." VALUE 0x80001E60 RecordLayout_7 0 CompuMethod_91 0 65535 /end CHARACTERISTIC
/begin CHARACTERISTIC FaultManager.TPS1AdaptHiMin.Action_2_Condition "Fault manager configuration.  Select up to 4 actions for each fault." VALUE 0x80001E62 RecordLayout_7 0 CompuMethod_92 0 65535 /end CHARACTERISTIC
/begin CHARACTERISTIC FaultManager.TPS1AdaptHiMin.Action_3 "Fault manager configuration.  Select up to 4 actions for each fault." VALUE 0x80001E64 RecordLayout_7 0 CompuMethod_91 0 65535 /end CHARACTERISTIC
/begin CHARACTERISTIC FaultManager.TPS1AdaptHiMin.Action_3_Condition "Fault manager configuration.  Select up to 4 actions for each fault." VALUE 0x80001E66 RecordLayout_7 0 CompuMethod_92 0 65535 /end CHARACTERISTIC
/begin CHARACTERISTIC FaultManager.TPS1AdaptHiMin.Action_4 "Fault manager configuration.  Select up to 4 actions for each fault." VALUE 0x80001E68 RecordLayout_7 0 CompuMethod_91 0 65535 /end CHARACTERISTIC
/begin CHARACTERISTIC FaultManager.TPS1AdaptHiMin.Action_4_Condition "Fault manager configuration.  Select up to 4 actions for each fault." VALUE 0x80001E6A RecordLayout_7 0 CompuMethod_92 0 65535 /end CHARACTERISTIC
/begin CHARACTERISTIC FaultManager.TPS1AdaptLoMax.Mode "Fault manager configuration.  Select up to 4 actions for each fault." VALUE 0x80001E6C RecordLayout_7 0 CompuMethod_89 0 65535 /end CHARACTERISTIC
/begin CHARACTERISTIC FaultManager.TPS1AdaptLoMax.ID "Fault manager configuration.  Select up to 4 actions for each fault." VALUE 0x80001E6E RecordLayout_7 0 CompuMethod_1 0 65535 /end CHARACTERISTIC
/begin CHARACTERISTIC FaultManager.TPS1AdaptLoMax.Test "Fault manager configuration.  Select up to 4 actions for each fault." VALUE 0x80001E70 RecordLayout_7 0 CompuMethod_90 0 65535 /end CHARACTERISTIC
/begin CHARACTERISTIC FaultManager.TPS1AdaptLoMax.Faulty_Samples__X_ "Fault manager configuration.  Select up to 4 actions for each fault." VALUE 0x80001E72 RecordLayout_7 0 CompuMethod_1 0 65535 /end CHARACTERISTIC
/begin CHARACTERISTIC FaultManager.TPS1AdaptLoMax.Total_Samples__Y_ "Fault manager configuration.  Select up to 4 actions for each fault." VALUE 0x80001E74 RecordLayout_7 0 CompuMethod_1 0 65535 /end CHARACTERISTIC
/begin CHARACTERISTIC FaultManager.TPS1AdaptLoMax.Action_1 "Fault manager configuration.  Select up to 4 actions for each fault." VALUE 0x80001E76 RecordLayout_7 0 CompuMethod_91 0 65535 /end CHARACTERISTIC
/begin CHARACTERISTIC FaultManager.TPS1AdaptLoMax.Action_1_Condition "Fault manager configuration.  Select up to 4 actions for each fault." VALUE 0x80001E78 RecordLayout_7 0 CompuMethod_92 0 65535 /end CHARACTERISTIC
/begin CHARACTERISTIC FaultManager.TPS1AdaptLoMax.Action_2 "Fault manager configuration.  Select up to 4 actions for each fault." VALUE 0x80001E7A RecordLayout_7 0 CompuMethod_91 0 65535 /end CHARACTERISTIC
/begin CHARACTERISTIC FaultManager.TPS1AdaptLoMax.Action_2_Condition "Fault manager configuration.  Select up to 4 actions for each fault." VALUE 0x80001E7C RecordLayout_7 0 CompuMethod_92 0 65535 /end CHARACTERISTIC
/begin CHARACTERISTIC FaultManager.TPS1AdaptLoMax.Action_3 "Fault manager configuration.  Select up to 4 actions for each fault." VALUE 0x80001E7E RecordLayout_7 0 CompuMethod_91 0 65535 /end CHARACTERISTIC
/begin CHARACTERISTIC FaultManager.TPS1AdaptLoMax.Action_3_Condition "Fault manager configuration.  Select up to 4 actions for each fault." VALUE 0x80001E80 RecordLayout_7 0 CompuMethod_92 0 65535 /end CHARACTERISTIC
/begin CHARACTERISTIC FaultManager.TPS1AdaptLoMax.Action_4 "Fault manager configuration.  Select up to 4 actions for each fault." VALUE 0x80001E82 RecordLayout_7 0 CompuMethod_91 0 65535 /end CHARACTERISTIC
/begin CHARACTERISTIC FaultManager.TPS1AdaptLoMax.Action_4_Condition "Fault manager configuration.  Select up to 4 actions for each fault." VALUE 0x80001E84 RecordLayout_7 0 CompuMethod_92 0 65535 /end CHARACTERISTIC
/begin CHARACTERISTIC FaultManager.TPS1AdaptLoMin.Mode "Fault manager configuration.  Select up to 4 actions for each fault." VALUE 0x80001E86 RecordLayout_7 0 CompuMethod_89 0 65535 /end CHARACTERISTIC
/begin CHARACTERISTIC FaultManager.TPS1AdaptLoMin.ID "Fault manager configuration.  Select up to 4 actions for each fault." VALUE 0x80001E88 RecordLayout_7 0 CompuMethod_1 0 65535 /end CHARACTERISTIC
/begin CHARACTERISTIC FaultManager.TPS1AdaptLoMin.Test "Fault manager configuration.  Select up to 4 actions for each fault." VALUE 0x80001E8A RecordLayout_7 0 CompuMethod_90 0 65535 /end CHARACTERISTIC
/begin CHARACTERISTIC FaultManager.TPS1AdaptLoMin.Faulty_Samples__X_ "Fault manager configuration.  Select up to 4 actions for each fault." VALUE 0x80001E8C RecordLayout_7 0 CompuMethod_1 0 65535 /end CHARACTERISTIC
/begin CHARACTERISTIC FaultManager.TPS1AdaptLoMin.Total_Samples__Y_ "Fault manager configuration.  Select up to 4 actions for each fault." VALUE 0x80001E8E RecordLayout_7 0 CompuMethod_1 0 65535 /end CHARACTERISTIC
/begin CHARACTERISTIC FaultManager.TPS1AdaptLoMin.Action_1 "Fault manager configuration.  Select up to 4 actions for each fault." VALUE 0x80001E90 RecordLayout_7 0 CompuMethod_91 0 65535 /end CHARACTERISTIC
/begin CHARACTERISTIC FaultManager.TPS1AdaptLoMin.Action_1_Condition "Fault manager configuration.  Select up to 4 actions for each fault." VALUE 0x80001E92 RecordLayout_7 0 CompuMethod_92 0 65535 /end CHARACTERISTIC
/begin CHARACTERISTIC FaultManager.TPS1AdaptLoMin.Action_2 "Fault manager configuration.  Select up to 4 actions for each fault." VALUE 0x80001E94 RecordLayout_7 0 CompuMethod_91 0 65535 /end CHARACTERISTIC
/begin CHARACTERISTIC FaultManager.TPS1AdaptLoMin.Action_2_Condition "Fault manager configuration.  Select up to 4 actions for each fault." VALUE 0x80001E96 RecordLayout_7 0 CompuMethod_92 0 65535 /end CHARACTERISTIC
/begin CHARACTERISTIC FaultManager.TPS1AdaptLoMin.Action_3 "Fault manager configuration.  Select up to 4 actions for each fault." VALUE 0x80001E98 RecordLayout_7 0 CompuMethod_91 0 65535 /end CHARACTERISTIC
/begin CHARACTERISTIC FaultManager.TPS1AdaptLoMin.Action_3_Condition "Fault manager configuration.  Select up to 4 actions for each fault." VALUE 0x80001E9A RecordLayout_7 0 CompuMethod_92 0 65535 /end CHARACTERISTIC
/begin CHARACTERISTIC FaultManager.TPS1AdaptLoMin.Action_4 "Fault manager configuration.  Select up to 4 actions for each fault." VALUE 0x80001E9C RecordLayout_7 0 CompuMethod_91 0 65535 /end CHARACTERISTIC
/begin CHARACTERISTIC FaultManager.TPS1AdaptLoMin.Action_4_Condition "Fault manager configuration.  Select up to 4 actions for each fault." VALUE 0x80001E9E RecordLayout_7 0 CompuMethod_92 0 65535 /end CHARACTERISTIC
/begin CHARACTERISTIC FaultManager.TPS1RangeHigh.Mode "Fault manager configuration.  Select up to 4 actions for each fault." VALUE 0x80001EA0 RecordLayout_7 0 CompuMethod_89 0 65535 /end CHARACTERISTIC
/begin CHARACTERISTIC FaultManager.TPS1RangeHigh.ID "Fault manager configuration.  Select up to 4 actions for each fault." VALUE 0x80001EA2 RecordLayout_7 0 CompuMethod_1 0 65535 /end CHARACTERISTIC
/begin CHARACTERISTIC FaultManager.TPS1RangeHigh.Test "Fault manager configuration.  Select up to 4 actions for each fault." VALUE 0x80001EA4 RecordLayout_7 0 CompuMethod_90 0 65535 /end CHARACTERISTIC
/begin CHARACTERISTIC FaultManager.TPS1RangeHigh.Faulty_Samples__X_ "Fault manager configuration.  Select up to 4 actions for each fault." VALUE 0x80001EA6 RecordLayout_7 0 CompuMethod_1 0 65535 /end CHARACTERISTIC
/begin CHARACTERISTIC FaultManager.TPS1RangeHigh.Total_Samples__Y_ "Fault manager configuration.  Select up to 4 actions for each fault." VALUE 0x80001EA8 RecordLayout_7 0 CompuMethod_1 0 65535 /end CHARACTERISTIC
/begin CHARACTERISTIC FaultManager.TPS1RangeHigh.Action_1 "Fault manager configuration.  Select up to 4 actions for each fault." VALUE 0x80001EAA RecordLayout_7 0 CompuMethod_91 0 65535 /end CHARACTERISTIC
/begin CHARACTERISTIC FaultManager.TPS1RangeHigh.Action_1_Condition "Fault manager configuration.  Select up to 4 actions for each fault." VALUE 0x80001EAC RecordLayout_7 0 CompuMethod_92 0 65535 /end CHARACTERISTIC
/begin CHARACTERISTIC FaultManager.TPS1RangeHigh.Action_2 "Fault manager configuration.  Select up to 4 actions for each fault." VALUE 0x80001EAE RecordLayout_7 0 CompuMethod_91 0 65535 /end CHARACTERISTIC
/begin CHARACTERISTIC FaultManager.TPS1RangeHigh.Action_2_Condition "Fault manager configuration.  Select up to 4 actions for each fault." VALUE 0x80001EB0 RecordLayout_7 0 CompuMethod_92 0 65535 /end CHARACTERISTIC
/begin CHARACTERISTIC FaultManager.TPS1RangeHigh.Action_3 "Fault manager configuration.  Select up to 4 actions for each fault." VALUE 0x80001EB2 RecordLayout_7 0 CompuMethod_91 0 65535 /end CHARACTERISTIC
/begin CHARACTERISTIC FaultManager.TPS1RangeHigh.Action_3_Condition "Fault manager configuration.  Select up to 4 actions for each fault." VALUE 0x80001EB4 RecordLayout_7 0 CompuMethod_92 0 65535 /end CHARACTERISTIC
/begin CHARACTERISTIC FaultManager.TPS1RangeHigh.Action_4 "Fault manager configuration.  Select up to 4 actions for each fault." VALUE 0x80001EB6 RecordLayout_7 0 CompuMethod_91 0 65535 /end CHARACTERISTIC
/begin CHARACTERISTIC FaultManager.TPS1RangeHigh.Action_4_Condition "Fault manager configuration.  Select up to 4 actions for each fault." VALUE 0x80001EB8 RecordLayout_7 0 CompuMethod_92 0 65535 /end CHARACTERISTIC
/begin CHARACTERISTIC FaultManager.TPS1RangeLow.Mode "Fault manager configuration.  Select up to 4 actions for each fault." VALUE 0x80001EBA RecordLayout_7 0 CompuMethod_89 0 65535 /end CHARACTERISTIC
/begin CHARACTERISTIC FaultManager.TPS1RangeLow.ID "Fault manager configuration.  Select up to 4 actions for each fault." VALUE 0x80001EBC RecordLayout_7 0 CompuMethod_1 0 65535 /end CHARACTERISTIC
/begin CHARACTERISTIC FaultManager.TPS1RangeLow.Test "Fault manager configuration.  Select up to 4 actions for each fault." VALUE 0x80001EBE RecordLayout_7 0 CompuMethod_90 0 65535 /end CHARACTERISTIC
/begin CHARACTERISTIC FaultManager.TPS1RangeLow.Faulty_Samples__X_ "Fault manager configuration.  Select up to 4 actions for each fault." VALUE 0x80001EC0 RecordLayout_7 0 CompuMethod_1 0 65535 /end CHARACTERISTIC
/begin CHARACTERISTIC FaultManager.TPS1RangeLow.Total_Samples__Y_ "Fault manager configuration.  Select up to 4 actions for each fault." VALUE 0x80001EC2 RecordLayout_7 0 CompuMethod_1 0 65535 /end CHARACTERISTIC
/begin CHARACTERISTIC FaultManager.TPS1RangeLow.Action_1 "Fault manager configuration.  Select up to 4 actions for each fault." VALUE 0x80001EC4 RecordLayout_7 0 CompuMethod_91 0 65535 /end CHARACTERISTIC
/begin CHARACTERISTIC FaultManager.TPS1RangeLow.Action_1_Condition "Fault manager configuration.  Select up to 4 actions for each fault." VALUE 0x80001EC6 RecordLayout_7 0 CompuMethod_92 0 65535 /end CHARACTERISTIC
/begin CHARACTERISTIC FaultManager.TPS1RangeLow.Action_2 "Fault manager configuration.  Select up to 4 actions for each fault." VALUE 0x80001EC8 RecordLayout_7 0 CompuMethod_91 0 65535 /end CHARACTERISTIC
/begin CHARACTERISTIC FaultManager.TPS1RangeLow.Action_2_Condition "Fault manager configuration.  Select up to 4 actions for each fault." VALUE 0x80001ECA RecordLayout_7 0 CompuMethod_92 0 65535 /end CHARACTERISTIC
/begin CHARACTERISTIC FaultManager.TPS1RangeLow.Action_3 "Fault manager configuration.  Select up to 4 actions for each fault." VALUE 0x80001ECC RecordLayout_7 0 CompuMethod_91 0 65535 /end CHARACTERISTIC
/begin CHARACTERISTIC FaultManager.TPS1RangeLow.Action_3_Condition "Fault manager configuration.  Select up to 4 actions for each fault." VALUE 0x80001ECE RecordLayout_7 0 CompuMethod_92 0 65535 /end CHARACTERISTIC
/begin CHARACTERISTIC FaultManager.TPS1RangeLow.Action_4 "Fault manager configuration.  Select up to 4 actions for each fault." VALUE 0x80001ED0 RecordLayout_7 0 CompuMethod_91 0 65535 /end CHARACTERISTIC
/begin CHARACTERISTIC FaultManager.TPS1RangeLow.Action_4_Condition "Fault manager configuration.  Select up to 4 actions for each fault." VALUE 0x80001ED2 RecordLayout_7 0 CompuMethod_92 0 65535 /end CHARACTERISTIC
/begin CHARACTERISTIC FaultManager.TPS2AdaptHiMax.Mode "Fault manager configuration.  Select up to 4 actions for each fault." VALUE 0x80001ED4 RecordLayout_7 0 CompuMethod_89 0 65535 /end CHARACTERISTIC
/begin CHARACTERISTIC FaultManager.TPS2AdaptHiMax.ID "Fault manager configuration.  Select up to 4 actions for each fault." VALUE 0x80001ED6 RecordLayout_7 0 CompuMethod_1 0 65535 /end CHARACTERISTIC
/begin CHARACTERISTIC FaultManager.TPS2AdaptHiMax.Test "Fault manager configuration.  Select up to 4 actions for each fault." VALUE 0x80001ED8 RecordLayout_7 0 CompuMethod_90 0 65535 /end CHARACTERISTIC
/begin CHARACTERISTIC FaultManager.TPS2AdaptHiMax.Faulty_Samples__X_ "Fault manager configuration.  Select up to 4 actions for each fault." VALUE 0x80001EDA RecordLayout_7 0 CompuMethod_1 0 65535 /end CHARACTERISTIC
/begin CHARACTERISTIC FaultManager.TPS2AdaptHiMax.Total_Samples__Y_ "Fault manager configuration.  Select up to 4 actions for each fault." VALUE 0x80001EDC RecordLayout_7 0 CompuMethod_1 0 65535 /end CHARACTERISTIC
/begin CHARACTERISTIC FaultManager.TPS2AdaptHiMax.Action_1 "Fault manager configuration.  Select up to 4 actions for each fault." VALUE 0x80001EDE RecordLayout_7 0 CompuMethod_91 0 65535 /end CHARACTERISTIC
/begin CHARACTERISTIC FaultManager.TPS2AdaptHiMax.Action_1_Condition "Fault manager configuration.  Select up to 4 actions for each fault." VALUE 0x80001EE0 RecordLayout_7 0 CompuMethod_92 0 65535 /end CHARACTERISTIC
/begin CHARACTERISTIC FaultManager.TPS2AdaptHiMax.Action_2 "Fault manager configuration.  Select up to 4 actions for each fault." VALUE 0x80001EE2 RecordLayout_7 0 CompuMethod_91 0 65535 /end CHARACTERISTIC
/begin CHARACTERISTIC FaultManager.TPS2AdaptHiMax.Action_2_Condition "Fault manager configuration.  Select up to 4 actions for each fault." VALUE 0x80001EE4 RecordLayout_7 0 CompuMethod_92 0 65535 /end CHARACTERISTIC
/begin CHARACTERISTIC FaultManager.TPS2AdaptHiMax.Action_3 "Fault manager configuration.  Select up to 4 actions for each fault." VALUE 0x80001EE6 RecordLayout_7 0 CompuMethod_91 0 65535 /end CHARACTERISTIC
/begin CHARACTERISTIC FaultManager.TPS2AdaptHiMax.Action_3_Condition "Fault manager configuration.  Select up to 4 actions for each fault." VALUE 0x80001EE8 RecordLayout_7 0 CompuMethod_92 0 65535 /end CHARACTERISTIC
/begin CHARACTERISTIC FaultManager.TPS2AdaptHiMax.Action_4 "Fault manager configuration.  Select up to 4 actions for each fault." VALUE 0x80001EEA RecordLayout_7 0 CompuMethod_91 0 65535 /end CHARACTERISTIC
/begin CHARACTERISTIC FaultManager.TPS2AdaptHiMax.Action_4_Condition "Fault manager configuration.  Select up to 4 actions for each fault." VALUE 0x80001EEC RecordLayout_7 0 CompuMethod_92 0 65535 /end CHARACTERISTIC
/begin CHARACTERISTIC FaultManager.TPS2AdaptHiMin.Mode "Fault manager configuration.  Select up to 4 actions for each fault." VALUE 0x80001EEE RecordLayout_7 0 CompuMethod_89 0 65535 /end CHARACTERISTIC
/begin CHARACTERISTIC FaultManager.TPS2AdaptHiMin.ID "Fault manager configuration.  Select up to 4 actions for each fault." VALUE 0x80001EF0 RecordLayout_7 0 CompuMethod_1 0 65535 /end CHARACTERISTIC
/begin CHARACTERISTIC FaultManager.TPS2AdaptHiMin.Test "Fault manager configuration.  Select up to 4 actions for each fault." VALUE 0x80001EF2 RecordLayout_7 0 CompuMethod_90 0 65535 /end CHARACTERISTIC
/begin CHARACTERISTIC FaultManager.TPS2AdaptHiMin.Faulty_Samples__X_ "Fault manager configuration.  Select up to 4 actions for each fault." VALUE 0x80001EF4 RecordLayout_7 0 CompuMethod_1 0 65535 /end CHARACTERISTIC
/begin CHARACTERISTIC FaultManager.TPS2AdaptHiMin.Total_Samples__Y_ "Fault manager configuration.  Select up to 4 actions for each fault." VALUE 0x80001EF6 RecordLayout_7 0 CompuMethod_1 0 65535 /end CHARACTERISTIC
/begin CHARACTERISTIC FaultManager.TPS2AdaptHiMin.Action_1 "Fault manager configuration.  Select up to 4 actions for each fault." VALUE 0x80001EF8 RecordLayout_7 0 CompuMethod_91 0 65535 /end CHARACTERISTIC
/begin CHARACTERISTIC FaultManager.TPS2AdaptHiMin.Action_1_Condition "Fault manager configuration.  Select up to 4 actions for each fault." VALUE 0x80001EFA RecordLayout_7 0 CompuMethod_92 0 65535 /end CHARACTERISTIC
/begin CHARACTERISTIC FaultManager.TPS2AdaptHiMin.Action_2 "Fault manager configuration.  Select up to 4 actions for each fault." VALUE 0x80001EFC RecordLayout_7 0 CompuMethod_91 0 65535 /end CHARACTERISTIC
/begin CHARACTERISTIC FaultManager.TPS2AdaptHiMin.Action_2_Condition "Fault manager configuration.  Select up to 4 actions for each fault." VALUE 0x80001EFE RecordLayout_7 0 CompuMethod_92 0 65535 /end CHARACTERISTIC
/begin CHARACTERISTIC FaultManager.TPS2AdaptHiMin.Action_3 "Fault manager configuration.  Select up to 4 actions for each fault." VALUE 0x80001F00 RecordLayout_7 0 CompuMethod_91 0 65535 /end CHARACTERISTIC
/begin CHARACTERISTIC FaultManager.TPS2AdaptHiMin.Action_3_Condition "Fault manager configuration.  Select up to 4 actions for each fault." VALUE 0x80001F02 RecordLayout_7 0 CompuMethod_92 0 65535 /end CHARACTERISTIC
/begin CHARACTERISTIC FaultManager.TPS2AdaptHiMin.Action_4 "Fault manager configuration.  Select up to 4 actions for each fault." VALUE 0x80001F04 RecordLayout_7 0 CompuMethod_91 0 65535 /end CHARACTERISTIC
/begin CHARACTERISTIC FaultManager.TPS2AdaptHiMin.Action_4_Condition "Fault manager configuration.  Select up to 4 actions for each fault." VALUE 0x80001F06 RecordLayout_7 0 CompuMethod_92 0 65535 /end CHARACTERISTIC
/begin CHARACTERISTIC FaultManager.TPS2AdaptLoMax.Mode "Fault manager configuration.  Select up to 4 actions for each fault." VALUE 0x80001F08 RecordLayout_7 0 CompuMethod_89 0 65535 /end CHARACTERISTIC
/begin CHARACTERISTIC FaultManager.TPS2AdaptLoMax.ID "Fault manager configuration.  Select up to 4 actions for each fault." VALUE 0x80001F0A RecordLayout_7 0 CompuMethod_1 0 65535 /end CHARACTERISTIC
/begin CHARACTERISTIC FaultManager.TPS2AdaptLoMax.Test "Fault manager configuration.  Select up to 4 actions for each fault." VALUE 0x80001F0C RecordLayout_7 0 CompuMethod_90 0 65535 /end CHARACTERISTIC
/begin CHARACTERISTIC FaultManager.TPS2AdaptLoMax.Faulty_Samples__X_ "Fault manager configuration.  Select up to 4 actions for each fault." VALUE 0x80001F0E RecordLayout_7 0 CompuMethod_1 0 65535 /end CHARACTERISTIC
/begin CHARACTERISTIC FaultManager.TPS2AdaptLoMax.Total_Samples__Y_ "Fault manager configuration.  Select up to 4 actions for each fault." VALUE 0x80001F10 RecordLayout_7 0 CompuMethod_1 0 65535 /end CHARACTERISTIC
/begin CHARACTERISTIC FaultManager.TPS2AdaptLoMax.Action_1 "Fault manager configuration.  Select up to 4 actions for each fault." VALUE 0x80001F12 RecordLayout_7 0 CompuMethod_91 0 65535 /end CHARACTERISTIC
/begin CHARACTERISTIC FaultManager.TPS2AdaptLoMax.Action_1_Condition "Fault manager configuration.  Select up to 4 actions for each fault." VALUE 0x80001F14 RecordLayout_7 0 CompuMethod_92 0 65535 /end CHARACTERISTIC
/begin CHARACTERISTIC FaultManager.TPS2AdaptLoMax.Action_2 "Fault manager configuration.  Select up to 4 actions for each fault." VALUE 0x80001F16 RecordLayout_7 0 CompuMethod_91 0 65535 /end CHARACTERISTIC
/begin CHARACTERISTIC FaultManager.TPS2AdaptLoMax.Action_2_Condition "Fault manager configuration.  Select up to 4 actions for each fault." VALUE 0x80001F18 RecordLayout_7 0 CompuMethod_92 0 65535 /end CHARACTERISTIC
/begin CHARACTERISTIC FaultManager.TPS2AdaptLoMax.Action_3 "Fault manager configuration.  Select up to 4 actions for each fault." VALUE 0x80001F1A RecordLayout_7 0 CompuMethod_91 0 65535 /end CHARACTERISTIC
/begin CHARACTERISTIC FaultManager.TPS2AdaptLoMax.Action_3_Condition "Fault manager configuration.  Select up to 4 actions for each fault." VALUE 0x80001F1C RecordLayout_7 0 CompuMethod_92 0 65535 /end CHARACTERISTIC
/begin CHARACTERISTIC FaultManager.TPS2AdaptLoMax.Action_4 "Fault manager configuration.  Select up to 4 actions for each fault." VALUE 0x80001F1E RecordLayout_7 0 CompuMethod_91 0 65535 /end CHARACTERISTIC
/begin CHARACTERISTIC FaultManager.TPS2AdaptLoMax.Action_4_Condition "Fault manager configuration.  Select up to 4 actions for each fault." VALUE 0x80001F20 RecordLayout_7 0 CompuMethod_92 0 65535 /end CHARACTERISTIC
/begin CHARACTERISTIC FaultManager.TPS2AdaptLoMin.Mode "Fault manager configuration.  Select up to 4 actions for each fault." VALUE 0x80001F22 RecordLayout_7 0 CompuMethod_89 0 65535 /end CHARACTERISTIC
/begin CHARACTERISTIC FaultManager.TPS2AdaptLoMin.ID "Fault manager configuration.  Select up to 4 actions for each fault." VALUE 0x80001F24 RecordLayout_7 0 CompuMethod_1 0 65535 /end CHARACTERISTIC
/begin CHARACTERISTIC FaultManager.TPS2AdaptLoMin.Test "Fault manager configuration.  Select up to 4 actions for each fault." VALUE 0x80001F26 RecordLayout_7 0 CompuMethod_90 0 65535 /end CHARACTERISTIC
/begin CHARACTERISTIC FaultManager.TPS2AdaptLoMin.Faulty_Samples__X_ "Fault manager configuration.  Select up to 4 actions for each fault." VALUE 0x80001F28 RecordLayout_7 0 CompuMethod_1 0 65535 /end CHARACTERISTIC
/begin CHARACTERISTIC FaultManager.TPS2AdaptLoMin.Total_Samples__Y_ "Fault manager configuration.  Select up to 4 actions for each fault." VALUE 0x80001F2A RecordLayout_7 0 CompuMethod_1 0 65535 /end CHARACTERISTIC
/begin CHARACTERISTIC FaultManager.TPS2AdaptLoMin.Action_1 "Fault manager configuration.  Select up to 4 actions for each fault." VALUE 0x80001F2C RecordLayout_7 0 CompuMethod_91 0 65535 /end CHARACTERISTIC
/begin CHARACTERISTIC FaultManager.TPS2AdaptLoMin.Action_1_Condition "Fault manager configuration.  Select up to 4 actions for each fault." VALUE 0x80001F2E RecordLayout_7 0 CompuMethod_92 0 65535 /end CHARACTERISTIC
/begin CHARACTERISTIC FaultManager.TPS2AdaptLoMin.Action_2 "Fault manager configuration.  Select up to 4 actions for each fault." VALUE 0x80001F30 RecordLayout_7 0 CompuMethod_91 0 65535 /end CHARACTERISTIC
/begin CHARACTERISTIC FaultManager.TPS2AdaptLoMin.Action_2_Condition "Fault manager configuration.  Select up to 4 actions for each fault." VALUE 0x80001F32 RecordLayout_7 0 CompuMethod_92 0 65535 /end CHARACTERISTIC
/begin CHARACTERISTIC FaultManager.TPS2AdaptLoMin.Action_3 "Fault manager configuration.  Select up to 4 actions for each fault." VALUE 0x80001F34 RecordLayout_7 0 CompuMethod_91 0 65535 /end CHARACTERISTIC
/begin CHARACTERISTIC FaultManager.TPS2AdaptLoMin.Action_3_Condition "Fault manager configuration.  Select up to 4 actions for each fault." VALUE 0x80001F36 RecordLayout_7 0 CompuMethod_92 0 65535 /end CHARACTERISTIC
/begin CHARACTERISTIC FaultManager.TPS2AdaptLoMin.Action_4 "Fault manager configuration.  Select up to 4 actions for each fault." VALUE 0x80001F38 RecordLayout_7 0 CompuMethod_91 0 65535 /end CHARACTERISTIC
/begin CHARACTERISTIC FaultManager.TPS2AdaptLoMin.Action_4_Condition "Fault manager configuration.  Select up to 4 actions for each fault." VALUE 0x80001F3A RecordLayout_7 0 CompuMethod_92 0 65535 /end CHARACTERISTIC
/begin CHARACTERISTIC FaultManager.TPS2RangeHigh.Mode "Fault manager configuration.  Select up to 4 actions for each fault." VALUE 0x80001F3C RecordLayout_7 0 CompuMethod_89 0 65535 /end CHARACTERISTIC
/begin CHARACTERISTIC FaultManager.TPS2RangeHigh.ID "Fault manager configuration.  Select up to 4 actions for each fault." VALUE 0x80001F3E RecordLayout_7 0 CompuMethod_1 0 65535 /end CHARACTERISTIC
/begin CHARACTERISTIC FaultManager.TPS2RangeHigh.Test "Fault manager configuration.  Select up to 4 actions for each fault." VALUE 0x80001F40 RecordLayout_7 0 CompuMethod_90 0 65535 /end CHARACTERISTIC
/begin CHARACTERISTIC FaultManager.TPS2RangeHigh.Faulty_Samples__X_ "Fault manager configuration.  Select up to 4 actions for each fault." VALUE 0x80001F42 RecordLayout_7 0 CompuMethod_1 0 65535 /end CHARACTERISTIC
/begin CHARACTERISTIC FaultManager.TPS2RangeHigh.Total_Samples__Y_ "Fault manager configuration.  Select up to 4 actions for each fault." VALUE 0x80001F44 RecordLayout_7 0 CompuMethod_1 0 65535 /end CHARACTERISTIC
/begin CHARACTERISTIC FaultManager.TPS2RangeHigh.Action_1 "Fault manager configuration.  Select up to 4 actions for each fault." VALUE 0x80001F46 RecordLayout_7 0 CompuMethod_91 0 65535 /end CHARACTERISTIC
/begin CHARACTERISTIC FaultManager.TPS2RangeHigh.Action_1_Condition "Fault manager configuration.  Select up to 4 actions for each fault." VALUE 0x80001F48 RecordLayout_7 0 CompuMethod_92 0 65535 /end CHARACTERISTIC
/begin CHARACTERISTIC FaultManager.TPS2RangeHigh.Action_2 "Fault manager configuration.  Select up to 4 actions for each fault." VALUE 0x80001F4A RecordLayout_7 0 CompuMethod_91 0 65535 /end CHARACTERISTIC
/begin CHARACTERISTIC FaultManager.TPS2RangeHigh.Action_2_Condition "Fault manager configuration.  Select up to 4 actions for each fault." VALUE 0x80001F4C RecordLayout_7 0 CompuMethod_92 0 65535 /end CHARACTERISTIC
/begin CHARACTERISTIC FaultManager.TPS2RangeHigh.Action_3 "Fault manager configuration.  Select up to 4 actions for each fault." VALUE 0x80001F4E RecordLayout_7 0 CompuMethod_91 0 65535 /end CHARACTERISTIC
/begin CHARACTERISTIC FaultManager.TPS2RangeHigh.Action_3_Condition "Fault manager configuration.  Select up to 4 actions for each fault." VALUE 0x80001F50 RecordLayout_7 0 CompuMethod_92 0 65535 /end CHARACTERISTIC
/begin CHARACTERISTIC FaultManager.TPS2RangeHigh.Action_4 "Fault manager configuration.  Select up to 4 actions for each fault." VALUE 0x80001F52 RecordLayout_7 0 CompuMethod_91 0 65535 /end CHARACTERISTIC
/begin CHARACTERISTIC FaultManager.TPS2RangeHigh.Action_4_Condition "Fault manager configuration.  Select up to 4 actions for each fault." VALUE 0x80001F54 RecordLayout_7 0 CompuMethod_92 0 65535 /end CHARACTERISTIC
/begin CHARACTERISTIC FaultManager.TPS2RangeLow.Mode "Fault manager configuration.  Select up to 4 actions for each fault." VALUE 0x80001F56 RecordLayout_7 0 CompuMethod_89 0 65535 /end CHARACTERISTIC
/begin CHARACTERISTIC FaultManager.TPS2RangeLow.ID "Fault manager configuration.  Select up to 4 actions for each fault." VALUE 0x80001F58 RecordLayout_7 0 CompuMethod_1 0 65535 /end CHARACTERISTIC
/begin CHARACTERISTIC FaultManager.TPS2RangeLow.Test "Fault manager configuration.  Select up to 4 actions for each fault." VALUE 0x80001F5A RecordLayout_7 0 CompuMethod_90 0 65535 /end CHARACTERISTIC
/begin CHARACTERISTIC FaultManager.TPS2RangeLow.Faulty_Samples__X_ "Fault manager configuration.  Select up to 4 actions for each fault." VALUE 0x80001F5C RecordLayout_7 0 CompuMethod_1 0 65535 /end CHARACTERISTIC
/begin CHARACTERISTIC FaultManager.TPS2RangeLow.Total_Samples__Y_ "Fault manager configuration.  Select up to 4 actions for each fault." VALUE 0x80001F5E RecordLayout_7 0 CompuMethod_1 0 65535 /end CHARACTERISTIC
/begin CHARACTERISTIC FaultManager.TPS2RangeLow.Action_1 "Fault manager configuration.  Select up to 4 actions for each fault." VALUE 0x80001F60 RecordLayout_7 0 CompuMethod_91 0 65535 /end CHARACTERISTIC
/begin CHARACTERISTIC FaultManager.TPS2RangeLow.Action_1_Condition "Fault manager configuration.  Select up to 4 actions for each fault." VALUE 0x80001F62 RecordLayout_7 0 CompuMethod_92 0 65535 /end CHARACTERISTIC
/begin CHARACTERISTIC FaultManager.TPS2RangeLow.Action_2 "Fault manager configuration.  Select up to 4 actions for each fault." VALUE 0x80001F64 RecordLayout_7 0 CompuMethod_91 0 65535 /end CHARACTERISTIC
/begin CHARACTERISTIC FaultManager.TPS2RangeLow.Action_2_Condition "Fault manager configuration.  Select up to 4 actions for each fault." VALUE 0x80001F66 RecordLayout_7 0 CompuMethod_92 0 65535 /end CHARACTERISTIC
/begin CHARACTERISTIC FaultManager.TPS2RangeLow.Action_3 "Fault manager configuration.  Select up to 4 actions for each fault." VALUE 0x80001F68 RecordLayout_7 0 CompuMethod_91 0 65535 /end CHARACTERISTIC
/begin CHARACTERISTIC FaultManager.TPS2RangeLow.Action_3_Condition "Fault manager configuration.  Select up to 4 actions for each fault." VALUE 0x80001F6A RecordLayout_7 0 CompuMethod_92 0 65535 /end CHARACTERISTIC
/begin CHARACTERISTIC FaultManager.TPS2RangeLow.Action_4 "Fault manager configuration.  Select up to 4 actions for each fault." VALUE 0x80001F6C RecordLayout_7 0 CompuMethod_91 0 65535 /end CHARACTERISTIC
/begin CHARACTERISTIC FaultManager.TPS2RangeLow.Action_4_Condition "Fault manager configuration.  Select up to 4 actions for each fault." VALUE 0x80001F6E RecordLayout_7 0 CompuMethod_92 0 65535 /end CHARACTERISTIC
/begin CHARACTERISTIC FaultManager.TPS_Sensors_Conflict.Mode "Fault manager configuration.  Select up to 4 actions for each fault." VALUE 0x80001F70 RecordLayout_7 0 CompuMethod_89 0 65535 /end CHARACTERISTIC
/begin CHARACTERISTIC FaultManager.TPS_Sensors_Conflict.ID "Fault manager configuration.  Select up to 4 actions for each fault." VALUE 0x80001F72 RecordLayout_7 0 CompuMethod_1 0 65535 /end CHARACTERISTIC
/begin CHARACTERISTIC FaultManager.TPS_Sensors_Conflict.Test "Fault manager configuration.  Select up to 4 actions for each fault." VALUE 0x80001F74 RecordLayout_7 0 CompuMethod_90 0 65535 /end CHARACTERISTIC
/begin CHARACTERISTIC FaultManager.TPS_Sensors_Conflict.Faulty_Samples__X_ "Fault manager configuration.  Select up to 4 actions for each fault." VALUE 0x80001F76 RecordLayout_7 0 CompuMethod_1 0 65535 /end CHARACTERISTIC
/begin CHARACTERISTIC FaultManager.TPS_Sensors_Conflict.Total_Samples__Y_ "Fault manager configuration.  Select up to 4 actions for each fault." VALUE 0x80001F78 RecordLayout_7 0 CompuMethod_1 0 65535 /end CHARACTERISTIC
/begin CHARACTERISTIC FaultManager.TPS_Sensors_Conflict.Action_1 "Fault manager configuration.  Select up to 4 actions for each fault." VALUE 0x80001F7A RecordLayout_7 0 CompuMethod_91 0 65535 /end CHARACTERISTIC
/begin CHARACTERISTIC FaultManager.TPS_Sensors_Conflict.Action_1_Condition "Fault manager configuration.  Select up to 4 actions for each fault." VALUE 0x80001F7C RecordLayout_7 0 CompuMethod_92 0 65535 /end CHARACTERISTIC
/begin CHARACTERISTIC FaultManager.TPS_Sensors_Conflict.Action_2 "Fault manager configuration.  Select up to 4 actions for each fault." VALUE 0x80001F7E RecordLayout_7 0 CompuMethod_91 0 65535 /end CHARACTERISTIC
/begin CHARACTERISTIC FaultManager.TPS_Sensors_Conflict.Action_2_Condition "Fault manager configuration.  Select up to 4 actions for each fault." VALUE 0x80001F80 RecordLayout_7 0 CompuMethod_92 0 65535 /end CHARACTERISTIC
/begin CHARACTERISTIC FaultManager.TPS_Sensors_Conflict.Action_3 "Fault manager configuration.  Select up to 4 actions for each fault." VALUE 0x80001F82 RecordLayout_7 0 CompuMethod_91 0 65535 /end CHARACTERISTIC
/begin CHARACTERISTIC FaultManager.TPS_Sensors_Conflict.Action_3_Condition "Fault manager configuration.  Select up to 4 actions for each fault." VALUE 0x80001F84 RecordLayout_7 0 CompuMethod_92 0 65535 /end CHARACTERISTIC
/begin CHARACTERISTIC FaultManager.TPS_Sensors_Conflict.Action_4 "Fault manager configuration.  Select up to 4 actions for each fault." VALUE 0x80001F86 RecordLayout_7 0 CompuMethod_91 0 65535 /end CHARACTERISTIC
/begin CHARACTERISTIC FaultManager.TPS_Sensors_Conflict.Action_4_Condition "Fault manager configuration.  Select up to 4 actions for each fault." VALUE 0x80001F88 RecordLayout_7 0 CompuMethod_92 0 65535 /end CHARACTERISTIC
/begin CHARACTERISTIC FuelAdaptDelta "O2_Error must be less than this delta to adapt the FuelFlowComp map" VALUE 0x80001FE5 RecordLayout_4 0 CompuMethod_8 0 2 /end CHARACTERISTIC
/begin CHARACTERISTIC FuelAdaptEnable "Determines whether the FuelFlowComp map will be adapted using the MAF sensor" VALUE 0x80001FE9 RecordLayout_1 0 CompuMethod_6 0 1 /end CHARACTERISTIC
/begin CHARACTERISTIC FuelAdaptGainTbl "Gain for updating FuelFlowComp map.  This fraction of the error is added to the map every 5ms." CURVE 0x80001FF2 RecordLayout_4 0 CompuMethod_23 -1E+17 1E+17
 /begin AXIS_DESCR COM_AXIS O2ITermIn CompuMethod_8 9 -1E+17 1E+17 AXIS_PTS_REF O2ITermIdxArr /end AXIS_DESCR
/end CHARACTERISTIC
/begin CHARACTERISTIC FuelFlowCompAdaptMap "Adapt map based on O2 ITerm that is multiplied into FuelFlowComp." MAP 0x8000201A RecordLayout_4 0 CompuMethod_8 -1E+17 1E+17
 /begin AXIS_DESCR COM_AXIS RPM09In CompuMethod_2 9 -1E+17 1E+17 AXIS_PTS_REF RPM09IdxArr /end AXIS_DESCR
 /begin AXIS_DESCR COM_AXIS IndLoadNom09In CompuMethod_2 9 -1E+17 1E+17 AXIS_PTS_REF IndLoadNom09IdxArr /end AXIS_DESCR
/end CHARACTERISTIC
/begin CHARACTERISTIC FuelFlowCompMap "Fuel Flow Compensation Multiplier - gain to adjust modelling errors in mechanical fuel system." MAP 0x8000215E RecordLayout_4 0 CompuMethod_8 -1E+17 1E+17
 /begin AXIS_DESCR COM_AXIS RPM09In CompuMethod_2 9 -1E+17 1E+17 AXIS_PTS_REF RPM09IdxArr /end AXIS_DESCR
 /begin AXIS_DESCR COM_AXIS IndLoadNom09In CompuMethod_2 9 -1E+17 1E+17 AXIS_PTS_REF IndLoadNom09IdxArr /end AXIS_DESCR
/end CHARACTERISTIC
/begin CHARACTERISTIC Generating_Max_Torque "" VALUE 0x80002319 RecordLayout_4 0 CompuMethod_26 -1E+17 1E+17 /end CHARACTERISTIC
/begin CHARACTERISTIC IdleExitTimeConst "Time constant for idle air and spark ramp out" VALUE 0x8000266C RecordLayout_4 0 CompuMethod_106 0 100 /end CHARACTERISTIC
/begin CHARACTERISTIC IndLoadTbl "Converts APC into Indicated Torque." CURVE 0x800026EE RecordLayout_4 0 CompuMethod_108 -1E+17 1E+17
 /begin AXIS_DESCR COM_AXIS APCPort CompuMethod_2 10 -1E+17 1E+17 AXIS_PTS_REF APC_TPS10IdxArr /end AXIS_DESCR
/end CHARACTERISTIC
/begin CHARACTERISTIC Max_Cranking_RPM "" VALUE 0x80002E74 RecordLayout_4 0 CompuMethod_26 -1E+17 1E+17 /end CHARACTERISTIC
/begin CHARACTERISTIC MaxETCSetPtLimitTbl "Maximum allowable ETC position." CURVE 0x80002E78 RecordLayout_4 0 CompuMethod_5 0 100
 /begin AXIS_DESCR COM_AXIS RPM09In CompuMethod_2 9 -1E+17 1E+17 AXIS_PTS_REF RPM09IdxArr /end AXIS_DESCR
/end CHARACTERISTIC
/begin CHARACTERISTIC MinETCSetpoint "Minimum setpoint for ETC." VALUE 0x80003036 RecordLayout_4 0 CompuMethod_5 -1E+17 1E+17 /end CHARACTERISTIC
/begin CHARACTERISTIC ThrottleSource "Selects source of throttle command" VALUE 0x80003E3B RecordLayout_1 0 CompuMethod_161 0 1 /end CHARACTERISTIC
/begin CHARACTERISTIC VE_Adapt_Enable "" VALUE 0x80003EFC RecordLayout_4 0 CompuMethod_2 0 1 /end CHARACTERISTIC
/begin CHARACTERISTIC VEAdaptFilt "Filter time constant" VALUE 0x80003F08 RecordLayout_4 0 CompuMethod_54 -1E+17 1E+17 /end CHARACTERISTIC
/*~~~~~~~~~ 6.3.17 AXIS_PTS ~~~~~~~~~*/
/begin AXIS_PTS AirMinGovSpeedErrorIdxArr "" 0x800000FB AirMinGovSpeedErrorIn RecordLayout_5 0 CompuMethod_2 9 -1E+17 1E+17 DEPOSIT ABSOLUTE /end AXIS_PTS
/begin AXIS_PTS APC_TPS10IdxArr "" 0x80000129 APCPort RecordLayout_5 0 CompuMethod_2 10 -1E+17 1E+17 DEPOSIT ABSOLUTE /end AXIS_PTS
/begin AXIS_PTS APP17IdxArr "" 0x8000016E APP17In RecordLayout_5 0 CompuMethod_2 17 -1E+17 1E+17 DEPOSIT ABSOLUTE /end AXIS_PTS
/begin AXIS_PTS IndLoadNom09IdxArr "" 0x80002686 IndLoadNom09In RecordLayout_5 0 CompuMethod_2 9 -1E+17 1E+17 DEPOSIT ABSOLUTE /end AXIS_PTS
/begin AXIS_PTS O2ITermIdxArr "Index for O2 ITerm." 0x800031E2 O2ITermIn RecordLayout_5 0 CompuMethod_8 9 -1E+17 1E+17 DEPOSIT ABSOLUTE /end AXIS_PTS
/begin AXIS_PTS RPM09IdxArr "" 0x80003721 RPM09In RecordLayout_5 0 CompuMethod_2 9 -1E+17 1E+17 DEPOSIT ABSOLUTE /end AXIS_PTS
/begin AXIS_PTS TPS09IdxArr "" 0x80003E66 TPS09In RecordLayout_5 0 CompuMethod_2 9 -1E+17 1E+17 DEPOSIT ABSOLUTE /end AXIS_PTS
/*~~~~~~~~~ 6.3.106 RECORD_LAYOUTs ~~~~~~~~~*/
/begin RECORD_LAYOUT RecordLayout_1 FNC_VALUES 1 UBYTE ROW_DIR DIRECT /end RECORD_LAYOUT
/begin RECORD_LAYOUT RecordLayout_4 FNC_VALUES 1 FLOAT32_IEEE ROW_DIR DIRECT /end RECORD_LAYOUT
/begin RECORD_LAYOUT RecordLayout_5 AXIS_PTS_X 1 FLOAT32_IEEE /* IndexIncr */ INDEX_INCR /* Addressing */ DIRECT /end RECORD_LAYOUT
/begin RECORD_LAYOUT RecordLayout_7 FNC_VALUES 1 UWORD ROW_DIR DIRECT /end RECORD_LAYOUT
/*~~~~~~~~~ 6.3.31 COMPU_METHODs ~~~~~~~~~*/
/begin COMPU_METHOD CompuMethod_1 "" RAT_FUNC "%3.0" "" COEFFS 0 1 0 0 0 1 /end COMPU_METHOD
/begin COMPU_METHOD CompuMethod_2 "" RAT_FUNC "%6.2" "" COEFFS 0 1 0 0 0 1 /end COMPU_METHOD
/begin COMPU_METHOD CompuMethod_4 "" TAB_VERB "%1.0" "" COMPU_TAB_REF CompuVtab_1 /end COMPU_METHOD
/begin COMPU_METHOD CompuMethod_5 "" RAT_FUNC "%6.2" "%" COEFFS 0 1 0 0 0 1 /end COMPU_METHOD
/begin COMPU_METHOD CompuMethod_6 "" TAB_VERB "%1.0" "bool" COMPU_TAB_REF CompuVtab_2 /end COMPU_METHOD
/begin COMPU_METHOD CompuMethod_7 "" RAT_FUNC "%6.2" "g/s" COEFFS 0 1 0 0 0 1 /end COMPU_METHOD
/begin COMPU_METHOD CompuMethod_8 "" RAT_FUNC "%6.2" "mult" COEFFS 0 1 0 0 0 1 /end COMPU_METHOD
/begin COMPU_METHOD CompuMethod_9 "" TAB_VERB "%6.2" "" COMPU_TAB_REF CompuVtab_3 /end COMPU_METHOD
/begin COMPU_METHOD CompuMethod_10 "" TAB_VERB "%1.0" "" COMPU_TAB_REF CompuVtab_4 /end COMPU_METHOD
/begin COMPU_METHOD CompuMethod_11 "" RAT_FUNC "%6.2" "idx.frac" COEFFS 0 1 0 0 0 0.00195313 /end COMPU_METHOD
/begin COMPU_METHOD CompuMethod_12 "" RAT_FUNC "%6.2" "mg" COEFFS 0 1 0 0 0 1 /end COMPU_METHOD
/begin COMPU_METHOD CompuMethod_13 "" TAB_VERB "%1.0" "" COMPU_TAB_REF CompuVtab_5 /end COMPU_METHOD
/begin COMPU_METHOD CompuMethod_16 "" TAB_VERB "%1.0" "" COMPU_TAB_REF CompuVtab_6 /end COMPU_METHOD
/begin COMPU_METHOD CompuMethod_17 "" TAB_VERB "%1.0" "" COMPU_TAB_REF CompuVtab_7 /end COMPU_METHOD
/begin COMPU_METHOD CompuMethod_18 "" TAB_VERB "%1.0" "" COMPU_TAB_REF CompuVtab_8 /end COMPU_METHOD
/begin COMPU_METHOD CompuMethod_22 "" TAB_VERB "%1.0" "" COMPU_TAB_REF CompuVtab_10 /end COMPU_METHOD
/begin COMPU_METHOD CompuMethod_23 "" RAT_FUNC "%5.4" "" COEFFS 0 1 0 0 0 1 /end COMPU_METHOD
/begin COMPU_METHOD CompuMethod_25 "" RAT_FUNC "%7.2" "%" COEFFS 0 1 0 0 0 1 /end COMPU_METHOD
/begin COMPU_METHOD CompuMethod_26 "" RAT_FUNC "%6.2" "RPM" COEFFS 0 1 0 0 0 1 /end COMPU_METHOD
/begin COMPU_METHOD CompuMethod_38 "" RAT_FUNC "%1.0" "" COEFFS 0 1 0 0 0 1 /end COMPU_METHOD
/begin COMPU_METHOD CompuMethod_46 "" RAT_FUNC "%6.2" "s" COEFFS 0 1 0 0 0 0.005 /end COMPU_METHOD
/begin COMPU_METHOD CompuMethod_49 "" RAT_FUNC "%6.2" "nm" COEFFS 0 1 0 0 0 1 /end COMPU_METHOD
/begin COMPU_METHOD CompuMethod_54 "" RAT_FUNC "%6.2" "sec" COEFFS 0 1 0 0 0 1 /end COMPU_METHOD
/begin COMPU_METHOD CompuMethod_56 "" RAT_FUNC "%7.2" "ratio" COEFFS 0 1 0 0 0 1 /end COMPU_METHOD
/begin COMPU_METHOD CompuMethod_57 "" RAT_FUNC "%6.2" "C" COEFFS 0 1 0 0 0 1 /end COMPU_METHOD
/begin COMPU_METHOD CompuMethod_85 "" RAT_FUNC "%6.2" "%/sec" COEFFS 0 1 0 0 0 1 /end COMPU_METHOD
/begin COMPU_METHOD CompuMethod_86 "" TAB_VERB "%1.0" "" COMPU_TAB_REF CompuVtab_27 /end COMPU_METHOD
/begin COMPU_METHOD CompuMethod_89 "" TAB_VERB "%3.0" "" COMPU_TAB_REF CompuVtab_30 /end COMPU_METHOD
/begin COMPU_METHOD CompuMethod_90 "" TAB_VERB "%3.0" "" COMPU_TAB_REF CompuVtab_31 /end COMPU_METHOD
/begin COMPU_METHOD CompuMethod_91 "" TAB_VERB "%3.0" "" COMPU_TAB_REF CompuVtab_32 /end COMPU_METHOD
/begin COMPU_METHOD CompuMethod_92 "" TAB_VERB "%3.0" "" COMPU_TAB_REF CompuVtab_33 /end COMPU_METHOD
/begin COMPU_METHOD CompuMethod_106 "" RAT_FUNC "%5.3" "sec" COEFFS 0 1 0 0 0 1 /end COMPU_METHOD
/begin COMPU_METHOD CompuMethod_108 "" RAT_FUNC "%6.2" "Nm" COEFFS 0 1 0 0 0 1 /end COMPU_METHOD
/begin COMPU_METHOD CompuMethod_161 "" TAB_VERB "%1.0" "" COMPU_TAB_REF CompuVtab_66 /end COMPU_METHOD
/*~~~~~~~~~ 6.3.34 COMPU_VTABs ~~~~~~~~~*/
/begin COMPU_VTAB CompuVtab_1 "" TAB_VERB 2 0 "Pass-Through" 1 "Override" /end COMPU_VTAB
/begin COMPU_VTAB CompuVtab_2 "" TAB_VERB 2 0 "Disabled" 1 "Enabled" /end COMPU_VTAB
/begin COMPU_VTAB CompuVtab_3 "" TAB_VERB 90 0 "Normal Operation" 1 "Bad Resource ID" 2 "Hardware Not Supported" 3 "Behaviour Not Supported" 4 "Bad Attribute Data" 5 "Fail On Create" 6 "Fail On Set Attributes" 7 "Resource Not Created" 8 "Missing Attribute" 9 "Behaviour Method Not Supported" 10 "A Service Failed" 11 "Failed to destroy a resource" 12 "Resource Was Created" 13 "Resource Conflict" 14 "Invalid Encoder Type" 15 "2-Strike Not Supported" 16 "720degCA Pattern Not Supported" 17 "CAM Pattern Not Supported" 18 "Unknown CAM Pattern Supplied" 19 "Engine Speed Present" 20 "Hardware Interface Not Supported" 21 "Service Already Started" 22 "Register Write Failed to verify" 23 "Register access was denied" 24 "Out of free store memory" 25 "Software Q Overrun" 26 "Hardware Q Overrun" 27 "Feature unsupported in archive" 28 "Insufficient FW resource" 29 "OS Resource conflict" 30 "Driver Mode conflict" 31 "RTC time is illegal" 32 "FFS unmounted" 33 "Access from an ISR" 34 "FFS internal" 35 "Operation timed out" 36 "Task Kernel API Usage" 37 "Operation aborted" 38 "File not Found" 39 "Invalid characters in filename" 40 "Duplicate filename" 41 "Filename is too long" 42 "Dir not empty on remove" 43 "Dir not found" 44 "Dir name invalid" 45 "Dir exists" 46 "Dir too deep" 47 "Illegal Handle" 48 "End of File" 49 "Media Full" 50 "Media Write" 51 "Media Read" 52 "Media Write Protected" 53 "File Read Only" 54 "FS Media Changed" 55 "Internal USB" 56 "Voltage too high for USB IC" 57 "Encoder not created" 64 "TPU Chan Conflict" 65 "TPU Func Unavailable" 66 "TPU Config" 67 "TPU Primative Usage" 68 "TPU Primitive Count" 69 "TPU Restricted TPU channel" 70 "TPU Not Created" 71 "TPU Self Modify constant write err" 72 "TPU Error 0x48" 73 "TPU Error 0x49" 74 "TPU Error 0x4A" 75 "TPU Error 0x4B" 76 "TPU Error 0x4C" 77 "TPU Error 0x4D" 78 "TPU Error 0x4E" 79 "TPU Error 0x4F" 80 "TPU Error 0x50" 81 "TPU Error 0x51" 82 "TPU Error 0x52" 83 "TPU Error 0x53" 84 "TPU Error 0x54" 85 "TPU Error 0x55" 86 "TPU Error 0x56" 87 "TPU Error 0x57" 88 "TPU Error 0x58" 89 "TPU Error 0x59" 90 "TPU Error 0x5A" 91 "TPU Error 0x5B" 92 "TPU Error 0x5C" 93 "TPU Error 0x5D" 94 "TPU Error 0x5E" 95 "TPU Error 0x5F" /end COMPU_VTAB
/begin COMPU_VTAB CompuVtab_4 "" TAB_VERB 2 0 "ETC" 1 "IAC" /end COMPU_VTAB
/begin COMPU_VTAB CompuVtab_5 "" TAB_VERB 4 0 "Before Model Initialize" 1 "After Model Init - Before STARTUP Event" 2 "After STARTUP Event - Before Run" 3 "Run" /end COMPU_VTAB
/begin COMPU_VTAB CompuVtab_6 "" TAB_VERB 4 0 "Initializing" 1 "Run" 2 "Pause" 3 "Stop" /end COMPU_VTAB
/begin COMPU_VTAB CompuVtab_7 "" TAB_VERB 9 0 "Running normally" 1 "Requested by user" 2 "Foreground stack margin violation" 3 "Background stack margin violation" 4 "Idle stack margin violation" 5 "Interrupt stack margin violation" 6 "Heap margin violation" 7 "Idle CPU margin violation" 8 "OS error detected" /end COMPU_VTAB
/begin COMPU_VTAB CompuVtab_8 "" TAB_VERB 9 0 "-" 1 "-" 2 "Application Monitor" 3 "Application Monitor" 4 "Application Monitor" 5 "Application Monitor" 6 "Application Monitor" 7 "Application Monitor" 8 "Application Monitor" /end COMPU_VTAB
/begin COMPU_VTAB CompuVtab_10 "" TAB_VERB 2 0 "Not Enabled" 1 "Enabled" /end COMPU_VTAB
/begin COMPU_VTAB CompuVtab_27 "" TAB_VERB 2 0 "Decreasing" 1 "Increasing" /end COMPU_VTAB
/begin COMPU_VTAB CompuVtab_30 "" TAB_VERB 6 0 "Disabled" 1 "Enabled" 2 "Sticky" 3 "Enabled - Persistent" 4 "Sticky - Persistent" 5 "Save Occurred" /end COMPU_VTAB
/begin COMPU_VTAB CompuVtab_31 "" TAB_VERB 2 0 "-" 1 "Test" /end COMPU_VTAB
/begin COMPU_VTAB CompuVtab_32 "" TAB_VERB 10 0 "CEL" 1 "CutThrottle" 2 "DelayedEngineShutdown" 3 "DisableO2Ctrl" 4 "EngineShutdown" 5 "HardRevLimit" 6 "MediumRevLimit" 7 "SoftRevLimit" 8 "Wrench_Light" 9 "(None)" /end COMPU_VTAB
/begin COMPU_VTAB CompuVtab_33 "" TAB_VERB 8 0 "(None)" 1 "Suspected" 2 "Active" 3 "Suspected or Active" 4 "Occurred" 5 "Suspected or Occurred" 6 "Active or Occurred" 7 "Suspected or Active or Occurred" /end COMPU_VTAB
/begin COMPU_VTAB CompuVtab_66 "" TAB_VERB 2 0 "APP1" 1 "NORMAL" /end COMPU_VTAB
/begin FUNCTION BaseEngineController_A02 ""
 /begin DEF_CHARACTERISTIC FaultManager.MAPRangeHigh.Total_Samples__Y_ FaultManager.MAPRangeHigh.Action_1 FaultManager.MAPRangeHigh.Action_1_Condition FaultManager.MAPRangeHigh.Action_2 FaultManager.MAPRangeHigh.Action_2_Condition FaultManager.MAPRangeHigh.Action_3 FaultManager.MAPRangeHigh.Action_3_Condition FaultManager.MAPRangeHigh.Action_4 FaultManager.MAPRangeHigh.Action_4_Condition FaultManager.MAPRangeLow.Mode FaultManager.MAPRangeLow.ID FaultManager.MAPRangeLow.Test FaultManager.MAPRangeLow.Faulty_Samples__X_ FaultManager.MAPRangeLow.Total_Samples__Y_ FaultManager.MAPRangeLow.Action_1 FaultManager.MAPRangeLow.Action_1_Condition FaultManager.MAPRangeLow.Action_2 FaultManager.MAPRangeLow.Action_2_Condition FaultManager.MAPRangeLow.Action_3 FaultManager.MAPRangeLow.Action_3_Condition FaultManager.MAPRangeLow.Action_4 FaultManager.MAPRangeLow.Action_4_Condition FaultManager.MAPTimeRangeHigh.Mode FaultManager.MAPTimeRangeHigh.ID FaultManager.MAPTimeRangeHigh.Test FaultManager.MAPTimeRangeHigh.Faulty_Samples__X_ FaultManager.MAPTimeRangeHigh.Total_Samples__Y_ FaultManager.MAPTimeRangeHigh.Action_1 FaultManager.MAPTimeRangeHigh.Action_1_Condition FaultManager.MAPTimeRangeHigh.Action_2 FaultManager.MAPTimeRangeHigh.Action_2_Condition FaultManager.MAPTimeRangeHigh.Action_3 FaultManager.MAPTimeRangeHigh.Action_3_Condition FaultManager.MAPTimeRangeHigh.Action_4 FaultManager.MAPTimeRangeHigh.Action_4_Condition FaultManager.MAPTimeRangeLow.Mode FaultManager.MAPTimeRangeLow.ID FaultManager.MAPTimeRangeLow.Test FaultManager.MAPTimeRangeLow.Faulty_Samples__X_ FaultManager.MAPTimeRangeLow.Total_Samples__Y_ FaultManager.MAPTimeRangeLow.Action_1 FaultManager.MAPTimeRangeLow.Action_1_Condition FaultManager.MAPTimeRangeLow.Action_2 FaultManager.MAPTimeRangeLow.Action_2_Condition FaultManager.MAPTimeRangeLow.Action_3 FaultManager.MAPTimeRangeLow.Action_3_Condition FaultManager.MAPTimeRangeLow.Action_4 FaultManager.MAPTimeRangeLow.Action_4_Condition FaultManager.MAP_IR_HI.Mode FaultManager.MAP_IR_HI.ID FaultManager.MAP_IR_HI.Test FaultManager.MAP_IR_HI.Faulty_Samples__X_ FaultManager.MAP_IR_HI.Total_Samples__Y_ FaultManager.MAP_IR_HI.Action_1 FaultManager.MAP_IR_HI.Action_1_Condition FaultManager.MAP_IR_HI.Action_2 FaultManager.MAP_IR_HI.Action_2_Condition FaultManager.MAP_IR_HI.Action_3 FaultManager.MAP_IR_HI.Action_3_Condition FaultManager.MAP_IR_HI.Action_4 FaultManager.MAP_IR_HI.Action_4_Condition FaultManager.MAP_IR_LO.Mode FaultManager.MAP_IR_LO.ID FaultManager.MAP_IR_LO.Test FaultManager.MAP_IR_LO.Faulty_Samples__X_ FaultManager.MAP_IR_LO.Total_Samples__Y_ FaultManager.MAP_IR_LO.Action_1 FaultManager.MAP_IR_LO.Action_1_Condition FaultManager.MAP_IR_LO.Action_2 FaultManager.MAP_IR_LO.Action_2_Condition FaultManager.MAP_IR_LO.Action_3 FaultManager.MAP_IR_LO.Action_3_Condition FaultManager.MAP_IR_LO.Action_4 FaultManager.MAP_IR_LO.Action_4_Condition FaultManager.MAP_STICKING.Mode FaultManager.MAP_STICKING.ID FaultManager.MAP_STICKING.Test FaultManager.MAP_STICKING.Faulty_Samples__X_ FaultManager.MAP_STICKING.Total_Samples__Y_ FaultManager.MAP_STICKING.Action_1 FaultManager.MAP_STICKING.Action_1_Condition FaultManager.MAP_STICKING.Action_2 FaultManager.MAP_STICKING.Action_2_Condition FaultManager.MAP_STICKING.Action_3 FaultManager.MAP_STICKING.Action_3_Condition FaultManager.MAP_STICKING.Action_4 FaultManager.MAP_STICKING.Action_4_Condition FaultManager.MediumOverspeed.Mode FaultManager.MediumOverspeed.ID FaultManager.MediumOverspeed.Test FaultManager.MediumOverspeed.Faulty_Samples__X_ FaultManager.MediumOverspeed.Total_Samples__Y_ FaultManager.MediumOverspeed.Action_1 FaultManager.MediumOverspeed.Action_1_Condition FaultManager.MediumOverspeed.Action_2 FaultManager.MediumOverspeed.Action_2_Condition FaultManager.MediumOverspeed.Action_3 FaultManager.MediumOverspeed.Action_3_Condition FaultManager.MediumOverspeed.Action_4 FaultManager.MediumOverspeed.Action_4_Condition FaultManager.Motor_Hot.Mode FaultManager.Motor_Hot.ID FaultManager.Motor_Hot.Test FaultManager.Motor_Hot.Faulty_Samples__X_ FaultManager.Motor_Hot.Total_Samples__Y_ FaultManager.Motor_Hot.Action_1 FaultManager.Motor_Hot.Action_1_Condition FaultManager.Motor_Hot.Action_2 FaultManager.Motor_Hot.Action_2_Condition FaultManager.Motor_Hot.Action_3 FaultManager.Motor_Hot.Action_3_Condition FaultManager.Motor_Hot.Action_4 FaultManager.Motor_Hot.Action_4_Condition FaultManager.Motor_Warm.Mode FaultManager.Motor_Warm.ID FaultManager.Motor_Warm.Test FaultManager.Motor_Warm.Faulty_Samples__X_ FaultManager.Motor_Warm.Total_Samples__Y_ FaultManager.Motor_Warm.Action_1 FaultManager.Motor_Warm.Action_1_Condition FaultManager.Motor_Warm.Action_2 FaultManager.Motor_Warm.Action_2_Condition FaultManager.Motor_Warm.Action_3 FaultManager.Motor_Warm.Action_3_Condition FaultManager.Motor_Warm.Action_4 FaultManager.Motor_Warm.Action_4_Condition FaultManager.NoOil_Fault.Mode FaultManager.NoOil_Fault.ID FaultManager.NoOil_Fault.Test FaultManager.NoOil_Fault.Faulty_Samples__X_ FaultManager.NoOil_Fault.Total_Samples__Y_ FaultManager.NoOil_Fault.Action_1 FaultManager.NoOil_Fault.Action_1_Condition FaultManager.NoOil_Fault.Action_2 FaultManager.NoOil_Fault.Action_2_Condition FaultManager.NoOil_Fault.Action_3 FaultManager.NoOil_Fault.Action_3_Condition FaultManager.NoOil_Fault.Action_4 FaultManager.NoOil_Fault.Action_4_Condition FaultManager.O2FailedLean.Mode FaultManager.O2FailedLean.ID FaultManager.O2FailedLean.Test FaultManager.O2FailedLean.Faulty_Samples__X_ FaultManager.O2FailedLean.Total_Samples__Y_ FaultManager.O2FailedLean.Action_1 FaultManager.O2FailedLean.Action_1_Condition FaultManager.O2FailedLean.Action_2 FaultManager.O2FailedLean.Action_2_Condition FaultManager.O2FailedLean.Action_3 FaultManager.O2FailedLean.Action_3_Condition FaultManager.O2FailedLean.Action_4 FaultManager.O2FailedLean.Action_4_Condition FaultManager.O2FailedRich.Mode FaultManager.O2FailedRich.ID FaultManager.O2FailedRich.Test FaultManager.O2FailedRich.Faulty_Samples__X_ FaultManager.O2FailedRich.Total_Samples__Y_ FaultManager.O2FailedRich.Action_1 FaultManager.O2FailedRich.Action_1_Condition FaultManager.O2FailedRich.Action_2 FaultManager.O2FailedRich.Action_2_Condition FaultManager.O2FailedRich.Action_3 FaultManager.O2FailedRich.Action_3_Condition FaultManager.O2FailedRich.Action_4 FaultManager.O2FailedRich.Action_4_Condition FaultManager.O2NotActive.Mode FaultManager.O2NotActive.ID FaultManager.O2NotActive.Test FaultManager.O2NotActive.Faulty_Samples__X_ FaultManager.O2NotActive.Total_Samples__Y_ FaultManager.O2NotActive.Action_1 FaultManager.O2NotActive.Action_1_Condition FaultManager.O2NotActive.Action_2 FaultManager.O2NotActive.Action_2_Condition FaultManager.O2NotActive.Action_3 FaultManager.O2NotActive.Action_3_Condition FaultManager.O2NotActive.Action_4 FaultManager.O2NotActive.Action_4_Condition FaultManager.O2_PostCatRangeHigh.Mode FaultManager.O2_PostCatRangeHigh.ID FaultManager.O2_PostCatRangeHigh.Test FaultManager.O2_PostCatRangeHigh.Faulty_Samples__X_ FaultManager.O2_PostCatRangeHigh.Total_Samples__Y_ FaultManager.O2_PostCatRangeHigh.Action_1 FaultManager.O2_PostCatRangeHigh.Action_1_Condition FaultManager.O2_PostCatRangeHigh.Action_2 FaultManager.O2_PostCatRangeHigh.Action_2_Condition FaultManager.O2_PostCatRangeHigh.Action_3 FaultManager.O2_PostCatRangeHigh.Action_3_Condition FaultManager.O2_PostCatRangeHigh.Action_4 FaultManager.O2_PostCatRangeHigh.Action_4_Condition FaultManager.O2_PostCatRangeLow.Mode FaultManager.O2_PostCatRangeLow.ID FaultManager.O2_PostCatRangeLow.Test FaultManager.O2_PostCatRangeLow.Faulty_Samples__X_ FaultManager.O2_PostCatRangeLow.Total_Samples__Y_ FaultManager.O2_PostCatRangeLow.Action_1 FaultManager.O2_PostCatRangeLow.Action_1_Condition FaultManager.O2_PostCatRangeLow.Action_2 FaultManager.O2_PostCatRangeLow.Action_2_Condition FaultManager.O2_PostCatRangeLow.Action_3 FaultManager.O2_PostCatRangeLow.Action_3_Condition FaultManager.O2_PostCatRangeLow.Action_4 FaultManager.O2_PostCatRangeLow.Action_4_Condition FaultManager.OilPresRangeHigh.Mode FaultManager.OilPresRangeHigh.ID FaultManager.OilPresRangeHigh.Test FaultManager.OilPresRangeHigh.Faulty_Samples__X_ FaultManager.OilPresRangeHigh.Total_Samples__Y_ FaultManager.OilPresRangeHigh.Action_1 FaultManager.OilPresRangeHigh.Action_1_Condition FaultManager.OilPresRangeHigh.Action_2 FaultManager.OilPresRangeHigh.Action_2_Condition FaultManager.OilPresRangeHigh.Action_3 FaultManager.OilPresRangeHigh.Action_3_Condition FaultManager.OilPresRangeHigh.Action_4 FaultManager.OilPresRangeHigh.Action_4_Condition FaultManager.OilPresRangeLow.Mode FaultManager.OilPresRangeLow.ID FaultManager.OilPresRangeLow.Test FaultManager.OilPresRangeLow.Faulty_Samples__X_ FaultManager.OilPresRangeLow.Total_Samples__Y_ FaultManager.OilPresRangeLow.Action_1 FaultManager.OilPresRangeLow.Action_1_Condition FaultManager.OilPresRangeLow.Action_2 FaultManager.OilPresRangeLow.Action_2_Condition FaultManager.OilPresRangeLow.Action_3 FaultManager.OilPresRangeLow.Action_3_Condition FaultManager.OilPresRangeLow.Action_4 FaultManager.OilPresRangeLow.Action_4_Condition FaultManager.SensVoltRangeHigh.Mode FaultManager.SensVoltRangeHigh.ID FaultManager.SensVoltRangeHigh.Test FaultManager.SensVoltRangeHigh.Faulty_Samples__X_ FaultManager.SensVoltRangeHigh.Total_Samples__Y_ FaultManager.SensVoltRangeHigh.Action_1 FaultManager.SensVoltRangeHigh.Action_1_Condition FaultManager.SensVoltRangeHigh.Action_2 FaultManager.SensVoltRangeHigh.Action_2_Condition FaultManager.SensVoltRangeHigh.Action_3 FaultManager.SensVoltRangeHigh.Action_3_Condition FaultManager.SensVoltRangeHigh.Action_4 FaultManager.SensVoltRangeHigh.Action_4_Condition FaultManager.SensVoltRangeLow.Mode FaultManager.SensVoltRangeLow.ID FaultManager.SensVoltRangeLow.Test FaultManager.SensVoltRangeLow.Faulty_Samples__X_ FaultManager.SensVoltRangeLow.Total_Samples__Y_ FaultManager.SensVoltRangeLow.Action_1 FaultManager.SensVoltRangeLow.Action_1_Condition FaultManager.SensVoltRangeLow.Action_2 FaultManager.SensVoltRangeLow.Action_2_Condition FaultManager.SensVoltRangeLow.Action_3 FaultManager.SensVoltRangeLow.Action_3_Condition FaultManager.SensVoltRangeLow.Action_4 FaultManager.SensVoltRangeLow.Action_4_Condition FaultManager.SoftOverspeed.Mode FaultManager.SoftOverspeed.ID FaultManager.SoftOverspeed.Test FaultManager.SoftOverspeed.Faulty_Samples__X_ FaultManager.SoftOverspeed.Total_Samples__Y_ FaultManager.SoftOverspeed.Action_1 FaultManager.SoftOverspeed.Action_1_Condition FaultManager.SoftOverspeed.Action_2 FaultManager.SoftOverspeed.Action_2_Condition FaultManager.SoftOverspeed.Action_3 FaultManager.SoftOverspeed.Action_3_Condition FaultManager.SoftOverspeed.Action_4 FaultManager.SoftOverspeed.Action_4_Condition FaultManager.SysVoltRangeHigh.Mode FaultManager.SysVoltRangeHigh.ID FaultManager.SysVoltRangeHigh.Test FaultManager.SysVoltRangeHigh.Faulty_Samples__X_ FaultManager.SysVoltRangeHigh.Total_Samples__Y_ FaultManager.SysVoltRangeHigh.Action_1 FaultManager.SysVoltRangeHigh.Action_1_Condition FaultManager.SysVoltRangeHigh.Action_2 FaultManager.SysVoltRangeHigh.Action_2_Condition FaultManager.SysVoltRangeHigh.Action_3 FaultManager.SysVoltRangeHigh.Action_3_Condition FaultManager.SysVoltRangeHigh.Action_4 FaultManager.SysVoltRangeHigh.Action_4_Condition FaultManager.SysVoltRangeLow.Mode FaultManager.SysVoltRangeLow.ID FaultManager.SysVoltRangeLow.Test FaultManager.SysVoltRangeLow.Faulty_Samples__X_ FaultManager.SysVoltRangeLow.Total_Samples__Y_ FaultManager.SysVoltRangeLow.Action_1 FaultManager.SysVoltRangeLow.Action_1_Condition FaultManager.SysVoltRangeLow.Action_2 FaultManager.SysVoltRangeLow.Action_2_Condition FaultManager.SysVoltRangeLow.Action_3 FaultManager.SysVoltRangeLow.Action_3_Condition FaultManager.SysVoltRangeLow.Action_4 FaultManager.SysVoltRangeLow.Action_4_Condition FaultManager.TPS1AdaptHiMax.Mode FaultManager.TPS1AdaptHiMax.ID FaultManager.TPS1AdaptHiMax.Test FaultManager.TPS1AdaptHiMax.Faulty_Samples__X_ FaultManager.TPS1AdaptHiMax.Total_Samples__Y_ FaultManager.TPS1AdaptHiMax.Action_1 FaultManager.TPS1AdaptHiMax.Action_1_Condition FaultManager.TPS1AdaptHiMax.Action_2 FaultManager.TPS1AdaptHiMax.Action_2_Condition FaultManager.TPS1AdaptHiMax.Action_3 FaultManager.TPS1AdaptHiMax.Action_3_Condition FaultManager.TPS1AdaptHiMax.Action_4 FaultManager.TPS1AdaptHiMax.Action_4_Condition FaultManager.TPS1AdaptHiMin.Mode FaultManager.TPS1AdaptHiMin.ID FaultManager.TPS1AdaptHiMin.Test FaultManager.TPS1AdaptHiMin.Faulty_Samples__X_ FaultManager.TPS1AdaptHiMin.Total_Samples__Y_ FaultManager.TPS1AdaptHiMin.Action_1 FaultManager.TPS1AdaptHiMin.Action_1_Condition FaultManager.TPS1AdaptHiMin.Action_2 FaultManager.TPS1AdaptHiMin.Action_2_Condition FaultManager.TPS1AdaptHiMin.Action_3 FaultManager.TPS1AdaptHiMin.Action_3_Condition FaultManager.TPS1AdaptHiMin.Action_4 FaultManager.TPS1AdaptHiMin.Action_4_Condition FaultManager.TPS1AdaptLoMax.Mode FaultManager.TPS1AdaptLoMax.ID FaultManager.TPS1AdaptLoMax.Test FaultManager.TPS1AdaptLoMax.Faulty_Samples__X_ FaultManager.TPS1AdaptLoMax.Total_Samples__Y_ FaultManager.TPS1AdaptLoMax.Action_1 FaultManager.TPS1AdaptLoMax.Action_1_Condition FaultManager.TPS1AdaptLoMax.Action_2 FaultManager.TPS1AdaptLoMax.Action_2_Condition FaultManager.TPS1AdaptLoMax.Action_3 FaultManager.TPS1AdaptLoMax.Action_3_Condition FaultManager.TPS1AdaptLoMax.Action_4 FaultManager.TPS1AdaptLoMax.Action_4_Condition FaultManager.TPS1AdaptLoMin.Mode FaultManager.TPS1AdaptLoMin.ID FaultManager.TPS1AdaptLoMin.Test FaultManager.TPS1AdaptLoMin.Faulty_Samples__X_ FaultManager.TPS1AdaptLoMin.Total_Samples__Y_ FaultManager.TPS1AdaptLoMin.Action_1 FaultManager.TPS1AdaptLoMin.Action_1_Condition FaultManager.TPS1AdaptLoMin.Action_2 FaultManager.TPS1AdaptLoMin.Action_2_Condition FaultManager.TPS1AdaptLoMin.Action_3 FaultManager.TPS1AdaptLoMin.Action_3_Condition FaultManager.TPS1AdaptLoMin.Action_4 FaultManager.TPS1AdaptLoMin.Action_4_Condition FaultManager.TPS1RangeHigh.Mode FaultManager.TPS1RangeHigh.ID FaultManager.TPS1RangeHigh.Test FaultManager.TPS1RangeHigh.Faulty_Samples__X_ FaultManager.TPS1RangeHigh.Total_Samples__Y_ FaultManager.TPS1RangeHigh.Action_1 FaultManager.TPS1RangeHigh.Action_1_Condition FaultManager.TPS1RangeHigh.Action_2 FaultManager.TPS1RangeHigh.Action_2_Condition FaultManager.TPS1RangeHigh.Action_3 FaultManager.TPS1RangeHigh.Action_3_Condition FaultManager.TPS1RangeHigh.Action_4 FaultManager.TPS1RangeHigh.Action_4_Condition FaultManager.TPS1RangeLow.Mode FaultManager.TPS1RangeLow.ID FaultManager.TPS1RangeLow.Test FaultManager.TPS1RangeLow.Faulty_Samples__X_ FaultManager.TPS1RangeLow.Total_Samples__Y_ FaultManager.TPS1RangeLow.Action_1 FaultManager.TPS1RangeLow.Action_1_Condition FaultManager.TPS1RangeLow.Action_2 FaultManager.TPS1RangeLow.Action_2_Condition FaultManager.TPS1RangeLow.Action_3 FaultManager.TPS1RangeLow.Action_3_Condition FaultManager.TPS1RangeLow.Action_4 FaultManager.TPS1RangeLow.Action_4_Condition FaultManager.TPS2AdaptHiMax.Mode FaultManager.TPS2AdaptHiMax.ID FaultManager.TPS2AdaptHiMax.Test FaultManager.TPS2AdaptHiMax.Faulty_Samples__X_ FaultManager.TPS2AdaptHiMax.Total_Samples__Y_ FaultManager.TPS2AdaptHiMax.Action_1 FaultManager.TPS2AdaptHiMax.Action_1_Condition FaultManager.TPS2AdaptHiMax.Action_2 FaultManager.TPS2AdaptHiMax.Action_2_Condition FaultManager.TPS2AdaptHiMax.Action_3 FaultManager.TPS2AdaptHiMax.Action_3_Condition FaultManager.TPS2AdaptHiMax.Action_4 FaultManager.TPS2AdaptHiMax.Action_4_Condition FaultManager.TPS2AdaptHiMin.Mode FaultManager.TPS2AdaptHiMin.ID FaultManager.TPS2AdaptHiMin.Test FaultManager.TPS2AdaptHiMin.Faulty_Samples__X_ FaultManager.TPS2AdaptHiMin.Total_Samples__Y_ FaultManager.TPS2AdaptHiMin.Action_1 FaultManager.TPS2AdaptHiMin.Action_1_Condition FaultManager.TPS2AdaptHiMin.Action_2 FaultManager.TPS2AdaptHiMin.Action_2_Condition FaultManager.TPS2AdaptHiMin.Action_3 FaultManager.TPS2AdaptHiMin.Action_3_Condition FaultManager.TPS2AdaptHiMin.Action_4 FaultManager.TPS2AdaptHiMin.Action_4_Condition FaultManager.TPS2AdaptLoMax.Mode FaultManager.TPS2AdaptLoMax.ID FaultManager.TPS2AdaptLoMax.Test FaultManager.TPS2AdaptLoMax.Faulty_Samples__X_ FaultManager.TPS2AdaptLoMax.Total_Samples__Y_ FaultManager.TPS2AdaptLoMax.Action_1 FaultManager.TPS2AdaptLoMax.Action_1_Condition FaultManager.TPS2AdaptLoMax.Action_2 FaultManager.TPS2AdaptLoMax.Action_2_Condition FaultManager.TPS2AdaptLoMax.Action_3 FaultManager.TPS2AdaptLoMax.Action_3_Condition FaultManager.TPS2AdaptLoMax.Action_4 FaultManager.TPS2AdaptLoMax.Action_4_Condition FaultManager.TPS2AdaptLoMin.Mode FaultManager.TPS2AdaptLoMin.ID FaultManager.TPS2AdaptLoMin.Test FaultManager.TPS2AdaptLoMin.Faulty_Samples__X_ FaultManager.TPS2AdaptLoMin.Total_Samples__Y_ FaultManager.TPS2AdaptLoMin.Action_1 FaultManager.TPS2AdaptLoMin.Action_1_Condition FaultManager.TPS2AdaptLoMin.Action_2 FaultManager.TPS2AdaptLoMin.Action_2_Condition FaultManager.TPS2AdaptLoMin.Action_3 FaultManager.TPS2AdaptLoMin.Action_3_Condition FaultManager.TPS2AdaptLoMin.Action_4 FaultManager.TPS2AdaptLoMin.Action_4_Condition FaultManager.TPS2RangeHigh.Mode FaultManager.TPS2RangeHigh.ID FaultManager.TPS2RangeHigh.Test FaultManager.TPS2RangeHigh.Faulty_Samples__X_ FaultManager.TPS2RangeHigh.Total_Samples__Y_ FaultManager.TPS2RangeHigh.Action_1 FaultManager.TPS2RangeHigh.Action_1_Condition FaultManager.TPS2RangeHigh.Action_2 FaultManager.TPS2RangeHigh.Action_2_Condition FaultManager.TPS2RangeHigh.Action_3 FaultManager.TPS2RangeHigh.Action_3_Condition FaultManager.TPS2RangeHigh.Action_4 FaultManager.TPS2RangeHigh.Action_4_Condition FaultManager.TPS2RangeLow.Mode FaultManager.TPS2RangeLow.ID FaultManager.TPS2RangeLow.Test FaultManager.TPS2RangeLow.Faulty_Samples__X_ FaultManager.TPS2RangeLow.Total_Samples__Y_ FaultManager.TPS2RangeLow.Action_1 FaultManager.TPS2RangeLow.Action_1_Condition FaultManager.TPS2RangeLow.Action_2 FaultManager.TPS2RangeLow.Action_2_Condition FaultManager.TPS2RangeLow.Action_3 FaultManager.TPS2RangeLow.Action_3_Condition FaultManager.TPS2RangeLow.Action_4 FaultManager.TPS2RangeLow.Action_4_Condition FaultManager.TPS_Sensors_Conflict.Mode FaultManager.TPS_Sensors_Conflict.ID FaultManager.TPS_Sensors_Conflict.Test FaultManager.TPS_Sensors_Conflict.Faulty_Samples__X_ FaultManager.TPS_Sensors_Conflict.Total_Samples__Y_ FaultManager.TPS_Sensors_Conflict.Action_1 FaultManager.TPS_Sensors_Conflict.Action_1_Condition FaultManager.TPS_Sensors_Conflict.Action_2 FaultManager.TPS_Sensors_Conflict.Action_2_Condition FaultManager.TPS_Sensors_Conflict.Action_3 FaultManager.TPS_Sensors_Conflict.Action_3_Condition FaultManager.TPS_Sensors_Conflict.Action_4 FaultManager.TPS_Sensors_Conflict.Action_4_Condition /end DEF_CHARACTERISTIC
/end FUNCTION
/begin FUNCTION AD_Input1_Vin_Ovr_Override "" /begin DEF_CHARACTERISTIC AD_Input1_Vin_Ovr_new AD_Input1_Vin_Ovr_ovr /end DEF_CHARACTERISTIC /end FUNCTION
/begin FUNCTION AD_Input2_En_Ovr_Override "" /begin DEF_CHARACTERISTIC AD_Input2_En_Ovr_new AD_Input2_En_Ovr_ovr /end DEF_CHARACTERISTIC /end FUNCTION
/begin FUNCTION AD_Input2_Vin_Ovr_Override "" /begin DEF_CHARACTERISTIC AD_Input2_Vin_Ovr_new AD_Input2_Vin_Ovr_ovr /end DEF_CHARACTERISTIC /end FUNCTION
/begin FUNCTION VE_Adapt "" /begin DEF_CHARACTERISTIC VE_Adapt_Enable VEAdaptFilt /end DEF_CHARACTERISTIC /begin OUT_MEASUREMENT Adapt_Amount VE_Error /end OUT_MEASUREMENT /begin SUB_FUNCTION Stable_Engine Adapt_Table /end SUB_FUNCTION /end FUNCTION
/begin FUNCTION AirFlow_Manager ""
 /begin DEF_CHARACTERISTIC AirControlSource MaxETCSetPtLimitTbl MinETCSetpoint ThrottleSource /end DEF_CHARACTERISTIC
 /begin OUT_MEASUREMENT ETCRequestFinal MaxETCSetPtLimit /end OUT_MEASUREMENT
 /begin SUB_FUNCTION VE_Adapt /end SUB_FUNCTION
/end FUNCTION
/begin FUNCTION Run ""
 /begin SUB_FUNCTION AirFlow_Manager Fuel_System_Manager MinGovernor Base_Equiv_Ratio Spark_Manager O2_Control EGR MaxGovernor /end SUB_FUNCTION
/end FUNCTION
/begin FUNCTION Controller "" /begin SUB_FUNCTION Run Hybrid Crank Stall /end SUB_FUNCTION /end FUNCTION
/begin FUNCTION Control ""
 /begin SUB_FUNCTION Controller VirtualSensors Diagnostics ActuatorCharacterization /end SUB_FUNCTION
/end FUNCTION
/begin FUNCTION O2_Fuel_Adapt ""
 /begin DEF_CHARACTERISTIC AdaptEnable FuelAdaptDelta FuelAdaptEnable FuelAdaptGainTbl FuelFlowCompAdaptMap FuelFlowCompMap /end DEF_CHARACTERISTIC
 /begin OUT_MEASUREMENT FuelAdapt_Error FuelAdaptEnabled FuelAdaptGain FuelFlowComp FuelFlowCompAdapt /end OUT_MEASUREMENT
 /begin SUB_FUNCTION Saturation__Tunable__1 Adapt_FuelFlowComp_Map O2_Control_Enable_Delay WarmUp_Disable /end SUB_FUNCTION
/end FUNCTION
/begin FUNCTION Fuel_System_Manager "" /begin SUB_FUNCTION O2_Fuel_Adapt Fuel_Calculation Injector_Manager /end SUB_FUNCTION /end FUNCTION
/begin FUNCTION Fuel_Calculation ""
 /begin OUT_MEASUREMENT AdjustedPerCylFuelRate GlobalBaseFuelRate PerCylBaseFuelRate /end OUT_MEASUREMENT
 /begin SUB_FUNCTION Calculate_Fuel_Flow /end SUB_FUNCTION
/end FUNCTION
/begin FUNCTION Calculate_A_F_Ratio "" /begin DEF_CHARACTERISTIC AF_Ethanol AF_Gasoline /end DEF_CHARACTERISTIC /end FUNCTION
/begin FUNCTION Calculate_Fuel_Flow "" /begin OUT_MEASUREMENT Desired_AF_Ratio /end OUT_MEASUREMENT /begin SUB_FUNCTION Calculate_A_F_Ratio /end SUB_FUNCTION /end FUNCTION
/begin FUNCTION AnalogIn ""
 /begin OUT_MEASUREMENT ain_create_ECTSensorPin ain_create_ECUP ain_create_EGRPin ain_create_FuelPresPin ain_create_IATSensorPin ain_create_MAPSensorPin ain_create_OilPresPin ain_create_PostO2Pin ain_create_SensVoltSensorPin ain_create_SysVoltage ain_create_TPS1AnalogInput ain_create_TPS2AnalogInput ain_read_ECTSensorPin ain_read_ECUP ain_read_EGRPin ain_read_FuelPresPin ain_read_IATSensorPin ain_read_MAPSensorPin ain_read_OilPresPin ain_read_PostO2Pin ain_read_SensVoltSensorPin ain_read_SysVoltage ain_read_TPS1AnalogInput ain_read_TPS2AnalogInput /end OUT_MEASUREMENT
/end FUNCTION
/begin FUNCTION Resources ""
 /begin SUB_FUNCTION AnalogIn CAN DiscreteOut Encoder SequenceOut FrequencyIn OneShot PWM Other /end SUB_FUNCTION
/end FUNCTION
/begin FUNCTION Debug ""
 /begin SUB_FUNCTION Resources Application_Monitor Application_Monitor_Config Event_Pause_Counters General /end SUB_FUNCTION
/end FUNCTION
/begin FUNCTION PID_Gain_Select1 ""
 /begin DEF_CHARACTERISTIC AirMinGovDGain AirMinGovDGainErrorMultTbl AirMinGovIGain AirMinGovIGainErrorMultTbl AirMinGovPGain AirMinGovPGainErrorMultTbl /end DEF_CHARACTERISTIC
 /begin OUT_MEASUREMENT AirMinGovDGainErrorMult AirMinGovIGainErrorMult AirMinGovPGainErrorMult /end OUT_MEASUREMENT
/end FUNCTION
/begin FUNCTION Universal_PID__Tunable___Scheduled_ ""
 /begin OUT_MEASUREMENT AirMinGovDTerm AirMinGovError AirMinGovITerm AirMinGovPTerm AirMinGovSpeedErrorIdx AirMinGovSpeedErrorIn /end OUT_MEASUREMENT
 /begin SUB_FUNCTION PID_Gain_Select1 /end SUB_FUNCTION
/end FUNCTION
/begin FUNCTION MinGovernor "" /begin DEF_CHARACTERISTIC IdleExitTimeConst /end DEF_CHARACTERISTIC
 /begin OUT_MEASUREMENT AirMinGovOutput IdleHandOffMult MinGovReset SpkMinGovOutput /end OUT_MEASUREMENT
 /begin SUB_FUNCTION Universal_PID__Tunable___Scheduled_ Air_PID_Config Base_Airflow_Table_Adapt AiflowOffset Idle_State_Determination Ramp_RPM Base_RPM_Set_Pt MotoringDetection Universal_PD__Tunable___Scheduled_ /end SUB_FUNCTION
/end FUNCTION
/begin FUNCTION Air_PID_Config ""
 /begin DEF_CHARACTERISTIC AirMinGovErrorGain AirMinGovITermLowerLimit AirMinGovITermUpperLimit AirMinGovPIDOutLowerLimit AirMinGovPIDOutUpperLimit /end DEF_CHARACTERISTIC
/end FUNCTION
/begin FUNCTION An_PosSense1_Ovr_Override "" /begin DEF_CHARACTERISTIC An_PosSense1_Ovr_new An_PosSense1_Ovr_ovr /end DEF_CHARACTERISTIC /end FUNCTION
/begin FUNCTION An_PosSense2_Ovr_Override "" /begin DEF_CHARACTERISTIC An_PosSense2_Ovr_new An_PosSense2_Ovr_ovr /end DEF_CHARACTERISTIC /end FUNCTION
/begin FUNCTION Load__Torque__Power__Work___Using_APC "" /begin DEF_CHARACTERISTIC IndLoadTbl /end DEF_CHARACTERISTIC /begin OUT_MEASUREMENT APC_TPS10Idx APCPort IndLoad /end OUT_MEASUREMENT /begin SUB_FUNCTION Calculate_Power_and_Work /end SUB_FUNCTION /end FUNCTION
/begin FUNCTION LoadBasedCalcs ""
 /begin OUT_MEASUREMENT SSLoadDirection SSLoadFilterConst SSLoadFiltered SSRPMDirection SSRPMFilterConst SSRPMFiltered /end OUT_MEASUREMENT
 /begin SUB_FUNCTION Load__Torque__Power__Work___Using_APC Normalized_Effective_Combustion_Chamber_Temperature Engine_Steady_State_Flag LoadBasedCalcs_Config /end SUB_FUNCTION
/end FUNCTION
/begin FUNCTION VirtualSensors ""
 /begin SUB_FUNCTION LoadBasedCalcs Virtual_Indexes RawProcessed AirCalcs Raw_Indexes /end SUB_FUNCTION
/end FUNCTION
/begin FUNCTION Hybrid ""
 /begin DEF_CHARACTERISTIC APP Caught_RPM Crank_Time Crank_Wait_Before_Retry Cranking_Torque Generating_Max_Torque Max_Cranking_RPM /end DEF_CHARACTERISTIC
/end FUNCTION
/begin FUNCTION Virtual_Indexes ""
 /begin OUT_MEASUREMENT App05Idx App05In RPMAccel17Idx RPMAccel17In TimeSinceRun09Idx TimeSinceRun09In /end OUT_MEASUREMENT
 /begin SUB_FUNCTION ECT_KeyUp Torque_Indexes Power_Index MAFPortIndex NECCT_Index /end SUB_FUNCTION
/end FUNCTION
/begin FUNCTION APP1_Ovr_Override "" /begin DEF_CHARACTERISTIC APP1_Ovr_new APP1_Ovr_ovr /end DEF_CHARACTERISTIC /end FUNCTION
/begin FUNCTION PotentiometerSensors "" /begin OUT_MEASUREMENT APP1_Prb APP2_Prb /end OUT_MEASUREMENT /begin SUB_FUNCTION APP1_Ovr_Override APP2_Ovr_Override TPS1 TPS2 /end SUB_FUNCTION /end FUNCTION
/begin FUNCTION Base_TPS_Request ""
 /begin DEF_CHARACTERISTIC ETCReqDecFiltC ETCReqFallRateTbl ETCReqIncFiltC ETCReqRiseRateTbl ETCRequestTbl /end DEF_CHARACTERISTIC
 /begin OUT_MEASUREMENT APP17Idx APP17In ETCReqFallRate ETCReqFilterConst ETCReqRiseRate ETCRequest ETCRequestDirection FilteredETCRequest /end OUT_MEASUREMENT
/end FUNCTION
/begin FUNCTION RawProcessed "" /begin OUT_MEASUREMENT APPPcnt ECT_KeyUp /end OUT_MEASUREMENT
 /begin SUB_FUNCTION Base_TPS_Request EngineState Capture_ECT_At_Startup Engine_Accel Fuel_Delta_Pressure_Calculation Capture_IAT_At_Startup O2_De_lag CutThrottle_APP_Limiting Time_Since_Key_On Time_Since_Run Time_Since_Stall TPS__Sensor_Arbitration /end SUB_FUNCTION
/end FUNCTION
/begin FUNCTION APP2_Ovr_Override "" /begin DEF_CHARACTERISTIC APP2_Ovr_new APP2_Ovr_ovr /end DEF_CHARACTERISTIC /end FUNCTION
/begin FUNCTION Application_Monitor "" /begin DEF_CHARACTERISTIC ApplicationStatus /end DEF_CHARACTERISTIC
 /begin OUT_MEASUREMENT ApplicationInitStatus ApplicationStopReason ApplicationStopReasonBlock /end OUT_MEASUREMENT
/end FUNCTION
/end MODULE
/end PROJECT
